ASAP2_VERSION 1 70
/begin PROJECT _GA1_103 "SCU3_B3_VAR_04"
/begin HEADER "" VERSION "GA1_103_C_03_00" PROJECT_NO _GA1_103 /end HEADER
/begin MODULE XCP_EPS_ECU "G08"
/begin MOD_COMMON "" BYTE_ORDER MSB_LAST ALIGNMENT_BYTE 1 ALIGNMENT_WORD 2 ALIGNMENT_LONG 4 ALIGNMENT_FLOAT32_IEEE 4 ALIGNMENT_FLOAT64_IEEE 8 /end MOD_COMMON
/begin CHARACTERISTIC aPDC_MaxVehicleAcceleration4Learn_XDU16 "Maximales Längsbeschleunigung für das Berechnen des Kompensationsmoments" VALUE 0x14A03C AblGLKWuw 30 AFZ 0 30 FORMAT "%8.5" /end CHARACTERISTIC
/begin CHARACTERISTIC cLdTrk_OffsetLine_XDS16 "Offset b der Geraden zum Berechnen der Schneckenradtemperatur" VALUE 0x150546 AblGLKWsw 63.9902 RIGHTSH10NP -32 31.99023 FORMAT "%8.5" /end CHARACTERISTIC
/begin CHARACTERISTIC cLdTrk_SubstTemp_XDU8 "Ersatzwert für Temperatur wenn Temp-Signale ungültig" VALUE 0x150AA7 AblGLKWub 184 TMPOUTS 0 184 FORMAT "%5.1" /end CHARACTERISTIC
/begin CHARACTERISTIC cLdTrk_TemperatureBorder10_XDU8 "Limit Temperatur Zone 10" VALUE 0x14A0C8 AblGLKWub 210 TMPOUTS -70 140 FORMAT "%5.1" /end CHARACTERISTIC
/begin CHARACTERISTIC cLdTrk_TemperatureBorder11_XDU8 "Limit Temperatur Zone 11" VALUE 0x14A0C9 AblGLKWub 210 TMPOUTS -70 140 FORMAT "%5.1" /end CHARACTERISTIC
/begin CHARACTERISTIC cLdTrk_TemperatureBorder12_XDU8 "Limit Temperatur Zone 12" VALUE 0x14A0CA AblGLKWub 210 TMPOUTS -70 140 FORMAT "%5.1" /end CHARACTERISTIC
/begin CHARACTERISTIC cLdTrk_TemperatureBorder13_XDU8 "Limit Temperatur Zone 13" VALUE 0x14A0CB AblGLKWub 210 TMPOUTS -70 140 FORMAT "%5.1" /end CHARACTERISTIC
/begin CHARACTERISTIC cLdTrk_TemperatureBorder14_XDU8 "Limit Temperatur Zone 14" VALUE 0x14A0CC AblGLKWub 210 TMPOUTS -70 140 FORMAT "%5.1" /end CHARACTERISTIC
/begin CHARACTERISTIC cLdTrk_TemperatureBorder15_XDU8 "Limit Temperatur Zone 15" VALUE 0x14A0CD AblGLKWub 210 TMPOUTS -70 140 FORMAT "%5.1" /end CHARACTERISTIC
/begin CHARACTERISTIC cLdTrk_TemperatureBorder16_XDU8 "Limit Temperatur Zone 16" VALUE 0x14A0CE AblGLKWub 210 TMPOUTS -70 140 FORMAT "%5.1" /end CHARACTERISTIC
/begin CHARACTERISTIC cLdTrk_TemperatureBorder17_XDU8 "Limit Temperatur Zone 17" VALUE 0x14A0CF AblGLKWub 210 TMPOUTS -70 140 FORMAT "%5.1" /end CHARACTERISTIC
/begin CHARACTERISTIC cLdTrk_TemperatureBorder18_XDU8 "Limit Temperatur Zone 18" VALUE 0x14A0D0 AblGLKWub 210 TMPOUTS -70 140 FORMAT "%5.1" /end CHARACTERISTIC
/begin CHARACTERISTIC cLdTrk_TemperatureBorder19_XDU8 "Limit Temperatur Zone 19" VALUE 0x14A0D1 AblGLKWub 210 TMPOUTS -70 140 FORMAT "%5.1" /end CHARACTERISTIC
/begin CHARACTERISTIC cLdTrk_TemperatureBorder1_XDU8 "Limit Temperatur Zone 1" VALUE 0x14A0D2 AblGLKWub 210 TMPOUTS -70 140 FORMAT "%5.1" /end CHARACTERISTIC
/begin CHARACTERISTIC cLdTrk_TemperatureBorder2_XDU8 "Limit Temperatur Zone 2" VALUE 0x14A0D3 AblGLKWub 210 TMPOUTS -70 140 FORMAT "%5.1" /end CHARACTERISTIC
/begin CHARACTERISTIC cLdTrk_TemperatureBorder3_XDU8 "Limit Temperatur Zone 3" VALUE 0x14A0D4 AblGLKWub 210 TMPOUTS -70 140 FORMAT "%5.1" /end CHARACTERISTIC
/begin CHARACTERISTIC cLdTrk_TemperatureBorder4_XDU8 "Limit Temperatur Zone 4" VALUE 0x14A0D5 AblGLKWub 210 TMPOUTS -70 140 FORMAT "%5.1" /end CHARACTERISTIC
/begin CHARACTERISTIC cLdTrk_TemperatureBorder5_XDU8 "Limit Temperatur Zone 5" VALUE 0x14A0D6 AblGLKWub 210 TMPOUTS -70 140 FORMAT "%5.1" /end CHARACTERISTIC
/begin CHARACTERISTIC cLdTrk_TemperatureBorder6_XDU8 "Limit Temperatur Zone 6" VALUE 0x14A0D7 AblGLKWub 210 TMPOUTS -70 140 FORMAT "%5.1" /end CHARACTERISTIC
/begin CHARACTERISTIC cLdTrk_TemperatureBorder7_XDU8 "Limit Temperatur Zone 7" VALUE 0x14A0D8 AblGLKWub 210 TMPOUTS -70 140 FORMAT "%5.1" /end CHARACTERISTIC
/begin CHARACTERISTIC cLdTrk_TemperatureBorder8_XDU8 "Limit Temperatur Zone 8" VALUE 0x14A0D9 AblGLKWub 210 TMPOUTS -70 140 FORMAT "%5.1" /end CHARACTERISTIC
/begin CHARACTERISTIC cLdTrk_TemperatureBorder9_XDU8 "Limit Temperatur Zone 9" VALUE 0x14A0DA AblGLKWub 210 TMPOUTS -70 140 FORMAT "%5.1" /end CHARACTERISTIC
/begin CHARACTERISTIC fMotTorLim_DeactivateLevel2Error_XDU8 "deaktiviere Errormodus durch Level-2-Vergleich (NUR ZUM TESTEN)" VALUE 0x150ADC AblGLKWub 1 ZU0 0 1 FORMAT "%5.3" /end CHARACTERISTIC
/begin CHARACTERISTIC fOCC_Enable_XDU8_00___A "Aktivierung von OnCenterConnection" VALUE 0x1584CC AblGLKWub 1 ZU0 0 1 FORMAT "%5.3" /end CHARACTERISTIC
/begin CHARACTERISTIC fOCC_Enable_XDU8_01___A "Aktivierung von OnCenterConnection" VALUE 0x1584CD AblGLKWub 1 ZU0 0 1 FORMAT "%5.3" /end CHARACTERISTIC
/begin CHARACTERISTIC fOCC_Enable_XDU8_02___A "Aktivierung von OnCenterConnection" VALUE 0x1584CE AblGLKWub 1 ZU0 0 1 FORMAT "%5.3" /end CHARACTERISTIC
/begin CHARACTERISTIC fOCC_Enable_XDU8_03___A "Aktivierung von OnCenterConnection" VALUE 0x1584CF AblGLKWub 1 ZU0 0 1 FORMAT "%5.3" /end CHARACTERISTIC
/begin CHARACTERISTIC fOCC_Enable_XDU8_04___A "Aktivierung von OnCenterConnection" VALUE 0x1584D0 AblGLKWub 1 ZU0 0 1 FORMAT "%5.3" /end CHARACTERISTIC
/begin CHARACTERISTIC fOCC_Enable_XDU8_05___A "Aktivierung von OnCenterConnection" VALUE 0x1584D1 AblGLKWub 1 ZU0 0 1 FORMAT "%5.3" /end CHARACTERISTIC
/begin CHARACTERISTIC fOCC_Enable_XDU8_06___A "Aktivierung von OnCenterConnection" VALUE 0x1584D2 AblGLKWub 1 ZU0 0 1 FORMAT "%5.3" /end CHARACTERISTIC
/begin CHARACTERISTIC fOCC_Enable_XDU8_07___A "Aktivierung von OnCenterConnection" VALUE 0x1584D3 AblGLKWub 1 ZU0 0 1 FORMAT "%5.3" /end CHARACTERISTIC
/begin CHARACTERISTIC fOCC_Enable_XDU8_08___A "Aktivierung von OnCenterConnection" VALUE 0x1584D4 AblGLKWub 1 ZU0 0 1 FORMAT "%5.3" /end CHARACTERISTIC
/begin CHARACTERISTIC fOCC_Enable_XDU8_09___A "Aktivierung von OnCenterConnection" VALUE 0x1584D5 AblGLKWub 1 ZU0 0 1 FORMAT "%5.3" /end CHARACTERISTIC
/begin CHARACTERISTIC fOCC_Enable_XDU8_10___A "Aktivierung von OnCenterConnection" VALUE 0x1584D6 AblGLKWub 1 ZU0 0 1 FORMAT "%5.3" /end CHARACTERISTIC
/begin CHARACTERISTIC fOCC_Enable_XDU8_11___A "Aktivierung von OnCenterConnection" VALUE 0x1584D7 AblGLKWub 1 ZU0 0 1 FORMAT "%5.3" /end CHARACTERISTIC
/begin CHARACTERISTIC fOCC_Enable_XDU8_12___A "Aktivierung von OnCenterConnection" VALUE 0x1584D8 AblGLKWub 1 ZU0 0 1 FORMAT "%5.3" /end CHARACTERISTIC
/begin CHARACTERISTIC fOCC_Enable_XDU8_13___A "Aktivierung von OnCenterConnection" VALUE 0x1584D9 AblGLKWub 1 ZU0 0 1 FORMAT "%5.3" /end CHARACTERISTIC
/begin CHARACTERISTIC fOCC_Enable_XDU8_14___A "Aktivierung von OnCenterConnection" VALUE 0x1584DA AblGLKWub 1 ZU0 0 1 FORMAT "%5.3" /end CHARACTERISTIC
/begin CHARACTERISTIC fOCC_Enable_XDU8_15___A "Aktivierung von OnCenterConnection" VALUE 0x1584DB AblGLKWub 1 ZU0 0 1 FORMAT "%5.3" /end CHARACTERISTIC
/begin CHARACTERISTIC fOCC_Enable_XDU8_16___A "Aktivierung von OnCenterConnection" VALUE 0x1584DC AblGLKWub 1 ZU0 0 1 FORMAT "%5.3" /end CHARACTERISTIC
/begin CHARACTERISTIC fOCC_Enable_XDU8_17___A "Aktivierung von OnCenterConnection" VALUE 0x1584DD AblGLKWub 1 ZU0 0 1 FORMAT "%5.3" /end CHARACTERISTIC
/begin CHARACTERISTIC fOCC_Enable_XDU8_18___A "Aktivierung von OnCenterConnection" VALUE 0x1584DE AblGLKWub 1 ZU0 0 1 FORMAT "%5.3" /end CHARACTERISTIC
/begin CHARACTERISTIC fOCC_Enable_XDU8_19___A "Aktivierung von OnCenterConnection" VALUE 0x1584DF AblGLKWub 1 ZU0 0 1 FORMAT "%5.3" /end CHARACTERISTIC
/begin CHARACTERISTIC fOCC_Enable_XDU8_20___A "Aktivierung von OnCenterConnection" VALUE 0x1584E0 AblGLKWub 1 ZU0 0 1 FORMAT "%5.3" /end CHARACTERISTIC
/begin CHARACTERISTIC fOCC_Enable_XDU8_21___A "Aktivierung von OnCenterConnection" VALUE 0x1584E1 AblGLKWub 1 ZU0 0 1 FORMAT "%5.3" /end CHARACTERISTIC
/begin CHARACTERISTIC fOCC_Enable_XDU8_22___A "Aktivierung von OnCenterConnection" VALUE 0x1584E2 AblGLKWub 1 ZU0 0 1 FORMAT "%5.3" /end CHARACTERISTIC
/begin CHARACTERISTIC fOCC_Enable_XDU8_23___A "Aktivierung von OnCenterConnection" VALUE 0x1584E3 AblGLKWub 1 ZU0 0 1 FORMAT "%5.3" /end CHARACTERISTIC
/begin CHARACTERISTIC fOCC_Enable_XDU8_24___A "Aktivierung von OnCenterConnection" VALUE 0x1584E4 AblGLKWub 1 ZU0 0 1 FORMAT "%5.3" /end CHARACTERISTIC
/begin CHARACTERISTIC fOCC_Enable_XDU8_25___A "Aktivierung von OnCenterConnection" VALUE 0x1584E5 AblGLKWub 1 ZU0 0 1 FORMAT "%5.3" /end CHARACTERISTIC
/begin CHARACTERISTIC fOCC_Enable_XDU8_26___A "Aktivierung von OnCenterConnection" VALUE 0x1584E6 AblGLKWub 1 ZU0 0 1 FORMAT "%5.3" /end CHARACTERISTIC
/begin CHARACTERISTIC fOCC_Enable_XDU8_27___A "Aktivierung von OnCenterConnection" VALUE 0x1584E7 AblGLKWub 1 ZU0 0 1 FORMAT "%5.3" /end CHARACTERISTIC
/begin CHARACTERISTIC fOCC_Enable_XDU8_28___A "Aktivierung von OnCenterConnection" VALUE 0x1584E8 AblGLKWub 1 ZU0 0 1 FORMAT "%5.3" /end CHARACTERISTIC
/begin CHARACTERISTIC fOCC_Enable_XDU8_29___A "Aktivierung von OnCenterConnection" VALUE 0x1584E9 AblGLKWub 1 ZU0 0 1 FORMAT "%5.3" /end CHARACTERISTIC
/begin CHARACTERISTIC fOCC_Enable_XDU8_30___A "Aktivierung von OnCenterConnection" VALUE 0x1584EA AblGLKWub 1 ZU0 0 1 FORMAT "%5.3" /end CHARACTERISTIC
/begin CHARACTERISTIC fOCC_Enable_XDU8_31___A "Aktivierung von OnCenterConnection" VALUE 0x1584EB AblGLKWub 1 ZU0 0 1 FORMAT "%5.3" /end CHARACTERISTIC
/begin CHARACTERISTIC fOCC_Enable_XDU8_32___A "Aktivierung von OnCenterConnection" VALUE 0x1584EC AblGLKWub 1 ZU0 0 1 FORMAT "%5.3" /end CHARACTERISTIC
/begin CHARACTERISTIC fOCC_Enable_XDU8_33___A "Aktivierung von OnCenterConnection" VALUE 0x1584ED AblGLKWub 1 ZU0 0 1 FORMAT "%5.3" /end CHARACTERISTIC
/begin CHARACTERISTIC fOCC_Enable_XDU8_34___A "Aktivierung von OnCenterConnection" VALUE 0x1584EE AblGLKWub 1 ZU0 0 1 FORMAT "%5.3" /end CHARACTERISTIC
/begin CHARACTERISTIC fOCC_Enable_XDU8_35___A "Aktivierung von OnCenterConnection" VALUE 0x1584EF AblGLKWub 1 ZU0 0 1 FORMAT "%5.3" /end CHARACTERISTIC
/begin CHARACTERISTIC fOvSt_UseLiftForceComp_XDB "Hubkraftkompensation aktivieren (Level 2)" VALUE 0x150ADD AblGLKWub 1 ZU0 0 1 FORMAT "%5.3" /end CHARACTERISTIC
/begin CHARACTERISTIC fOvSt_UseOscRetTorque_XDB "Rueckstellmomentenzweig aktivieren (Level 3)" VALUE 0x150ADE AblGLKWub 1 ZU0 0 1 FORMAT "%5.3" /end CHARACTERISTIC
/begin CHARACTERISTIC fPAMotSum_EnableLimitation_XDU8 "" VALUE 0x150ADF AblGLKWub 1 ZU0 0 1 FORMAT "%5.3" /end CHARACTERISTIC
/begin CHARACTERISTIC fPDC_FctSwitch_XDB "Aktiviere PullDriftCompensation Fct. (XOR-Verknuepfung mit Codierschalter)" VALUE 0x14A0DB AblGLKWub 1 ZU0 0 1 FORMAT "%5.3" /end CHARACTERISTIC
/begin CHARACTERISTIC fRpCorr_LtStCorrActive_XDU8 "" VALUE 0x150AE2 AblGLKWub 1 ZU0 0 1 FORMAT "%5.3" /end CHARACTERISTIC
/begin CHARACTERISTIC hLdTrk_StAngleLvlCrossingHysteresis_XDU16 "Hysteresis limit for Steering Angle Level Crossing ((Classwidth*Hysteresis percentage)/100)" VALUE 0x15054C AblGLKWuw 4 FACTOR_100 1 5 FORMAT "%8.6" /end CHARACTERISTIC
/begin CHARACTERISTIC hLdTrk_SteeringAngleLevelCrossingLimit_XAS16 "Grenze des Lenkhubs, fuer Zaehler" VAL_BLK 0x150EDC AblGLKWBsw 200 FACTOR_100 -100 100 NUMBER 21 FORMAT "%8.4" /end CHARACTERISTIC
/begin CHARACTERISTIC kOCC_OccBaseFriction_XDU16_00___A "Occ Grund Reibung" VALUE 0x158064 AblGLKWuw 150 FRACK 0 150 FORMAT "%8.4" /end CHARACTERISTIC
/begin CHARACTERISTIC kOCC_OccBaseFriction_XDU16_01___A "Occ Grund Reibung" VALUE 0x158066 AblGLKWuw 150 FRACK 0 150 FORMAT "%8.4" /end CHARACTERISTIC
/begin CHARACTERISTIC kOCC_OccBaseFriction_XDU16_02___A "Occ Grund Reibung" VALUE 0x158068 AblGLKWuw 150 FRACK 0 150 FORMAT "%8.4" /end CHARACTERISTIC
/begin CHARACTERISTIC kOCC_OccBaseFriction_XDU16_03___A "Occ Grund Reibung" VALUE 0x15806A AblGLKWuw 150 FRACK 0 150 FORMAT "%8.4" /end CHARACTERISTIC
/begin CHARACTERISTIC kOCC_OccBaseFriction_XDU16_04___A "Occ Grund Reibung" VALUE 0x15806C AblGLKWuw 150 FRACK 0 150 FORMAT "%8.4" /end CHARACTERISTIC
/begin CHARACTERISTIC kOCC_OccBaseFriction_XDU16_05___A "Occ Grund Reibung" VALUE 0x15806E AblGLKWuw 150 FRACK 0 150 FORMAT "%8.4" /end CHARACTERISTIC
/begin CHARACTERISTIC kOCC_OccBaseFriction_XDU16_06___A "Occ Grund Reibung" VALUE 0x158070 AblGLKWuw 150 FRACK 0 150 FORMAT "%8.4" /end CHARACTERISTIC
/begin CHARACTERISTIC kOCC_OccBaseFriction_XDU16_07___A "Occ Grund Reibung" VALUE 0x158072 AblGLKWuw 150 FRACK 0 150 FORMAT "%8.4" /end CHARACTERISTIC
/begin CHARACTERISTIC kOCC_OccBaseFriction_XDU16_08___A "Occ Grund Reibung" VALUE 0x158074 AblGLKWuw 150 FRACK 0 150 FORMAT "%8.4" /end CHARACTERISTIC
/begin CHARACTERISTIC kOCC_OccBaseFriction_XDU16_09___A "Occ Grund Reibung" VALUE 0x158076 AblGLKWuw 150 FRACK 0 150 FORMAT "%8.4" /end CHARACTERISTIC
/begin CHARACTERISTIC kOCC_OccBaseFriction_XDU16_10___A "Occ Grund Reibung" VALUE 0x158078 AblGLKWuw 150 FRACK 0 150 FORMAT "%8.4" /end CHARACTERISTIC
/begin CHARACTERISTIC kOCC_OccBaseFriction_XDU16_11___A "Occ Grund Reibung" VALUE 0x15807A AblGLKWuw 150 FRACK 0 150 FORMAT "%8.4" /end CHARACTERISTIC
/begin CHARACTERISTIC kOCC_OccBaseFriction_XDU16_12___A "Occ Grund Reibung" VALUE 0x15807C AblGLKWuw 150 FRACK 0 150 FORMAT "%8.4" /end CHARACTERISTIC
/begin CHARACTERISTIC kOCC_OccBaseFriction_XDU16_13___A "Occ Grund Reibung" VALUE 0x15807E AblGLKWuw 150 FRACK 0 150 FORMAT "%8.4" /end CHARACTERISTIC
/begin CHARACTERISTIC kOCC_OccBaseFriction_XDU16_14___A "Occ Grund Reibung" VALUE 0x158080 AblGLKWuw 150 FRACK 0 150 FORMAT "%8.4" /end CHARACTERISTIC
/begin CHARACTERISTIC kOCC_OccBaseFriction_XDU16_15___A "Occ Grund Reibung" VALUE 0x158082 AblGLKWuw 150 FRACK 0 150 FORMAT "%8.4" /end CHARACTERISTIC
/begin CHARACTERISTIC kOCC_OccBaseFriction_XDU16_16___A "Occ Grund Reibung" VALUE 0x158084 AblGLKWuw 150 FRACK 0 150 FORMAT "%8.4" /end CHARACTERISTIC
/begin CHARACTERISTIC kOCC_OccBaseFriction_XDU16_17___A "Occ Grund Reibung" VALUE 0x158086 AblGLKWuw 150 FRACK 0 150 FORMAT "%8.4" /end CHARACTERISTIC
/begin CHARACTERISTIC kOCC_OccBaseFriction_XDU16_18___A "Occ Grund Reibung" VALUE 0x158088 AblGLKWuw 150 FRACK 0 150 FORMAT "%8.4" /end CHARACTERISTIC
/begin CHARACTERISTIC kOCC_OccBaseFriction_XDU16_19___A "Occ Grund Reibung" VALUE 0x15808A AblGLKWuw 150 FRACK 0 150 FORMAT "%8.4" /end CHARACTERISTIC
/begin CHARACTERISTIC kOCC_OccBaseFriction_XDU16_20___A "Occ Grund Reibung" VALUE 0x15808C AblGLKWuw 150 FRACK 0 150 FORMAT "%8.4" /end CHARACTERISTIC
/begin CHARACTERISTIC kOCC_OccBaseFriction_XDU16_21___A "Occ Grund Reibung" VALUE 0x15808E AblGLKWuw 150 FRACK 0 150 FORMAT "%8.4" /end CHARACTERISTIC
/begin CHARACTERISTIC kOCC_OccBaseFriction_XDU16_22___A "Occ Grund Reibung" VALUE 0x158090 AblGLKWuw 150 FRACK 0 150 FORMAT "%8.4" /end CHARACTERISTIC
/begin CHARACTERISTIC kOCC_OccBaseFriction_XDU16_23___A "Occ Grund Reibung" VALUE 0x158092 AblGLKWuw 150 FRACK 0 150 FORMAT "%8.4" /end CHARACTERISTIC
/begin CHARACTERISTIC kOCC_OccBaseFriction_XDU16_24___A "Occ Grund Reibung" VALUE 0x158094 AblGLKWuw 150 FRACK 0 150 FORMAT "%8.4" /end CHARACTERISTIC
/begin CHARACTERISTIC kOCC_OccBaseFriction_XDU16_25___A "Occ Grund Reibung" VALUE 0x158096 AblGLKWuw 150 FRACK 0 150 FORMAT "%8.4" /end CHARACTERISTIC
/begin CHARACTERISTIC kOCC_OccBaseFriction_XDU16_26___A "Occ Grund Reibung" VALUE 0x158098 AblGLKWuw 150 FRACK 0 150 FORMAT "%8.4" /end CHARACTERISTIC
/begin CHARACTERISTIC kOCC_OccBaseFriction_XDU16_27___A "Occ Grund Reibung" VALUE 0x15809A AblGLKWuw 150 FRACK 0 150 FORMAT "%8.4" /end CHARACTERISTIC
/begin CHARACTERISTIC kOCC_OccBaseFriction_XDU16_28___A "Occ Grund Reibung" VALUE 0x15809C AblGLKWuw 150 FRACK 0 150 FORMAT "%8.4" /end CHARACTERISTIC
/begin CHARACTERISTIC kOCC_OccBaseFriction_XDU16_29___A "Occ Grund Reibung" VALUE 0x15809E AblGLKWuw 150 FRACK 0 150 FORMAT "%8.4" /end CHARACTERISTIC
/begin CHARACTERISTIC kOCC_OccBaseFriction_XDU16_30___A "Occ Grund Reibung" VALUE 0x1580A0 AblGLKWuw 150 FRACK 0 150 FORMAT "%8.4" /end CHARACTERISTIC
/begin CHARACTERISTIC kOCC_OccBaseFriction_XDU16_31___A "Occ Grund Reibung" VALUE 0x1580A2 AblGLKWuw 150 FRACK 0 150 FORMAT "%8.4" /end CHARACTERISTIC
/begin CHARACTERISTIC kOCC_OccBaseFriction_XDU16_32___A "Occ Grund Reibung" VALUE 0x1580A4 AblGLKWuw 150 FRACK 0 150 FORMAT "%8.4" /end CHARACTERISTIC
/begin CHARACTERISTIC kOCC_OccBaseFriction_XDU16_33___A "Occ Grund Reibung" VALUE 0x1580A6 AblGLKWuw 150 FRACK 0 150 FORMAT "%8.4" /end CHARACTERISTIC
/begin CHARACTERISTIC kOCC_OccBaseFriction_XDU16_34___A "Occ Grund Reibung" VALUE 0x1580A8 AblGLKWuw 150 FRACK 0 150 FORMAT "%8.4" /end CHARACTERISTIC
/begin CHARACTERISTIC kOCC_OccBaseFriction_XDU16_35___A "Occ Grund Reibung" VALUE 0x1580AA AblGLKWuw 150 FRACK 0 150 FORMAT "%8.4" /end CHARACTERISTIC
/begin CHARACTERISTIC kPDC_LimitCompRackForce_XDU16 "Maximal erlaubte Kompensation Zahnstangenkraft" VALUE 0x150556 AblGLKWuw 1400 FRACK 0 1400 FORMAT "%8.3" /end CHARACTERISTIC
/begin CHARACTERISTIC kPDC_MaxCompFrackLongTerm_XDU16 "Maximal erlaubte Langzeit-Kompensations Zahnstangenkraft" VALUE 0x14A040 AblGLKWuw 700 PDC_FRACK 0 700 FORMAT "%8.4" /end CHARACTERISTIC
/begin CHARACTERISTIC kPDC_MaxCompFrackShortTerm_XAU16 "Maximal erlaubte Kurzzeit-Kompensations Zahnstangenkraft beim Lernen (Eingangswert: Fahrzeuggeschwindigkeit)" CURVE 0x14A118 AblGLKLuw 700 PDC_FRACK 0 700 FORMAT "%8.4"
 /begin AXIS_DESCR STD_AXIS vApplI_AbsVehicleSpeedFilt_xdu16 VFZHIGH 4 0 500 FORMAT "%8.4" DEPOSIT ABSOLUTE /end AXIS_DESCR
/end CHARACTERISTIC
/begin CHARACTERISTIC kPDC_MaxRateCompFrack_XDU16 "Maximal erlaubte Rate der Kompensationszahnstangenkraft" VALUE 0x14A042 AblGLKWuw 2799 PDC_FRACK 1 2800 FORMAT "%8.3" /end CHARACTERISTIC
/begin CHARACTERISTIC kPDC_MinCompFrack4BigCrowningChangeDetection_XDU16 "Minimale Kompensationszahnstangenkraft für das Erkennen einer starken Änderung der Fahrbahnneigung für das Ändern des Integrationsfaktors" VALUE 0x14A044 AblGLKWuw 1400 FRACK 0 1400 FORMAT "%8.3" /end CHARACTERISTIC
/begin CHARACTERISTIC kPDC_MinCompFrack4CompFrackWrongDetection_XDU16 "Minimale Kompensationszahnstangenkraft für das Erkennen einer falschen Kompensationszahnstangenkraft für das Herausrampen aus dem Status Hold" VALUE 0x14A046 AblGLKWuw 1400 FRACK 0 1400 FORMAT "%8.3" /end CHARACTERISTIC
/begin CHARACTERISTIC kPDC_RateCompFrackErrorRampOut_XDU16 "Rate mit der die Kompensationszahnstangenkraft im Fehlerfall runtergerampt wird" VALUE 0x14A048 AblGLKWuw 1399 PDC_FRACK 1 1400 FORMAT "%8.3" /end CHARACTERISTIC
/begin CHARACTERISTIC kPDC_RateCompFrackNormalRampOut_XDU16 "Rate mit der die Kompensationszahnstangenkraft im Normalfall runtergerampt wird" VALUE 0x14A04A AblGLKWuw 1399 PDC_FRACK 1 1400 FORMAT "%8.3" /end CHARACTERISTIC
/begin CHARACTERISTIC lLdTrk_MaxDistanceLimit_XDU32 "Saturation Limit for Maximum Distance Travelled" VALUE 0x150408 AblGLKWul 6E+08 METERS 0 600000000 FORMAT "%13.3" /end CHARACTERISTIC
/begin CHARACTERISTIC mLdTrk_ClassOffsetGenMech_XDU16 "Generiert: Offset auf obere Wendepunkte zur Kompensation von Rundungsfehlern [Nm]" VALUE 0x14A050 AblGLKWuw 1 MMOT 0 1 FORMAT "%8.6" /end CHARACTERISTIC
/begin CHARACTERISTIC mLdTrk_ClassOffsetWorm_XDU16 "Generiert: Offset auf obere Wendepunkte zur Kompensation von Rundungsfehlern [Nm]" VALUE 0x14A052 AblGLKWuw 1 MMOT 0 1 FORMAT "%8.6" /end CHARACTERISTIC
/begin CHARACTERISTIC mLdTrk_HysteresisSchlepAreaGenMech_XDU16 "Generiert: Filterbreite Hysteresefilter [Nm]" VALUE 0x14A054 AblGLKWuw 1 MMOT 0 1 FORMAT "%8.6" /end CHARACTERISTIC
/begin CHARACTERISTIC mLdTrk_HysteresisSchlepAreaWorm_XDU16 "Generiert: Filterbreite Hysteresefilter [Nm]" VALUE 0x14A056 AblGLKWuw 1 MMOT 0 1 FORMAT "%8.6" /end CHARACTERISTIC
/begin CHARACTERISTIC mLdTrk_InvClassWidthGenMech_XDU16 "Generiert: Kehrwert Klassenbreite" VALUE 0x14A058 AblGLKWuw 10 MMOT 0 10 FORMAT "%8.5" /end CHARACTERISTIC
/begin CHARACTERISTIC mLdTrk_InvClassWidthWorm_XDU16 "Generiert: Kehrwert Klassenbreite" VALUE 0x14A05A AblGLKWuw 0 MMOT 5 5 FORMAT "%8.6" /end CHARACTERISTIC
/begin CHARACTERISTIC mLdTrk_MaxDeltaWWT_XDU16 "Maximale Aenderungsrate des Schneckenradmoments, sodass es noch als rotatorisch gewertet wird." VALUE 0x14A05C AblGLKWuw 1000 RIGHTSH6NP 0 1000 FORMAT "%8.3" /end CHARACTERISTIC
/begin CHARACTERISTIC mLdTrk_StartClassGenMech_XDU16 "Generiert: Startklasse [Nm]" VALUE 0x14A05E AblGLKWuw 11 MMOT 1 12 FORMAT "%8.5" /end CHARACTERISTIC
/begin CHARACTERISTIC mLdTrk_StartClassWormImpact_XDU16 "Generiert: Startklasse für Impact Damage [Nm]" VALUE 0x14A060 AblGLKWuw 19 MMOT 1 20 FORMAT "%8.5" /end CHARACTERISTIC
/begin CHARACTERISTIC mLdTrk_StartClassWormImp_XDU16 "Generiert: Startklasse für Impact Damage [Nm]" VALUE 0x14A062 AblGLKWuw 19 MMOT 1 20 FORMAT "%8.5" /end CHARACTERISTIC
/begin CHARACTERISTIC mLdTrk_StartClassWormRot_XDU16 "Generiert: Startklasse [Nm]" VALUE 0x14A064 AblGLKWuw 11 MMOT 1 12 FORMAT "%8.5" /end CHARACTERISTIC
/begin CHARACTERISTIC mLka_DefaultGradient_XDU16 "Lane Assist Gradientenlimitierungsoffset(Handmoment)" VALUE 0x15064C AblGLKWuw 25 RAMPRATE 0 25 FORMAT "%8.5" /end CHARACTERISTIC
/begin CHARACTERISTIC mLka_DrvInterventionTorque_XAU16_0___A "Driver intervention torque threshold in LKA" VAL_BLK 0x1580C4 AblGLKWBuw 8 TBTHIGH 0 8 NUMBER 3 FORMAT "%8.6" /end CHARACTERISTIC
/begin CHARACTERISTIC mLka_DrvInterventionTorque_XAU16_1___A "Driver intervention torque threshold in LKA" VAL_BLK 0x1580CC AblGLKWBuw 8 TBTHIGH 0 8 NUMBER 3 FORMAT "%8.6" /end CHARACTERISTIC
/begin CHARACTERISTIC mLka_DrvInterventionTorque_XAU16_2___A "Driver intervention torque threshold in LKA" VAL_BLK 0x1580D4 AblGLKWBuw 8 TBTHIGH 0 8 NUMBER 3 FORMAT "%8.6" /end CHARACTERISTIC
/begin CHARACTERISTIC mLka_DrvInterventionTorque_XAU16_3___A "Driver intervention torque threshold in LKA" VAL_BLK 0x1580DC AblGLKWBuw 8 TBTHIGH 0 8 NUMBER 3 FORMAT "%8.6" /end CHARACTERISTIC
/begin CHARACTERISTIC mLka_DrvInterventionTorque_XAU16_4___A "Driver intervention torque threshold in LKA" VAL_BLK 0x1580E4 AblGLKWBuw 8 TBTHIGH 0 8 NUMBER 3 FORMAT "%8.6" /end CHARACTERISTIC
/begin CHARACTERISTIC mLka_DrvInterventionTorque_XAU16_5___A "Driver intervention torque threshold in LKA" VAL_BLK 0x1580EC AblGLKWBuw 8 TBTHIGH 0 8 NUMBER 3 FORMAT "%8.6" /end CHARACTERISTIC
/begin CHARACTERISTIC mLka_DrvInterventionTrqChk_XAU16_0___A "Driver intervention torque threshold in LKA check" VAL_BLK 0x1580F4 AblGLKWBuw 8 TBTHIGH 0 8 NUMBER 3 FORMAT "%8.6" /end CHARACTERISTIC
/begin CHARACTERISTIC mLka_DrvInterventionTrqChk_XAU16_1___A "Driver intervention torque threshold in LKA check" VAL_BLK 0x1580FC AblGLKWBuw 8 TBTHIGH 0 8 NUMBER 3 FORMAT "%8.6" /end CHARACTERISTIC
/begin CHARACTERISTIC mLka_DrvInterventionTrqChk_XAU16_2___A "Driver intervention torque threshold in LKA check" VAL_BLK 0x158104 AblGLKWBuw 8 TBTHIGH 0 8 NUMBER 3 FORMAT "%8.6" /end CHARACTERISTIC
/begin CHARACTERISTIC mLka_DrvInterventionTrqChk_XAU16_3___A "Driver intervention torque threshold in LKA check" VAL_BLK 0x15810C AblGLKWBuw 8 TBTHIGH 0 8 NUMBER 3 FORMAT "%8.6" /end CHARACTERISTIC
/begin CHARACTERISTIC mLka_DrvInterventionTrqChk_XAU16_4___A "Driver intervention torque threshold in LKA check" VAL_BLK 0x158114 AblGLKWBuw 8 TBTHIGH 0 8 NUMBER 3 FORMAT "%8.6" /end CHARACTERISTIC
/begin CHARACTERISTIC mLka_DrvInterventionTrqChk_XAU16_5___A "Driver intervention torque threshold in LKA check" VAL_BLK 0x15811C AblGLKWBuw 8 TBTHIGH 0 8 NUMBER 3 FORMAT "%8.6" /end CHARACTERISTIC
/begin CHARACTERISTIC mLka_DrvInterventionTrqChk_XDU16_0___A "Driver Intervention Torque Threshold (Nm) in check" VALUE 0x158124 AblGLKWuw 15 TBTHIGH 0 15 FORMAT "%8.5" /end CHARACTERISTIC
/begin CHARACTERISTIC mLka_DrvInterventionTrqChk_XDU16_1___A "Driver Intervention Torque Threshold (Nm) in check" VALUE 0x158126 AblGLKWuw 15 TBTHIGH 0 15 FORMAT "%8.5" /end CHARACTERISTIC
/begin CHARACTERISTIC mLka_DrvInterventionTrqChk_XDU16_2___A "Driver Intervention Torque Threshold (Nm) in check" VALUE 0x158128 AblGLKWuw 15 TBTHIGH 0 15 FORMAT "%8.5" /end CHARACTERISTIC
/begin CHARACTERISTIC mLka_DrvInterventionTrqChk_XDU16_3___A "Driver Intervention Torque Threshold (Nm) in check" VALUE 0x15812A AblGLKWuw 15 TBTHIGH 0 15 FORMAT "%8.5" /end CHARACTERISTIC
/begin CHARACTERISTIC mLka_DrvInterventionTrqChk_XDU16_4___A "Driver Intervention Torque Threshold (Nm) in check" VALUE 0x15812C AblGLKWuw 15 TBTHIGH 0 15 FORMAT "%8.5" /end CHARACTERISTIC
/begin CHARACTERISTIC mLka_DrvInterventionTrqChk_XDU16_5___A "Driver Intervention Torque Threshold (Nm) in check" VALUE 0x15812E AblGLKWuw 15 TBTHIGH 0 15 FORMAT "%8.5" /end CHARACTERISTIC
/begin CHARACTERISTIC mLka_GradientLimit_XAU16_0___A "Lane Keep Assist Input Gradientenlimitierungs Check(Handmoment) (Nm/s)" VAL_BLK 0x158130 AblGLKWBuw 25 RAMPRATE 0 25 NUMBER 3 FORMAT "%8.5" /end CHARACTERISTIC
/begin CHARACTERISTIC mLka_GradientLimit_XAU16_1___A "Lane Keep Assist Input Gradientenlimitierungs Check(Handmoment) (Nm/s)" VAL_BLK 0x158138 AblGLKWBuw 25 RAMPRATE 0 25 NUMBER 3 FORMAT "%8.5" /end CHARACTERISTIC
/begin CHARACTERISTIC mLka_GradientLimit_XAU16_2___A "Lane Keep Assist Input Gradientenlimitierungs Check(Handmoment) (Nm/s)" VAL_BLK 0x158140 AblGLKWBuw 25 RAMPRATE 0 25 NUMBER 3 FORMAT "%8.5" /end CHARACTERISTIC
/begin CHARACTERISTIC mLka_GradientLimit_XAU16_3___A "Lane Keep Assist Input Gradientenlimitierungs Check(Handmoment) (Nm/s)" VAL_BLK 0x158148 AblGLKWBuw 25 RAMPRATE 0 25 NUMBER 3 FORMAT "%8.5" /end CHARACTERISTIC
/begin CHARACTERISTIC mLka_GradientLimit_XAU16_4___A "Lane Keep Assist Input Gradientenlimitierungs Check(Handmoment) (Nm/s)" VAL_BLK 0x158150 AblGLKWBuw 25 RAMPRATE 0 25 NUMBER 3 FORMAT "%8.5" /end CHARACTERISTIC
/begin CHARACTERISTIC mLka_GradientLimit_XAU16_5___A "Lane Keep Assist Input Gradientenlimitierungs Check(Handmoment) (Nm/s)" VAL_BLK 0x158158 AblGLKWBuw 25 RAMPRATE 0 25 NUMBER 3 FORMAT "%8.5" /end CHARACTERISTIC
/begin CHARACTERISTIC mLka_MaxMmotOffsetMonSafe_XAU16_0___A "Max. Motormomentenoffset Lane Assist" CURVE 0x15B4F4 AblGLKLuw 0.5 MMOT 0 0.5 FORMAT "%9.7"
 /begin AXIS_DESCR STD_AXIS vVehSpI_AbsMaxSafeVehSpd_xdu16 VFZHIGH 6 0 500 FORMAT "%8.4" DEPOSIT ABSOLUTE /end AXIS_DESCR
/end CHARACTERISTIC
/begin CHARACTERISTIC mLka_MaxMmotOffsetMonSafe_XAU16_1___A "Max. Motormomentenoffset Lane Assist" CURVE 0x15B510 AblGLKLuw 0.5 MMOT 0 0.5 FORMAT "%9.7"
 /begin AXIS_DESCR STD_AXIS vVehSpI_AbsMaxSafeVehSpd_xdu16 VFZHIGH 6 0 500 FORMAT "%8.4" DEPOSIT ABSOLUTE /end AXIS_DESCR
/end CHARACTERISTIC
/begin CHARACTERISTIC mLka_MaxMmotOffsetMonSafe_XAU16_2___A "Max. Motormomentenoffset Lane Assist" CURVE 0x15B52C AblGLKLuw 0.5 MMOT 0 0.5 FORMAT "%9.7"
 /begin AXIS_DESCR STD_AXIS vVehSpI_AbsMaxSafeVehSpd_xdu16 VFZHIGH 6 0 500 FORMAT "%8.4" DEPOSIT ABSOLUTE /end AXIS_DESCR
/end CHARACTERISTIC
/begin CHARACTERISTIC mLka_MaxMmotOffsetMonSafe_XAU16_3___A "Max. Motormomentenoffset Lane Assist" CURVE 0x15B548 AblGLKLuw 0.5 MMOT 0 0.5 FORMAT "%9.7"
 /begin AXIS_DESCR STD_AXIS vVehSpI_AbsMaxSafeVehSpd_xdu16 VFZHIGH 6 0 500 FORMAT "%8.4" DEPOSIT ABSOLUTE /end AXIS_DESCR
/end CHARACTERISTIC
/begin CHARACTERISTIC mLka_MaxMmotOffsetMonSafe_XAU16_4___A "Max. Motormomentenoffset Lane Assist" CURVE 0x15B564 AblGLKLuw 0.5 MMOT 0 0.5 FORMAT "%9.7"
 /begin AXIS_DESCR STD_AXIS vVehSpI_AbsMaxSafeVehSpd_xdu16 VFZHIGH 6 0 500 FORMAT "%8.4" DEPOSIT ABSOLUTE /end AXIS_DESCR
/end CHARACTERISTIC
/begin CHARACTERISTIC mLka_MaxMmotOffsetMonSafe_XAU16_5___A "Max. Motormomentenoffset Lane Assist" CURVE 0x15B580 AblGLKLuw 0.5 MMOT 0 0.5 FORMAT "%9.7"
 /begin AXIS_DESCR STD_AXIS vVehSpI_AbsMaxSafeVehSpd_xdu16 VFZHIGH 6 0 500 FORMAT "%8.4" DEPOSIT ABSOLUTE /end AXIS_DESCR
/end CHARACTERISTIC
/begin CHARACTERISTIC mLka_MaxTbtOffsetMonSafe_XAU16_0___A "" CURVE 0x15B644 AblGLKLuw 10 TBTHIGH 0 10 FORMAT "%8.5"
 /begin AXIS_DESCR STD_AXIS vVehSpI_AbsMaxSafeVehSpd_xdu16 VFZHIGH 6 0 500 FORMAT "%8.4" DEPOSIT ABSOLUTE /end AXIS_DESCR
/end CHARACTERISTIC
/begin CHARACTERISTIC mLka_MaxTbtOffsetMonSafe_XAU16_1___A "" CURVE 0x15B660 AblGLKLuw 10 TBTHIGH 0 10 FORMAT "%8.5"
 /begin AXIS_DESCR STD_AXIS vVehSpI_AbsMaxSafeVehSpd_xdu16 VFZHIGH 6 0 500 FORMAT "%8.4" DEPOSIT ABSOLUTE /end AXIS_DESCR
/end CHARACTERISTIC
/begin CHARACTERISTIC mLka_MaxTbtOffsetMonSafe_XAU16_2___A "" CURVE 0x15B67C AblGLKLuw 10 TBTHIGH 0 10 FORMAT "%8.5"
 /begin AXIS_DESCR STD_AXIS vVehSpI_AbsMaxSafeVehSpd_xdu16 VFZHIGH 6 0 500 FORMAT "%8.4" DEPOSIT ABSOLUTE /end AXIS_DESCR
/end CHARACTERISTIC
/begin CHARACTERISTIC mLka_MaxTbtOffsetMonSafe_XAU16_3___A "" CURVE 0x15B698 AblGLKLuw 10 TBTHIGH 0 10 FORMAT "%8.5"
 /begin AXIS_DESCR STD_AXIS vVehSpI_AbsMaxSafeVehSpd_xdu16 VFZHIGH 6 0 500 FORMAT "%8.4" DEPOSIT ABSOLUTE /end AXIS_DESCR
/end CHARACTERISTIC
/begin CHARACTERISTIC mLka_MaxTbtOffsetMonSafe_XAU16_4___A "" CURVE 0x15B6B4 AblGLKLuw 10 TBTHIGH 0 10 FORMAT "%8.5"
 /begin AXIS_DESCR STD_AXIS vVehSpI_AbsMaxSafeVehSpd_xdu16 VFZHIGH 6 0 500 FORMAT "%8.4" DEPOSIT ABSOLUTE /end AXIS_DESCR
/end CHARACTERISTIC
/begin CHARACTERISTIC mLka_MaxTbtOffsetMonSafe_XAU16_5___A "" CURVE 0x15B6D0 AblGLKLuw 10 TBTHIGH 0 10 FORMAT "%8.5"
 /begin AXIS_DESCR STD_AXIS vVehSpI_AbsMaxSafeVehSpd_xdu16 VFZHIGH 6 0 500 FORMAT "%8.4" DEPOSIT ABSOLUTE /end AXIS_DESCR
/end CHARACTERISTIC
/begin CHARACTERISTIC mLka_MaxTBTOffsetMonSafe_XDU16 "Max. Handmomentenoffset Lane Assist " VALUE 0x15064E AblGLKWuw 5 TBTHIGH 0 5 FORMAT "%8.6" /end CHARACTERISTIC
/begin CHARACTERISTIC mLka_MaxTorqueRequestCheck_XDU16 "" VALUE 0x150650 AblGLKWuw 8 TBTHIGH 0 8 FORMAT "%8.6" /end CHARACTERISTIC
/begin CHARACTERISTIC mLka_MaxTrqReq_XAU16 "" VAL_BLK 0x150654 AblGLKWBuw 8 TBTHIGH 0 8 NUMBER 3 FORMAT "%8.6" /end CHARACTERISTIC
/begin CHARACTERISTIC mLka_VdtomTrqMonSafe_XAU16 "" CURVE 0x151364 AblGLKLuw 10 RAMPRATE 0 10 FORMAT "%8.5"
 /begin AXIS_DESCR STD_AXIS vVehSpI_AbsMaxSafeVehSpd_xdu16 VFZHIGH 6 0 500 FORMAT "%8.4" DEPOSIT ABSOLUTE /end AXIS_DESCR
/end CHARACTERISTIC
/begin CHARACTERISTIC mMchStPrv_MaxSafetyMotorTorq_XDU16 "maximales erlaubtes motormoment" VALUE 0x15065C AblGLKWuw 0.5 MMOT 0 0.5 FORMAT "%9.7" /end CHARACTERISTIC
/begin CHARACTERISTIC mMotTorLim_ErrorInjectionMotorTorque_XDS16 "Motormoment für Fehleraufschalttests (Testvariable)" VALUE 0x15065E AblGLKWsw 24 MMOT -12 12 FORMAT "%8.5" /end CHARACTERISTIC
/begin CHARACTERISTIC mMotTorLim_GeneratoricModeLimit_XAF32_0___A "Begrenzungskennlinie im generatorischen Betrieb" CURVE 0x15859C AblGLKLfl4 12 ZU0 0 12 FORMAT "%10.7"
 /begin AXIS_DESCR STD_AXIS nMotTorLim_AbsGeneratoricRotorSpeed_xdf32 ZU0 3 0 13000 FORMAT "%10.4" DEPOSIT ABSOLUTE /end AXIS_DESCR
/end CHARACTERISTIC
/begin CHARACTERISTIC mMotTorLim_GeneratoricModeLimit_XAF32_1___A "Begrenzungskennlinie im generatorischen Betrieb" CURVE 0x1585B8 AblGLKLfl4 12 ZU0 0 12 FORMAT "%10.7"
 /begin AXIS_DESCR STD_AXIS nMotTorLim_AbsGeneratoricRotorSpeed_xdf32 ZU0 3 0 13000 FORMAT "%10.4" DEPOSIT ABSOLUTE /end AXIS_DESCR
/end CHARACTERISTIC
/begin CHARACTERISTIC mMotTorLim_GeneratoricModeLimit_XAF32_2___A "Begrenzungskennlinie im generatorischen Betrieb" CURVE 0x1585D4 AblGLKLfl4 12 ZU0 0 12 FORMAT "%10.7"
 /begin AXIS_DESCR STD_AXIS nMotTorLim_AbsGeneratoricRotorSpeed_xdf32 ZU0 3 0 13000 FORMAT "%10.4" DEPOSIT ABSOLUTE /end AXIS_DESCR
/end CHARACTERISTIC
/begin CHARACTERISTIC mMotTorLim_GeneratoricModeLimit_XAF32_3___A "Begrenzungskennlinie im generatorischen Betrieb" CURVE 0x1585F0 AblGLKLfl4 12 ZU0 0 12 FORMAT "%10.7"
 /begin AXIS_DESCR STD_AXIS nMotTorLim_AbsGeneratoricRotorSpeed_xdf32 ZU0 3 0 13000 FORMAT "%10.4" DEPOSIT ABSOLUTE /end AXIS_DESCR
/end CHARACTERISTIC
/begin CHARACTERISTIC mMotTorLim_GeneratoricModeLimit_XAF32_4___A "Begrenzungskennlinie im generatorischen Betrieb" CURVE 0x15860C AblGLKLfl4 12 ZU0 0 12 FORMAT "%10.7"
 /begin AXIS_DESCR STD_AXIS nMotTorLim_AbsGeneratoricRotorSpeed_xdf32 ZU0 3 0 13000 FORMAT "%10.4" DEPOSIT ABSOLUTE /end AXIS_DESCR
/end CHARACTERISTIC
/begin CHARACTERISTIC mMotTorLim_GeneratoricModeLimit_XAF32_5___A "Begrenzungskennlinie im generatorischen Betrieb" CURVE 0x158628 AblGLKLfl4 12 ZU0 0 12 FORMAT "%10.7"
 /begin AXIS_DESCR STD_AXIS nMotTorLim_AbsGeneratoricRotorSpeed_xdf32 ZU0 3 0 13000 FORMAT "%10.4" DEPOSIT ABSOLUTE /end AXIS_DESCR
/end CHARACTERISTIC
/begin CHARACTERISTIC mMotTorLim_GeneratoricModeLimit_XAS16 "Begrenzungskennlinie im generatorischen Betrieb" CURVE 0x151380 AblGLKLsw 12 MMOT 0 12 FORMAT "%8.5"
 /begin AXIS_DESCR STD_AXIS nMotTorLim_AbsGeneratoricRotorSpeed_xds16 VROT 3 0 13000 FORMAT "%3.0" DEPOSIT ABSOLUTE /end AXIS_DESCR
/end CHARACTERISTIC
/begin CHARACTERISTIC mMotTorLim_GradToReduceOffset_XDU16 "Gradient fuer Reduktion auf Assistkennlinie Nm/ms" VALUE 0x150660 AblGLKWuw 1 MMOT 0 1 FORMAT "%8.6" /end CHARACTERISTIC
/begin CHARACTERISTIC mMotTorLim_L2MmotShiftForCalculatedLimits_XAF32_0___A "L2 Motormomentenoffset für Berechnung der Begrenzungskennlinie aus der Assist-Kennlinie" CURVE 0x158644 AblGLKLfl4 4 ZU0 0 4 FORMAT "%10.8"
 /begin AXIS_DESCR STD_AXIS vMotTorLim_L2AbsSafeVehicleSpeed_xdf32 ZU0 7 0 500 FORMAT "%10.6" DEPOSIT ABSOLUTE /end AXIS_DESCR
/end CHARACTERISTIC
/begin CHARACTERISTIC mMotTorLim_L2MmotShiftForCalculatedLimits_XAF32_1___A "L2 Motormomentenoffset für Berechnung der Begrenzungskennlinie aus der Assist-Kennlinie" CURVE 0x158680 AblGLKLfl4 4 ZU0 0 4 FORMAT "%10.8"
 /begin AXIS_DESCR STD_AXIS vMotTorLim_L2AbsSafeVehicleSpeed_xdf32 ZU0 7 0 500 FORMAT "%10.6" DEPOSIT ABSOLUTE /end AXIS_DESCR
/end CHARACTERISTIC
/begin CHARACTERISTIC mMotTorLim_L2MmotShiftForCalculatedLimits_XAF32_2___A "L2 Motormomentenoffset für Berechnung der Begrenzungskennlinie aus der Assist-Kennlinie" CURVE 0x1586BC AblGLKLfl4 4 ZU0 0 4 FORMAT "%10.8"
 /begin AXIS_DESCR STD_AXIS vMotTorLim_L2AbsSafeVehicleSpeed_xdf32 ZU0 7 0 500 FORMAT "%10.6" DEPOSIT ABSOLUTE /end AXIS_DESCR
/end CHARACTERISTIC
/begin CHARACTERISTIC mMotTorLim_L2MmotShiftForCalculatedLimits_XAF32_3___A "L2 Motormomentenoffset für Berechnung der Begrenzungskennlinie aus der Assist-Kennlinie" CURVE 0x1586F8 AblGLKLfl4 4 ZU0 0 4 FORMAT "%10.8"
 /begin AXIS_DESCR STD_AXIS vMotTorLim_L2AbsSafeVehicleSpeed_xdf32 ZU0 7 0 500 FORMAT "%10.6" DEPOSIT ABSOLUTE /end AXIS_DESCR
/end CHARACTERISTIC
/begin CHARACTERISTIC mMotTorLim_L2MmotShiftForCalculatedLimits_XAF32_4___A "L2 Motormomentenoffset für Berechnung der Begrenzungskennlinie aus der Assist-Kennlinie" CURVE 0x158734 AblGLKLfl4 4 ZU0 0 4 FORMAT "%10.8"
 /begin AXIS_DESCR STD_AXIS vMotTorLim_L2AbsSafeVehicleSpeed_xdf32 ZU0 7 0 500 FORMAT "%10.6" DEPOSIT ABSOLUTE /end AXIS_DESCR
/end CHARACTERISTIC
/begin CHARACTERISTIC mMotTorLim_L2MmotShiftForCalculatedLimits_XAF32_5___A "L2 Motormomentenoffset für Berechnung der Begrenzungskennlinie aus der Assist-Kennlinie" CURVE 0x158770 AblGLKLfl4 4 ZU0 0 4 FORMAT "%10.8"
 /begin AXIS_DESCR STD_AXIS vMotTorLim_L2AbsSafeVehicleSpeed_xdf32 ZU0 7 0 500 FORMAT "%10.6" DEPOSIT ABSOLUTE /end AXIS_DESCR
/end CHARACTERISTIC
/begin CHARACTERISTIC mMotTorLim_L2SwitchOffTestMotorTorque_XDS16 "Motormoment für L2 Vergleich test (Testvariable)" VALUE 0x150662 AblGLKWsw 10 MMOT -5 5 FORMAT "%8.6" /end CHARACTERISTIC
/begin CHARACTERISTIC mMotTorLim_MaxAllowedNomMot_XDU16 "max erlaubtes NominalMotTorq für WarnLampCheck" VALUE 0x150664 AblGLKWuw 8 MMOT 0 8 FORMAT "%8.6" /end CHARACTERISTIC
/begin CHARACTERISTIC mMotTorLim_MaxAllowedTBT_XDU16 "max erlaubtes TBT für WarnLampCheck" VALUE 0x150666 AblGLKWuw 25 TBTHIGH 0 25 FORMAT "%8.5" /end CHARACTERISTIC
/begin CHARACTERISTIC mMotTorLim_MaxIntegralInv_XDU16 "inverses maximal zulässiges Integral [s/Nm]" VALUE 0x150668 AblGLKWuw 0.984985 RIGHTSH15NP 0.01501465 1 FORMAT "%8.6" /end CHARACTERISTIC
/begin CHARACTERISTIC mMotTorLim_MaxIntegral_XDU16 "Maximal zulässiges Integral [Nm/s]" VALUE 0x15066A AblGLKWuw 49 MMOT 1 50 FORMAT "%8.5" /end CHARACTERISTIC
/begin CHARACTERISTIC mMotTorLim_MinMMotForVibrationCycleDetection_XDU16 "Minimales Motormoment für die Rattererkennung" VALUE 0x15066C AblGLKWuw 12 MMOT 0 12 FORMAT "%8.5" /end CHARACTERISTIC
/begin CHARACTERISTIC mMotTorLim_MinTbtForVibrationCycleDetection_XDU16 "Minimales Handmoment für die Rattererkennung" VALUE 0x15066E AblGLKWuw 25 TBTHIGH 0 25 FORMAT "%8.5" /end CHARACTERISTIC
/begin CHARACTERISTIC mMotTorLim_MinTbtForVibrationOnLimitsCycleDetection_XDU16 "Minimales Handmoment für die am Limit Rattererkennung" VALUE 0x150670 AblGLKWuw 25 TBTHIGH 0 25 FORMAT "%8.5" /end CHARACTERISTIC
/begin CHARACTERISTIC mMotTorLim_MmotShiftForCalculatedLimits_XAU16_0___A "Motormomentenoffset für Berechnung der Begrenzungskennlinie aus der Assist-Kennlinie" CURVE 0x15B83C AblGLKLuw 4 MMOT 0 4 FORMAT "%8.6"
 /begin AXIS_DESCR STD_AXIS vMotTorLim_AbsSafeVehicleSpeed_xdu16 VFZHIGH 7 0 500 FORMAT "%8.4" DEPOSIT ABSOLUTE /end AXIS_DESCR
/end CHARACTERISTIC
/begin CHARACTERISTIC mMotTorLim_MmotShiftForCalculatedLimits_XAU16_1___A "Motormomentenoffset für Berechnung der Begrenzungskennlinie aus der Assist-Kennlinie" CURVE 0x15B85C AblGLKLuw 4 MMOT 0 4 FORMAT "%8.6"
 /begin AXIS_DESCR STD_AXIS vMotTorLim_AbsSafeVehicleSpeed_xdu16 VFZHIGH 7 0 500 FORMAT "%8.4" DEPOSIT ABSOLUTE /end AXIS_DESCR
/end CHARACTERISTIC
/begin CHARACTERISTIC mMotTorLim_MmotShiftForCalculatedLimits_XAU16_2___A "Motormomentenoffset für Berechnung der Begrenzungskennlinie aus der Assist-Kennlinie" CURVE 0x15B87C AblGLKLuw 4 MMOT 0 4 FORMAT "%8.6"
 /begin AXIS_DESCR STD_AXIS vMotTorLim_AbsSafeVehicleSpeed_xdu16 VFZHIGH 7 0 500 FORMAT "%8.4" DEPOSIT ABSOLUTE /end AXIS_DESCR
/end CHARACTERISTIC
/begin CHARACTERISTIC mMotTorLim_MmotShiftForCalculatedLimits_XAU16_3___A "Motormomentenoffset für Berechnung der Begrenzungskennlinie aus der Assist-Kennlinie" CURVE 0x15B89C AblGLKLuw 4 MMOT 0 4 FORMAT "%8.6"
 /begin AXIS_DESCR STD_AXIS vMotTorLim_AbsSafeVehicleSpeed_xdu16 VFZHIGH 7 0 500 FORMAT "%8.4" DEPOSIT ABSOLUTE /end AXIS_DESCR
/end CHARACTERISTIC
/begin CHARACTERISTIC mMotTorLim_MmotShiftForCalculatedLimits_XAU16_4___A "Motormomentenoffset für Berechnung der Begrenzungskennlinie aus der Assist-Kennlinie" CURVE 0x15B8BC AblGLKLuw 4 MMOT 0 4 FORMAT "%8.6"
 /begin AXIS_DESCR STD_AXIS vMotTorLim_AbsSafeVehicleSpeed_xdu16 VFZHIGH 7 0 500 FORMAT "%8.4" DEPOSIT ABSOLUTE /end AXIS_DESCR
/end CHARACTERISTIC
/begin CHARACTERISTIC mMotTorLim_MmotShiftForCalculatedLimits_XAU16_5___A "Motormomentenoffset für Berechnung der Begrenzungskennlinie aus der Assist-Kennlinie" CURVE 0x15B8DC AblGLKLuw 4 MMOT 0 4 FORMAT "%8.6"
 /begin AXIS_DESCR STD_AXIS vMotTorLim_AbsSafeVehicleSpeed_xdu16 VFZHIGH 7 0 500 FORMAT "%8.4" DEPOSIT ABSOLUTE /end AXIS_DESCR
/end CHARACTERISTIC
/begin CHARACTERISTIC mMotTorLim_Tbt2StopGenRotSpeedExp_XDU16 "Handmoment ab welchem die generatorische Aufweitung deaktiviert ist" VALUE 0x150672 AblGLKWuw 15 TBTHIGH 0 15 FORMAT "%8.5" /end CHARACTERISTIC
/begin CHARACTERISTIC mMotTorLim_TbtShiftForZeroMmotTh_XDS16_0___A "Handmoment bis MTL-Kennlinie auf 0Nm runtergezogen wird" VALUE 0x158160 AblGLKWsw 5.99902 TBTHIGH 0.0009765625 6 FORMAT "%8.6" /end CHARACTERISTIC
/begin CHARACTERISTIC mMotTorLim_TbtShiftForZeroMmotTh_XDS16_1___A "Handmoment bis MTL-Kennlinie auf 0Nm runtergezogen wird" VALUE 0x158162 AblGLKWsw 5.99902 TBTHIGH 0.0009765625 6 FORMAT "%8.6" /end CHARACTERISTIC
/begin CHARACTERISTIC mMotTorLim_TbtShiftForZeroMmotTh_XDS16_2___A "Handmoment bis MTL-Kennlinie auf 0Nm runtergezogen wird" VALUE 0x158164 AblGLKWsw 5.99902 TBTHIGH 0.0009765625 6 FORMAT "%8.6" /end CHARACTERISTIC
/begin CHARACTERISTIC mMotTorLim_TbtShiftForZeroMmotTh_XDS16_3___A "Handmoment bis MTL-Kennlinie auf 0Nm runtergezogen wird" VALUE 0x158166 AblGLKWsw 5.99902 TBTHIGH 0.0009765625 6 FORMAT "%8.6" /end CHARACTERISTIC
/begin CHARACTERISTIC mMotTorLim_TbtShiftForZeroMmotTh_XDS16_4___A "Handmoment bis MTL-Kennlinie auf 0Nm runtergezogen wird" VALUE 0x158168 AblGLKWsw 5.99902 TBTHIGH 0.0009765625 6 FORMAT "%8.6" /end CHARACTERISTIC
/begin CHARACTERISTIC mMotTorLim_TbtShiftForZeroMmotTh_XDS16_5___A "Handmoment bis MTL-Kennlinie auf 0Nm runtergezogen wird" VALUE 0x15816A AblGLKWsw 5.99902 TBTHIGH 0.0009765625 6 FORMAT "%8.6" /end CHARACTERISTIC
/begin CHARACTERISTIC mOCC_MaxAllowedTorque_XDU16 "Occ Motormoment-Begrenzung " VALUE 0x150674 AblGLKWuw 0.5 MMOT 0 0.5 FORMAT "%9.7" /end CHARACTERISTIC
/begin CHARACTERISTIC mOvSt_LiftingTorqueOnPinionAngle_XAU16 "Moment zur Hubkraftkompensation in Ahaengigkeit des Ritzelwinkels [Nm]" CURVE 0x151390 AblGLKLuw 1 MMOT 0 1 FORMAT "%8.6"
 /begin AXIS_DESCR STD_AXIS wOvSt_AbsBlendPinionAngle_xdu16 SA_10 6 0 1000 FORMAT "%8.3" DEPOSIT ABSOLUTE /end AXIS_DESCR
/end CHARACTERISTIC
/begin CHARACTERISTIC mOvSt_LimitRetTorque_XDU16 "Begrenzung Rueckstellmoment aus Oversteer" VALUE 0x15067C AblGLKWuw 1 MMOT 0 1 FORMAT "%8.6" /end CHARACTERISTIC
/begin CHARACTERISTIC mPDC_DeadBandTorsionBarTorque_XDU16 "Totband auf das Drehstabmoment" VALUE 0x14A066 AblGLKWuw 1 TBTHIGH 0 1 FORMAT "%8.6" /end CHARACTERISTIC
/begin CHARACTERISTIC mPDC_MaxTorsionBarTorque4Learn_XDU16 "Maximales Drehstabmoment für das Berechnen des Kompensationsmoments" VALUE 0x14A068 AblGLKWuw 25 TBTHIGH 0 25 FORMAT "%8.5" /end CHARACTERISTIC
/begin CHARACTERISTIC mPDC_MinTorsionBarTorque4BigCrowningChangeDetection_XDU16 "Minimales Drehstabmoment für das Erkennen einer starken Änderung der Fahrbahnneigung für das Ändern des Integrationsfaktors" VALUE 0x14A06A AblGLKWuw 25 TBTHIGH 0 25 FORMAT "%8.5" /end CHARACTERISTIC
/begin CHARACTERISTIC mPDC_MinTorsionBarTorque4CompFrackWrongDetection_XDU16 "Minimales Drehstabmoment für das Erkennen einer falschen Kompensationszahnstangenkraft für das Herausrampen aus dem Status Hold" VALUE 0x14A06C AblGLKWuw 25 TBTHIGH 0 25 FORMAT "%8.5" /end CHARACTERISTIC
/begin CHARACTERISTIC mPDC_MinTorsionBarTorque4TurnDetection_XDU16 "Minimales Drehstabmoment für das Erkennen einer Kurve für das Herausrampen aus dem Status Hold" VALUE 0x14A06E AblGLKWuw 25 TBTHIGH 0 25 FORMAT "%8.5" /end CHARACTERISTIC
/begin CHARACTERISTIC mRackForce_BaseFriction_XDU16 "Basis Reibung für Reibungskompensation [Nm]" VALUE 0x14A070 AblGLKWuw 1 MMOT 0 1 FORMAT "%8.6" /end CHARACTERISTIC
/begin CHARACTERISTIC mRpCorr_LTATBT_XDU16 "Max.Handmoment Langzeitkorrektur" VALUE 0x15068A AblGLKWuw 8 TBTHIGH 0 8 FORMAT "%8.6" /end CHARACTERISTIC
/begin CHARACTERISTIC mRpCorr_LTMaxMotTorq_XDU16 "Max. Motormoment fuer Geradeauserkennung in Langzeitkorrektur" VALUE 0x15068C AblGLKWuw 8 TBTHIGH 0 8 FORMAT "%8.6" /end CHARACTERISTIC
/begin CHARACTERISTIC mRpCorr_STMaxMotTorq_XDU16 "Max. Motormoment fuer Geradeauserkennung in Kurzzeitkorrektur" VALUE 0x15068E AblGLKWuw 8 TBTHIGH 0 8 FORMAT "%8.6" /end CHARACTERISTIC
/begin CHARACTERISTIC mRpCorr_STMaxTBT_XDU16 "Max.Handmoment Kurzzeitkorrektur" VALUE 0x150690 AblGLKWuw 8 TBTHIGH 0 8 FORMAT "%8.6" /end CHARACTERISTIC
/begin CHARACTERISTIC nMchStPrv_BoundRotSpeedGRADTBT_XAU16_0___A "Referenzdrehzahl abhängig vom Gradient Handmoment" CURVE 0x15B95C AblGLKLuw 150 VROT 0 150 FORMAT "%3.0"
 /begin AXIS_DESCR STD_AXIS mMchStPrv_FilteredGRADTBT_xdu16 TORGRAD 4 0 10 FORMAT "%8.5" DEPOSIT ABSOLUTE /end AXIS_DESCR
/end CHARACTERISTIC
/begin CHARACTERISTIC nMchStPrv_BoundRotSpeedGRADTBT_XAU16_1___A "Referenzdrehzahl abhängig vom Gradient Handmoment" CURVE 0x15B970 AblGLKLuw 150 VROT 0 150 FORMAT "%3.0"
 /begin AXIS_DESCR STD_AXIS mMchStPrv_FilteredGRADTBT_xdu16 TORGRAD 4 0 10 FORMAT "%8.5" DEPOSIT ABSOLUTE /end AXIS_DESCR
/end CHARACTERISTIC
/begin CHARACTERISTIC nMchStPrv_BoundRotSpeedGRADTBT_XAU16_2___A "Referenzdrehzahl abhängig vom Gradient Handmoment" CURVE 0x15B984 AblGLKLuw 150 VROT 0 150 FORMAT "%3.0"
 /begin AXIS_DESCR STD_AXIS mMchStPrv_FilteredGRADTBT_xdu16 TORGRAD 4 0 10 FORMAT "%8.5" DEPOSIT ABSOLUTE /end AXIS_DESCR
/end CHARACTERISTIC
/begin CHARACTERISTIC nMchStPrv_BoundRotSpeedGRADTBT_XAU16_3___A "Referenzdrehzahl abhängig vom Gradient Handmoment" CURVE 0x15B998 AblGLKLuw 150 VROT 0 150 FORMAT "%3.0"
 /begin AXIS_DESCR STD_AXIS mMchStPrv_FilteredGRADTBT_xdu16 TORGRAD 4 0 10 FORMAT "%8.5" DEPOSIT ABSOLUTE /end AXIS_DESCR
/end CHARACTERISTIC
/begin CHARACTERISTIC nMchStPrv_BoundRotSpeedGRADTBT_XAU16_4___A "Referenzdrehzahl abhängig vom Gradient Handmoment" CURVE 0x15B9AC AblGLKLuw 150 VROT 0 150 FORMAT "%3.0"
 /begin AXIS_DESCR STD_AXIS mMchStPrv_FilteredGRADTBT_xdu16 TORGRAD 4 0 10 FORMAT "%8.5" DEPOSIT ABSOLUTE /end AXIS_DESCR
/end CHARACTERISTIC
/begin CHARACTERISTIC nMchStPrv_BoundRotSpeedGRADTBT_XAU16_5___A "Referenzdrehzahl abhängig vom Gradient Handmoment" CURVE 0x15B9C0 AblGLKLuw 150 VROT 0 150 FORMAT "%3.0"
 /begin AXIS_DESCR STD_AXIS mMchStPrv_FilteredGRADTBT_xdu16 TORGRAD 4 0 10 FORMAT "%8.5" DEPOSIT ABSOLUTE /end AXIS_DESCR
/end CHARACTERISTIC
/begin CHARACTERISTIC nMchStPrv_BoundRotSpeedMeffVO_XAU16 "Referenzdrehzahl abhängig vom Wirkmoment für geringe Fahrzeuggeschwindigkeiten" CURVE 0x1514B8 AblGLKLuw 150 VROT 0 150 FORMAT "%3.0"
 /begin AXIS_DESCR STD_AXIS mMchStPrv_AbsEffMotTor_xdu16 MMOT 4 0 10 FORMAT "%8.5" DEPOSIT ABSOLUTE /end AXIS_DESCR
/end CHARACTERISTIC
/begin CHARACTERISTIC nMchStPrv_BoundRotSpeedMeff_XAU16_0___A "Referenzdrehzahl abhängig vom Wirkmoment" CURVE 0x15B9D4 AblGLKLuw 150 VROT 0 150 FORMAT "%3.0"
 /begin AXIS_DESCR STD_AXIS mMchStPrv_AbsEffMotTor_xdu16 MMOT 4 0 10 FORMAT "%8.5" DEPOSIT ABSOLUTE /end AXIS_DESCR
/end CHARACTERISTIC
/begin CHARACTERISTIC nMchStPrv_BoundRotSpeedMeff_XAU16_1___A "Referenzdrehzahl abhängig vom Wirkmoment" CURVE 0x15B9E8 AblGLKLuw 150 VROT 0 150 FORMAT "%3.0"
 /begin AXIS_DESCR STD_AXIS mMchStPrv_AbsEffMotTor_xdu16 MMOT 4 0 10 FORMAT "%8.5" DEPOSIT ABSOLUTE /end AXIS_DESCR
/end CHARACTERISTIC
/begin CHARACTERISTIC nMchStPrv_BoundRotSpeedMeff_XAU16_2___A "Referenzdrehzahl abhängig vom Wirkmoment" CURVE 0x15B9FC AblGLKLuw 150 VROT 0 150 FORMAT "%3.0"
 /begin AXIS_DESCR STD_AXIS mMchStPrv_AbsEffMotTor_xdu16 MMOT 4 0 10 FORMAT "%8.5" DEPOSIT ABSOLUTE /end AXIS_DESCR
/end CHARACTERISTIC
/begin CHARACTERISTIC nMchStPrv_BoundRotSpeedMeff_XAU16_3___A "Referenzdrehzahl abhängig vom Wirkmoment" CURVE 0x15BA10 AblGLKLuw 150 VROT 0 150 FORMAT "%3.0"
 /begin AXIS_DESCR STD_AXIS mMchStPrv_AbsEffMotTor_xdu16 MMOT 4 0 10 FORMAT "%8.5" DEPOSIT ABSOLUTE /end AXIS_DESCR
/end CHARACTERISTIC
/begin CHARACTERISTIC nMchStPrv_BoundRotSpeedMeff_XAU16_4___A "Referenzdrehzahl abhängig vom Wirkmoment" CURVE 0x15BA24 AblGLKLuw 150 VROT 0 150 FORMAT "%3.0"
 /begin AXIS_DESCR STD_AXIS mMchStPrv_AbsEffMotTor_xdu16 MMOT 4 0 10 FORMAT "%8.5" DEPOSIT ABSOLUTE /end AXIS_DESCR
/end CHARACTERISTIC
/begin CHARACTERISTIC nMchStPrv_BoundRotSpeedMeff_XAU16_5___A "Referenzdrehzahl abhängig vom Wirkmoment" CURVE 0x15BA38 AblGLKLuw 150 VROT 0 150 FORMAT "%3.0"
 /begin AXIS_DESCR STD_AXIS mMchStPrv_AbsEffMotTor_xdu16 MMOT 4 0 10 FORMAT "%8.5" DEPOSIT ABSOLUTE /end AXIS_DESCR
/end CHARACTERISTIC
/begin CHARACTERISTIC nMchStPrv_BoundRotSpeedSWA_XAU16 "Referenzdrehzahl abhängig vom Lenkwinkel" CURVE 0x1514CC AblGLKLuw 150 VROT 0 150 FORMAT "%3.0"
 /begin AXIS_DESCR STD_AXIS wApplI_AbsSteeringAngle_xdu16 SA_10 4 0 10 FORMAT "%8.5" DEPOSIT ABSOLUTE /end AXIS_DESCR
/end CHARACTERISTIC
/begin CHARACTERISTIC nOCC_OccDeadZone_XDU16 "Occ Motorgeschw. Totband" VALUE 0x1506E4 AblGLKWuw 100 VROT 0 100 FORMAT "%3.0" /end CHARACTERISTIC
/begin CHARACTERISTIC ProductionServices_L_Adapter_UseShutdownFlashState_XDB "Produktion Flash State wie bisher oder ohne" VALUE 0x150AFE AblGLKWub 1 ZU0 0 1 FORMAT "%5.3" /end CHARACTERISTIC
/begin CHARACTERISTIC sLka_ActDectChks_XDU8 "LKA bit configured Activation/Deactivation checks" VALUE 0x150B12 AblGLKWub 255 ZU0 0 255 FORMAT "%5.1" /end CHARACTERISTIC
/begin CHARACTERISTIC sLka_ConfigErrorFlag_XDU8 "Configuration of for Errors to transit to Inhibit" VALUE 0x150B13 AblGLKWub 255 ZU0 0 255 FORMAT "%5.1" /end CHARACTERISTIC
/begin CHARACTERISTIC sLka_DrvChkConfig_XDU8 "Driver Intervention configuration to change from same/opposite direction" VALUE 0x150B14 AblGLKWub 1 ZU0 0 1 FORMAT "%5.3" /end CHARACTERISTIC
/begin CHARACTERISTIC sLka_ModeReq_XDU8 "No. of Modes supported by LKA" VALUE 0x150B15 AblGLKWub 254 ZU0 1 255 FORMAT "%5.1" /end CHARACTERISTIC
/begin CHARACTERISTIC sLka_ModeSelect_XDU8 "LKA Mode Selection 0-> Single Interface, 1->Multiple signal selection from CAN" VALUE 0x150B16 AblGLKWub 1 ZU0 0 1 FORMAT "%5.3" /end CHARACTERISTIC
/begin CHARACTERISTIC sMotTorLim_EnableErrorInjection_XDU8 "Freigabe Fehleraufschaltung (Testvariable): 0=aus, 1=Festwertvorgabe, 2=Offsetvorgabe" VALUE 0x150B17 AblGLKWub 2 ZU0 0 2 FORMAT "%5.3" /end CHARACTERISTIC
/begin CHARACTERISTIC sMotTorLim_LimiterSwitch_XDU8 "Begrenzerschalter (0=Begrenzer aktiv[Standard], 1=Begrenzer immer deaktiv)" VALUE 0x150B18 AblGLKWub 1 ZU0 0 1 FORMAT "%5.3" /end CHARACTERISTIC
/begin CHARACTERISTIC sMotTorLim_UseFilterOnDecrLimits_XDU8 "1=PT1-Filterung auf abnehmende upper and lower limits aktiv, 0=Filterung inaktiv" VALUE 0x150B19 AblGLKWub 1 ZU0 0 1 FORMAT "%5.3" /end CHARACTERISTIC
/begin CHARACTERISTIC sMotTorLim_UseSteeringTorqueOffset_XDU8 "Umschalter, für Addition des Handmomentenoffsets zum Handmoment. (1 -> Addiere offset zum TBT, 0 -> nur TBT benutzt)" VALUE 0x150B1A AblGLKWub 1 ZU0 0 1 FORMAT "%5.3" /end CHARACTERISTIC
/begin CHARACTERISTIC sMotTorLim_VibrationOnLimitsSwitch_XDU8 "Reset Rattern am Limit Status (0-> kein Reset/Aufruf ErrHdl, 1-> Reset aktiv/kein Aufruf ErrHdl -> 2-> kein Reset/kein Aufruf ErrHdl, 3 -> Disable Vibration Detection )" VALUE 0x150B1B AblGLKWub 3 ZU0 0 3 FORMAT "%5.3" /end CHARACTERISTIC
/begin CHARACTERISTIC sMotTorLim_VibrationSwitch_XDU8 "Reset Ratter-Status (0-> kein Reset/Aufruf ErrHdl, 1-> Reset aktiv/kein Aufruf ErrHdl -> 2-> kein Reset/kein Aufruf ErrHdl, 3 -> Disable Vibration Detection)" VALUE 0x150B1C AblGLKWub 3 ZU0 0 3 FORMAT "%5.3" /end CHARACTERISTIC
/begin CHARACTERISTIC sRpCorr_ConfigFlagsCorr_XDU8 "Configflags Lenkwinkelkorrektur (bitcodiert): 0-inaktiv, 1-LTCorr aktivierbar, 2-STCorr aktivierbar, 4-TB Verdrehung in DynSteerAng, 8-CheckCalibCntr NVR" VALUE 0x150B1D AblGLKWub 255 ZU0 0 255 FORMAT "%5.1" /end CHARACTERISTIC
/begin CHARACTERISTIC tLdTrk_TimeMaxInTempZone_XDU32 "Maximum value of TimeTempZoneXX. " VALUE 0x14A000 AblGLKWul 7.2E+08 ZU0 0 720000000 FORMAT "%13.3" /end CHARACTERISTIC
/begin CHARACTERISTIC tLka_DriverInterventionTime_XAU16 "" VAL_BLK 0x1507A8 AblGLKWBuw 2500 TIMMS 0 2500 NUMBER 3 FORMAT "%8.3" /end CHARACTERISTIC
/begin CHARACTERISTIC tLka_DrvInterventionTimeCheck_XDU8 "Time to exceed max driver torque before Lka will ramp out" VALUE 0x150B33 AblGLKWub 2500 TIMMS_10 0 2500 FORMAT "%5.0" /end CHARACTERISTIC
/begin CHARACTERISTIC tLka_DrvInterventionTimeChk_XAU16 "" VAL_BLK 0x1507B0 AblGLKWBuw 2500 TIMMS 0 2500 NUMBER 3 FORMAT "%8.3" /end CHARACTERISTIC
/begin CHARACTERISTIC tLka_ErrorTime_XDU16 "" VALUE 0x1507B8 AblGLKWuw 10000 TIMMS 0 10000 FORMAT "%8.2" /end CHARACTERISTIC
/begin CHARACTERISTIC tLka_ExceedTorqueLimitCheck_XDU8 "" VALUE 0x150B34 AblGLKWub 2500 TIMMS_10 0 2500 FORMAT "%5.0" /end CHARACTERISTIC
/begin CHARACTERISTIC tLka_MaxTrqReqTime_XAU8 "Maximum torque request time for different modes" VAL_BLK 0x150B7E AblGLKWBub 240 TIMMS 10 250 NUMBER 3 FORMAT "%5.1" /end CHARACTERISTIC
/begin CHARACTERISTIC tLka_RateLimTime_XAU8 "" VAL_BLK 0x150B81 AblGLKWBub 240 TIMMS 10 250 NUMBER 3 FORMAT "%5.1" /end CHARACTERISTIC
/begin CHARACTERISTIC tLka_VehSpdErrTime_XAU8 "" VAL_BLK 0x150B84 AblGLKWBub 240 TIMMS 10 250 NUMBER 3 FORMAT "%5.1" /end CHARACTERISTIC
/begin CHARACTERISTIC tLowVoltAssRed_UnderVoltageHoldTime_XDU16 "holding time for rejecting an instant rising of assistance torque" VALUE 0x1507BA AblGLKWuw 65 TIMSEC_1000 0 65 FORMAT "%8.5" /end CHARACTERISTIC
/begin CHARACTERISTIC tMchStPrv_HakelPeriodHalf_XDU16_0___A "Zeit in ms für eine halbe Periode für das MchStPrv Moment" VALUE 0x158184 AblGLKWuw 50 ZU0 0 50 FORMAT "%8.5" /end CHARACTERISTIC
/begin CHARACTERISTIC tMchStPrv_HakelPeriodHalf_XDU16_1___A "Zeit in ms für eine halbe Periode für das MchStPrv Moment" VALUE 0x158186 AblGLKWuw 50 ZU0 0 50 FORMAT "%8.5" /end CHARACTERISTIC
/begin CHARACTERISTIC tMchStPrv_HakelPeriodHalf_XDU16_2___A "Zeit in ms für eine halbe Periode für das MchStPrv Moment" VALUE 0x158188 AblGLKWuw 50 ZU0 0 50 FORMAT "%8.5" /end CHARACTERISTIC
/begin CHARACTERISTIC tMchStPrv_HakelPeriodHalf_XDU16_3___A "Zeit in ms für eine halbe Periode für das MchStPrv Moment" VALUE 0x15818A AblGLKWuw 50 ZU0 0 50 FORMAT "%8.5" /end CHARACTERISTIC
/begin CHARACTERISTIC tMchStPrv_HakelPeriodHalf_XDU16_4___A "Zeit in ms für eine halbe Periode für das MchStPrv Moment" VALUE 0x15818C AblGLKWuw 50 ZU0 0 50 FORMAT "%8.5" /end CHARACTERISTIC
/begin CHARACTERISTIC tMchStPrv_HakelPeriodHalf_XDU16_5___A "Zeit in ms für eine halbe Periode für das MchStPrv Moment" VALUE 0x15818E AblGLKWuw 50 ZU0 0 50 FORMAT "%8.5" /end CHARACTERISTIC
/begin CHARACTERISTIC tMotTorLim_DelayToStartReduction_XDU16 "Zeit bis reduziert wird" VALUE 0x1507BC AblGLKWuw 10 TIMSEC_1000 0 10 FORMAT "%8.5" /end CHARACTERISTIC
/begin CHARACTERISTIC tMotTorLim_DiagTime_XDU16 "max Zeit im Prefailed oder Prepassed Status" VALUE 0x1507BE AblGLKWuw 200 TIMMS 0 200 FORMAT "%8.4" /end CHARACTERISTIC
/begin CHARACTERISTIC tMotTorLim_Time2StopGenRotSpeedExp_XDU8 "minimum time to stop the expansion of motor torque limits over generatoric rotor speed" VALUE 0x150B36 AblGLKWub 0.02 TIMSEC_1000 0 0.02 FORMAT "%7.5" /end CHARACTERISTIC
/begin CHARACTERISTIC tMotTorLim_VibrationCycleTime2NextCycle_XDU16 "Maximales Zeitlimit für einen Ratterzyklus" VALUE 0x1507C0 AblGLKWuw 5 TIMSEC_1000 0 5 FORMAT "%8.6" /end CHARACTERISTIC
/begin CHARACTERISTIC tMotTorLim_VibrationOnLimitsCycleTime2NextCycle_XDU16 "Maximales Zeitlimit für einen am Limit Ratterzyklus" VALUE 0x1507C2 AblGLKWuw 5 TIMSEC_1000 0 5 FORMAT "%8.6" /end CHARACTERISTIC
/begin CHARACTERISTIC tPDC_MinTime4Active_XDU8 "Zeit für Übergang in Status Active" VALUE 0x14A0E0 AblGLKWub 2500 TIMMS_10 0 2500 FORMAT "%5.0" /end CHARACTERISTIC
/begin CHARACTERISTIC tPDC_MinTime4BigCrowningChangeDetection_XDU8 "Zeit für das Erkennen einer starken Änderung der Fahrbahnneigung für das Ändern des Integrationsfaktors" VALUE 0x14A0E1 AblGLKWub 2500 TIMMS_10 0 2500 FORMAT "%5.0" /end CHARACTERISTIC
/begin CHARACTERISTIC tPDC_MinTime4CompFrackWrongDetection_XDU16 "Zeit für das Erkennen einer falschen Kompensationszahnstangenkraft für das Herausrampen aus dem Status Hold" VALUE 0x14A07A AblGLKWuw 600000 TIMMS_10 0 600000 FORMAT "%8.1" /end CHARACTERISTIC
/begin CHARACTERISTIC tPDC_MinTime4Hold_XDU8 "Zeit für Übergang in Status Hold" VALUE 0x14A0E2 AblGLKWub 2500 TIMMS_10 0 2500 FORMAT "%5.0" /end CHARACTERISTIC
/begin CHARACTERISTIC tPDC_MinTime4TurnDetection_XDU8 "Zeit für das Erkennen einer Kurve für das Herausrampen aus dem Status Hold" VALUE 0x14A0E3 AblGLKWub 2500 TIMMS_10 0 2500 FORMAT "%5.0" /end CHARACTERISTIC
/begin CHARACTERISTIC tRpCorr_CycleTimeRpCorr_XDU8 "Taskzeit fuer Lenkwinkelkorrektur" VALUE 0x150B3A AblGLKWub 1 TIMSEC_10 0 1 FORMAT "%5.3" /end CHARACTERISTIC
/begin CHARACTERISTIC tRpCorr_DetectionTimerLT_XDU8 "Erkennungszeit fuer Geradeaus in Langzeitkorrektur" VALUE 0x150B3B AblGLKWub 20 TIMSEC_10 0 20 FORMAT "%5.2" /end CHARACTERISTIC
/begin CHARACTERISTIC tRpCorr_DetectionTimerST_XDU8 "Erkennungszeit fuer Geradeaus in Kurzzeitkorrektur" VALUE 0x150B3C AblGLKWub 20 TIMSEC_10 0 20 FORMAT "%5.2" /end CHARACTERISTIC
/begin CHARACTERISTIC tRpCorr_LTimeIntegTime_XDU8 "Nachlaufzeit fuer Langzeitkorrektur beim Verlassen des Lernbereichs" VALUE 0x150B3D AblGLKWub 19 TIMSEC_10 1 20 FORMAT "%5.2" /end CHARACTERISTIC
/begin CHARACTERISTIC uLowVoltAssRed_SubstSupplyVoltage_XDU16 "substitute value in case of invalid SupplyVoltage" VALUE 0x150816 AblGLKWuw 33 U64V 0 33 FORMAT "%8.5" /end CHARACTERISTIC
/begin CHARACTERISTIC vLka_MaxVehicleSpeed_XAU16 "" VAL_BLK 0x150880 AblGLKWBuw 500 VFZHIGH 0 500 NUMBER 3 FORMAT "%8.4" /end CHARACTERISTIC
/begin CHARACTERISTIC vLka_MinVehicleSpeed_XAU16 "" VAL_BLK 0x150888 AblGLKWBuw 500 VFZHIGH 0 500 NUMBER 3 FORMAT "%8.4" /end CHARACTERISTIC
/begin CHARACTERISTIC vLowVoltAssRed_ValidMinSpeed_XDU16 "Min Vehicle speed for Low Volt Assist Reduction Activation to protect against SLoA" VALUE 0x150890 AblGLKWuw 500 VFZHIGH 0 500 FORMAT "%8.4" /end CHARACTERISTIC
/begin CHARACTERISTIC vMchStPrv_MeffV0bound_XDU16_0___A "Umschaltwert für BoundRotSpeedTBTV0 nach BoundRotSpeedTBT" VALUE 0x158198 AblGLKWuw 230 VFZHIGH 0 230 FORMAT "%8.4" /end CHARACTERISTIC
/begin CHARACTERISTIC vMchStPrv_MeffV0bound_XDU16_1___A "Umschaltwert für BoundRotSpeedTBTV0 nach BoundRotSpeedTBT" VALUE 0x15819A AblGLKWuw 230 VFZHIGH 0 230 FORMAT "%8.4" /end CHARACTERISTIC
/begin CHARACTERISTIC vMchStPrv_MeffV0bound_XDU16_2___A "Umschaltwert für BoundRotSpeedTBTV0 nach BoundRotSpeedTBT" VALUE 0x15819C AblGLKWuw 230 VFZHIGH 0 230 FORMAT "%8.4" /end CHARACTERISTIC
/begin CHARACTERISTIC vMchStPrv_MeffV0bound_XDU16_3___A "Umschaltwert für BoundRotSpeedTBTV0 nach BoundRotSpeedTBT" VALUE 0x15819E AblGLKWuw 230 VFZHIGH 0 230 FORMAT "%8.4" /end CHARACTERISTIC
/begin CHARACTERISTIC vMchStPrv_MeffV0bound_XDU16_4___A "Umschaltwert für BoundRotSpeedTBTV0 nach BoundRotSpeedTBT" VALUE 0x1581A0 AblGLKWuw 230 VFZHIGH 0 230 FORMAT "%8.4" /end CHARACTERISTIC
/begin CHARACTERISTIC vMchStPrv_MeffV0bound_XDU16_5___A "Umschaltwert für BoundRotSpeedTBTV0 nach BoundRotSpeedTBT" VALUE 0x1581A2 AblGLKWuw 230 VFZHIGH 0 230 FORMAT "%8.4" /end CHARACTERISTIC
/begin CHARACTERISTIC vPDC_MaxVehicleSpeed4Learn_XDU16 "Maximale Fahrzeuggeschwindigkeit für das Berechnen des Kompensationsmoments" VALUE 0x14A080 AblGLKWuw 500 VFZHIGH 0 500 FORMAT "%8.4" /end CHARACTERISTIC
/begin CHARACTERISTIC vPDC_MaxYawVelocity4Learn_XAU16 "Maximal erlaubte Gierrate beim Lernen (Eingangswert: Fahrzeuggeschwindigkeit)" CURVE 0x14A144 AblGLKLuw 150 VGIER 0 150 FORMAT "%8.4"
 /begin AXIS_DESCR STD_AXIS vApplI_AbsVehicleSpeedFilt_xdu16 VFZHIGH 4 0 500 FORMAT "%8.4" DEPOSIT ABSOLUTE /end AXIS_DESCR
/end CHARACTERISTIC
/begin CHARACTERISTIC vPDC_MaxYawVelocity4Learn_XDU16 "Maximale Gierrate für das Berechnen des Kompensationsmoments" VALUE 0x14A082 AblGLKWuw 150 VGIER 0 150 FORMAT "%8.4" /end CHARACTERISTIC
/begin CHARACTERISTIC vPDC_MinVehicleSpeed4CompFrackWrongDetection_XDU16 "Minimale Fahrzeuggeschwindigkeit für das Erkennen einer falschen Kompensationszahnstangenkraft für das Herausrampen aus dem Status Hold" VALUE 0x14A084 AblGLKWuw 500 VFZHIGH 0 500 FORMAT "%8.4" /end CHARACTERISTIC
/begin CHARACTERISTIC vPDC_MinVehicleSpeed4Learn_XDU16 "Minimale Fahrzeuggeschwindigkeit für das Berechnen der Kompensationszahnstangenkraft" VALUE 0x14A086 AblGLKWuw 500 VFZHIGH 0 500 FORMAT "%8.4" /end CHARACTERISTIC
/begin CHARACTERISTIC vPDC_MinVehicleSpeed4TurnDetection_XDU16 "Minimale Fahrzeuggeschwindigkeit für das Erkennen einer Kurve für das Herausrampen aus dem Status Hold" VALUE 0x14A088 AblGLKWuw 500 VFZHIGH 0 500 FORMAT "%8.4" /end CHARACTERISTIC
/begin CHARACTERISTIC vPDC_MinYawVelocity4TurnDetection_XDU16 "Minimale Gierrate für das Erkennen einer Kurve für das Herausrampen aus dem Status Hold" VALUE 0x14A08A AblGLKWuw 150 VGIER 0 150 FORMAT "%8.4" /end CHARACTERISTIC
/begin CHARACTERISTIC vRpCorr_STMinVehicleSpeed_XDU16 "Schwelle Fahrzeuggeschwindigkeit Kurzzeitkorrektur" VALUE 0x1508A4 AblGLKWuw 255 VFZHIGH 0 255 FORMAT "%8.4" /end CHARACTERISTIC
/begin CHARACTERISTIC vRpCorr_VehicleSpeedWeight_XDU16 "Geschwindigkeit, oberhalb der mit Faktor 1 gelernt wird" VALUE 0x1508A6 AblGLKWuw 240 VFZ 10 250 FORMAT "%8.4" /end CHARACTERISTIC
/begin CHARACTERISTIC wLdTrk_BallNutHysteresisFilterWidth_XDU16 "Filterbreite Hysteresefilter" VALUE 0x14A08C AblGLKWuw 1000 SA_10 0 1000 FORMAT "%8.3" /end CHARACTERISTIC
/begin CHARACTERISTIC wLdTrk_MaxDeltaRotPos_XDU16 "DeltaRotPos-Schwellwert zw. zwei Extrema, damit neues Extrema als Rototorisch eingestuft wird" VALUE 0x1508F8 AblGLKWuw 5000.01 ROTPOS 0 5000.01 FORMAT "%8.3" /end CHARACTERISTIC
/begin CHARACTERISTIC wLdTrk_MaxSteeringRange_XDU16 "Maximum Steering Range till Mechanical EndStops" VALUE 0x14A08E AblGLKWuw 999 SA_10 1 1000 FORMAT "%8.3" /end CHARACTERISTIC
/begin CHARACTERISTIC wPDC_MaxSteeringAngle4Learn_XDU16 "Maximaler Lenkwinkel für das Berechnen der Kompensationszahnstangenkraft" VALUE 0x14A090 AblGLKWuw 100 SA_10 0 100 FORMAT "%8.4" /end CHARACTERISTIC
/begin CHARACTERISTIC wPDC_MinSteeringAngle4TurnDetection_XDU16 "Minimaler Lenkwinkel für das Erkennen einer Kurve für das Herausrampen aus dem Status Hold" VALUE 0x14A092 AblGLKWuw 100 SA_10 0 100 FORMAT "%8.4" /end CHARACTERISTIC
/begin CHARACTERISTIC wRackForce_MaxMotVelFric_XDU16 "Grenze der Rotorgeschwindigkeit für vollständige Aktivierung der Reibungskompensation [°/s]" VALUE 0x14A094 AblGLKWuw 999 SAS 1 1000 FORMAT "%8.3" /end CHARACTERISTIC
/begin CHARACTERISTIC wRpCorr_LTACompIntegRange_XDU16 "Arbeitsbereich Langzeitkorrektur" VALUE 0x15090E AblGLKWuw 600 ANGLE_1 0 600 FORMAT "%8.4" /end CHARACTERISTIC
/begin CHARACTERISTIC wRpCorr_LTACompMaxAngle_XDU16 "max. Korrekturwinkel Langzeitkorrektur bzgl. Rotor" VALUE 0x150910 AblGLKWuw 600 ANGLE_1 0 600 FORMAT "%8.4" /end CHARACTERISTIC
/begin CHARACTERISTIC wRpCorr_Resolution_XDU16 "Resolution Adjustments for slow learning or learning only significant changes" VALUE 0x150B52 AblGLKWub 254 ANGLE_1 1 255 FORMAT "%5.1" /end CHARACTERISTIC
/begin CHARACTERISTIC wRpCorr_STACompIntegRange_XDU16 "Arbeitsbereich Kurzzeitkorrektur (unkorrigierter Rotorwinkel)" VALUE 0x150912 AblGLKWuw 600 ANGLE_1 0 600 FORMAT "%8.4" /end CHARACTERISTIC
/begin CHARACTERISTIC wRpCorr_STACompMaxAngle_XDU16 "max. Korrekturwinkel Kurzzeitkorrektur; Begrenzung des korr. Rotorwinkels und Integrals" VALUE 0x150914 AblGLKWuw 600 ANGLE_1 0 600 FORMAT "%8.4" /end CHARACTERISTIC
/begin CHARACTERISTIC xLdTrk_BallNutMMotFilterFact_XDU16 "Filter Faktor fur Motormoment - BallNutGear" VALUE 0x14A098 AblGLKWuw 0.999023 RIGHTSH10NP 0.0009765625 1 FORMAT "%8.6" /end CHARACTERISTIC
/begin CHARACTERISTIC xLdTrk_FilterFactMMOTGenMech_XDU16 "Filter Faktor Motormoment" VALUE 0x14A09A AblGLKWuw 0.999023 RIGHTSH10NP 0.0009765625 1 FORMAT "%8.6" /end CHARACTERISTIC
/begin CHARACTERISTIC xLdTrk_FilterFactTempWorm_XDU16 "Filterfaktor zum Filtern der Schneckenradtemperatur" VALUE 0x1509E8 AblGLKWuw 0.999985 RIGHTSH16NP 0 0.9999847 FORMAT "%9.7" /end CHARACTERISTIC
/begin CHARACTERISTIC xLdTrk_GradLine_XDU16 "Steigung a der Geraden zum Berechnen der Schneckenradtemperatur" VALUE 0x1509EA AblGLKWuw 1 RIGHTSH10NP 0 1 FORMAT "%8.6" /end CHARACTERISTIC
/begin CHARACTERISTIC xLdTrk_LoadFactor_XDF32 "Load Factor For BallNutGear" VALUE 0x14A010 AblGLKWfl4 9.9E-06 FLOAT 1E-07 1E-05 FORMAT "%21.19" /end CHARACTERISTIC
/begin CHARACTERISTIC xLdTrk_MeanStressSensitivityGenMech_XDF32 "Generiert: Mittelspannungsempfindlichkeit" VALUE 0x14A014 AblGLKWfl4 0.499 FLOAT 0 0.499 FORMAT "%17.15" /end CHARACTERISTIC
/begin CHARACTERISTIC xLdTrk_MeanStressSensitivityImp_XDF32 "Mittelspannungsempfindlichkeit für Impact Damage" VALUE 0x14A018 AblGLKWfl4 0.499 FLOAT 0 0.499 FORMAT "%17.15" /end CHARACTERISTIC
/begin CHARACTERISTIC xLdTrk_MeanStressSensitivityRot_XDF32 "Mittelspannungsempfindlichkeit" VALUE 0x14A01C AblGLKWfl4 0.499 FLOAT 0 0.499 FORMAT "%17.15" /end CHARACTERISTIC
/begin CHARACTERISTIC xLdTrk_TransmissionWormGear_XDU16 "Uebersetzung i des Schneckenradgetriebes" VALUE 0x1509F0 AblGLKWuw 1 ZU0 20 21 FORMAT "%8.5" /end CHARACTERISTIC
/begin CHARACTERISTIC xLka_ActDampFact_XDU16 "Active damping factor for LKA" VALUE 0x1509FA AblGLKWuw 1 RIGHTSH10NP 0 1 FORMAT "%8.6" /end CHARACTERISTIC
/begin CHARACTERISTIC xLka_ActRetFuncFact_XDU16 "Active return function factor for LKA" VALUE 0x1509FC AblGLKWuw 1 RIGHTSH10NP 0 1 FORMAT "%8.6" /end CHARACTERISTIC
/begin CHARACTERISTIC xLka_ActRetSpeedFact_XDU16 "Active return speed factor for LKA" VALUE 0x1509FE AblGLKWuw 1 RIGHTSH10NP 0 1 FORMAT "%8.6" /end CHARACTERISTIC
/begin CHARACTERISTIC xLowVoltAssRed_NegativeMotorTorqueGradient_XDU16 "negative motor torque reduction level" VALUE 0x150A00 AblGLKWuw 1 RIGHTSH15NP_1MS 0 1 FORMAT "%8.6" /end CHARACTERISTIC
/begin CHARACTERISTIC xLowVoltAssRed_NegGradCompressMotorChar_XDU16 "negative gradient of compressing motor characterisic curve" VALUE 0x150A02 AblGLKWuw 1 RIGHTSH15NP_1MS 0 1 FORMAT "%8.6" /end CHARACTERISTIC
/begin CHARACTERISTIC xLowVoltAssRed_NegRedGradMotorTorqueGrad_XDU16 "negative motor torque gradient limit" VALUE 0x150A04 AblGLKWuw 1 RIGHTSH15NP_1MS 0 1 FORMAT "%8.6" /end CHARACTERISTIC
/begin CHARACTERISTIC xLowVoltAssRed_PosGradCompressMotorChar_XDU16 "positive gradient of compressing motor characterisic curve" VALUE 0x150A06 AblGLKWuw 0.00100708 RIGHTSH15NP_1MS 0 0.00100708 FORMAT "%11.9" /end CHARACTERISTIC
/begin CHARACTERISTIC xLowVoltAssRed_PositiveMotorTorqueGradient_XDU16 "positive  motor torque reduction level" VALUE 0x150A08 AblGLKWuw 0.00100708 RIGHTSH15NP_1MS 0 0.00100708 FORMAT "%11.9" /end CHARACTERISTIC
/begin CHARACTERISTIC xLowVoltAssRed_PosRedGradMotorTorqueGrad_XDU16 "positive motor torque gradient limit" VALUE 0x150A0A AblGLKWuw 0.00100708 RIGHTSH15NP_1MS 0 0.00100708 FORMAT "%11.9" /end CHARACTERISTIC
/begin CHARACTERISTIC xLowVoltAssRed_UnderVoltageMotorCharTorqueAxis_XAU16 "compression motor characteristic curve" CURVE 0x151874 AblGLKLuw 1 RIGHTSH15NP 0 1 FORMAT "%8.6"
 /begin AXIS_DESCR STD_AXIS uLowVoltAssRed_SupplyVoltage_xdu16 U64V 4 0 33 FORMAT "%8.5" DEPOSIT ABSOLUTE /end AXIS_DESCR
/end CHARACTERISTIC
/begin CHARACTERISTIC xLowVoltAssRed_UnderVoltageReductionLevel_XAU16 "reduction motor torque due to under voltage" CURVE 0x151888 AblGLKLuw 1 RIGHTSH15NP 0 1 FORMAT "%8.6"
 /begin AXIS_DESCR STD_AXIS uLowVoltAssRed_SupplyVoltage_xdu16 U64V 4 0 33 FORMAT "%8.5" DEPOSIT ABSOLUTE /end AXIS_DESCR
/end CHARACTERISTIC
/begin CHARACTERISTIC xLowVoltAssRed_UnderVoltageTorqueReductionGradient_XAU16 "reduction motor torque gradient due to under voltage" CURVE 0x15189C AblGLKLuw 1 RIGHTSH15NP 0 1 FORMAT "%8.6"
 /begin AXIS_DESCR STD_AXIS uLowVoltAssRed_SupplyVoltage_xdu16 U64V 2 0 33 FORMAT "%8.5" DEPOSIT ABSOLUTE /end AXIS_DESCR
/end CHARACTERISTIC
/begin CHARACTERISTIC xMchStPrv_GradTBTFilterFact_XDU16 "Filterfaktor auf Gradienten des TBT" VALUE 0x150A0C AblGLKWuw 0.999023 RIGHTSH10NP 0.0009765625 1 FORMAT "%8.6" /end CHARACTERISTIC
/begin CHARACTERISTIC xMchStPrv_GroundLevelFactHakel_XDU16 "Faktor auf die MchStPrv Amplitude für Grundniveau das immer aufgeschaltet wird" VALUE 0x150A0E AblGLKWuw 1 RIGHTSH15NP 0 1 FORMAT "%8.6" /end CHARACTERISTIC
/begin CHARACTERISTIC xMchStPrv_GroundLevelHakelAngle_XAU16 "Faktor auf Grundnieveau der Antihakelamplitude abhängig vom Lenkwinkel" CURVE 0x1518A8 AblGLKLuw 1 RIGHTSH15NP 0 1 FORMAT "%8.6"
 /begin AXIS_DESCR STD_AXIS wApplI_AbsSteeringAngle_xdu16 SA_10 4 0 500 FORMAT "%8.4" DEPOSIT ABSOLUTE /end AXIS_DESCR
/end CHARACTERISTIC
/begin CHARACTERISTIC xMchStPrv_GroundLevelHakelVFZFactor_XAU16 "Faktor auf Grundniveau der MchStPrv Amplitude abhängig von der Fahrzeuggeschwindigkeit" CURVE 0x1518BC AblGLKLuw 1 RIGHTSH15NP 0 1 FORMAT "%8.6"
 /begin AXIS_DESCR STD_AXIS vApplI_AbsVehicleSpeedFilt_xdu16 VFZHIGH 4 0 250 FORMAT "%8.4" DEPOSIT ABSOLUTE /end AXIS_DESCR
/end CHARACTERISTIC
/begin CHARACTERISTIC xMchStPrv_HakelGrad_XDU16 "Gradient zum Einrampen des MchStPrv Momentes" VALUE 0x150A10 AblGLKWuw 1 RIGHTSH15NP 0 1 FORMAT "%8.6" /end CHARACTERISTIC
/begin CHARACTERISTIC xMchStPrv_MaxActDepSteeringAngle_XAU16_0___A "Maximale Aktivierung in Abhängigkeit des Lenkwinkels" CURVE 0x15EC74 AblGLKLuw 1 RIGHTSH15NP 0 1 FORMAT "%8.6"
 /begin AXIS_DESCR STD_AXIS wApplI_AbsSteeringAngle_xdu16 SA_10 3 0 600 FORMAT "%8.4" DEPOSIT ABSOLUTE /end AXIS_DESCR
/end CHARACTERISTIC
/begin CHARACTERISTIC xMchStPrv_MaxActDepSteeringAngle_XAU16_1___A "Maximale Aktivierung in Abhängigkeit des Lenkwinkels" CURVE 0x15EC84 AblGLKLuw 1 RIGHTSH15NP 0 1 FORMAT "%8.6"
 /begin AXIS_DESCR STD_AXIS wApplI_AbsSteeringAngle_xdu16 SA_10 3 0 600 FORMAT "%8.4" DEPOSIT ABSOLUTE /end AXIS_DESCR
/end CHARACTERISTIC
/begin CHARACTERISTIC xMchStPrv_MaxActDepSteeringAngle_XAU16_2___A "Maximale Aktivierung in Abhängigkeit des Lenkwinkels" CURVE 0x15EC94 AblGLKLuw 1 RIGHTSH15NP 0 1 FORMAT "%8.6"
 /begin AXIS_DESCR STD_AXIS wApplI_AbsSteeringAngle_xdu16 SA_10 3 0 600 FORMAT "%8.4" DEPOSIT ABSOLUTE /end AXIS_DESCR
/end CHARACTERISTIC
/begin CHARACTERISTIC xMchStPrv_MaxActDepSteeringAngle_XAU16_3___A "Maximale Aktivierung in Abhängigkeit des Lenkwinkels" CURVE 0x15ECA4 AblGLKLuw 1 RIGHTSH15NP 0 1 FORMAT "%8.6"
 /begin AXIS_DESCR STD_AXIS wApplI_AbsSteeringAngle_xdu16 SA_10 3 0 600 FORMAT "%8.4" DEPOSIT ABSOLUTE /end AXIS_DESCR
/end CHARACTERISTIC
/begin CHARACTERISTIC xMchStPrv_MaxActDepSteeringAngle_XAU16_4___A "Maximale Aktivierung in Abhängigkeit des Lenkwinkels" CURVE 0x15ECB4 AblGLKLuw 1 RIGHTSH15NP 0 1 FORMAT "%8.6"
 /begin AXIS_DESCR STD_AXIS wApplI_AbsSteeringAngle_xdu16 SA_10 3 0 600 FORMAT "%8.4" DEPOSIT ABSOLUTE /end AXIS_DESCR
/end CHARACTERISTIC
/begin CHARACTERISTIC xMchStPrv_MaxActDepSteeringAngle_XAU16_5___A "Maximale Aktivierung in Abhängigkeit des Lenkwinkels" CURVE 0x15ECC4 AblGLKLuw 1 RIGHTSH15NP 0 1 FORMAT "%8.6"
 /begin AXIS_DESCR STD_AXIS wApplI_AbsSteeringAngle_xdu16 SA_10 3 0 600 FORMAT "%8.4" DEPOSIT ABSOLUTE /end AXIS_DESCR
/end CHARACTERISTIC
/begin CHARACTERISTIC xMchStPrv_MaxActDepVFZ_XAU16_0___A "Maximale Aktivierung in Abhängigkeit der Fahrzeugeschwindigkeit" CURVE 0x15ECD4 AblGLKLuw 1 RIGHTSH15NP 0 1 FORMAT "%8.6"
 /begin AXIS_DESCR STD_AXIS vApplI_AbsVehicleSpeedFilt_xdu16 VFZHIGH 4 0 250 FORMAT "%8.4" DEPOSIT ABSOLUTE /end AXIS_DESCR
/end CHARACTERISTIC
/begin CHARACTERISTIC xMchStPrv_MaxActDepVFZ_XAU16_1___A "Maximale Aktivierung in Abhängigkeit der Fahrzeugeschwindigkeit" CURVE 0x15ECE8 AblGLKLuw 1 RIGHTSH15NP 0 1 FORMAT "%8.6"
 /begin AXIS_DESCR STD_AXIS vApplI_AbsVehicleSpeedFilt_xdu16 VFZHIGH 4 0 250 FORMAT "%8.4" DEPOSIT ABSOLUTE /end AXIS_DESCR
/end CHARACTERISTIC
/begin CHARACTERISTIC xMchStPrv_MaxActDepVFZ_XAU16_2___A "Maximale Aktivierung in Abhängigkeit der Fahrzeugeschwindigkeit" CURVE 0x15ECFC AblGLKLuw 1 RIGHTSH15NP 0 1 FORMAT "%8.6"
 /begin AXIS_DESCR STD_AXIS vApplI_AbsVehicleSpeedFilt_xdu16 VFZHIGH 4 0 250 FORMAT "%8.4" DEPOSIT ABSOLUTE /end AXIS_DESCR
/end CHARACTERISTIC
/begin CHARACTERISTIC xMchStPrv_MaxActDepVFZ_XAU16_3___A "Maximale Aktivierung in Abhängigkeit der Fahrzeugeschwindigkeit" CURVE 0x15ED10 AblGLKLuw 1 RIGHTSH15NP 0 1 FORMAT "%8.6"
 /begin AXIS_DESCR STD_AXIS vApplI_AbsVehicleSpeedFilt_xdu16 VFZHIGH 4 0 250 FORMAT "%8.4" DEPOSIT ABSOLUTE /end AXIS_DESCR
/end CHARACTERISTIC
/begin CHARACTERISTIC xMchStPrv_MaxActDepVFZ_XAU16_4___A "Maximale Aktivierung in Abhängigkeit der Fahrzeugeschwindigkeit" CURVE 0x15ED24 AblGLKLuw 1 RIGHTSH15NP 0 1 FORMAT "%8.6"
 /begin AXIS_DESCR STD_AXIS vApplI_AbsVehicleSpeedFilt_xdu16 VFZHIGH 4 0 250 FORMAT "%8.4" DEPOSIT ABSOLUTE /end AXIS_DESCR
/end CHARACTERISTIC
/begin CHARACTERISTIC xMchStPrv_MaxActDepVFZ_XAU16_5___A "Maximale Aktivierung in Abhängigkeit der Fahrzeugeschwindigkeit" CURVE 0x15ED38 AblGLKLuw 1 RIGHTSH15NP 0 1 FORMAT "%8.6"
 /begin AXIS_DESCR STD_AXIS vApplI_AbsVehicleSpeedFilt_xdu16 VFZHIGH 4 0 250 FORMAT "%8.4" DEPOSIT ABSOLUTE /end AXIS_DESCR
/end CHARACTERISTIC
/begin CHARACTERISTIC xMchStPrv_RotSpeedRefVFZFactor_XAU16 "Faktor auf Referenzdrehzahl abhängig von der Fahrzeuggeschwindigkeit" CURVE 0x1518D0 AblGLKLuw 1 RIGHTSH10NP 0 1 FORMAT "%8.6"
 /begin AXIS_DESCR STD_AXIS vApplI_AbsVehicleSpeedFilt_xdu16 VFZHIGH 4 0 250 FORMAT "%8.4" DEPOSIT ABSOLUTE /end AXIS_DESCR
/end CHARACTERISTIC
/begin CHARACTERISTIC xMotTorLim_FactExpandLimitsDepOnTbt_XAS16_0___A "Handmomentenabhängiger Faktor auf den erlaubten Motormomentenoffset" CURVE 0x15ED4C AblGLKLsw 1.90039 RIGHTSH10NP 0.09960938 2 FORMAT "%8.6"
 /begin AXIS_DESCR STD_AXIS mMotTorLim_TorsionBarTorque_xds16 TBTHIGH 7 -25 25 FORMAT "%8.5" DEPOSIT ABSOLUTE /end AXIS_DESCR
/end CHARACTERISTIC
/begin CHARACTERISTIC xMotTorLim_FactExpandLimitsDepOnTbt_XAS16_1___A "Handmomentenabhängiger Faktor auf den erlaubten Motormomentenoffset" CURVE 0x15ED6C AblGLKLsw 1.90039 RIGHTSH10NP 0.09960938 2 FORMAT "%8.6"
 /begin AXIS_DESCR STD_AXIS mMotTorLim_TorsionBarTorque_xds16 TBTHIGH 7 -25 25 FORMAT "%8.5" DEPOSIT ABSOLUTE /end AXIS_DESCR
/end CHARACTERISTIC
/begin CHARACTERISTIC xMotTorLim_FactExpandLimitsDepOnTbt_XAS16_2___A "Handmomentenabhängiger Faktor auf den erlaubten Motormomentenoffset" CURVE 0x15ED8C AblGLKLsw 1.90039 RIGHTSH10NP 0.09960938 2 FORMAT "%8.6"
 /begin AXIS_DESCR STD_AXIS mMotTorLim_TorsionBarTorque_xds16 TBTHIGH 7 -25 25 FORMAT "%8.5" DEPOSIT ABSOLUTE /end AXIS_DESCR
/end CHARACTERISTIC
/begin CHARACTERISTIC xMotTorLim_FactExpandLimitsDepOnTbt_XAS16_3___A "Handmomentenabhängiger Faktor auf den erlaubten Motormomentenoffset" CURVE 0x15EDAC AblGLKLsw 1.90039 RIGHTSH10NP 0.09960938 2 FORMAT "%8.6"
 /begin AXIS_DESCR STD_AXIS mMotTorLim_TorsionBarTorque_xds16 TBTHIGH 7 -25 25 FORMAT "%8.5" DEPOSIT ABSOLUTE /end AXIS_DESCR
/end CHARACTERISTIC
/begin CHARACTERISTIC xMotTorLim_FactExpandLimitsDepOnTbt_XAS16_4___A "Handmomentenabhängiger Faktor auf den erlaubten Motormomentenoffset" CURVE 0x15EDCC AblGLKLsw 1.90039 RIGHTSH10NP 0.09960938 2 FORMAT "%8.6"
 /begin AXIS_DESCR STD_AXIS mMotTorLim_TorsionBarTorque_xds16 TBTHIGH 7 -25 25 FORMAT "%8.5" DEPOSIT ABSOLUTE /end AXIS_DESCR
/end CHARACTERISTIC
/begin CHARACTERISTIC xMotTorLim_FactExpandLimitsDepOnTbt_XAS16_5___A "Handmomentenabhängiger Faktor auf den erlaubten Motormomentenoffset" CURVE 0x15EDEC AblGLKLsw 1.90039 RIGHTSH10NP 0.09960938 2 FORMAT "%8.6"
 /begin AXIS_DESCR STD_AXIS mMotTorLim_TorsionBarTorque_xds16 TBTHIGH 7 -25 25 FORMAT "%8.5" DEPOSIT ABSOLUTE /end AXIS_DESCR
/end CHARACTERISTIC
/begin CHARACTERISTIC xMotTorLim_FadeDepOnIntegrator_XAU16 "Steilheit des Fadingfaktors (1. Stützstelle so wählen, um Level-2-Abschalter zu vermeiden)" CURVE 0x1518E4 AblGLKLuw 1 RIGHTSH15NP 0 1 FORMAT "%8.6"
 /begin AXIS_DESCR STD_AXIS xMotTorLimI_WeightedIntegratedDeviation_xdu16 RIGHTSH15NP 3 0 1 FORMAT "%8.6" DEPOSIT ABSOLUTE /end AXIS_DESCR
/end CHARACTERISTIC
/begin CHARACTERISTIC xMotTorLim_FilterFactorOnDecrLimits_XDU16 "Filter Faktor des PT1-Filters für abnehmende upper and lower Limits" VALUE 0x150A12 AblGLKWuw 0.0898438 RIGHTSH10NP 0.009765625 0.09960938 FORMAT "%9.7" /end CHARACTERISTIC
/begin CHARACTERISTIC xMotTorLim_Grad4RedRampDown_XAU16 "Reduktionsgradient runterrampen [Faktor/ms]" CURVE 0x1518F4 AblGLKLuw 1 RIGHTSH15NP 0 1 FORMAT "%8.6"
 /begin AXIS_DESCR STD_AXIS xMotTorLim_ReductionLevel_xdu16 RIGHTSH15NP 3 0 1 FORMAT "%8.6" DEPOSIT ABSOLUTE /end AXIS_DESCR
/end CHARACTERISTIC
/begin CHARACTERISTIC xMotTorLim_Grad4RedRampUp_XAU16 "Reduktionsgradient hochrampen [Faktor/ms]" CURVE 0x151904 AblGLKLuw 0.999817 RIGHTSH15NP 0.0001831055 1 FORMAT "%8.6"
 /begin AXIS_DESCR STD_AXIS xMotTorLim_ReductionLevel_xdu16 RIGHTSH15NP 3 0 1 FORMAT "%8.6" DEPOSIT ABSOLUTE /end AXIS_DESCR
/end CHARACTERISTIC
/begin CHARACTERISTIC xMotTorLim_Integ2StopFilterOnDecrLimits_XDU16 "kleinster Wert der gewichteten, aufintegrierte Motormomentenabweichung um die PT1-Filterung auf abnehmende upper and lower limits zu stoppen" VALUE 0x150A14 AblGLKWuw 0.98999 RIGHTSH15NP 0 0.9899902 FORMAT "%9.7" /end CHARACTERISTIC
/begin CHARACTERISTIC xMotTorLim_Integ2StopGenRotSpeedExp_XDU16 "minimum weighted integrated deviation to stop the expansion of motor torque limits over generatoric rotor speed" VALUE 0x150A16 AblGLKWuw 0.98999 RIGHTSH15NP 0 0.9899902 FORMAT "%9.7" /end CHARACTERISTIC
/begin CHARACTERISTIC xMotTorLim_L2FactExpandLimitsDepOnTbt_XAF32_0___A "L2 Handmomentenabhängiger Faktor auf den erlaubten Motormomentenoffset" CURVE 0x1587AC AblGLKLfl4 1.9 ZU0 0.1 2 FORMAT "%10.8"
 /begin AXIS_DESCR STD_AXIS mMotTorLim_L2TorsionBarTorque_xdf32 ZU0 7 -25 25 FORMAT "%10.7" DEPOSIT ABSOLUTE /end AXIS_DESCR
/end CHARACTERISTIC
/begin CHARACTERISTIC xMotTorLim_L2FactExpandLimitsDepOnTbt_XAF32_1___A "L2 Handmomentenabhängiger Faktor auf den erlaubten Motormomentenoffset" CURVE 0x1587E8 AblGLKLfl4 1.9 ZU0 0.1 2 FORMAT "%10.8"
 /begin AXIS_DESCR STD_AXIS mMotTorLim_L2TorsionBarTorque_xdf32 ZU0 7 -25 25 FORMAT "%10.7" DEPOSIT ABSOLUTE /end AXIS_DESCR
/end CHARACTERISTIC
/begin CHARACTERISTIC xMotTorLim_L2FactExpandLimitsDepOnTbt_XAF32_2___A "L2 Handmomentenabhängiger Faktor auf den erlaubten Motormomentenoffset" CURVE 0x158824 AblGLKLfl4 1.9 ZU0 0.1 2 FORMAT "%10.8"
 /begin AXIS_DESCR STD_AXIS mMotTorLim_L2TorsionBarTorque_xdf32 ZU0 7 -25 25 FORMAT "%10.7" DEPOSIT ABSOLUTE /end AXIS_DESCR
/end CHARACTERISTIC
/begin CHARACTERISTIC xMotTorLim_L2FactExpandLimitsDepOnTbt_XAF32_3___A "L2 Handmomentenabhängiger Faktor auf den erlaubten Motormomentenoffset" CURVE 0x158860 AblGLKLfl4 1.9 ZU0 0.1 2 FORMAT "%10.8"
 /begin AXIS_DESCR STD_AXIS mMotTorLim_L2TorsionBarTorque_xdf32 ZU0 7 -25 25 FORMAT "%10.7" DEPOSIT ABSOLUTE /end AXIS_DESCR
/end CHARACTERISTIC
/begin CHARACTERISTIC xMotTorLim_L2FactExpandLimitsDepOnTbt_XAF32_4___A "L2 Handmomentenabhängiger Faktor auf den erlaubten Motormomentenoffset" CURVE 0x15889C AblGLKLfl4 1.9 ZU0 0.1 2 FORMAT "%10.8"
 /begin AXIS_DESCR STD_AXIS mMotTorLim_L2TorsionBarTorque_xdf32 ZU0 7 -25 25 FORMAT "%10.7" DEPOSIT ABSOLUTE /end AXIS_DESCR
/end CHARACTERISTIC
/begin CHARACTERISTIC xMotTorLim_L2FactExpandLimitsDepOnTbt_XAF32_5___A "L2 Handmomentenabhängiger Faktor auf den erlaubten Motormomentenoffset" CURVE 0x1588D8 AblGLKLfl4 1.9 ZU0 0.1 2 FORMAT "%10.8"
 /begin AXIS_DESCR STD_AXIS mMotTorLim_L2TorsionBarTorque_xdf32 ZU0 7 -25 25 FORMAT "%10.7" DEPOSIT ABSOLUTE /end AXIS_DESCR
/end CHARACTERISTIC
/begin CHARACTERISTIC xMotTorLim_LowestReductionLevel_XDU16 "kleinster, erlaubter Reduzierungsfaktor" VALUE 0x150A18 AblGLKWuw 1 RIGHTSH15NP 0 1 FORMAT "%8.6" /end CHARACTERISTIC
/begin CHARACTERISTIC xMotTorLim_PreFailedRedLvl_XDU16 "Reduzierunglevel zwischen mApplI_NominalMotorTorque und mMotTorLimI_ValidatedMotorTorque bevor es in State Prefailed geht" VALUE 0x150A1A AblGLKWuw 1 RIGHTSH15NP 0 1 FORMAT "%8.6" /end CHARACTERISTIC
/begin CHARACTERISTIC xMotTorLim_PrePassedRedLvl_XDU16 "Reduzierunglevel zwischen mApplI_NominalMotorTorque und mMotTorLimI_ValidatedMotorTorque bevor es in State Prepassed geht" VALUE 0x150A1C AblGLKWuw 1 RIGHTSH15NP 0 1 FORMAT "%8.6" /end CHARACTERISTIC
/begin CHARACTERISTIC xMotTorLim_VibrationCycleGrad4RampDown_XDU16 "Reduktionsgradient bei erkannter Vibration[Faktor/ms]" CURVE 0x151914 AblGLKLuw 0.999817 RIGHTSH15NP 0.0001831055 1 FORMAT "%8.6"
 /begin AXIS_DESCR STD_AXIS xMotTorLim_ReductionLevel_xdu16 RIGHTSH15NP 3 0 1 FORMAT "%8.6" DEPOSIT ABSOLUTE /end AXIS_DESCR
/end CHARACTERISTIC
/begin CHARACTERISTIC xMotTorLim_VibrationOnLimitsMinDeviation_XDU16 "Weighted integrated deviation Threshold for vibration detection at limitation" VALUE 0x150A1E AblGLKWuw 0.98999 RIGHTSH15NP 0 0.9899902 FORMAT "%9.7" /end CHARACTERISTIC
/begin CHARACTERISTIC xMotTorLim_WeightIntDevForRampToAssist_XDU16 "Gewichtete, aufintegrierte Motormomentenabweichungsgrenze um auf die Assistkennlinie zu rampen" VALUE 0x150A20 AblGLKWuw 1 RIGHTSH15NP 0 1 FORMAT "%8.6" /end CHARACTERISTIC
/begin CHARACTERISTIC xOCC_OccFilterFactor_XDU16 "Occ Filter Faktor" VALUE 0x150A22 AblGLKWuw 1 RIGHTSH10NP 0 1 FORMAT "%8.6" /end CHARACTERISTIC
/begin CHARACTERISTIC xOCC_OccScalBaseFric_XAU16_00___A "Occ geschw. abhaengiger Skallierungsfaktor der Grund Reibung" CURVE 0x15EE0C AblGLKLuw 1 RIGHTSH4NP 0 1 FORMAT "%8.6"
 /begin AXIS_DESCR STD_AXIS vApplI_AbsVehicleSpeedFilt_xdu16 VFZHIGH 7 0 400 FORMAT "%8.4" DEPOSIT ABSOLUTE /end AXIS_DESCR
/end CHARACTERISTIC
/begin CHARACTERISTIC xOCC_OccScalBaseFric_XAU16_01___A "Occ geschw. abhaengiger Skallierungsfaktor der Grund Reibung" CURVE 0x15EE2C AblGLKLuw 1 RIGHTSH4NP 0 1 FORMAT "%8.6"
 /begin AXIS_DESCR STD_AXIS vApplI_AbsVehicleSpeedFilt_xdu16 VFZHIGH 7 0 400 FORMAT "%8.4" DEPOSIT ABSOLUTE /end AXIS_DESCR
/end CHARACTERISTIC
/begin CHARACTERISTIC xOCC_OccScalBaseFric_XAU16_02___A "Occ geschw. abhaengiger Skallierungsfaktor der Grund Reibung" CURVE 0x15EE4C AblGLKLuw 1 RIGHTSH4NP 0 1 FORMAT "%8.6"
 /begin AXIS_DESCR STD_AXIS vApplI_AbsVehicleSpeedFilt_xdu16 VFZHIGH 7 0 400 FORMAT "%8.4" DEPOSIT ABSOLUTE /end AXIS_DESCR
/end CHARACTERISTIC
/begin CHARACTERISTIC xOCC_OccScalBaseFric_XAU16_03___A "Occ geschw. abhaengiger Skallierungsfaktor der Grund Reibung" CURVE 0x15EE6C AblGLKLuw 1 RIGHTSH4NP 0 1 FORMAT "%8.6"
 /begin AXIS_DESCR STD_AXIS vApplI_AbsVehicleSpeedFilt_xdu16 VFZHIGH 7 0 400 FORMAT "%8.4" DEPOSIT ABSOLUTE /end AXIS_DESCR
/end CHARACTERISTIC
/begin CHARACTERISTIC xOCC_OccScalBaseFric_XAU16_04___A "Occ geschw. abhaengiger Skallierungsfaktor der Grund Reibung" CURVE 0x15EE8C AblGLKLuw 1 RIGHTSH4NP 0 1 FORMAT "%8.6"
 /begin AXIS_DESCR STD_AXIS vApplI_AbsVehicleSpeedFilt_xdu16 VFZHIGH 7 0 400 FORMAT "%8.4" DEPOSIT ABSOLUTE /end AXIS_DESCR
/end CHARACTERISTIC
/begin CHARACTERISTIC xOCC_OccScalBaseFric_XAU16_05___A "Occ geschw. abhaengiger Skallierungsfaktor der Grund Reibung" CURVE 0x15EEAC AblGLKLuw 1 RIGHTSH4NP 0 1 FORMAT "%8.6"
 /begin AXIS_DESCR STD_AXIS vApplI_AbsVehicleSpeedFilt_xdu16 VFZHIGH 7 0 400 FORMAT "%8.4" DEPOSIT ABSOLUTE /end AXIS_DESCR
/end CHARACTERISTIC
/begin CHARACTERISTIC xOCC_OccScalBaseFric_XAU16_06___A "Occ geschw. abhaengiger Skallierungsfaktor der Grund Reibung" CURVE 0x15EECC AblGLKLuw 1 RIGHTSH4NP 0 1 FORMAT "%8.6"
 /begin AXIS_DESCR STD_AXIS vApplI_AbsVehicleSpeedFilt_xdu16 VFZHIGH 7 0 400 FORMAT "%8.4" DEPOSIT ABSOLUTE /end AXIS_DESCR
/end CHARACTERISTIC
/begin CHARACTERISTIC xOCC_OccScalBaseFric_XAU16_07___A "Occ geschw. abhaengiger Skallierungsfaktor der Grund Reibung" CURVE 0x15EEEC AblGLKLuw 1 RIGHTSH4NP 0 1 FORMAT "%8.6"
 /begin AXIS_DESCR STD_AXIS vApplI_AbsVehicleSpeedFilt_xdu16 VFZHIGH 7 0 400 FORMAT "%8.4" DEPOSIT ABSOLUTE /end AXIS_DESCR
/end CHARACTERISTIC
/begin CHARACTERISTIC xOCC_OccScalBaseFric_XAU16_08___A "Occ geschw. abhaengiger Skallierungsfaktor der Grund Reibung" CURVE 0x15EF0C AblGLKLuw 1 RIGHTSH4NP 0 1 FORMAT "%8.6"
 /begin AXIS_DESCR STD_AXIS vApplI_AbsVehicleSpeedFilt_xdu16 VFZHIGH 7 0 400 FORMAT "%8.4" DEPOSIT ABSOLUTE /end AXIS_DESCR
/end CHARACTERISTIC
/begin CHARACTERISTIC xOCC_OccScalBaseFric_XAU16_09___A "Occ geschw. abhaengiger Skallierungsfaktor der Grund Reibung" CURVE 0x15EF2C AblGLKLuw 1 RIGHTSH4NP 0 1 FORMAT "%8.6"
 /begin AXIS_DESCR STD_AXIS vApplI_AbsVehicleSpeedFilt_xdu16 VFZHIGH 7 0 400 FORMAT "%8.4" DEPOSIT ABSOLUTE /end AXIS_DESCR
/end CHARACTERISTIC
/begin CHARACTERISTIC xOCC_OccScalBaseFric_XAU16_10___A "Occ geschw. abhaengiger Skallierungsfaktor der Grund Reibung" CURVE 0x15EF4C AblGLKLuw 1 RIGHTSH4NP 0 1 FORMAT "%8.6"
 /begin AXIS_DESCR STD_AXIS vApplI_AbsVehicleSpeedFilt_xdu16 VFZHIGH 7 0 400 FORMAT "%8.4" DEPOSIT ABSOLUTE /end AXIS_DESCR
/end CHARACTERISTIC
/begin CHARACTERISTIC xOCC_OccScalBaseFric_XAU16_11___A "Occ geschw. abhaengiger Skallierungsfaktor der Grund Reibung" CURVE 0x15EF6C AblGLKLuw 1 RIGHTSH4NP 0 1 FORMAT "%8.6"
 /begin AXIS_DESCR STD_AXIS vApplI_AbsVehicleSpeedFilt_xdu16 VFZHIGH 7 0 400 FORMAT "%8.4" DEPOSIT ABSOLUTE /end AXIS_DESCR
/end CHARACTERISTIC
/begin CHARACTERISTIC xOCC_OccScalBaseFric_XAU16_12___A "Occ geschw. abhaengiger Skallierungsfaktor der Grund Reibung" CURVE 0x15EF8C AblGLKLuw 1 RIGHTSH4NP 0 1 FORMAT "%8.6"
 /begin AXIS_DESCR STD_AXIS vApplI_AbsVehicleSpeedFilt_xdu16 VFZHIGH 7 0 400 FORMAT "%8.4" DEPOSIT ABSOLUTE /end AXIS_DESCR
/end CHARACTERISTIC
/begin CHARACTERISTIC xOCC_OccScalBaseFric_XAU16_13___A "Occ geschw. abhaengiger Skallierungsfaktor der Grund Reibung" CURVE 0x15EFAC AblGLKLuw 1 RIGHTSH4NP 0 1 FORMAT "%8.6"
 /begin AXIS_DESCR STD_AXIS vApplI_AbsVehicleSpeedFilt_xdu16 VFZHIGH 7 0 400 FORMAT "%8.4" DEPOSIT ABSOLUTE /end AXIS_DESCR
/end CHARACTERISTIC
/begin CHARACTERISTIC xOCC_OccScalBaseFric_XAU16_14___A "Occ geschw. abhaengiger Skallierungsfaktor der Grund Reibung" CURVE 0x15EFCC AblGLKLuw 1 RIGHTSH4NP 0 1 FORMAT "%8.6"
 /begin AXIS_DESCR STD_AXIS vApplI_AbsVehicleSpeedFilt_xdu16 VFZHIGH 7 0 400 FORMAT "%8.4" DEPOSIT ABSOLUTE /end AXIS_DESCR
/end CHARACTERISTIC
/begin CHARACTERISTIC xOCC_OccScalBaseFric_XAU16_15___A "Occ geschw. abhaengiger Skallierungsfaktor der Grund Reibung" CURVE 0x15EFEC AblGLKLuw 1 RIGHTSH4NP 0 1 FORMAT "%8.6"
 /begin AXIS_DESCR STD_AXIS vApplI_AbsVehicleSpeedFilt_xdu16 VFZHIGH 7 0 400 FORMAT "%8.4" DEPOSIT ABSOLUTE /end AXIS_DESCR
/end CHARACTERISTIC
/begin CHARACTERISTIC xOCC_OccScalBaseFric_XAU16_16___A "Occ geschw. abhaengiger Skallierungsfaktor der Grund Reibung" CURVE 0x15F00C AblGLKLuw 1 RIGHTSH4NP 0 1 FORMAT "%8.6"
 /begin AXIS_DESCR STD_AXIS vApplI_AbsVehicleSpeedFilt_xdu16 VFZHIGH 7 0 400 FORMAT "%8.4" DEPOSIT ABSOLUTE /end AXIS_DESCR
/end CHARACTERISTIC
/begin CHARACTERISTIC xOCC_OccScalBaseFric_XAU16_17___A "Occ geschw. abhaengiger Skallierungsfaktor der Grund Reibung" CURVE 0x15F02C AblGLKLuw 1 RIGHTSH4NP 0 1 FORMAT "%8.6"
 /begin AXIS_DESCR STD_AXIS vApplI_AbsVehicleSpeedFilt_xdu16 VFZHIGH 7 0 400 FORMAT "%8.4" DEPOSIT ABSOLUTE /end AXIS_DESCR
/end CHARACTERISTIC
/begin CHARACTERISTIC xOCC_OccScalBaseFric_XAU16_18___A "Occ geschw. abhaengiger Skallierungsfaktor der Grund Reibung" CURVE 0x15F04C AblGLKLuw 1 RIGHTSH4NP 0 1 FORMAT "%8.6"
 /begin AXIS_DESCR STD_AXIS vApplI_AbsVehicleSpeedFilt_xdu16 VFZHIGH 7 0 400 FORMAT "%8.4" DEPOSIT ABSOLUTE /end AXIS_DESCR
/end CHARACTERISTIC
/begin CHARACTERISTIC xOCC_OccScalBaseFric_XAU16_19___A "Occ geschw. abhaengiger Skallierungsfaktor der Grund Reibung" CURVE 0x15F06C AblGLKLuw 1 RIGHTSH4NP 0 1 FORMAT "%8.6"
 /begin AXIS_DESCR STD_AXIS vApplI_AbsVehicleSpeedFilt_xdu16 VFZHIGH 7 0 400 FORMAT "%8.4" DEPOSIT ABSOLUTE /end AXIS_DESCR
/end CHARACTERISTIC
/begin CHARACTERISTIC xOCC_OccScalBaseFric_XAU16_20___A "Occ geschw. abhaengiger Skallierungsfaktor der Grund Reibung" CURVE 0x15F08C AblGLKLuw 1 RIGHTSH4NP 0 1 FORMAT "%8.6"
 /begin AXIS_DESCR STD_AXIS vApplI_AbsVehicleSpeedFilt_xdu16 VFZHIGH 7 0 400 FORMAT "%8.4" DEPOSIT ABSOLUTE /end AXIS_DESCR
/end CHARACTERISTIC
/begin CHARACTERISTIC xOCC_OccScalBaseFric_XAU16_21___A "Occ geschw. abhaengiger Skallierungsfaktor der Grund Reibung" CURVE 0x15F0AC AblGLKLuw 1 RIGHTSH4NP 0 1 FORMAT "%8.6"
 /begin AXIS_DESCR STD_AXIS vApplI_AbsVehicleSpeedFilt_xdu16 VFZHIGH 7 0 400 FORMAT "%8.4" DEPOSIT ABSOLUTE /end AXIS_DESCR
/end CHARACTERISTIC
/begin CHARACTERISTIC xOCC_OccScalBaseFric_XAU16_22___A "Occ geschw. abhaengiger Skallierungsfaktor der Grund Reibung" CURVE 0x15F0CC AblGLKLuw 1 RIGHTSH4NP 0 1 FORMAT "%8.6"
 /begin AXIS_DESCR STD_AXIS vApplI_AbsVehicleSpeedFilt_xdu16 VFZHIGH 7 0 400 FORMAT "%8.4" DEPOSIT ABSOLUTE /end AXIS_DESCR
/end CHARACTERISTIC
/begin CHARACTERISTIC xOCC_OccScalBaseFric_XAU16_23___A "Occ geschw. abhaengiger Skallierungsfaktor der Grund Reibung" CURVE 0x15F0EC AblGLKLuw 1 RIGHTSH4NP 0 1 FORMAT "%8.6"
 /begin AXIS_DESCR STD_AXIS vApplI_AbsVehicleSpeedFilt_xdu16 VFZHIGH 7 0 400 FORMAT "%8.4" DEPOSIT ABSOLUTE /end AXIS_DESCR
/end CHARACTERISTIC
/begin CHARACTERISTIC xOCC_OccScalBaseFric_XAU16_24___A "Occ geschw. abhaengiger Skallierungsfaktor der Grund Reibung" CURVE 0x15F10C AblGLKLuw 1 RIGHTSH4NP 0 1 FORMAT "%8.6"
 /begin AXIS_DESCR STD_AXIS vApplI_AbsVehicleSpeedFilt_xdu16 VFZHIGH 7 0 400 FORMAT "%8.4" DEPOSIT ABSOLUTE /end AXIS_DESCR
/end CHARACTERISTIC
/begin CHARACTERISTIC xOCC_OccScalBaseFric_XAU16_25___A "Occ geschw. abhaengiger Skallierungsfaktor der Grund Reibung" CURVE 0x15F12C AblGLKLuw 1 RIGHTSH4NP 0 1 FORMAT "%8.6"
 /begin AXIS_DESCR STD_AXIS vApplI_AbsVehicleSpeedFilt_xdu16 VFZHIGH 7 0 400 FORMAT "%8.4" DEPOSIT ABSOLUTE /end AXIS_DESCR
/end CHARACTERISTIC
/begin CHARACTERISTIC xOCC_OccScalBaseFric_XAU16_26___A "Occ geschw. abhaengiger Skallierungsfaktor der Grund Reibung" CURVE 0x15F14C AblGLKLuw 1 RIGHTSH4NP 0 1 FORMAT "%8.6"
 /begin AXIS_DESCR STD_AXIS vApplI_AbsVehicleSpeedFilt_xdu16 VFZHIGH 7 0 400 FORMAT "%8.4" DEPOSIT ABSOLUTE /end AXIS_DESCR
/end CHARACTERISTIC
/begin CHARACTERISTIC xOCC_OccScalBaseFric_XAU16_27___A "Occ geschw. abhaengiger Skallierungsfaktor der Grund Reibung" CURVE 0x15F16C AblGLKLuw 1 RIGHTSH4NP 0 1 FORMAT "%8.6"
 /begin AXIS_DESCR STD_AXIS vApplI_AbsVehicleSpeedFilt_xdu16 VFZHIGH 7 0 400 FORMAT "%8.4" DEPOSIT ABSOLUTE /end AXIS_DESCR
/end CHARACTERISTIC
/begin CHARACTERISTIC xOCC_OccScalBaseFric_XAU16_28___A "Occ geschw. abhaengiger Skallierungsfaktor der Grund Reibung" CURVE 0x15F18C AblGLKLuw 1 RIGHTSH4NP 0 1 FORMAT "%8.6"
 /begin AXIS_DESCR STD_AXIS vApplI_AbsVehicleSpeedFilt_xdu16 VFZHIGH 7 0 400 FORMAT "%8.4" DEPOSIT ABSOLUTE /end AXIS_DESCR
/end CHARACTERISTIC
/begin CHARACTERISTIC xOCC_OccScalBaseFric_XAU16_29___A "Occ geschw. abhaengiger Skallierungsfaktor der Grund Reibung" CURVE 0x15F1AC AblGLKLuw 1 RIGHTSH4NP 0 1 FORMAT "%8.6"
 /begin AXIS_DESCR STD_AXIS vApplI_AbsVehicleSpeedFilt_xdu16 VFZHIGH 7 0 400 FORMAT "%8.4" DEPOSIT ABSOLUTE /end AXIS_DESCR
/end CHARACTERISTIC
/begin CHARACTERISTIC xOCC_OccScalBaseFric_XAU16_30___A "Occ geschw. abhaengiger Skallierungsfaktor der Grund Reibung" CURVE 0x15F1CC AblGLKLuw 1 RIGHTSH4NP 0 1 FORMAT "%8.6"
 /begin AXIS_DESCR STD_AXIS vApplI_AbsVehicleSpeedFilt_xdu16 VFZHIGH 7 0 400 FORMAT "%8.4" DEPOSIT ABSOLUTE /end AXIS_DESCR
/end CHARACTERISTIC
/begin CHARACTERISTIC xOCC_OccScalBaseFric_XAU16_31___A "Occ geschw. abhaengiger Skallierungsfaktor der Grund Reibung" CURVE 0x15F1EC AblGLKLuw 1 RIGHTSH4NP 0 1 FORMAT "%8.6"
 /begin AXIS_DESCR STD_AXIS vApplI_AbsVehicleSpeedFilt_xdu16 VFZHIGH 7 0 400 FORMAT "%8.4" DEPOSIT ABSOLUTE /end AXIS_DESCR
/end CHARACTERISTIC
/begin CHARACTERISTIC xOCC_OccScalBaseFric_XAU16_32___A "Occ geschw. abhaengiger Skallierungsfaktor der Grund Reibung" CURVE 0x15F20C AblGLKLuw 1 RIGHTSH4NP 0 1 FORMAT "%8.6"
 /begin AXIS_DESCR STD_AXIS vApplI_AbsVehicleSpeedFilt_xdu16 VFZHIGH 7 0 400 FORMAT "%8.4" DEPOSIT ABSOLUTE /end AXIS_DESCR
/end CHARACTERISTIC
/begin CHARACTERISTIC xOCC_OccScalBaseFric_XAU16_33___A "Occ geschw. abhaengiger Skallierungsfaktor der Grund Reibung" CURVE 0x15F22C AblGLKLuw 1 RIGHTSH4NP 0 1 FORMAT "%8.6"
 /begin AXIS_DESCR STD_AXIS vApplI_AbsVehicleSpeedFilt_xdu16 VFZHIGH 7 0 400 FORMAT "%8.4" DEPOSIT ABSOLUTE /end AXIS_DESCR
/end CHARACTERISTIC
/begin CHARACTERISTIC xOCC_OccScalBaseFric_XAU16_34___A "Occ geschw. abhaengiger Skallierungsfaktor der Grund Reibung" CURVE 0x15F24C AblGLKLuw 1 RIGHTSH4NP 0 1 FORMAT "%8.6"
 /begin AXIS_DESCR STD_AXIS vApplI_AbsVehicleSpeedFilt_xdu16 VFZHIGH 7 0 400 FORMAT "%8.4" DEPOSIT ABSOLUTE /end AXIS_DESCR
/end CHARACTERISTIC
/begin CHARACTERISTIC xOCC_OccScalBaseFric_XAU16_35___A "Occ geschw. abhaengiger Skallierungsfaktor der Grund Reibung" CURVE 0x15F26C AblGLKLuw 1 RIGHTSH4NP 0 1 FORMAT "%8.6"
 /begin AXIS_DESCR STD_AXIS vApplI_AbsVehicleSpeedFilt_xdu16 VFZHIGH 7 0 400 FORMAT "%8.4" DEPOSIT ABSOLUTE /end AXIS_DESCR
/end CHARACTERISTIC
/begin CHARACTERISTIC xOvSt_ActDampingFactorDepOnDegOversteer_XAU16 "Faktor auf Aktive Daempfung abhaengig von aufbereitetem Uebersteuersignal" CURVE 0x151924 AblGLKLuw 1 RIGHTSH15NP 0 1 FORMAT "%8.6"
 /begin AXIS_DESCR STD_AXIS xOvSt_DegreeOfOversteerFilt_xdu16 RIGHTSH15NP 2 0 1 FORMAT "%8.6" DEPOSIT ABSOLUTE /end AXIS_DESCR
/end CHARACTERISTIC
/begin CHARACTERISTIC xOvSt_ActivateOversteer_XDU8 "Aktivierung fahrphysikalischen Ruecklaufanpassung" VALUE 0x150B56 AblGLKWub 1 ZU0 0 1 FORMAT "%5.3" /end CHARACTERISTIC
/begin CHARACTERISTIC xOvSt_ActRetFuncFactorDepOnDegOversteer_XAU16 "Faktor auf Aktiven Ruecklauf abhaengig von aufbereitetem Uebersteuersignal. Wird auch verwendet für Ueberblenden auf Uebersteuer-Ruecklauf (1-x)" CURVE 0x151930 AblGLKLuw 1 RIGHTSH15NP 0 1 FORMAT "%8.6"
 /begin AXIS_DESCR STD_AXIS xOvSt_DegreeOfOversteerFilt_xdu16 RIGHTSH15NP 2 0 1 FORMAT "%8.6" DEPOSIT ABSOLUTE /end AXIS_DESCR
/end CHARACTERISTIC
/begin CHARACTERISTIC xOvSt_BankedCurveDZOffset_XDU16 "Offset auf Todzone ?bersteuergrad in Steilkurven" VALUE 0x150A24 AblGLKWuw 1 RIGHTSH10NP 0 1 FORMAT "%8.6" /end CHARACTERISTIC
/begin CHARACTERISTIC xOvSt_BlendLiftingForceFact_XAU16 "Einblenden der Hubkraftkompensation in Abhaengigkeit der Gierrate [°/s] beim Lenken in Richtung Endanschlag [%/100]" CURVE 0x15193C AblGLKLuw 1 RIGHTSH10NP 0 1 FORMAT "%8.6"
 /begin AXIS_DESCR STD_AXIS vOvSt_AbsYawVelocity_xdu16 RIGHTSH5NP 9 0 20 FORMAT "%8.5" DEPOSIT ABSOLUTE /end AXIS_DESCR
/end CHARACTERISTIC
/begin CHARACTERISTIC xOvSt_FilterFactOversteer_XDU16 "Abtastschritte für Uebersteuergrad" VALUE 0x150A26 AblGLKWuw 0.999023 RIGHTSH10NP 0.0009765625 1 FORMAT "%8.6" /end CHARACTERISTIC
/begin CHARACTERISTIC xOvSt_FilterFactSAS_XDU16 "Filter-Faktor Lenkgeschwindigkeit" VALUE 0x150A28 AblGLKWuw 0.999023 RIGHTSH10NP 0.0009765625 1 FORMAT "%8.6" /end CHARACTERISTIC
/begin CHARACTERISTIC xOvSt_FilterFactSideSlipVel_XDU16 "Filter-Faktor Schwimmwinkelgeschwindigkeit" VALUE 0x150A2A AblGLKWuw 0.999023 RIGHTSH10NP 0.0009765625 1 FORMAT "%8.6" /end CHARACTERISTIC
/begin CHARACTERISTIC xOvSt_FilterFactTBT_XDU16 "Filter-Faktor Drehstabmoment" VALUE 0x150A2C AblGLKWuw 0.999023 RIGHTSH10NP 0.0009765625 1 FORMAT "%8.6" /end CHARACTERISTIC
/begin CHARACTERISTIC xOvSt_LiftingForceOnVelocityFact_XAU16 "Skalierung der Hubkraft in Abhaengigkeit der Fahrzeuggeschwindigkeit [%/100]" CURVE 0x151964 AblGLKLuw 1 RIGHTSH10NP 0 1 FORMAT "%8.6"
 /begin AXIS_DESCR STD_AXIS vVehSpI_AbsAvgVehSpd_xdu16 VFZHIGH 4 0 500 FORMAT "%8.4" DEPOSIT ABSOLUTE /end AXIS_DESCR
/end CHARACTERISTIC
/begin CHARACTERISTIC xOvSt_RampDownGradDepOnSideSlipVel_XAU16 "max. neg. Gradient fuer den Uebersteuergrad" CURVE 0x151978 AblGLKLuw 1 RIGHTSH15NP 0 1 FORMAT "%8.6"
 /begin AXIS_DESCR STD_AXIS vOvSt_AbsSideSlipVelocityFilt_xdu16 RIGHTSH10NP 5 0 50 FORMAT "%8.5" DEPOSIT ABSOLUTE /end AXIS_DESCR
/end CHARACTERISTIC
/begin CHARACTERISTIC xOvSt_RetSpeedOnSideSlipVelocityFact_XAU16 "Faktor Lenkradwinkelgeschwindigkeit in Abhaengigkeit der Schwimmwinkelgeschwindigkeit (->Faktor*Lenkuebersetzung)" CURVE 0x151990 AblGLKLuw 2 RIGHTSH10NP 0 2 FORMAT "%8.6"
 /begin AXIS_DESCR STD_AXIS vOvSt_AbsSideSlipVelocityFilt_xdu16 RIGHTSH10NP 7 0 50 FORMAT "%8.5" DEPOSIT ABSOLUTE /end AXIS_DESCR
/end CHARACTERISTIC
/begin CHARACTERISTIC xOvSt_TbtDepCtrlAmpFact_XAU16 "Faktor Regelverstaerkung abhaengig von Handmoment ohne Lenkradtraegheit" CURVE 0x1519B0 AblGLKLuw 2 RIGHTSH10NP 0 2 FORMAT "%8.6"
 /begin AXIS_DESCR STD_AXIS mOvSt_FiltAbsDriverTorque_xdu16 TBTHIGH 10 0 8 FORMAT "%8.6" DEPOSIT ABSOLUTE /end AXIS_DESCR
/end CHARACTERISTIC
/begin CHARACTERISTIC xOvSt_VelDepCtrlAmpFact_XAF32 "Faktor Regelverstaerkung abhaengig von der Fahrzeuggeschwindigkeit [*1000]" CURVE 0x150E4C AblGLKLfl4 5 FLOAT 0 5 FORMAT "%16.14"
 /begin AXIS_DESCR STD_AXIS vOvStI_AbsVehicleSpeedFilt_xdf32 FLOAT 6 0 250 FORMAT "%16.12" DEPOSIT ABSOLUTE /end AXIS_DESCR
/end CHARACTERISTIC
/begin CHARACTERISTIC xPDC_CompFrackFactor_XAU16 "Faktor für die berechnete Kompensationszahnstangenkraft (Eingangswert: Fahrzeuggeschwindigkeit)" CURVE 0x14A158 AblGLKLuw 1 RIGHTSH15NP 0 1 FORMAT "%8.6"
 /begin AXIS_DESCR STD_AXIS vApplI_AbsVehicleSpeedFilt_xdu16 VFZHIGH 4 0 500 FORMAT "%8.4" DEPOSIT ABSOLUTE /end AXIS_DESCR
/end CHARACTERISTIC
/begin CHARACTERISTIC xPDC_FastIntegrationFactorShortTerm_XDU16_0___A "Schneller Filterfaktor des Kurzzeit-Integrators (Filterfaktor = Abtastrate / Zeitkonstante);scaling:2^-22-->2^-20" VALUE 0x1582E8 AblGLKWuw 0.0624991 RIGHTSH20NP 0 0.06249905 FORMAT "%10.8" /end CHARACTERISTIC
/begin CHARACTERISTIC xPDC_FastIntegrationFactorShortTerm_XDU16_1___A "Schneller Filterfaktor des Kurzzeit-Integrators (Filterfaktor = Abtastrate / Zeitkonstante);scaling:2^-22-->2^-20" VALUE 0x1582EA AblGLKWuw 0.0624991 RIGHTSH20NP 0 0.06249905 FORMAT "%10.8" /end CHARACTERISTIC
/begin CHARACTERISTIC xPDC_FastIntegrationFactorShortTerm_XDU16_2___A "Schneller Filterfaktor des Kurzzeit-Integrators (Filterfaktor = Abtastrate / Zeitkonstante);scaling:2^-22-->2^-20" VALUE 0x1582EC AblGLKWuw 0.0624991 RIGHTSH20NP 0 0.06249905 FORMAT "%10.8" /end CHARACTERISTIC
/begin CHARACTERISTIC xPDC_FastIntegrationFactorShortTerm_XDU16_3___A "Schneller Filterfaktor des Kurzzeit-Integrators (Filterfaktor = Abtastrate / Zeitkonstante);scaling:2^-22-->2^-20" VALUE 0x1582EE AblGLKWuw 0.0624991 RIGHTSH20NP 0 0.06249905 FORMAT "%10.8" /end CHARACTERISTIC
/begin CHARACTERISTIC xPDC_FastIntegrationFactorShortTerm_XDU16_4___A "Schneller Filterfaktor des Kurzzeit-Integrators (Filterfaktor = Abtastrate / Zeitkonstante);scaling:2^-22-->2^-20" VALUE 0x1582F0 AblGLKWuw 0.0624991 RIGHTSH20NP 0 0.06249905 FORMAT "%10.8" /end CHARACTERISTIC
/begin CHARACTERISTIC xPDC_FastIntegrationFactorShortTerm_XDU16_5___A "Schneller Filterfaktor des Kurzzeit-Integrators (Filterfaktor = Abtastrate / Zeitkonstante);scaling:2^-22-->2^-20" VALUE 0x1582F2 AblGLKWuw 0.0624991 RIGHTSH20NP 0 0.06249905 FORMAT "%10.8" /end CHARACTERISTIC
/begin CHARACTERISTIC xPDC_IntegrationFactorLongTerm_XDU16_0___A "Filterfaktor des Langzeit-Integrators (Filterfaktor = Abtastrate / Zeitkonstante);scaling:2^-22-->2^-20" VALUE 0x1582F4 AblGLKWuw 0.0624991 RIGHTSH20NP 0 0.06249905 FORMAT "%10.8" /end CHARACTERISTIC
/begin CHARACTERISTIC xPDC_IntegrationFactorLongTerm_XDU16_1___A "Filterfaktor des Langzeit-Integrators (Filterfaktor = Abtastrate / Zeitkonstante);scaling:2^-22-->2^-20" VALUE 0x1582F6 AblGLKWuw 0.0624991 RIGHTSH20NP 0 0.06249905 FORMAT "%10.8" /end CHARACTERISTIC
/begin CHARACTERISTIC xPDC_IntegrationFactorLongTerm_XDU16_2___A "Filterfaktor des Langzeit-Integrators (Filterfaktor = Abtastrate / Zeitkonstante);scaling:2^-22-->2^-20" VALUE 0x1582F8 AblGLKWuw 0.0624991 RIGHTSH20NP 0 0.06249905 FORMAT "%10.8" /end CHARACTERISTIC
/begin CHARACTERISTIC xPDC_IntegrationFactorLongTerm_XDU16_3___A "Filterfaktor des Langzeit-Integrators (Filterfaktor = Abtastrate / Zeitkonstante);scaling:2^-22-->2^-20" VALUE 0x1582FA AblGLKWuw 0.0624991 RIGHTSH20NP 0 0.06249905 FORMAT "%10.8" /end CHARACTERISTIC
/begin CHARACTERISTIC xPDC_IntegrationFactorLongTerm_XDU16_4___A "Filterfaktor des Langzeit-Integrators (Filterfaktor = Abtastrate / Zeitkonstante);scaling:2^-22-->2^-20" VALUE 0x1582FC AblGLKWuw 0.0624991 RIGHTSH20NP 0 0.06249905 FORMAT "%10.8" /end CHARACTERISTIC
/begin CHARACTERISTIC xPDC_IntegrationFactorLongTerm_XDU16_5___A "Filterfaktor des Langzeit-Integrators (Filterfaktor = Abtastrate / Zeitkonstante);scaling:2^-22-->2^-20" VALUE 0x1582FE AblGLKWuw 0.0624991 RIGHTSH20NP 0 0.06249905 FORMAT "%10.8" /end CHARACTERISTIC
/begin CHARACTERISTIC xPDC_NormalIntegrationFactorShortTerm_XDU16_0___A "Normaler Filterfaktor des Kurzzeit-Integrators (Filterfaktor = Abtastrate / Zeitkonstante);scaling:2^-22-->2^-20" VALUE 0x158300 AblGLKWuw 0.0624991 RIGHTSH20NP 0 0.06249905 FORMAT "%10.8" /end CHARACTERISTIC
/begin CHARACTERISTIC xPDC_NormalIntegrationFactorShortTerm_XDU16_1___A "Normaler Filterfaktor des Kurzzeit-Integrators (Filterfaktor = Abtastrate / Zeitkonstante);scaling:2^-22-->2^-20" VALUE 0x158302 AblGLKWuw 0.0624991 RIGHTSH20NP 0 0.06249905 FORMAT "%10.8" /end CHARACTERISTIC
/begin CHARACTERISTIC xPDC_NormalIntegrationFactorShortTerm_XDU16_2___A "Normaler Filterfaktor des Kurzzeit-Integrators (Filterfaktor = Abtastrate / Zeitkonstante);scaling:2^-22-->2^-20" VALUE 0x158304 AblGLKWuw 0.0624991 RIGHTSH20NP 0 0.06249905 FORMAT "%10.8" /end CHARACTERISTIC
/begin CHARACTERISTIC xPDC_NormalIntegrationFactorShortTerm_XDU16_3___A "Normaler Filterfaktor des Kurzzeit-Integrators (Filterfaktor = Abtastrate / Zeitkonstante);scaling:2^-22-->2^-20" VALUE 0x158306 AblGLKWuw 0.0624991 RIGHTSH20NP 0 0.06249905 FORMAT "%10.8" /end CHARACTERISTIC
/begin CHARACTERISTIC xPDC_NormalIntegrationFactorShortTerm_XDU16_4___A "Normaler Filterfaktor des Kurzzeit-Integrators (Filterfaktor = Abtastrate / Zeitkonstante);scaling:2^-22-->2^-20" VALUE 0x158308 AblGLKWuw 0.0624991 RIGHTSH20NP 0 0.06249905 FORMAT "%10.8" /end CHARACTERISTIC
/begin CHARACTERISTIC xPDC_NormalIntegrationFactorShortTerm_XDU16_5___A "Normaler Filterfaktor des Kurzzeit-Integrators (Filterfaktor = Abtastrate / Zeitkonstante);scaling:2^-22-->2^-20" VALUE 0x15830A AblGLKWuw 0.0624991 RIGHTSH20NP 0 0.06249905 FORMAT "%10.8" /end CHARACTERISTIC
/begin CHARACTERISTIC xPDC_PT1FilterFactorTorsionBarTorque_XDU16 "Filterfaktor des PT1-Filters für Drehstabmoment(Filter Faktor = 2 * pi * Knickfrequenz * Abtastrate)" VALUE 0x14A0A4 AblGLKWuw 0.999023 RIGHTSH10NP 0.0009765625 1 FORMAT "%8.6" /end CHARACTERISTIC
/begin CHARACTERISTIC xPDC_PT1FilterFactorVehicleAcceleration_XDU16 "Filterfaktor des PT1-Filters für Fahrzeugbeschleunigung (Filter Faktor = 2 * pi * Knickfrequenz * Abtastrate)" VALUE 0x14A0A6 AblGLKWuw 0.999023 RIGHTSH10NP 0.0009765625 1 FORMAT "%8.6" /end CHARACTERISTIC
/begin CHARACTERISTIC xPDC_PT1FilterFactorYawVelocity_XDU16 "Filterfaktor des PT1-Filters für Gierrate (Filter Faktor = 2 * pi * Knickfrequenz * Abtastrate)" VALUE 0x14A0A8 AblGLKWuw 0.999023 RIGHTSH10NP 0.0009765625 1 FORMAT "%8.6" /end CHARACTERISTIC
/begin CHARACTERISTIC xRackForce_FricFilterFact_XDU16 "Filterfaktor der Reibungskompensation" VALUE 0x14A0AA AblGLKWuw 0.999023 RIGHTSH12NP 0.0009765625 1 FORMAT "%8.6" /end CHARACTERISTIC
/begin CHARACTERISTIC xRackForce_Ginv_N1_XDF32 "FIR-Filter Koeffizient N1" VALUE 0x14A020 AblGLKWfl4 10000 FLOAT -5000 5000 FORMAT "%16.11" /end CHARACTERISTIC
/begin CHARACTERISTIC xRackForce_Ginv_N2_XDF32 "FIR-Filter Koeffizient N2" VALUE 0x14A024 AblGLKWfl4 10000 FLOAT -5000 5000 FORMAT "%16.11" /end CHARACTERISTIC
/begin CHARACTERISTIC xRackForce_Ginv_N3_XDF32 "FIR-Filter Koeffizient N3" VALUE 0x14A028 AblGLKWfl4 10000 FLOAT -5000 5000 FORMAT "%16.11" /end CHARACTERISTIC
/begin CHARACTERISTIC xRackForce_LoadFactor_XDU16 "Lastfaktor for friction compensation [Nm/Nm]" VALUE 0x14A0AC AblGLKWuw 1 RIGHTSH10NP 0 1 FORMAT "%8.6" /end CHARACTERISTIC
/begin CHARACTERISTIC xRackForce_MMOTFilterFact_XDU16 "Filterfaktor 1 und 2 des Motormoments" VALUE 0x14A0AE AblGLKWuw 0.999023 RIGHTSH12NP 0.0009765625 1 FORMAT "%8.6" /end CHARACTERISTIC
/begin CHARACTERISTIC xRackForce_RotAccFilterFact_XDU16 "Filterfaktor 1 und 2 der Rotorbeschleunigung" VALUE 0x14A0B0 AblGLKWuw 0.999023 RIGHTSH12NP 0.0009765625 1 FORMAT "%8.6" /end CHARACTERISTIC
/begin CHARACTERISTIC xRackForce_TBTFilterFact_XDU16 "Filterfaktor 1 und 2 des Drehstabmoments" VALUE 0x14A0B2 AblGLKWuw 0.999023 RIGHTSH12NP 0.0009765625 1 FORMAT "%8.6" /end CHARACTERISTIC
/begin CHARACTERISTIC xRpCorr_LTACompIntegFactor_XDU16 "Integrationsfaktor Langzeitkorrektur" VALUE 0x150A38 AblGLKWuw 0.0209961 RIGHTSH16NP 0 0.02099609 FORMAT "%10.8" /end CHARACTERISTIC
/begin CHARACTERISTIC xRpCorr_STIntegrationFactor_XDU16 "Integrationsfaktor Kurzzeitkorrektur; Lerngeschwindigkeit" VALUE 0x150A3A AblGLKWuw 0.899994 RIGHTSH16NP 0 0.8999939 FORMAT "%9.7" /end CHARACTERISTIC
/begin CHARACTERISTIC yErrInjectionLocalSwitchDummy_XDU8 "Dieser Schalter hat keine Funktion. Dummy für fehlenden Übergabeparameter bei Damos-Größen die per fault injection stimuliert werden können." VALUE 0x150B5A AblGLKWub 1 ZU0 0 1 FORMAT "%5.3" /end CHARACTERISTIC
/begin CHARACTERISTIC yLdTrk_DamageTabGenMech_XAF32 "Generiert: Schaedigungs-Kennlinie Generic Mechanical Load Tracker" VAL_BLK 0x151B74 AblGLKWBfl4 1E+21 FLOAT 0 1E+21 NUMBER 120 FORMAT "%16.0" /end CHARACTERISTIC
/begin CHARACTERISTIC yLdTrk_DamageTabWormImp_XAF32 "Generiert: Impact Damage Schaedigungs-Kennlinie in LoadTracking" VAL_BLK 0x151D54 AblGLKWBfl4 1.4E+11 FLOAT 0 140000000000 NUMBER 200 FORMAT "%16.3" /end CHARACTERISTIC
/begin CHARACTERISTIC yLdTrk_DamageTabWormRot_XAF32 "Generiert: rotatorische Schaedigungs-Kennlinie in LoadTracking" VAL_BLK 0x152074 AblGLKWBfl4 9E+12 FLOAT 0 9E+12 NUMBER 120 FORMAT "%16.2" /end CHARACTERISTIC
/begin CHARACTERISTIC yLdTrk_MaxLoopCountGenMech_XDU8 "Max. Anzahl an Abarbeitungsschleifen GenMech" VALUE 0x14A0E7 AblGLKWub 8 ZU0 1 9 FORMAT "%5.3" /end CHARACTERISTIC
/begin CHARACTERISTIC yLdTrk_MaxLoopCount_XDU8 "Max. Anzahl an Abarbeitungsschleifen" VALUE 0x14A0E8 AblGLKWub 8 ZU0 1 9 FORMAT "%5.3" /end CHARACTERISTIC
/begin CHARACTERISTIC yLdTrk_TempNdWormImp_XDF32 "Generiert: Gewichtung Lastwechsel bei Dauerfestigkeit [1/x]" VALUE 0x14A02C AblGLKWfl4 2E+07 FLOAT 0 20000000 /end CHARACTERISTIC
/begin CHARACTERISTIC yLdTrk_TempNdWormRot_XAF32 "Generiert: Temperaturabhängige Gewichtung der Lastwechsel bei Dauerfestigkeit [1/x]" CURVE 0x152254 AblGLKLfl4 2E+06 FLOAT 0 2000000 FORMAT "%16.8"
 /begin AXIS_DESCR STD_AXIS cLdTrk_CalcWormWheelTempRot_xdf32 FLOAT 20 -70 185 FORMAT "%16.12" DEPOSIT ABSOLUTE /end AXIS_DESCR
/end CHARACTERISTIC
/begin CHARACTERISTIC yLdTrk_WormWheelImpDamageDefault_XDF32 "Defaultwert für impact Schneckenradschädigung nach unvollständigem Shutdown" VALUE 0x14A030 AblGLKWfl4 1.84467E+19 FLOAT 0 1.8446744E+19 FORMAT "%16.0" /end CHARACTERISTIC
/begin CHARACTERISTIC yLdTrk_WormWheelRotDamageDefault_XDF32 "Defaultwert für rotatorische Schneckenradschädigung nach unvollständigem Shutdown" VALUE 0x14A034 AblGLKWfl4 1.84467E+19 FLOAT 0 1.8446744E+19 FORMAT "%16.0" /end CHARACTERISTIC
/begin CHARACTERISTIC zLdTrk_MaxCountRange_XDU32 "Maximum value fur Range Counters" VALUE 0x14A038 AblGLKWul 4.29497E+09 ZU0 0 4294967295 FORMAT "%13.2" /end CHARACTERISTIC
/begin CHARACTERISTIC zLdTrk_MaxImpactCycles_XDU8 "Anzahl Zyklen (10ms) die zw. zwei Extrema vergehen muessen, damit neues Extrema als Rotatorisch eingestuft wird" VALUE 0x150B73 AblGLKWub 200 ZU0 0 200 FORMAT "%5.1" /end CHARACTERISTIC
/begin CHARACTERISTIC zLka_CycleFactor_XDU8 "" VALUE 0x150B75 AblGLKWub 9 ZU0 1 10 FORMAT "%5.2" /end CHARACTERISTIC
/begin CHARACTERISTIC zLka_ErrorCnt_XDU8 "" VALUE 0x150B76 AblGLKWub 99 ZU0 1 100 FORMAT "%5.1" /end CHARACTERISTIC
/begin CHARACTERISTIC zLka_SignCheckFailedCycle_XDU8 "" VALUE 0x150B77 AblGLKWub 254 ZU0 1 255 FORMAT "%5.1" /end CHARACTERISTIC
/begin CHARACTERISTIC zMotTorLim_VibrationCycleCount2Reduction_XDU8 "Anzahl Ratterzyklen die zur Reduzierung führen" VALUE 0x150B78 AblGLKWub 200 ZU0 0 200 FORMAT "%5.1" /end CHARACTERISTIC
/begin CHARACTERISTIC zMotTorLim_VibrationOnLimitsCycleCount2Reduction_XDU8 "Anzahl am Limit Ratterzyklen die zur Reduzierung führen" VALUE 0x150B79 AblGLKWub 200 ZU0 0 200 FORMAT "%5.1" /end CHARACTERISTIC
/begin MEASUREMENT aPDC_VehicleAccelerationFilt_xds16 "Gefilterte Fahrzeugbeschleunigung" SWORD AFZ 1 100 -30 30 FORMAT "%8.5" ECU_ADDRESS 0xFEBE93A2 /end MEASUREMENT
/begin MEASUREMENT aRackForceI_AbsLatAccel_xdu16 "Abs. Querbeschleunigung aus Fahrzeugmodell" UWORD AFZ 1 100 0 60 FORMAT "%8.5" ECU_ADDRESS 0xFEBE93A4 /end MEASUREMENT
/begin MEASUREMENT aRackForceI_AbsLatAccel_xdu32 "Abs. Querbeschleunigung aus Fahrzeugmodell" ULONG AFZ 1 100 0 30 FORMAT "%13.10" ECU_ADDRESS 0xFEBE9054 /end MEASUREMENT
/begin MEASUREMENT cLdTrk_CalcWormWheelTempRot_xdf32 "Berechnete Schneckenradtemperatur" FLOAT32_IEEE FLOAT 1 100 -70 185 FORMAT "%16.12" ECU_ADDRESS 0xFEBE9060 /end MEASUREMENT
/begin MEASUREMENT cLdTrk_CalcWormWheelTemp_xdu8 "Berechnete Schneckenradtemperatur" UBYTE TMPOUTS 1 100 -70 185 FORMAT "%5.1" ECU_ADDRESS 0xFEBE983C /end MEASUREMENT
/begin MEASUREMENT cLdTrk_ResiduumWormWheelRotTemperature_xau8 "Residuum Schneckenradtemperatur, Element_Anzahl muss gleich sein wie die Groesse von yLdTrk_ResiduumWormWheelRotDamage_xau8" UBYTE TMPOUTS 1 100 -70 185 FORMAT "%5.1" ECU_ADDRESS 0xFEBEA034 MATRIX_DIM 482 1 1 /end MEASUREMENT
/begin MEASUREMENT cLdTrk_WormGearTemperatureAtNewExtrema_xdu8 "Schneckenradtemperatur zum Zeitpunkt des aktuellen/neuen Extremas" UBYTE TMPOUTS 1 100 -70 185 FORMAT "%5.1" ECU_ADDRESS 0xFEBE983D /end MEASUREMENT
/begin MEASUREMENT cLdTrk_WormGearTemperatureAtOldExtrema_xdu8 "Schneckenradtemperatur zum Zeitpunkt des vorherigen Extremas" UBYTE TMPOUTS 1 100 -70 185 FORMAT "%5.1" ECU_ADDRESS 0xFEBE983E /end MEASUREMENT
/begin MEASUREMENT fevent_VoltageHigh_xdu8 "Final nm stack  State enum value: B_NM_KL15_OFF= 0u,B_NM_KL15_ON= 1u" UBYTE ZU0 1 100 0 5 FORMAT "%5.3" ECU_ADDRESS 0xFEBE9881 /end MEASUREMENT
/begin MEASUREMENT fevent_VoltageLow_xdu8 "Final nm stack  State enum value: B_NM_KL15_OFF= 0u,B_NM_KL15_ON= 1u" UBYTE ZU0 1 100 0 5 FORMAT "%5.3" ECU_ADDRESS 0xFEBE9882 /end MEASUREMENT
/begin MEASUREMENT fLaI_ActivateFctCo_xdb "" UWORD ZU0 1 100 0 1 BIT_MASK 0x1 FORMAT "%5.3" ECU_ADDRESS 0xFEBE988E /end MEASUREMENT
/begin MEASUREMENT fLdTrk_BallNutJobResultOK_xdb "Job Result auf NVM Read all Betrieb" UWORD BIT 1 100 0 1 BIT_MASK 0x1 FORMAT "%5.3" ECU_ADDRESS 0xFEBE989C /end MEASUREMENT
/begin MEASUREMENT fLdTrk_FirstRunGenMech_xdb "Initialisierung für OldClass für General Mechanical Damage" UWORD BIT 1 100 0 1 BIT_MASK 0x1 FORMAT "%5.3" ECU_ADDRESS 0xFEBE989E /end MEASUREMENT
/begin MEASUREMENT fLdTrk_GenMechJobResultOK_xdb "Job Result auf NVM Read all Betrieb" UWORD BIT 1 100 0 1 BIT_MASK 0x1 FORMAT "%5.3" ECU_ADDRESS 0xFEBE989F /end MEASUREMENT
/begin MEASUREMENT fLdTrk_HysteresisLvlCrossed_xau8 "Flag to indicate Hysteresis Limit was crossed" UBYTE ZU0 1 100 0 1 FORMAT "%5.3" ECU_ADDRESS 0xFEBE9FC4 MATRIX_DIM 21 1 1 /end MEASUREMENT
/begin MEASUREMENT fLdTrk_MileageTrackerJobResultOK_xdb " flag for NvM read status" UWORD BIT 1 100 0 1 BIT_MASK 0x1 FORMAT "%5.3" ECU_ADDRESS 0xFEBE98A0 /end MEASUREMENT
/begin MEASUREMENT fLdTrk_NewExtremaType_xdu8 "Typ des aktuellen/neuen Extrema (Impact=1/rotatorisch=2, Init=0)" UBYTE ZU0 1 100 0 3 FORMAT "%5.3" ECU_ADDRESS 0xFEBE98A1 /end MEASUREMENT
/begin MEASUREMENT fLdTrk_OldExtremaType_xdu8 "Typ des vorherigen Extrema (Impact=1/rotatorisch=2, Init=3)" UBYTE ZU0 1 100 0 3 FORMAT "%5.3" ECU_ADDRESS 0xFEBE98A2 /end MEASUREMENT
/begin MEASUREMENT fLdTrk_OldExtremaVerified_xdu8 "Typ des vorherigen Extremas bestaetigt (Impact/rotatorisch)" UBYTE ZU0 1 100 0 1 FORMAT "%5.3" ECU_ADDRESS 0xFEBE98A3 /end MEASUREMENT
/begin MEASUREMENT fLdTrk_SteerRangeJobResultOK_xdb "Job Result auf NVM Read all Betrieb" UWORD BIT 1 100 0 1 BIT_MASK 0x1 FORMAT "%5.3" ECU_ADDRESS 0xFEBE98A4 /end MEASUREMENT
/begin MEASUREMENT fLdTrk_TemperatureTrackerJobResultOK_xdb " Flag for NvM read status" UWORD BIT 1 100 0 1 BIT_MASK 0x1 FORMAT "%5.3" ECU_ADDRESS 0xFEBE98A5 /end MEASUREMENT
/begin MEASUREMENT fLkaI_ActivateLKA_xdb "Indicates whether LKa shall actively calculate and request a torque." UWORD ZU0 1 100 0 1 BIT_MASK 0x1 FORMAT "%5.3" ECU_ADDRESS 0xFEBE98AB /end MEASUREMENT
/begin MEASUREMENT fLkaI_DrvOverrideChk_xdb "" UWORD ZU0 1 100 0 1 BIT_MASK 0x1 FORMAT "%5.3" ECU_ADDRESS 0xFEBE98AC /end MEASUREMENT
/begin MEASUREMENT fLkaI_MonSafeOk_xdb "Indicates whether the MonitorSafe checks report OK (true) or if they have detected a problem (false)" UWORD ZU0 1 100 0 1 BIT_MASK 0x1 FORMAT "%5.3" ECU_ADDRESS 0xFEBE98AD /end MEASUREMENT
/begin MEASUREMENT fLkaI_SignalChk_xdb "" UWORD ZU0 1 100 0 1 BIT_MASK 0x1 FORMAT "%5.3" ECU_ADDRESS 0xFEBE98AE /end MEASUREMENT
/begin MEASUREMENT fLka_ActivateFuncCo_xdb "LKA FctCo Activation Flag" UWORD ZU0 1 100 0 1 BIT_MASK 0x1 FORMAT "%5.3" ECU_ADDRESS 0xFEBE98AF /end MEASUREMENT
/begin MEASUREMENT fLka_LastLkaArbitrationResultPassive_xdb "Indicates whether the LkaArbitrationResult is Passive and the TbtOffset is 0 in previous cycle or not for Lka arbitration valid" UWORD ZU0 1 100 0 1 BIT_MASK 0x1 FORMAT "%5.3" ECU_ADDRESS 0xFEBE98B0 /end MEASUREMENT
/begin MEASUREMENT fMchStPrvI_MonSafeOk_xdb "Indicates whether MonitorSafe checks report OK (1) or if they have detected a problem (0)" UWORD ZU0 1 100 0 1 BIT_MASK 0x1 FORMAT "%5.3" ECU_ADDRESS 0xFEBE98B1 /end MEASUREMENT
/begin MEASUREMENT fMotTorLim_VibHlSetEventEntryTestCond_xdb "Vibrationserkennung TestConditions" UWORD ZU0 1 100 0 1 BIT_MASK 0x1 FORMAT "%5.3" ECU_ADDRESS 0xFEBE98B2 /end MEASUREMENT
/begin MEASUREMENT fMotTorLim_VibrationActive_xdb "Virbrationserkennung aktiv" UWORD ZU0 1 100 0 1 BIT_MASK 0x1 FORMAT "%5.3" ECU_ADDRESS 0xFEBE98B3 /end MEASUREMENT
/begin MEASUREMENT fNm_ValidWakeup_xdu8 "Final nm stack  State enum value: B_NM_KL15_OFF= 0u,B_NM_KL15_ON= 1u" UBYTE ZU0 1 100 0 5 FORMAT "%5.3" ECU_ADDRESS 0xFEBE98B4 /end MEASUREMENT
/begin MEASUREMENT fOCC_Activated_xdu8 "OCC Aktivierungsbedingungen Status" UBYTE ZU0 1 100 0 1 FORMAT "%5.3" ECU_ADDRESS 0xFEBE98B6 /end MEASUREMENT
/begin MEASUREMENT fOvSt_Activate_xdb "Indicates whether Oversteer is allowed to apply torque" UWORD ZU0 1 100 0 1 BIT_MASK 0x1 FORMAT "%5.3" ECU_ADDRESS 0xFEBE98B8 /end MEASUREMENT
/begin MEASUREMENT fOvSt_RequestActivation_xdb "Aktiv Anfrage an Statusmaschine" UWORD ZU0 1 100 0 1 BIT_MASK 0x1 FORMAT "%5.3" ECU_ADDRESS 0xFEBE98B9 /end MEASUREMENT
/begin MEASUREMENT fPDC_CalcRackForce_LastPdcArbPas_xdb "Indicates whether the PdcArbitrationResult is Passive and the RateLimitedCompFrack is 0 in previous cycle or not for rackforce calculation" UWORD ZU0 1 100 0 1 BIT_MASK 0x1 FORMAT "%5.3" ECU_ADDRESS 0xFEBE98BA /end MEASUREMENT
/begin MEASUREMENT fPDC_EstStateIsActive_xdb "zeigt an, ob PDC-Estimator aktiv ein Moment berechnet und anfordert." UWORD ZU0 1 100 0 1 BIT_MASK 0x1 FORMAT "%5.3" ECU_ADDRESS 0xFEBE98BB /end MEASUREMENT
/begin MEASUREMENT fPDC_FunctionEnabled_xdb "PDC ist eingeschaltet (über Codierung/Applikation)." UWORD ZU0 1 100 0 1 BIT_MASK 0x1 FORMAT "%5.3" ECU_ADDRESS 0xFEBE98BC /end MEASUREMENT
/begin MEASUREMENT fPDC_JobResultOK_xdb "flag for read status" UWORD ZU0 1 100 0 1 BIT_MASK 0x1 FORMAT "%5.3" ECU_ADDRESS 0xFEBE98BD /end MEASUREMENT
/begin MEASUREMENT fPDC_LastPdcArbitrationResultPassive_xdb "Indicates whether the PdcArbitrationResult is Passive and the RateLimitedCompFrack is 0 in previous cycle or not for pdc arbitration valid" UWORD ZU0 1 100 0 1 BIT_MASK 0x1 FORMAT "%5.3" ECU_ADDRESS 0xFEBE98BE /end MEASUREMENT
/begin MEASUREMENT fPDC_StateIsActive_xdb "zeigt an, ob PDC aktiv ein Moment berechnet und anfordert." UWORD ZU0 1 100 0 1 BIT_MASK 0x1 FORMAT "%5.3" ECU_ADDRESS 0xFEBE98BF /end MEASUREMENT
/begin MEASUREMENT fRpCorr_LearnCond_xdu8 "Lernbedingungen erfuellt fuer LW-Korrektur: 0x01-LTCorr, 0x02-STCorr" UBYTE ZU0 1 100 0 255 FORMAT "%5.1" ECU_ADDRESS 0xFEBE98C7 /end MEASUREMENT
/begin MEASUREMENT fRpCorr_ResetAdaptiveData_xdu8 " " UBYTE ZU0 1 100 0 255 FORMAT "%5.1" ECU_ADDRESS 0xFEBE98C8 /end MEASUREMENT
/begin MEASUREMENT hLdTrk_SteeringPercent_xds32 "Steering Percent (Steering Angle/wLdTrk_MaxSteeringRange_XDU16)*100" SLONG FACTOR_100 1 100 -100000 100000 FORMAT "%13.6" ECU_ADDRESS 0xFEBE906C /end MEASUREMENT
/begin MEASUREMENT kOCC_OccFriction_xds16 "Occ Offsetkraft" SWORD FRACK 1 100 -150 150 FORMAT "%8.4" ECU_ADDRESS 0xFEBE93B6 /end MEASUREMENT
/begin MEASUREMENT kPDC_LTIntCmpFrack_xds32 "Integrator kompensations Zahnstangenkraft Langzeit" SLONG PDC_FRACK_HIGH 1 100 -1400 1400 FORMAT "%13.8" ECU_ADDRESS 0xFEBE9070 /end MEASUREMENT
/begin MEASUREMENT kPDC_RateLimitedCompFrack_xds32 "Rate Begrenzte PDC-Rackkraft" SLONG FRACK 1 100 -5000 5000 FORMAT "%13.8" ECU_ADDRESS 0xFEBE9074 /end MEASUREMENT
/begin MEASUREMENT kPDC_SatRackForce_xds16 "Angeforderte PDC Zahnstangenkraft" SWORD FRACK 1 100 -5000 5000 FORMAT "%8.3" ECU_ADDRESS 0xFEBE93B8 /end MEASUREMENT
/begin MEASUREMENT kPDC_STIntCmpFrack_xds32 "Integrator kompensations Zahnstangenkraft Kurzzeit" SLONG PDC_FRACK_HIGH 1 100 -1400 1400 FORMAT "%13.8" ECU_ADDRESS 0xFEBE9078 /end MEASUREMENT
/begin MEASUREMENT kRackForceI_RackForceComfortRaw_xds16 "Komfort-Zahnstangenkraft roh" SWORD FRACK 1 100 -20000 20000 FORMAT "%8.2" ECU_ADDRESS 0xFEBE93BA /end MEASUREMENT
/begin MEASUREMENT kRackForceI_RackForceComfort_xds16 "Komfort-Zahnstangenkraft" SWORD FRACK 1 100 -20000 20000 FORMAT "%8.2" ECU_ADDRESS 0xFEBE93BC /end MEASUREMENT
/begin MEASUREMENT kRackForceI_RackForceSimple_xds16 "Einfache Zahnstangenkraft" SWORD FRACK 1 100 -20000 20000 FORMAT "%8.2" ECU_ADDRESS 0xFEBE93BE /end MEASUREMENT
/begin MEASUREMENT lLdTrkI_KMTravelled_xdu32 "gefahrene Distanz des Lenkgetriebes [1/1000 km]" ULONG METERS 1 100 0 4294967295 FORMAT "%13.2" ECU_ADDRESS 0xFEBE9080 /end MEASUREMENT
/begin MEASUREMENT mLdTrk_AbsDeltaWWTDelay_xdu16 "Value of mAltCalc_AbsDeltaWWT_xdu16 in last cycle of FindTurningPoints" UWORD RIGHTSH6NP 1 100 0 800 FORMAT "%8.4" ECU_ADDRESS 0xFEBE94F2 /end MEASUREMENT
/begin MEASUREMENT mLdTrk_BallNutMMotPT1_xds32 "Static fÃ¼r PT1-Filter" SLONG RIGHTSH20NP 1 100 -12 12 FORMAT "%13.10" ECU_ADDRESS 0xFEBE90AC /end MEASUREMENT
/begin MEASUREMENT mLdTrk_FiltMMot4BallNutLoadTracker_xds16 "Gefiltertes Motormoment" SWORD MMOT 1 100 -12 12 FORMAT "%8.5" ECU_ADDRESS 0xFEBE94F6 /end MEASUREMENT
/begin MEASUREMENT mLdTrk_FiltMmot4GenMech_xds16 "Gefiltertes Motormoment fur Generic Mechanical Load Tracker" SWORD MMOT 1 100 -12 12 FORMAT "%8.5" ECU_ADDRESS 0xFEBE94F8 /end MEASUREMENT
/begin MEASUREMENT mLdTrk_LowerSchlepPointerGenMech_xds16 "Unterer Schleppzeiger GenMech (stateflow static)" SWORD MMOT 1 100 -32 31.99902 FORMAT "%8.5" ECU_ADDRESS 0xFEBE94FC /end MEASUREMENT
/begin MEASUREMENT mLdTrk_LowerSchlepPointer_xds16 "Unterer Schleppzeiger (stateflow static)" SWORD MMOT 1 100 -32 31.99902 FORMAT "%8.5" ECU_ADDRESS 0xFEBE94FE /end MEASUREMENT
/begin MEASUREMENT mLdTrk_MMotPT1GenMech_xds32 "Static für PT1-Filter" SLONG RIGHTSH20NP 1 100 -12 12 FORMAT "%13.10" ECU_ADDRESS 0xFEBE90C0 /end MEASUREMENT
/begin MEASUREMENT mLdTrk_UpperSchlepPointerGenMech_xds16 "Oberer Schleppzeiger GenMech (stateflow static)" SWORD MMOT 1 100 -32 31.99902 FORMAT "%8.5" ECU_ADDRESS 0xFEBE9506 /end MEASUREMENT
/begin MEASUREMENT mLdTrk_UpperSchlepPointer_xds16 "Oberer Schleppzeiger (stateflow static)" SWORD MMOT 1 100 -32 31.99902 FORMAT "%8.5" ECU_ADDRESS 0xFEBE9508 /end MEASUREMENT
/begin MEASUREMENT mLkaI_CheckedMMotOffset_xds16 "Motormomentenoffset Lane Assist" SWORD MMOT 1 100 -8 8 FORMAT "%8.6" ECU_ADDRESS 0xFEBE9512 /end MEASUREMENT
/begin MEASUREMENT mLkaI_CheckedTBTOffset_xds16 "Handmomentenoffset Lane Assist" SWORD TBTHIGH 1 100 -25 25 FORMAT "%8.5" ECU_ADDRESS 0xFEBE9514 /end MEASUREMENT
/begin MEASUREMENT mLkaI_MMOTOffset_xds16 "" SWORD MMOT 1 100 -10.24023 10.23047 FORMAT "%8.5" ECU_ADDRESS 0xFEBE9516 /end MEASUREMENT
/begin MEASUREMENT mLkaI_TBTOffset_xds16 "" SWORD TBTHIGH 1 100 -10.24023 10.23047 FORMAT "%8.5" ECU_ADDRESS 0xFEBE9518 /end MEASUREMENT
/begin MEASUREMENT mLka_MaxRampRateCheck_xdu16 "" UWORD RIGHTSH10NP 1 100 0 63.99902 FORMAT "%8.5" ECU_ADDRESS 0xFEBE951A /end MEASUREMENT
/begin MEASUREMENT mLka_MMOTOffsetChecked_xds16 "" SWORD MMOT 1 100 -10.24023 10.23047 FORMAT "%8.5" ECU_ADDRESS 0xFEBE951E /end MEASUREMENT
/begin MEASUREMENT mLka_TBTOffsetChecked_xds16 "" SWORD TBTHIGH 1 100 -10.24023 10.23047 FORMAT "%8.5" ECU_ADDRESS 0xFEBE9520 /end MEASUREMENT
/begin MEASUREMENT mMchStPrvI_DesMotTrqOffset_xds16 "Abgesichertes Motormoment Mechanical Stuck Prevention" SWORD MMOT 1 100 -0.5 0.5 FORMAT "%9.7" ECU_ADDRESS 0xFEBE9522 /end MEASUREMENT
/begin MEASUREMENT mMchStPrvI_MotorTorque4Check_xds16 "Motormoment Mechanical Stuck Prevention zur Absicherung" SWORD MMOT 1 100 -10 10 FORMAT "%8.5" ECU_ADDRESS 0xFEBE9524 /end MEASUREMENT
/begin MEASUREMENT mMchStPrv_AbsEffMotTor_xdu16 "Betrag Effektives Motormoment (Wirkmoment = TBT * Übersetzung + MMOT)" UWORD MMOT 1 100 0 10 FORMAT "%8.5" ECU_ADDRESS 0xFEBE9526 /end MEASUREMENT
/begin MEASUREMENT mMchStPrv_FilteredGRADTBT_xdu16 "Gefilterter Gradient des Drehstabes" UWORD TORGRAD 1 100 0 25 FORMAT "%8.5" ECU_ADDRESS 0xFEBE9528 /end MEASUREMENT
/begin MEASUREMENT mMchStPrv_MotorTorqueSaturated_xds16 "saturated Motormoment Mechanical Stuck Prevention" SWORD MMOT 1 100 -0.5 0.5 FORMAT "%9.7" ECU_ADDRESS 0xFEBE952A /end MEASUREMENT
/begin MEASUREMENT mMotTorLimI_MmotLimitedToUsable_xds16 "Begrenztes Motormoment auf das maximal mögliche Motormoment der HWLib" SWORD MMOT 1 100 -12 12 FORMAT "%8.5" ECU_ADDRESS 0xFEBE952C /end MEASUREMENT
/begin MEASUREMENT mMotTorLimI_ValidatedMotorTorque_xds16 "Begrenztes Motormoment durch MotorTorqueLimiter" SWORD MMOT 1 100 -12 12 FORMAT "%8.5" ECU_ADDRESS 0xFEBE952E /end MEASUREMENT
/begin MEASUREMENT mMotTorLim_AbsIntegratedDeviation_xdu16 "absolute, aufintegrierte Motormomentenabweichung" UWORD MMOT 1 100 0 60 FORMAT "%8.5" ECU_ADDRESS 0xFEBE9530 /end MEASUREMENT
/begin MEASUREMENT mMotTorLim_ActLimCurveNegMMotY_xas16 "y-Achsenwerte der negativen Begrenzungskennlinie (nominelles Unterstützungsmoment)" SWORD MMOT 1 100 -20 20 FORMAT "%8.5" ECU_ADDRESS 0xFEBE9B68 MATRIX_DIM 12 1 1 /end MEASUREMENT
/begin MEASUREMENT mMotTorLim_ActLimCurveNegTBTX_xas16 "x-Achsenwerte der negativen Begrenzungskennlinie (Handmoment)" SWORD TBTHIGH 1 100 -22 22 FORMAT "%8.5" ECU_ADDRESS 0xFEBE9B80 MATRIX_DIM 12 1 1 /end MEASUREMENT
/begin MEASUREMENT mMotTorLim_ActLimCurvePosMMotY_xas16 "y-Achsenwerte der positiven Begrenzungskennlinie (nominelles Unterstützungsmoment)" SWORD MMOT 1 100 -20 20 FORMAT "%8.5" ECU_ADDRESS 0xFEBE9B98 MATRIX_DIM 12 1 1 /end MEASUREMENT
/begin MEASUREMENT mMotTorLim_ActLimCurvePosTBTX_xas16 "x-Achsenwerte der positiven Begrenzungskennlinie (Handmoment)" SWORD TBTHIGH 1 100 -22 22 FORMAT "%8.5" ECU_ADDRESS 0xFEBE9BB0 MATRIX_DIM 12 1 1 /end MEASUREMENT
/begin MEASUREMENT mMotTorLim_ErrInjLimMotTor_xds16 "Eingangs-Motormoment inklusive Fehlerinjektion" SWORD MMOT 1 100 -12 12 FORMAT "%8.5" ECU_ADDRESS 0xFEBE9532 /end MEASUREMENT
/begin MEASUREMENT mMotTorLim_IntegratedDeviation_xdf32 "aufintegrierte Motormomentenabweichung" FLOAT32_IEEE ZU0 1 100 -60 60 FORMAT "%10.7" ECU_ADDRESS 0xFEBE90CC /end MEASUREMENT
/begin MEASUREMENT mMotTorLim_IntegratedDeviation_xds32 "aufintegrierte Motormomentenabweichung" SLONG MMOT 1 100 -60 60 FORMAT "%13.10" ECU_ADDRESS 0xFEBE90D0 /end MEASUREMENT
/begin MEASUREMENT mMotTorLim_L2AbsIntegratedDeviation_xdf32 "aufintegrierte Motormomentenabweichung L2" FLOAT32_IEEE ZU0 1 100 0 60 FORMAT "%10.7" ECU_ADDRESS 0xFEBE90D4 /end MEASUREMENT
/begin MEASUREMENT mMotTorLim_L2LimitedMotorTorque_xdf32 "begrenztes Motormoment L2" FLOAT32_IEEE ZU0 1 100 -12 12 FORMAT "%10.7" ECU_ADDRESS 0xFEBE90D8 /end MEASUREMENT
/begin MEASUREMENT mMotTorLim_L2LowerLimit_xdf32 "kleinster Grenzwert für Motormoment vor FOC L2" FLOAT32_IEEE ZU0 1 100 -20 20 FORMAT "%10.7" ECU_ADDRESS 0xFEBE90DC /end MEASUREMENT
/begin MEASUREMENT mMotTorLim_L2NegMMotYActLimCurve_xaf32 "L2 y-Achsenwerte der negativen Begrenzungskennlinie (nominelles Unterstützungsmoment)" FLOAT32_IEEE ZU0 1 100 -12 12 FORMAT "%10.7" ECU_ADDRESS 0xFEBE9BC8 MATRIX_DIM 12 1 1 /end MEASUREMENT
/begin MEASUREMENT mMotTorLim_L2NegTBTXActLimCurve_xaf32 "L2 x-Achsenwerte der negativen Begrenzungskennlinie (Handmoment)" FLOAT32_IEEE ZU0 1 100 -15 15 FORMAT "%10.7" ECU_ADDRESS 0xFEBE9BF8 MATRIX_DIM 12 1 1 /end MEASUREMENT
/begin MEASUREMENT mMotTorLim_L2PosMMotYActLimCurve_xaf32 "L2 y-Achsenwerte der positiven Begrenzungskennlinie (nominelles Unterstützungsmoment)" FLOAT32_IEEE ZU0 1 100 -12 12 FORMAT "%10.7" ECU_ADDRESS 0xFEBE9C28 MATRIX_DIM 12 1 1 /end MEASUREMENT
/begin MEASUREMENT mMotTorLim_L2PosTBTXActLimCurve_xaf32 "L2 x-Achsenwerte der positiven Begrenzungskennlinie (Handmoment)" FLOAT32_IEEE ZU0 1 100 -15 15 FORMAT "%10.7" ECU_ADDRESS 0xFEBE9C58 MATRIX_DIM 12 1 1 /end MEASUREMENT
/begin MEASUREMENT mMotTorLim_L2TorqueForLimitation_xdf32 "L2 Eingangsmoment für die Motorbegrenzungskennlinie" FLOAT32_IEEE ZU0 1 100 -25 25 FORMAT "%10.7" ECU_ADDRESS 0xFEBE90E0 /end MEASUREMENT
/begin MEASUREMENT mMotTorLim_L2TorsionBarTorque_xdf32 "L2 Handmoment für Motorbegrenzungskennlinie" FLOAT32_IEEE ZU0 1 100 -25 25 FORMAT "%10.7" ECU_ADDRESS 0xFEBE90E4 /end MEASUREMENT
/begin MEASUREMENT mMotTorLim_L2UpperLimit_xdf32 "größter Grenzwert für Motormoment vor FOC L2" FLOAT32_IEEE ZU0 1 100 -20 20 FORMAT "%10.7" ECU_ADDRESS 0xFEBE90E8 /end MEASUREMENT
/begin MEASUREMENT mMotTorLim_LimitDueToGeneratedSpeed_xds16 "Grenzwert resultierend aus generatorischer Drehzahl" SWORD MMOT 1 100 0 12 FORMAT "%8.5" ECU_ADDRESS 0xFEBE9534 /end MEASUREMENT
/begin MEASUREMENT mMotTorLim_LimMotTor4Compare_xds16 "limited motor torque for compare" SWORD MMOT 1 100 -12 12 FORMAT "%8.5" ECU_ADDRESS 0xFEBE9536 /end MEASUREMENT
/begin MEASUREMENT mMotTorLim_LowerLimit_xds16 "kleinster Grenzwert für Motormoment vor FOC" SWORD MMOT 1 100 -20 20 FORMAT "%8.5" ECU_ADDRESS 0xFEBE9538 /end MEASUREMENT
/begin MEASUREMENT mMotTorLim_TorqueForLimitation_xds16 "Eingangsmoment für die Motorbegrenzungskennlinie" SWORD TBTHIGH 1 100 -25 25 FORMAT "%8.5" ECU_ADDRESS 0xFEBE953A /end MEASUREMENT
/begin MEASUREMENT mMotTorLim_TorsionBarTorque_xds16 "Handmoment für Motorbegrenzungskennlinie" SWORD TBTHIGH 1 100 -25 25 FORMAT "%8.5" ECU_ADDRESS 0xFEBE953C /end MEASUREMENT
/begin MEASUREMENT mMotTorLim_UpperLimit_xds16 "größter Grenzwert für Motormoment vor FOC" SWORD MMOT 1 100 -20 20 FORMAT "%8.5" ECU_ADDRESS 0xFEBE953E /end MEASUREMENT
/begin MEASUREMENT mMotTorLim_UsedLimit_xds16 "benutzter Grenzwert für Motormoment vor FOC" SWORD MMOT 1 100 -20 20 FORMAT "%8.5" ECU_ADDRESS 0xFEBE9540 /end MEASUREMENT
/begin MEASUREMENT mOCCI_MotorTorque_xds16 "motor torque of OnCenterConnection" SWORD MMOT 1 100 -0.5 0.5 FORMAT "%9.7" ECU_ADDRESS 0xFEBE9542 /end MEASUREMENT
/begin MEASUREMENT mOvStI_MotorTorque_xds16 "Motormoment aus Oversteer-Funktion" SWORD MMOT 1 100 -1 1 FORMAT "%8.6" ECU_ADDRESS 0xFEBE9544 /end MEASUREMENT
/begin MEASUREMENT mOvSt_FiltAbsDriverTorque_xdu16 "Absolutes gefiltertes Fahrermoment" UWORD TBTHIGH 1 100 0 25 FORMAT "%8.5" ECU_ADDRESS 0xFEBE9546 /end MEASUREMENT
/begin MEASUREMENT mOvSt_LiftingForceComp_xds16 "Hubkraftkompensationsmoment [Nm]" SWORD MMOT 1 100 -1 1 FORMAT "%8.6" ECU_ADDRESS 0xFEBE9548 /end MEASUREMENT
/begin MEASUREMENT mOvSt_OscRetTorque_xds32 "Rueckstellmoment aus Oversteer [Nm]" SLONG MMOT 1 100 -2 2 FORMAT "%13.11" ECU_ADDRESS 0xFEBE90EC /end MEASUREMENT
/begin MEASUREMENT mPDCI_MotorTorqueOffset_xds16 "Motormomentoffset PullDriftCompensation" SWORD MMOT 1 100 -0.5 0.5 FORMAT "%9.7" ECU_ADDRESS 0xFEBE954A /end MEASUREMENT
/begin MEASUREMENT mPDC_TorsionBarTorqueFilt_xds16 "Gefiltertes Drehstabmoment" SWORD TBTHIGH 1 100 -25 25 FORMAT "%8.5" ECU_ADDRESS 0xFEBE954C /end MEASUREMENT
/begin MEASUREMENT mRackForce_FrictionFilt_xds16 "Interne Messgröße Reibmoment" SWORD MMOT 1 100 -10 10 FORMAT "%8.5" ECU_ADDRESS 0xFEBE954E /end MEASUREMENT
/begin MEASUREMENT mRackForce_InertiaFilt_xds16 "Interne Messgröße Trägheitsmoment" SWORD MMOT 1 100 -10 10 FORMAT "%8.5" ECU_ADDRESS 0xFEBE9550 /end MEASUREMENT
/begin MEASUREMENT mTrqSumI_DisturbanceComp_xds16 "totalized motor torque of disturbance compensation for RG3" SWORD MMOT 1 100 -12 12 FORMAT "%8.5" ECU_ADDRESS 0xFEBE938A /end MEASUREMENT
/begin MEASUREMENT mTrqSumI_MotTrqSum1_xds16 "summation of all input motor torques of main connector" SWORD MMOT 1 100 -12 12 FORMAT "%8.5" ECU_ADDRESS 0xFEBE9586 /end MEASUREMENT
/begin MEASUREMENT nMotTorLim_AbsGeneratoricRotorSpeed_xdf32 "Generatorische Geschwindigkeit (Kennlinienersatzwert)" FLOAT32_IEEE ZU0 1 100 0 13000 FORMAT "%10.4" ECU_ADDRESS 0xFEBE90F8 /end MEASUREMENT
/begin MEASUREMENT nMotTorLim_AbsGeneratoricRotorSpeed_xds16 "Generatorische Geschwindigkeit (Kennlinienersatzwert)" SWORD VROT 1 100 0 13000 FORMAT "%3.0" ECU_ADDRESS 0xFEBE95D2 /end MEASUREMENT
/begin MEASUREMENT sApplI_SystemState_xdu8 "System Status" UBYTE SYSTEM_STATE 1 100 1 14 FORMAT "%13.10" ECU_ADDRESS 0xFEBE9929 /end MEASUREMENT
/begin MEASUREMENT sComControl_State_xdu8 "Final nm stack  State enum value: B_NM_KL15_OFF= 0u,B_NM_KL15_ON= 1u" UBYTE ZU0 1 100 0 255 FORMAT "%5.1" ECU_ADDRESS 0xFEBE9949 /end MEASUREMENT
/begin MEASUREMENT sLaI_NopDegradedSts_xdu8 "" UBYTE ZU0 1 100 0 10 FORMAT "%5.2" ECU_ADDRESS 0xFEBE99B5 /end MEASUREMENT
/begin MEASUREMENT sLaI_NopState_xdu8 "" UBYTE ZU0 1 100 0 7 FORMAT "%5.3" ECU_ADDRESS 0xFEBE99B6 /end MEASUREMENT
/begin MEASUREMENT sLaI_NopWarnlight_xdu8 "" UBYTE ZU0 1 100 0 2 FORMAT "%5.3" ECU_ADDRESS 0xFEBE99B7 /end MEASUREMENT
/begin MEASUREMENT sLkaI_LkaMode_xdu8 "" UBYTE ZU0 1 100 0 3 FORMAT "%5.3" ECU_ADDRESS 0xFEBE99CA /end MEASUREMENT
/begin MEASUREMENT sLkaI_State_xdu8 "" UBYTE ZU0 1 100 0 3 FORMAT "%5.3" ECU_ADDRESS 0xFEBE99CB /end MEASUREMENT
/begin MEASUREMENT sLka_CtrlState_xdu8 "RÃ¼ckgabewert des Function Coordinators" UBYTE ZU0 1 100 0 99 FORMAT "%5.2" ECU_ADDRESS 0xFEBE99CC /end MEASUREMENT
/begin MEASUREMENT sLka_FeatureState_xdu8 "interner Lane Assit Function Coordinator Status" UBYTE ZU0 1 100 0 99 FORMAT "%5.2" ECU_ADDRESS 0xFEBE99CD /end MEASUREMENT
/begin MEASUREMENT sLka_InhibitReason_xdu8 "Indicates the LKA Inhibit reason in check component" UBYTE ZU0 1 100 0 255 FORMAT "%5.1" ECU_ADDRESS 0xFEBE99CE /end MEASUREMENT
/begin MEASUREMENT sLowVoltAssRedI_EnableReduction_xdb "LowVoltageAssistReduction Activation Flag" UWORD ZU0 1 100 0 1 BIT_MASK 0x1 FORMAT "%5.3" ECU_ADDRESS 0xFEBE99CF /end MEASUREMENT
/begin MEASUREMENT sMcdI_ErrLvl_Red_xdu8 "Error Level Redundant MCDataIntegrity" UBYTE ZU0 1 100 0 1 FORMAT "%5.3" ECU_ADDRESS 0xFEBE429D /end MEASUREMENT
/begin MEASUREMENT sMcdI_ErrLvl_xdu8 "Error Level MCDataIntegrity" UBYTE ZU0 1 100 0 1 FORMAT "%5.3" ECU_ADDRESS 0xFEBE99D0 /end MEASUREMENT
/begin MEASUREMENT sMchStPrvI_RampState_xdu8 "State für den RampedIn/Out-Status des FunctionCoordinators" UBYTE ZU0 1 100 0 2 FORMAT "%5.3" ECU_ADDRESS 0xFEBE99D1 /end MEASUREMENT
/begin MEASUREMENT sMchStPrv_ActivationRequest_xdu8 "Flag für den ActivationRequest des FunctionCoordinators" UWORD ZU0 1 100 0 1 BIT_MASK 0x1 FORMAT "%5.3" ECU_ADDRESS 0xFEBE99D2 /end MEASUREMENT
/begin MEASUREMENT sMchStPrv_CtrlState_xdu8 "ControlState von FunctionCoordinator" UBYTE ZU0 1 100 0 99 FORMAT "%5.2" ECU_ADDRESS 0xFEBE99D3 /end MEASUREMENT
/begin MEASUREMENT sMchStPrv_EnableRateLimter_xdb "Flag für Aktivierung Rate Limiter" UWORD ZU0 1 100 0 1 BIT_MASK 0x1 FORMAT "%5.3" ECU_ADDRESS 0xFEBE99D4 /end MEASUREMENT
/begin MEASUREMENT sMchStPrv_FailureCause_xdu8 "Grund der Fehlererkennung" UBYTE ZU0 1 100 0 1 FORMAT "%5.3" ECU_ADDRESS 0xFEBE99D5 /end MEASUREMENT
/begin MEASUREMENT sMchStPrv_FeatureState_xdu8 "Mechanical Stuck Prevention interner Mode Manager Status" UBYTE ZU0 1 100 0 5 FORMAT "%5.3" ECU_ADDRESS 0xFEBE99D6 /end MEASUREMENT
/begin MEASUREMENT sMotTorLimI_ErrLvl_Red_xdu8 "Error Level Red MotorTorqueLimiter" UBYTE ZU0 1 100 0 1 FORMAT "%5.3" ECU_ADDRESS 0xFEBE429E /end MEASUREMENT
/begin MEASUREMENT sMotTorLimI_ErrLvl_xdu8 "Error Level MotorTorqueLimiter" UBYTE ZU0 1 100 0 1 FORMAT "%5.3" ECU_ADDRESS 0xFEBE99D7 /end MEASUREMENT
/begin MEASUREMENT sMotTorLim_L1ErrLvl_xdu8 "ErrLvl L1 Ueberwachung" UBYTE ZU0 1 100 0 1 FORMAT "%5.3" ECU_ADDRESS 0xFEBE99D8 /end MEASUREMENT
/begin MEASUREMENT sMotTorLim_L1PrestorageData_xdu32 "PrestorageData L1 Ueberwachung" ULONG ZU0 1 100 0 10 FORMAT "%13.10" ECU_ADDRESS 0xFEBE903C /end MEASUREMENT
/begin MEASUREMENT sMotTorLim_L2PrestorageData_xdu32 "PrestorageData L2 Ueberwachung" ULONG ZU0 1 100 0 10 FORMAT "%13.10" ECU_ADDRESS 0xFEBE9040 /end MEASUREMENT
/begin MEASUREMENT sMotTorLim_ReductionState_xdu8 "Reduktionsstatus (Disabled=0,Ready=1,WaitForRampDown=2,RampDown=3,RampUp=4)" UBYTE ZU0 1 100 0 5 FORMAT "%5.3" ECU_ADDRESS 0xFEBE99D9 /end MEASUREMENT
/begin MEASUREMENT sMotTorLim_VibErrLvl_xdu8 "ErrLvl Vibrationserkennung" UBYTE ZU0 1 100 0 1 FORMAT "%5.3" ECU_ADDRESS 0xFEBE99DA /end MEASUREMENT
/begin MEASUREMENT sMotTorLim_VibPrestorageData_xdu32 "PrestorageData Vibrationserkennung" ULONG ZU0 1 100 0 10 FORMAT "%13.10" ECU_ADDRESS 0xFEBE9044 /end MEASUREMENT
/begin MEASUREMENT sMotTorLim_VibrationDetectionState_xdu8 "Zustand der Schwingungserkennung (INACTIVE=0, DETECTED_POS=1,DETECTED_NEG=2, ACTIVE=3)" UBYTE ZU0 1 100 0 3 FORMAT "%5.3" ECU_ADDRESS 0xFEBE99DB /end MEASUREMENT
/begin MEASUREMENT sMotTorLim_VibrationOnLimitsDetectionState_xdu8 "Zustand der Schwingungserkennung am Limit( SF_STorque_Inactive=0, SF_STorque_DetectedPos=1, STorque_DetectedNeg=2, SF_STorque_Active=3)" UBYTE ZU0 1 100 0 3 FORMAT "%5.3" ECU_ADDRESS 0xFEBE99DC /end MEASUREMENT
/begin MEASUREMENT sNmBsI_AppCommNmStackState_xdu8 "Final nm stack  State enum value: B_NM_STATE_BUS_SLEEP_INIT= 0u,B_NM_STATE_PREPARE_BUS_SLEEP= 1u,B_NM_STATE_READY_SLEEP= 2u,  B_NM_STATE_NORMAL_OPERATION= 3u,  B_NM_STATE_REPEAT_MESSAGE= 4u, B_NM_STATE_BUS_SLEEP= 5u" UBYTE ZU0 1 100 0 5 FORMAT "%5.3" ECU_ADDRESS 0xFEBE99DE /end MEASUREMENT
/begin MEASUREMENT sOsMonI_ErrLvl_Red_xdu8 "Redundanter Error Level OsMon" UBYTE ZU0 1 100 0 2 FORMAT "%5.3" ECU_ADDRESS 0xFEBE4BDA /end MEASUREMENT
/begin MEASUREMENT sOsMonI_ErrLvl_xdu8 "Error Level OsMon" UBYTE ZU0 1 100 0 2 FORMAT "%5.3" ECU_ADDRESS 0xFEBE4B29 /end MEASUREMENT
/begin MEASUREMENT sPDC_ActivationRequest_xdu8 "Flag für den PDC ActivationRequest des FunctionCoordinator" UBYTE ZU0 1 100 0 1 FORMAT "%5.3" ECU_ADDRESS 0xFEBE99E7 /end MEASUREMENT
/begin MEASUREMENT sPDC_EstActivationRequest_xdu8 "Flag für den Estimator ActivationRequest des FunctionCoordinator" UBYTE ZU0 1 100 0 1 FORMAT "%5.3" ECU_ADDRESS 0xFEBE99E8 /end MEASUREMENT
/begin MEASUREMENT sPDC_EstCtrlState_xdu8 "Estimator Rückgabewert des Function Coordinators" UBYTE ZU0 1 100 0 99 FORMAT "%5.2" ECU_ADDRESS 0xFEBE99E9 /end MEASUREMENT
/begin MEASUREMENT sPDC_EstFeatureState_xdu8 "PullDriftCompensationEsimator interner FunctionCoordinator Status" UBYTE ZU0 1 100 0 5 FORMAT "%5.3" ECU_ADDRESS 0xFEBE99EA /end MEASUREMENT
/begin MEASUREMENT sPDC_MergedFctCoState_xdu8 "Status PullDriftCompensation (0 = Passive, 1 = Active, 2 = Hold)" UBYTE PDC_STATE 1 100 0 2 FORMAT "%13.11" ECU_ADDRESS 0xFEBE99EB /end MEASUREMENT
/begin MEASUREMENT sPDC_PdcCtrlState_xdu8 "PDC Rückgabewert des Function Coordinators" UBYTE ZU0 1 100 0 99 FORMAT "%5.2" ECU_ADDRESS 0xFEBE99EC /end MEASUREMENT
/begin MEASUREMENT sPDC_PdcFeatureState_xdu8 "PullDriftCompensation interner FunctionCoordinator Status" UBYTE ZU0 1 100 0 5 FORMAT "%5.3" ECU_ADDRESS 0xFEBE99ED /end MEASUREMENT
/begin MEASUREMENT sPDC_RampedIn_xdu8 "Flag für den RampedIn-Status des FunctionCoordinator" UBYTE ZU0 1 100 0 1 FORMAT "%5.3" ECU_ADDRESS 0xFEBE99EE /end MEASUREMENT
/begin MEASUREMENT sPDC_RampedOut_xdu8 "Flag für den RampedOut-Status des FunctionCoordinator" UBYTE ZU0 1 100 0 1 FORMAT "%5.3" ECU_ADDRESS 0xFEBE99EF /end MEASUREMENT
/begin MEASUREMENT sPDC_State_xdu8 "Status PullDriftCompensation (0 = Passive, 1 = Active, 2 = Hold, 3 = RampOut, 4 = RequestForActivation, 5 = HoldLongTerm)" UBYTE PDC_STATE 1 100 0 5 FORMAT "%13.11" ECU_ADDRESS 0xFEBE99F0 /end MEASUREMENT
/begin MEASUREMENT sRpCorrI_EnableCorrectionSupp_xdu8 "Allow/inhibit LT and ST correction: 0-no learning, 1-only LT learn, 2-only ST lear, 3 allow LT+ST" UBYTE ZU0 1 100 0 3 FORMAT "%5.3" ECU_ADDRESS 0xFEBE9A00 /end MEASUREMENT
/begin MEASUREMENT sRpCorr_JobResultOK_xdu8 " " UBYTE ZU0 1 100 0 3 FORMAT "%5.3" ECU_ADDRESS 0xFEBE9A01 /end MEASUREMENT
/begin MEASUREMENT sRpCorr_ResetCorrection_xdu8 "Torque state from AddOnCoordinator" UBYTE ZU0 1 100 0 3 FORMAT "%5.3" ECU_ADDRESS 0xFEBE9A02 /end MEASUREMENT
/begin MEASUREMENT sRpSyncI_SyncActSuppSuccess_xdu8 "Initialisierung aus SyncSupp-Funktionen moeglich" UBYTE ZU0 1 100 0 5 FORMAT "%5.3" ECU_ADDRESS 0xFEBE9A0B /end MEASUREMENT
/begin MEASUREMENT tMotTorLim_VibrationDetectionTimer_xdu16 "Maximale Zeit zwischen dem max. und min. Wert einer Schwingung" UWORD TIMSEC_1000 1 100 0 5 FORMAT "%8.6" ECU_ADDRESS 0xFEBE9614 /end MEASUREMENT
/begin MEASUREMENT tMotTorLim_VibrationOnLimitsDetectionTimer_xdu16 "Maximale Zeit zwischen dem max. und min. Wert einer Schwingung am Limit" UWORD TIMSEC_1000 1 100 0 5 FORMAT "%8.6" ECU_ADDRESS 0xFEBE9616 /end MEASUREMENT
/begin MEASUREMENT tPDC_Timer4BigCrowningChangeDetection_xdu8 "Timer für das Erkennen einer starken Änderung der Fahrbahnneigung für das Ändern des Integrationsfaktors" UBYTE TIMMS_10 1 100 0 2500 FORMAT "%5.0" ECU_ADDRESS 0xFEBE9A44 /end MEASUREMENT
/begin MEASUREMENT tPDC_Timer4CompFrackWrongDetection_xdu16 "Timer für das Erkennen einer falschen Kompensationszahnstangenkraft" UWORD TIMMS_10 1 100 0 600000 FORMAT "%8.1" ECU_ADDRESS 0xFEBE9618 /end MEASUREMENT
/begin MEASUREMENT tPDC_Timer4Learn_xdu8 "Timer für Statuswechsel in Status Active und Hold" UBYTE TIMMS_10 1 100 0 2500 FORMAT "%5.0" ECU_ADDRESS 0xFEBE9A45 /end MEASUREMENT
/begin MEASUREMENT tPDC_Timer4TurnDetection_xdu8 "Timer für das Erkennen einer Kurve für das Herausrampen aus dem Status Hold" UBYTE TIMMS_10 1 100 0 2500 FORMAT "%5.0" ECU_ADDRESS 0xFEBE9A46 /end MEASUREMENT
/begin MEASUREMENT tRpCorr_IntegTimedelay_xdu8 "Integral time delay" UBYTE TIMSEC_10 1 100 0 25.5 FORMAT "%5.2" ECU_ADDRESS 0xFEBE9A48 /end MEASUREMENT
/begin MEASUREMENT uLowVoltAssRed_SupplyVoltage_xdu16 "mapped SupplyVoltage signal to characteristic curve or substitute value" UWORD U64V 1 100 0 33 FORMAT "%8.5" ECU_ADDRESS 0xFEBE9640 /end MEASUREMENT
/begin MEASUREMENT vMotTorLim_AbsSafeVehicleSpeed_xdu16 "Abs. Fahrzeuggeschwindigkeit. siehe vApplI_AbsSafeVehicleSpeed_xdu16" UWORD VFZHIGH 1 100 0 500 FORMAT "%8.4" ECU_ADDRESS 0xFEBE9686 /end MEASUREMENT
/begin MEASUREMENT vMotTorLim_L2AbsSafeVehicleSpeed_xdf32 "Sichere Fahrzeuggeschwindigkeit für L2 Kennlinien" FLOAT32_IEEE ZU0 1 100 0 500 FORMAT "%10.6" ECU_ADDRESS 0xFEBE91B4 /end MEASUREMENT
/begin MEASUREMENT vOvStI_AbsVehicleSpeedFilt_xdf32 "Abs. Fahrzeuggeschwindigkeit: aufbereitet fuer Kennlinie" FLOAT32_IEEE FLOAT 1 100 0 500 FORMAT "%16.12" ECU_ADDRESS 0xFEBE91B8 /end MEASUREMENT
/begin MEASUREMENT vOvSt_AbsSideSlipVelocityFilt_xdu16 "Absolute gefilterte Schwimmwinkelgeschwindigkeit [°/s]" UWORD RIGHTSH10NP 1 100 0 50 FORMAT "%8.5" ECU_ADDRESS 0xFEBE9688 /end MEASUREMENT
/begin MEASUREMENT vOvSt_AbsYawVelocity_xdu16 "Absolute Gierrate als Eingang für Kennlinie Faktor Hubkraft [°/s]" UWORD RIGHTSH5NP 1 100 0 575 FORMAT "%8.4" ECU_ADDRESS 0xFEBE968A /end MEASUREMENT
/begin MEASUREMENT vOvSt_ReturnSpeed_xds16 "Soll-Ruecklaufgeschwindigkeit [°/s]" SWORD SAS_8 1 100 -1500 1500 FORMAT "%8.3" ECU_ADDRESS 0xFEBE968C /end MEASUREMENT
/begin MEASUREMENT vOvSt_SideSlipVelocityFilt_xds32 "Gefilterte Schwimmwinkelgeschwindigkeit [°/s]" SLONG RIGHTSH10NP 1 100 -50 50 FORMAT "%13.10" ECU_ADDRESS 0xFEBE91BC /end MEASUREMENT
/begin MEASUREMENT vOvSt_SpeedDiff_xds32 "Abweichung zwischen Soll- und Ist-Lenkgeschwindigkeit fuer Oversteer [°/s]" SLONG SAS_8 1 100 -1500 1500 FORMAT "%13.8" ECU_ADDRESS 0xFEBE91C0 /end MEASUREMENT
/begin MEASUREMENT vPDC_YawVelocityFilt_xds16 "Gefilterte Gierrate" SWORD VGIER 1 100 -150 150 FORMAT "%8.4" ECU_ADDRESS 0xFEBE968E /end MEASUREMENT
/begin MEASUREMENT vRackForceI_WindUpAdaption_xds32 "Änderungsrate der Kraft aus Zahnstangenkraft-Adaptionen" SLONG FRACK 1 100 -20000000 20000000 FORMAT "%13.4" ECU_ADDRESS 0xFEBE91C4 /end MEASUREMENT
/begin MEASUREMENT wLdTrk_RotorPositionDelay_xds32 "Value of RotorPosition in last cycle of FindTurningPoints" SLONG ROTPOS 1 100 -32000.0097656 32000.0097656 FORMAT "%13.7" ECU_ADDRESS 0xFEBE920C /end MEASUREMENT
/begin MEASUREMENT wLdTrk_RotPosAtNewExtrema_xds32 "RotorPosition zum Zeitpunkt des aktuellen/neuen Extrema" SLONG ROTPOS 1 100 -188743680 188743679.912 FORMAT "%13.3" ECU_ADDRESS 0xFEBE9210 /end MEASUREMENT
/begin MEASUREMENT wOvSt_AbsBlendPinionAngle_xdu16 "Absoluter eingeblendeter Ritzelwinkel für Kennlinie Hubkraft [°]" UWORD SA_10 1 100 0 1000 FORMAT "%8.3" ECU_ADDRESS 0xFEBE96CE /end MEASUREMENT
/begin MEASUREMENT wRackPoI_PinionAngleReal_xds16 "realer (i-variaber korrigierter) Ritzelwinkel" SWORD SA_10 1 100 -1000 1000 FORMAT "%8.3" ECU_ADDRESS 0xFEBE96D0 /end MEASUREMENT
/begin MEASUREMENT wRpCorrI_RotAngLTCorrNVR_xds16 "RotorAngle Langzeitkorrektur" SWORD ANGLE_1 1 100 -600 600 FORMAT "%8.4" ECU_ADDRESS 0xFEBE96E4 /end MEASUREMENT
/begin MEASUREMENT wRpCorrI_RotAngSTCorr_xds16 "Rotor Kurzzeitkorrektur" SWORD ANGLE_1 1 100 -600 600 FORMAT "%8.4" ECU_ADDRESS 0xFEBE96E6 /end MEASUREMENT
/begin MEASUREMENT wRpCorr_LTIntegral_xds32 "Integral des Langzeitkorrekturwerts des Lenkwinkels" SLONG RIGHTSH14NP 1 100 -131072 131071.999939 FORMAT "%13.6" ECU_ADDRESS 0xFEBE9234 /end MEASUREMENT
/begin MEASUREMENT wRpCorr_STIntegral_xds32 "Integral des Kurzzeitkorrekturwerts des Lenkwinkels" SLONG RIGHTSH14NP 1 100 -131072 131071.999939 FORMAT "%13.6" ECU_ADDRESS 0xFEBE9238 /end MEASUREMENT
/begin MEASUREMENT wRpSyncI_SyncActSuppIndexPosition_xds16 "ermittelte Indexposition aus Supp-Init-Funktionen" SWORD ANGLE_1 1 100 -32768 32767 FORMAT "%8.2" ECU_ADDRESS 0xFEBE96F4 /end MEASUREMENT
/begin MEASUREMENT xLdTrk_NvMCallbackCounter_xdu16 "FI Counter how often LdTrkI_NvMJobStatusCallback is called." UWORD ZU0 1 100 0 65535 FORMAT "%8.2" ECU_ADDRESS 0xFEBE9776 /end MEASUREMENT
/begin MEASUREMENT xLkaI_ActiveDampingFactor_xdu16 "Desired ActiveDamping factor of Lka" UWORD RIGHTSH10NP 1 100 0 1 FORMAT "%8.6" ECU_ADDRESS 0xFEBE977A /end MEASUREMENT
/begin MEASUREMENT xLkaI_ActiveReturnFuncFactor_xdu16 "Desired ActiveReturn function factor of Lka" UWORD RIGHTSH10NP 1 100 0 1 FORMAT "%8.6" ECU_ADDRESS 0xFEBE977C /end MEASUREMENT
/begin MEASUREMENT xLkaI_ActiveReturnSpeedFactor_xdu16 "Desired ActiveReturn Speed factor of Lka" UWORD RIGHTSH10NP 1 100 0 1 FORMAT "%8.6" ECU_ADDRESS 0xFEBE977E /end MEASUREMENT
/begin MEASUREMENT xLkaI_BoostFactorChk_xdu8 "" UBYTE ZU0 1 100 0 100 FORMAT "%5.1" ECU_ADDRESS 0xFEBE9A58 /end MEASUREMENT
/begin MEASUREMENT xMchStPrv_ActivationLevel_xdu16 "Activation Rechtecksignal Mechanical Stuck Prevention" UWORD RIGHTSH15NP 1 100 0 1 FORMAT "%8.6" ECU_ADDRESS 0xFEBE9780 /end MEASUREMENT
/begin MEASUREMENT xMchStPrv_MinActivationLevelRotSpeed_xdu16 "Rotorlagegeschwindigkeit ab der MechStPrev aktiv" UWORD VROT 1 100 0 13000 FORMAT "%3.0" ECU_ADDRESS 0xFEBE9782 /end MEASUREMENT
/begin MEASUREMENT xMchStPrv_squaresignal_xds16 "Rechtecksignal Mechanical Stuck Prevention" SWORD ZU0 1 100 -1 1 FORMAT "%8.6" ECU_ADDRESS 0xFEBE9784 /end MEASUREMENT
/begin MEASUREMENT xMotTorLimI_WeightedIntegratedDeviation_xdu16 "gewichtete, aufintegrierte Motormomentenabweichung" UWORD RIGHTSH15NP 1 100 0 1 FORMAT "%8.6" ECU_ADDRESS 0xFEBE9786 /end MEASUREMENT
/begin MEASUREMENT xMotTorLim_L2WeightedIntegratedDeviation_xdf32 "gewichtete, aufintegrierte Motormomentenabweichung" FLOAT32_IEEE ZU0 1 100 0 1 FORMAT "%10.8" ECU_ADDRESS 0xFEBE9280 /end MEASUREMENT
/begin MEASUREMENT xMotTorLim_ReductionLevel_xdu16 "Reduktionsgrad" UWORD RIGHTSH15NP 1 100 0 1 FORMAT "%8.6" ECU_ADDRESS 0xFEBE9788 /end MEASUREMENT
/begin MEASUREMENT xMotTorLim_TargetReductionLevelVibrationOnLimits_xdu16 "Reduktionsgrad" UWORD RIGHTSH15NP 1 100 0 1 FORMAT "%8.6" ECU_ADDRESS 0xFEBE978A /end MEASUREMENT
/begin MEASUREMENT xMotTorLim_TargetReductionLevelVibration_xdu16 "Reduktionsgrad" UWORD RIGHTSH15NP 1 100 0 1 FORMAT "%8.6" ECU_ADDRESS 0xFEBE978C /end MEASUREMENT
/begin MEASUREMENT xOvStI_ActiveDampingFactor_xdu16 "Active Damping bei Oversteer" UWORD RIGHTSH10NP 1 100 0 1 FORMAT "%8.6" ECU_ADDRESS 0xFEBE978E /end MEASUREMENT
/begin MEASUREMENT xOvStI_ActiveReturnFuncFactor_xdu16 "Aktiver Ruecklauf FuncFactor Ueberblendung aus Oversteer" UWORD RIGHTSH10NP 1 100 0 1 FORMAT "%8.6" ECU_ADDRESS 0xFEBE9790 /end MEASUREMENT
/begin MEASUREMENT xOvSt_DegreeOfOversteerFilt_xdu16 "gefilterter Uebersteuergrad [%/100]" UWORD RIGHTSH15NP 1 100 0 1 FORMAT "%8.6" ECU_ADDRESS 0xFEBE9792 /end MEASUREMENT
/begin MEASUREMENT xOvSt_RatioWheelAngle2SteerAngle_xdf32 "Uebersetzung Radlenkwinkel nach Lenkradwinkel" FLOAT32_IEEE FLOAT 1 100 0 165 FORMAT "%16.12" ECU_ADDRESS 0xFEBE9284 /end MEASUREMENT
/begin MEASUREMENT xRackForceI_RatioD2C_xdu16 "Verhältnis der gemergten Zahnstangekraft (1=100% Dynamic, 0=100% Comfort)" UWORD RIGHTSH10NP 1 100 0 1 FORMAT "%8.6" ECU_ADDRESS 0xFEBE9794 /end MEASUREMENT
/begin MEASUREMENT xRpCorr_BlendFactorOld_xdu8 "Blend factor delay" UBYTE RIGHTSH4NP 1 100 0 1 FORMAT "%5.3" ECU_ADDRESS 0xFEBE9A59 /end MEASUREMENT
/begin MEASUREMENT yLdTrkI_BallNutGearH_xdu32 "Value auf die Ball Nut Gear(KGT) Load - Hoch" ULONG ZU0 1 100 0 4294967295 FORMAT "%13.2" ECU_ADDRESS 0xFEBE92C0 /end MEASUREMENT
/begin MEASUREMENT yLdTrkI_BallNutGear_xdu32 "Value auf die Ball Nut Gear(KGT) Load" ULONG RIGHTSH10NP 1 100 0 4194303.99902 FORMAT "%13.5" ECU_ADDRESS 0xFEBE92C4 /end MEASUREMENT
/begin MEASUREMENT yLdTrkI_GenMechanicalLoadH_xdu32 "allgemeine mechanische Schaedigung High" ULONG ZU0 1 100 0 4294967295 FORMAT "%13.2" ECU_ADDRESS 0xFEBE92C8 /end MEASUREMENT
/begin MEASUREMENT yLdTrkI_GenMechanicalLoad_xdu32 "allgemeine mechanische Schaedigung" ULONG ZU0 1 100 0 4294967295 FORMAT "%13.2" ECU_ADDRESS 0xFEBE92CC /end MEASUREMENT
/begin MEASUREMENT yLdTrk_BallNutGearLDelta_xdf32 "Deviation from Ball Nut Gear(KGT) Load - Tief" FLOAT32_IEEE FLOAT 1 100 0 1 FORMAT "%16.14" ECU_ADDRESS 0xFEBE92E0 /end MEASUREMENT
/begin MEASUREMENT yLdTrk_CalcClassGenMechRest_xds16 "Calculated Klasse bei Schädigungsberechnung GenMechRest (Dev)" SWORD ZU0 1 100 0 119 FORMAT "%8.4" ECU_ADDRESS 0xFEBE97E6 /end MEASUREMENT
/begin MEASUREMENT yLdTrk_CalcClassGenMech_xds16 "Calculated Klasse bei Schädigungsberechnung GenMech (Dev)" SWORD ZU0 1 100 0 119 FORMAT "%8.4" ECU_ADDRESS 0xFEBE97E8 /end MEASUREMENT
/begin MEASUREMENT yLdTrk_FirstClassChange_xdb "Initialisierung für OldGrad" UWORD BIT 1 100 0 1 BIT_MASK 0x1 FORMAT "%5.3" ECU_ADDRESS 0xFEBE9A74 /end MEASUREMENT
/begin MEASUREMENT yLdTrk_FirstRun_xdb "Initialisierung für OldClass" UWORD BIT 1 100 0 1 BIT_MASK 0x1 FORMAT "%5.3" ECU_ADDRESS 0xFEBE9A75 /end MEASUREMENT
/begin MEASUREMENT yLdTrk_LowerClassGenMech_xdu8 "Untere Klasse bei Schädigungsberechnung GenMech (Dev)" UBYTE ZU0 1 100 0 120 FORMAT "%5.1" ECU_ADDRESS 0xFEBE9A76 /end MEASUREMENT
/begin MEASUREMENT yLdTrk_LowerClassImp_xdu8 "Untere Klasse bei Schädigungsberechnung (Dev) für Impact Damage" UBYTE ZU0 1 100 0 200 FORMAT "%5.1" ECU_ADDRESS 0xFEBE9A77 /end MEASUREMENT
/begin MEASUREMENT yLdTrk_LowerClassRot_xdu8 "Untere Klasse bei Schädigungsberechnung (Dev)" UBYTE ZU0 1 100 0 200 FORMAT "%5.1" ECU_ADDRESS 0xFEBE9A78 /end MEASUREMENT
/begin MEASUREMENT yLdTrk_NewExtrema_xdu8 "Klasse aktuelles/neus Extrema (stateflow static)" UBYTE ZU0 1 100 0 200 FORMAT "%5.1" ECU_ADDRESS 0xFEBE9A79 /end MEASUREMENT
/begin MEASUREMENT yLdTrk_OldClassGenMech_xdu8 "Alte Klasse GenMech (stateflow static)" UBYTE ZU0 1 100 0 120 FORMAT "%5.1" ECU_ADDRESS 0xFEBE9A7A /end MEASUREMENT
/begin MEASUREMENT yLdTrk_OldClass_xdu8 "Alte Klasse (stateflow static)" UBYTE ZU0 1 100 0 200 FORMAT "%5.1" ECU_ADDRESS 0xFEBE9A7B /end MEASUREMENT
/begin MEASUREMENT yLdTrk_OldExtrema_xdu8 "Klasse vorheriges Extrema (stateflow static)" UBYTE ZU0 1 100 0 200 FORMAT "%5.1" ECU_ADDRESS 0xFEBE9A7C /end MEASUREMENT
/begin MEASUREMENT yLdTrk_OldGradGenMech_xdu8 "Alter Gradient pos/neg GenMech (stateflow static)" UBYTE ZU0 1 100 0 2 FORMAT "%5.3" ECU_ADDRESS 0xFEBE9A7D /end MEASUREMENT
/begin MEASUREMENT yLdTrk_OldGrad_xdu8 "Alter Gradient pos/neg (stateflow static)" UBYTE ZU0 1 100 0 2 FORMAT "%5.3" ECU_ADDRESS 0xFEBE9A7E /end MEASUREMENT
/begin MEASUREMENT yLdTrk_ResiduumGenMechLoad_xau8 "Residuum Gen Mech, element_anzahl = (2*Klassenanzahl+1)*2" UBYTE ZU0 1 100 0 120 FORMAT "%5.1" ECU_ADDRESS 0xFEBEA218 MATRIX_DIM 482 1 1 /end MEASUREMENT
/begin MEASUREMENT yLdTrk_ResiduumWormWheelImpDamage_xau8 "Residuum Schneckenrad für Impact Damage, element_anzahl = (2*Klassenanzahl+1)*2, Klassenanzahl = maxp_w" UBYTE ZU0 1 100 0 200 FORMAT "%5.1" ECU_ADDRESS 0xFEBEA3FC MATRIX_DIM 802 1 1 /end MEASUREMENT
/begin MEASUREMENT yLdTrk_ResiduumWormWheelRotDamage_xau8 "Residuum Schneckenrad, element_anzahl = (2*Klassenanzahl+1)*2" UBYTE ZU0 1 100 40 159 FORMAT "%5.1" ECU_ADDRESS 0xFEBEA720 MATRIX_DIM 482 1 1 /end MEASUREMENT
/begin MEASUREMENT yLdTrk_UpperClassGenMech_xdu8 "Obere Klasse bei Schädigungsberechnung GenMech (Dev)" UBYTE ZU0 1 100 0 120 FORMAT "%5.1" ECU_ADDRESS 0xFEBE9A7F /end MEASUREMENT
/begin MEASUREMENT yLdTrk_UpperClassImp_xdu8 "Obere Klasse bei Schädigungsberechnung (Dev) für Impact Damage" UBYTE ZU0 1 100 0 200 FORMAT "%5.1" ECU_ADDRESS 0xFEBE9A80 /end MEASUREMENT
/begin MEASUREMENT yLdTrk_UpperClassRot_xdu8 "Obere Klasse bei Schädigungsberechnung (Dev)" UBYTE ZU0 1 100 0 200 FORMAT "%5.1" ECU_ADDRESS 0xFEBE9A81 /end MEASUREMENT
/begin MEASUREMENT yLdTrk_WormWheelImpDamageHigh_LastCycle_xdu32 "Schneckenradschaedigung des letzten Zyklus obere 32Bit" ULONG ZU0 1 100 0 4294967295 FORMAT "%13.2" ECU_ADDRESS 0xFEBE92E4 /end MEASUREMENT
/begin MEASUREMENT yLdTrk_WormWheelImpDamage_LastCycle_xdu32 "Schneckenradschaedigung des letzten Zyklus untere 32Bit" ULONG ZU0 1 100 0 4294967295 FORMAT "%13.2" ECU_ADDRESS 0xFEBE92E8 /end MEASUREMENT
/begin MEASUREMENT yLdTrk_WormWheelRotDamageHigh_LastCycle_xdu32 "Schneckenradschaedigung des letzten Zyklus obere 32Bit" ULONG ZU0 1 100 0 4294967295 FORMAT "%13.2" ECU_ADDRESS 0xFEBE92EC /end MEASUREMENT
/begin MEASUREMENT yLdTrk_WormWheelRotDamage_LastCycle_xdu32 "Schneckenradschaedigung des letzten Zyklus untere 32Bit" ULONG ZU0 1 100 0 4294967295 FORMAT "%13.2" ECU_ADDRESS 0xFEBE92F0 /end MEASUREMENT
/begin MEASUREMENT yMotTorLim_L1PosVal_xds16 "level 1 PosVal" SWORD ZU0 1 100 -32768 2048 FORMAT "%8.2" ECU_ADDRESS 0xFEBE97EA /end MEASUREMENT
/begin MEASUREMENT yMotTorLim_L2PosVal_xds16 "level 2 PosVal" SWORD ZU0 1 100 -32768 2048 FORMAT "%8.2" ECU_ADDRESS 0xFEBE97EC /end MEASUREMENT
/begin MEASUREMENT zLdTrk_ImpactTimer_xdu8 "Timer fuer Unterscheidung Impact/rotatorisch" UWORD ZU0 1 100 0 65535 FORMAT "%8.2" ECU_ADDRESS 0xFEBE9A8E /end MEASUREMENT
/begin MEASUREMENT zLdTrk_SteeringRangeCounterArray_xau32 "Steering Range Counter Array" ULONG ZU0 1 100 0 4294967295 FORMAT "%13.2" ECU_ADDRESS 0xFEBEA904 MATRIX_DIM 22 1 1 /end MEASUREMENT
/begin MEASUREMENT zLdTrk_ValuesInResiduum_xdu16 "Anzahl der Werte im Residuum, max Wert muss gleich sein wie die Element_Anzahl von yLdTrk_ResiduumGenMechLoad_xau8" UWORD ZU0 1 100 0 482 FORMAT "%8.4" ECU_ADDRESS 0xFEBE980E /end MEASUREMENT
/begin MEASUREMENT zLdTrk_ValuesInResImp_xdu16 "Anzahl der Werte im Residuum für impact damage, max Wert muss gleich sein wie die Groesse von yLdTrk_ResiduumWormWheelImpDamage_xau8" UWORD ZU0 1 100 0 802 FORMAT "%8.4" ECU_ADDRESS 0xFEBE9810 /end MEASUREMENT
/begin MEASUREMENT zLdTrk_ValuesInResRot_xdu16 "Anzahl der Werte im Residuum, max Wert muss gleich sein wie die Element_Anzahl von yLdTrk_ResiduumWormWheelRotDamage_xau8" UWORD ZU0 1 100 0 482 FORMAT "%8.4" ECU_ADDRESS 0xFEBE9812 /end MEASUREMENT
/begin MEASUREMENT zLka_ErrorCode_xdu8 "LKA error code" UBYTE ZU0 1 100 0 255 FORMAT "%5.1" ECU_ADDRESS 0xFEBE9A90 /end MEASUREMENT
/begin MEASUREMENT zMotTorLim_VibrationDetectionCycleCounter_xdu8 "Anzahl der erkannten Halbwellen einer Schwingung" UBYTE ZU0 1 100 0 200 FORMAT "%5.1" ECU_ADDRESS 0xFEBE9A91 /end MEASUREMENT
/begin MEASUREMENT zMotTorLim_VibrationOnLimitsDetectionCycleCounter_xdu8 "Anzahl der erkannten Halbwellen einer Schwingung am Limit" UBYTE ZU0 1 100 0 200 FORMAT "%5.1" ECU_ADDRESS 0xFEBE9A92 /end MEASUREMENT
/begin MEASUREMENT zOsMonI_HlAliveCounter_xdu8 "Zähler zeigt der HwLib an, dass High-level Software noch -lebendig- ist" UBYTE ZU0 1 100 0 255 FORMAT "%5.1" ECU_ADDRESS 0xFEBE4B30 /end MEASUREMENT
/begin MEASUREMENT zRpCorrI_CalibCycleCounterLTNVR_xdu8 "counter for calibration cycle, stored in NVR corr block" UBYTE ZU0 1 100 0 255 FORMAT "%5.1" ECU_ADDRESS 0xFEBE9A93 /end MEASUREMENT
/begin COMPU_METHOD AFZ "" RAT_FUNC "%6.5" "m/s^2" COEFFS 0 1024 0 0 0 1 /end COMPU_METHOD
/begin COMPU_METHOD ANGLE_1 "" RAT_FUNC "%6.2" "Â°" COEFFS 0 1 0 0 0 1 /end COMPU_METHOD
/begin COMPU_METHOD BIT "" RAT_FUNC "%6.2" "Bitanzeige" COEFFS 0 1 0 0 0 1 /end COMPU_METHOD
/begin COMPU_METHOD FACTOR_100 "" RAT_FUNC "%6.4" "%" COEFFS 0 100 0 0 0 1 /end COMPU_METHOD
/begin COMPU_METHOD FLOAT "" RAT_FUNC "%16.7" "NA" COEFFS 0 1 0 0 0 1 /end COMPU_METHOD
/begin COMPU_METHOD FRACK "" RAT_FUNC "%6.2" "N" COEFFS 0 1 0 0 0 1 /end COMPU_METHOD
/begin COMPU_METHOD METERS "" RAT_FUNC "%6.2" "m" COEFFS 0 1 0 0 0 1 /end COMPU_METHOD
/begin COMPU_METHOD MMOT "" RAT_FUNC "%6.5" "Nm" COEFFS 0 1024 0 0 0 1 /end COMPU_METHOD
/begin COMPU_METHOD PDC_FRACK "" RAT_FUNC "%6.3" "N" COEFFS 0 2 0 0 0 1 /end COMPU_METHOD
/begin COMPU_METHOD PDC_FRACK_HIGH "" RAT_FUNC "%8.7" "N" COEFFS 0 524288 0 0 0 1 /end COMPU_METHOD
/begin COMPU_METHOD PDC_STATE "" TAB_VERB "%6.3" "Status" COMPU_TAB_REF PDC_STATE /end COMPU_METHOD
/begin COMPU_METHOD RAMPRATE "" RAT_FUNC "%6.5" "Nm/s" COEFFS 0 1024 0 0 0 1 /end COMPU_METHOD
/begin COMPU_METHOD RIGHTSH10NP "" RAT_FUNC "%6.5" "" COEFFS 0 1024 0 0 0 1 /end COMPU_METHOD
/begin COMPU_METHOD RIGHTSH12NP "" RAT_FUNC "%6.5" "" COEFFS 0 4096 0 0 0 1 /end COMPU_METHOD
/begin COMPU_METHOD RIGHTSH14NP "" RAT_FUNC "%7.6" "" COEFFS 0 16384 0 0 0 1 /end COMPU_METHOD
/begin COMPU_METHOD RIGHTSH15NP "" RAT_FUNC "%7.6" "" COEFFS 0 32768 0 0 0 1 /end COMPU_METHOD
/begin COMPU_METHOD RIGHTSH15NP_1MS "" RAT_FUNC "%7.6" "1/1ms" COEFFS 0 32768 0 0 0 1 /end COMPU_METHOD
/begin COMPU_METHOD RIGHTSH16NP "" RAT_FUNC "%7.6" "" COEFFS 0 65536 0 0 0 1 /end COMPU_METHOD
/begin COMPU_METHOD RIGHTSH20NP "" RAT_FUNC "%9.8" "" COEFFS 0 1048576 0 0 0 1 /end COMPU_METHOD
/begin COMPU_METHOD RIGHTSH4NP "" RAT_FUNC "%6.4" "" COEFFS 0 16 0 0 0 1 /end COMPU_METHOD
/begin COMPU_METHOD RIGHTSH5NP "" RAT_FUNC "%6.4" "" COEFFS 0 32 0 0 0 1 /end COMPU_METHOD
/begin COMPU_METHOD RIGHTSH6NP "" RAT_FUNC "%6.4" "" COEFFS 0 64 0 0 0 1 /end COMPU_METHOD
/begin COMPU_METHOD ROTPOS "" RAT_FUNC "%6.3" "Â°" COEFFS 0 11.3777777778 0 0 0 1 /end COMPU_METHOD
/begin COMPU_METHOD SAS "" RAT_FUNC "%6.3" "Â°/s" COEFFS 0 2 0 0 0 1 /end COMPU_METHOD
/begin COMPU_METHOD SAS_8 "" RAT_FUNC "%6.3" "Â°/s" COEFFS 0 8 0 0 0 1 /end COMPU_METHOD
/begin COMPU_METHOD SA_10 "" RAT_FUNC "%6.3" "Â°" COEFFS 0 10 0 0 0 1 /end COMPU_METHOD
/begin COMPU_METHOD SYSTEM_STATE "" TAB_VERB "%6.3" "Status" COMPU_TAB_REF SYSTEM_STATE /end COMPU_METHOD
/begin COMPU_METHOD TBTHIGH "" RAT_FUNC "%6.5" "Nm" COEFFS 0 1024 0 0 0 1 /end COMPU_METHOD
/begin COMPU_METHOD TIMMS "" RAT_FUNC "%6.2" "ms" COEFFS 0 1 0 0 0 1 /end COMPU_METHOD
/begin COMPU_METHOD TIMMS_10 "" RAT_FUNC "%6.1" "ms" COEFFS 0 0.1 0 0 0 1 /end COMPU_METHOD
/begin COMPU_METHOD TIMSEC_10 "" RAT_FUNC "%6.3" "s" COEFFS 0 10 0 0 0 1 /end COMPU_METHOD
/begin COMPU_METHOD TIMSEC_1000 "" RAT_FUNC "%6.5" "s" COEFFS 0 1000 0 0 0 1 /end COMPU_METHOD
/begin COMPU_METHOD TMPOUTS "" RAT_FUNC "%6.2" "Â°C" COEFFS 0 1 70 0 0 1 /end COMPU_METHOD
/begin COMPU_METHOD TORGRAD "" RAT_FUNC "%6.5" "Nm/ms" COEFFS 0 1024 0 0 0 1 /end COMPU_METHOD
/begin COMPU_METHOD U64V "" RAT_FUNC "%6.4" "V" COEFFS 0 64 0 0 0 1 /end COMPU_METHOD
/begin COMPU_METHOD VFZ "" RAT_FUNC "%6.2" "km/h" COEFFS 0 1 0 0 0 1 /end COMPU_METHOD
/begin COMPU_METHOD VFZHIGH "" RAT_FUNC "%6.4" "km/h" COEFFS 0 64 0 0 0 1 /end COMPU_METHOD
/begin COMPU_METHOD VGIER "" RAT_FUNC "%6.4" "Â°/s" COEFFS 0 200 0 0 0 1 /end COMPU_METHOD
/begin COMPU_METHOD VROT "" RAT_FUNC "%3.1" "1/min" COEFFS 0 1 0 0 0 1 /end COMPU_METHOD
/begin COMPU_METHOD ZU0 "" RAT_FUNC "%6.2" "" COEFFS 0 1 0 0 0 1 /end COMPU_METHOD
/begin COMPU_METHOD default "" RAT_FUNC "%6.2" "" COEFFS 0 1 0 0 0 1 /end COMPU_METHOD
/begin COMPU_VTAB PDC_STATE "" TAB_VERB 6 0 "PDC_State_Passive" 1 "PDC_State_Active" 2 "PDC_State_Hold" 3 "PDC_State_RampDown" 4 "PDC_State_RequestForActivation" 5 "PDC_State_HoldLongTerm" DEFAULT_VALUE "undefined" /end COMPU_VTAB
/begin COMPU_VTAB SYSTEM_STATE "" TAB_VERB 12 0 "undefined" 1 "NMWait" 2 "KL30Wait" 3 "PreDrive" 4 "DriveDown" 5 "DriveUp" 6 "PostRun" 7 "Off" 8 "Error" 9 "Flash" 10 "LowVolt" 11 "LimpHome" DEFAULT_VALUE "undefined" /end COMPU_VTAB
/begin FUNCTION LaneKeepAssistCheck "Lane Keep Assist Check"
 /begin DEF_CHARACTERISTIC mLka_DefaultGradient_XDU16 mLka_DrvInterventionTrqChk_XAU16_0___A mLka_DrvInterventionTrqChk_XAU16_1___A mLka_DrvInterventionTrqChk_XAU16_2___A mLka_DrvInterventionTrqChk_XAU16_3___A mLka_DrvInterventionTrqChk_XAU16_4___A mLka_DrvInterventionTrqChk_XAU16_5___A mLka_DrvInterventionTrqChk_XDU16_0___A mLka_DrvInterventionTrqChk_XDU16_1___A mLka_DrvInterventionTrqChk_XDU16_2___A mLka_DrvInterventionTrqChk_XDU16_3___A mLka_DrvInterventionTrqChk_XDU16_4___A mLka_DrvInterventionTrqChk_XDU16_5___A mLka_MaxMmotOffsetMonSafe_XAU16_0___A mLka_MaxMmotOffsetMonSafe_XAU16_1___A mLka_MaxMmotOffsetMonSafe_XAU16_2___A mLka_MaxMmotOffsetMonSafe_XAU16_3___A mLka_MaxMmotOffsetMonSafe_XAU16_4___A mLka_MaxMmotOffsetMonSafe_XAU16_5___A mLka_MaxTbtOffsetMonSafe_XAU16_0___A mLka_MaxTbtOffsetMonSafe_XAU16_1___A mLka_MaxTbtOffsetMonSafe_XAU16_2___A mLka_MaxTbtOffsetMonSafe_XAU16_3___A mLka_MaxTbtOffsetMonSafe_XAU16_4___A mLka_MaxTbtOffsetMonSafe_XAU16_5___A mLka_MaxTBTOffsetMonSafe_XDU16 mLka_MaxTorqueRequestCheck_XDU16 mLka_VdtomTrqMonSafe_XAU16 sLka_ConfigErrorFlag_XDU8 tLka_DrvInterventionTimeCheck_XDU8 tLka_DrvInterventionTimeChk_XAU16 tLka_ExceedTorqueLimitCheck_XDU8 xLka_ActDampFact_XDU16 xLka_ActRetFuncFact_XDU16 xLka_ActRetSpeedFact_XDU16 zLka_SignCheckFailedCycle_XDU8 /end DEF_CHARACTERISTIC
 /begin IN_MEASUREMENT vVehSpI_AbsMaxSafeVehSpd_xdu16 /end IN_MEASUREMENT
 /begin OUT_MEASUREMENT fLka_LastLkaArbitrationResultPassive_xdb mLka_MaxRampRateCheck_xdu16 mLka_MMOTOffsetChecked_xds16 mLka_TBTOffsetChecked_xds16 sLka_InhibitReason_xdu8 /end OUT_MEASUREMENT
/end FUNCTION
/begin FUNCTION LaneKeepAssistCheckI "Interfacegrößen LaneKeepAssistCheck"
 /begin OUT_MEASUREMENT fLkaI_MonSafeOk_xdb mLkaI_CheckedMMotOffset_xds16 mLkaI_CheckedTBTOffset_xds16 xLkaI_ActiveDampingFactor_xdu16 xLkaI_ActiveReturnFuncFactor_xdu16 xLkaI_ActiveReturnSpeedFactor_xdu16 /end OUT_MEASUREMENT
/end FUNCTION
/begin FUNCTION LaneKeepAssistI "InterfacegrÃ¶ÃŸen CMP LaneKeepAssist"
 /begin OUT_MEASUREMENT fLkaI_DrvOverrideChk_xdb fLkaI_SignalChk_xdb mLkaI_MMOTOffset_xds16 mLkaI_TBTOffset_xds16 xLkaI_BoostFactorChk_xdu8 /end OUT_MEASUREMENT
/end FUNCTION
/begin FUNCTION LaneKeepAssistSupp ""
 /begin DEF_CHARACTERISTIC mLka_DrvInterventionTorque_XAU16_0___A mLka_DrvInterventionTorque_XAU16_1___A mLka_DrvInterventionTorque_XAU16_2___A mLka_DrvInterventionTorque_XAU16_3___A mLka_DrvInterventionTorque_XAU16_4___A mLka_DrvInterventionTorque_XAU16_5___A mLka_GradientLimit_XAU16_0___A mLka_GradientLimit_XAU16_1___A mLka_GradientLimit_XAU16_2___A mLka_GradientLimit_XAU16_3___A mLka_GradientLimit_XAU16_4___A mLka_GradientLimit_XAU16_5___A mLka_MaxTrqReq_XAU16 sLka_ActDectChks_XDU8 sLka_DrvChkConfig_XDU8 sLka_ModeReq_XDU8 sLka_ModeSelect_XDU8 tLka_DriverInterventionTime_XAU16 tLka_ErrorTime_XDU16 tLka_MaxTrqReqTime_XAU8 tLka_RateLimTime_XAU8 tLka_VehSpdErrTime_XAU8 vLka_MaxVehicleSpeed_XAU16 vLka_MinVehicleSpeed_XAU16 zLka_CycleFactor_XDU8 zLka_ErrorCnt_XDU8 /end DEF_CHARACTERISTIC
 /begin OUT_MEASUREMENT fLka_ActivateFuncCo_xdb sLka_CtrlState_xdu8 sLka_FeatureState_xdu8 zLka_ErrorCode_xdu8 /end OUT_MEASUREMENT
/end FUNCTION
/begin FUNCTION LaneKeepAssistSuppI "" /begin OUT_MEASUREMENT fLkaI_ActivateLKA_xdb sLkaI_LkaMode_xdu8 sLkaI_State_xdu8 /end OUT_MEASUREMENT /end FUNCTION
/begin FUNCTION LaNopStateMachineI "LaNopStateMachine - interfaces"
 /begin OUT_MEASUREMENT fLaI_ActivateFctCo_xdb sLaI_NopDegradedSts_xdu8 sLaI_NopState_xdu8 sLaI_NopWarnlight_xdu8 /end OUT_MEASUREMENT
/end FUNCTION
/begin FUNCTION LdTrkBallNutGear "Load Tracking - Ball Nut Gear"
 /begin DEF_CHARACTERISTIC wLdTrk_BallNutHysteresisFilterWidth_XDU16 xLdTrk_BallNutMMotFilterFact_XDU16 xLdTrk_LoadFactor_XDF32 /end DEF_CHARACTERISTIC
 /begin OUT_MEASUREMENT fLdTrk_BallNutJobResultOK_xdb mLdTrk_BallNutMMotPT1_xds32 mLdTrk_FiltMMot4BallNutLoadTracker_xds16 yLdTrk_BallNutGearLDelta_xdf32 /end OUT_MEASUREMENT
/end FUNCTION
/begin FUNCTION LdTrkBallNutGearI "LoadTracker - Ball Nut Gear Load Tracker" /begin OUT_MEASUREMENT yLdTrkI_BallNutGearH_xdu32 yLdTrkI_BallNutGear_xdu32 /end OUT_MEASUREMENT /end FUNCTION
/begin FUNCTION LdTrkFindTurningPoints "WormWheelDamageTracker - Schneckenradschädigung"
 /begin DEF_CHARACTERISTIC cLdTrk_OffsetLine_XDS16 cLdTrk_SubstTemp_XDU8 mLdTrk_ClassOffsetWorm_XDU16 mLdTrk_HysteresisSchlepAreaWorm_XDU16 mLdTrk_InvClassWidthWorm_XDU16 mLdTrk_MaxDeltaWWT_XDU16 mLdTrk_StartClassWormImpact_XDU16 wLdTrk_MaxDeltaRotPos_XDU16 xLdTrk_FilterFactTempWorm_XDU16 xLdTrk_GradLine_XDU16 xLdTrk_TransmissionWormGear_XDU16 zLdTrk_MaxImpactCycles_XDU8 /end DEF_CHARACTERISTIC
 /begin OUT_MEASUREMENT cLdTrk_CalcWormWheelTemp_xdu8 cLdTrk_WormGearTemperatureAtNewExtrema_xdu8 cLdTrk_WormGearTemperatureAtOldExtrema_xdu8 fLdTrk_NewExtremaType_xdu8 fLdTrk_OldExtremaType_xdu8 fLdTrk_OldExtremaVerified_xdu8 mLdTrk_AbsDeltaWWTDelay_xdu16 mLdTrk_LowerSchlepPointer_xds16 mLdTrk_UpperSchlepPointer_xds16 wLdTrk_RotorPositionDelay_xds32 wLdTrk_RotPosAtNewExtrema_xds32 yLdTrk_FirstClassChange_xdb yLdTrk_FirstRun_xdb yLdTrk_NewExtrema_xdu8 yLdTrk_OldClass_xdu8 yLdTrk_OldExtrema_xdu8 yLdTrk_OldGrad_xdu8 zLdTrk_ImpactTimer_xdu8 /end OUT_MEASUREMENT
/end FUNCTION
/begin FUNCTION LdTrkGenericMechLoad "Load Tracking - Mechanical Load Tracker"
 /begin DEF_CHARACTERISTIC mLdTrk_ClassOffsetGenMech_XDU16 mLdTrk_HysteresisSchlepAreaGenMech_XDU16 mLdTrk_InvClassWidthGenMech_XDU16 mLdTrk_StartClassGenMech_XDU16 xLdTrk_FilterFactMMOTGenMech_XDU16 xLdTrk_MeanStressSensitivityGenMech_XDF32 yLdTrk_DamageTabGenMech_XAF32 yLdTrk_MaxLoopCountGenMech_XDU8 /end DEF_CHARACTERISTIC
 /begin OUT_MEASUREMENT fLdTrk_FirstRunGenMech_xdb fLdTrk_GenMechJobResultOK_xdb mLdTrk_FiltMmot4GenMech_xds16 mLdTrk_LowerSchlepPointerGenMech_xds16 mLdTrk_MMotPT1GenMech_xds32 mLdTrk_UpperSchlepPointerGenMech_xds16 yLdTrk_CalcClassGenMechRest_xds16 yLdTrk_CalcClassGenMech_xds16 yLdTrk_LowerClassGenMech_xdu8 yLdTrk_OldClassGenMech_xdu8 yLdTrk_OldGradGenMech_xdu8 yLdTrk_ResiduumGenMechLoad_xau8 yLdTrk_UpperClassGenMech_xdu8 zLdTrk_ValuesInResiduum_xdu16 /end OUT_MEASUREMENT
/end FUNCTION
/begin FUNCTION LdTrkGenericMechLoadI "Mechanical Load Tracker - interface"
 /begin OUT_MEASUREMENT yLdTrkI_GenMechanicalLoadH_xdu32 yLdTrkI_GenMechanicalLoad_xdu32 /end OUT_MEASUREMENT
/end FUNCTION
/begin FUNCTION LdTrkITemperature ""
 /begin DEF_CHARACTERISTIC cLdTrk_TemperatureBorder10_XDU8 cLdTrk_TemperatureBorder11_XDU8 cLdTrk_TemperatureBorder12_XDU8 cLdTrk_TemperatureBorder13_XDU8 cLdTrk_TemperatureBorder14_XDU8 cLdTrk_TemperatureBorder15_XDU8 cLdTrk_TemperatureBorder16_XDU8 cLdTrk_TemperatureBorder17_XDU8 cLdTrk_TemperatureBorder18_XDU8 cLdTrk_TemperatureBorder19_XDU8 cLdTrk_TemperatureBorder1_XDU8 cLdTrk_TemperatureBorder2_XDU8 cLdTrk_TemperatureBorder3_XDU8 cLdTrk_TemperatureBorder4_XDU8 cLdTrk_TemperatureBorder5_XDU8 cLdTrk_TemperatureBorder6_XDU8 cLdTrk_TemperatureBorder7_XDU8 cLdTrk_TemperatureBorder8_XDU8 cLdTrk_TemperatureBorder9_XDU8 tLdTrk_TimeMaxInTempZone_XDU32 /end DEF_CHARACTERISTIC
 /begin OUT_MEASUREMENT fLdTrk_TemperatureTrackerJobResultOK_xdb /end OUT_MEASUREMENT
/end FUNCTION
/begin FUNCTION LdTrkMileageTracker "Load Tracking - MileageTracker" /begin DEF_CHARACTERISTIC lLdTrk_MaxDistanceLimit_XDU32 /end DEF_CHARACTERISTIC /begin OUT_MEASUREMENT fLdTrk_MileageTrackerJobResultOK_xdb /end OUT_MEASUREMENT /end FUNCTION
/begin FUNCTION LdTrkSteeringRange "LoadTracking - SteeringRange"
 /begin DEF_CHARACTERISTIC hLdTrk_StAngleLvlCrossingHysteresis_XDU16 hLdTrk_SteeringAngleLevelCrossingLimit_XAS16 wLdTrk_MaxSteeringRange_XDU16 zLdTrk_MaxCountRange_XDU32 /end DEF_CHARACTERISTIC
 /begin OUT_MEASUREMENT fLdTrk_HysteresisLvlCrossed_xau8 fLdTrk_SteerRangeJobResultOK_xdb hLdTrk_SteeringPercent_xds32 zLdTrk_SteeringRangeCounterArray_xau32 /end OUT_MEASUREMENT
/end FUNCTION
/begin FUNCTION LdTrkWormWheelDamage "WormWheelDamageTracker - Schneckenradschädigung"
 /begin DEF_CHARACTERISTIC mLdTrk_StartClassWormImp_XDU16 mLdTrk_StartClassWormRot_XDU16 xLdTrk_MeanStressSensitivityImp_XDF32 xLdTrk_MeanStressSensitivityRot_XDF32 yLdTrk_DamageTabWormImp_XAF32 yLdTrk_DamageTabWormRot_XAF32 yLdTrk_MaxLoopCount_XDU8 yLdTrk_TempNdWormImp_XDF32 yLdTrk_TempNdWormRot_XAF32 yLdTrk_WormWheelImpDamageDefault_XDF32 yLdTrk_WormWheelRotDamageDefault_XDF32 /end DEF_CHARACTERISTIC
 /begin OUT_MEASUREMENT cLdTrk_CalcWormWheelTempRot_xdf32 cLdTrk_ResiduumWormWheelRotTemperature_xau8 xLdTrk_NvMCallbackCounter_xdu16 yLdTrk_LowerClassImp_xdu8 yLdTrk_LowerClassRot_xdu8 yLdTrk_ResiduumWormWheelImpDamage_xau8 yLdTrk_ResiduumWormWheelRotDamage_xau8 yLdTrk_UpperClassImp_xdu8 yLdTrk_UpperClassRot_xdu8 yLdTrk_WormWheelImpDamageHigh_LastCycle_xdu32 yLdTrk_WormWheelImpDamage_LastCycle_xdu32 yLdTrk_WormWheelRotDamageHigh_LastCycle_xdu32 yLdTrk_WormWheelRotDamage_LastCycle_xdu32 zLdTrk_ValuesInResImp_xdu16 zLdTrk_ValuesInResRot_xdu16 /end OUT_MEASUREMENT
/end FUNCTION
/begin FUNCTION LowVoltageAssistReduction "UnderVoltageReduction"
 /begin DEF_CHARACTERISTIC tLowVoltAssRed_UnderVoltageHoldTime_XDU16 uLowVoltAssRed_SubstSupplyVoltage_XDU16 vLowVoltAssRed_ValidMinSpeed_XDU16 xLowVoltAssRed_NegativeMotorTorqueGradient_XDU16 xLowVoltAssRed_NegGradCompressMotorChar_XDU16 xLowVoltAssRed_NegRedGradMotorTorqueGrad_XDU16 xLowVoltAssRed_PosGradCompressMotorChar_XDU16 xLowVoltAssRed_PositiveMotorTorqueGradient_XDU16 xLowVoltAssRed_PosRedGradMotorTorqueGrad_XDU16 xLowVoltAssRed_UnderVoltageMotorCharTorqueAxis_XAU16 xLowVoltAssRed_UnderVoltageReductionLevel_XAU16 xLowVoltAssRed_UnderVoltageTorqueReductionGradient_XAU16 /end DEF_CHARACTERISTIC
 /begin OUT_MEASUREMENT uLowVoltAssRed_SupplyVoltage_xdu16 /end OUT_MEASUREMENT
/end FUNCTION
/begin FUNCTION LowVoltageAssistReductionSupp "UnderVoltage reduction activation" /begin OUT_MEASUREMENT sLowVoltAssRedI_EnableReduction_xdb /end OUT_MEASUREMENT /end FUNCTION
/begin FUNCTION MainConnMotTrqSumI "MainConnMotTrqSum - interface" /begin OUT_MEASUREMENT mTrqSumI_MotTrqSum1_xds16 /end OUT_MEASUREMENT /end FUNCTION
/begin FUNCTION MCDataIntegrity "MCDataIntegrity" /begin DEF_CHARACTERISTIC yErrInjectionLocalSwitchDummy_XDU8 /end DEF_CHARACTERISTIC /begin OUT_MEASUREMENT sMcdI_ErrLvl_Red_xdu8 sMcdI_ErrLvl_xdu8 /end OUT_MEASUREMENT /end FUNCTION
/begin FUNCTION MchStPrv "Mechanical Stuck Prevention"
 /begin DEF_CHARACTERISTIC nMchStPrv_BoundRotSpeedGRADTBT_XAU16_0___A nMchStPrv_BoundRotSpeedGRADTBT_XAU16_1___A nMchStPrv_BoundRotSpeedGRADTBT_XAU16_2___A nMchStPrv_BoundRotSpeedGRADTBT_XAU16_3___A nMchStPrv_BoundRotSpeedGRADTBT_XAU16_4___A nMchStPrv_BoundRotSpeedGRADTBT_XAU16_5___A nMchStPrv_BoundRotSpeedMeffVO_XAU16 nMchStPrv_BoundRotSpeedMeff_XAU16_0___A nMchStPrv_BoundRotSpeedMeff_XAU16_1___A nMchStPrv_BoundRotSpeedMeff_XAU16_2___A nMchStPrv_BoundRotSpeedMeff_XAU16_3___A nMchStPrv_BoundRotSpeedMeff_XAU16_4___A nMchStPrv_BoundRotSpeedMeff_XAU16_5___A nMchStPrv_BoundRotSpeedSWA_XAU16 tMchStPrv_HakelPeriodHalf_XDU16_0___A tMchStPrv_HakelPeriodHalf_XDU16_1___A tMchStPrv_HakelPeriodHalf_XDU16_2___A tMchStPrv_HakelPeriodHalf_XDU16_3___A tMchStPrv_HakelPeriodHalf_XDU16_4___A tMchStPrv_HakelPeriodHalf_XDU16_5___A vMchStPrv_MeffV0bound_XDU16_0___A vMchStPrv_MeffV0bound_XDU16_1___A vMchStPrv_MeffV0bound_XDU16_2___A vMchStPrv_MeffV0bound_XDU16_3___A vMchStPrv_MeffV0bound_XDU16_4___A vMchStPrv_MeffV0bound_XDU16_5___A xMchStPrv_GradTBTFilterFact_XDU16 xMchStPrv_GroundLevelFactHakel_XDU16 xMchStPrv_GroundLevelHakelAngle_XAU16 xMchStPrv_GroundLevelHakelVFZFactor_XAU16 xMchStPrv_HakelGrad_XDU16 xMchStPrv_MaxActDepSteeringAngle_XAU16_0___A xMchStPrv_MaxActDepSteeringAngle_XAU16_1___A xMchStPrv_MaxActDepSteeringAngle_XAU16_2___A xMchStPrv_MaxActDepSteeringAngle_XAU16_3___A xMchStPrv_MaxActDepSteeringAngle_XAU16_4___A xMchStPrv_MaxActDepSteeringAngle_XAU16_5___A xMchStPrv_MaxActDepVFZ_XAU16_0___A xMchStPrv_MaxActDepVFZ_XAU16_1___A xMchStPrv_MaxActDepVFZ_XAU16_2___A xMchStPrv_MaxActDepVFZ_XAU16_3___A xMchStPrv_MaxActDepVFZ_XAU16_4___A xMchStPrv_MaxActDepVFZ_XAU16_5___A xMchStPrv_RotSpeedRefVFZFactor_XAU16 /end DEF_CHARACTERISTIC
 /begin IN_MEASUREMENT vApplI_AbsVehicleSpeedFilt_xdu16 wApplI_AbsSteeringAngle_xdu16 /end IN_MEASUREMENT
 /begin OUT_MEASUREMENT mMchStPrv_AbsEffMotTor_xdu16 mMchStPrv_FilteredGRADTBT_xdu16 sMchStPrv_ActivationRequest_xdu8 sMchStPrv_CtrlState_xdu8 sMchStPrv_EnableRateLimter_xdb sMchStPrv_FeatureState_xdu8 xMchStPrv_ActivationLevel_xdu16 xMchStPrv_MinActivationLevelRotSpeed_xdu16 xMchStPrv_squaresignal_xds16 /end OUT_MEASUREMENT
/end FUNCTION
/begin FUNCTION MchStPrvI "Mechanical Stuck Prevention"
 /begin OUT_MEASUREMENT mMchStPrvI_MotorTorque4Check_xds16 sMchStPrvI_RampState_xdu8 /end OUT_MEASUREMENT
/end FUNCTION
/begin FUNCTION MchStPrv_Check "" /begin DEF_CHARACTERISTIC mMchStPrv_MaxSafetyMotorTorq_XDU16 /end DEF_CHARACTERISTIC
 /begin OUT_MEASUREMENT mMchStPrv_MotorTorqueSaturated_xds16 sMchStPrv_FailureCause_xdu8 /end OUT_MEASUREMENT
/end FUNCTION
/begin FUNCTION MchStPrv_CheckI "Interface Mess- und Applikationsgrößen Mechanical Stuck Prevention Check" /begin OUT_MEASUREMENT fMchStPrvI_MonSafeOk_xdb mMchStPrvI_DesMotTrqOffset_xds16 /end OUT_MEASUREMENT /end FUNCTION
/begin FUNCTION MileageTracker_Interface "MileageTracker Interfacee" /begin OUT_MEASUREMENT lLdTrkI_KMTravelled_xdu32 /end OUT_MEASUREMENT /end FUNCTION
/begin FUNCTION MotorTorqueLimiter "Begrenzung des Motormoments"
 /begin DEF_CHARACTERISTIC fMotTorLim_DeactivateLevel2Error_XDU8 mMotTorLim_ErrorInjectionMotorTorque_XDS16 mMotTorLim_GeneratoricModeLimit_XAS16 mMotTorLim_GradToReduceOffset_XDU16 mMotTorLim_L2SwitchOffTestMotorTorque_XDS16 mMotTorLim_MaxAllowedNomMot_XDU16 mMotTorLim_MaxAllowedTBT_XDU16 mMotTorLim_MaxIntegralInv_XDU16 mMotTorLim_MaxIntegral_XDU16 mMotTorLim_MinMMotForVibrationCycleDetection_XDU16 mMotTorLim_MinTbtForVibrationCycleDetection_XDU16 mMotTorLim_MinTbtForVibrationOnLimitsCycleDetection_XDU16 mMotTorLim_MmotShiftForCalculatedLimits_XAU16_0___A mMotTorLim_MmotShiftForCalculatedLimits_XAU16_1___A mMotTorLim_MmotShiftForCalculatedLimits_XAU16_2___A mMotTorLim_MmotShiftForCalculatedLimits_XAU16_3___A mMotTorLim_MmotShiftForCalculatedLimits_XAU16_4___A mMotTorLim_MmotShiftForCalculatedLimits_XAU16_5___A mMotTorLim_Tbt2StopGenRotSpeedExp_XDU16 mMotTorLim_TbtShiftForZeroMmotTh_XDS16_0___A mMotTorLim_TbtShiftForZeroMmotTh_XDS16_1___A mMotTorLim_TbtShiftForZeroMmotTh_XDS16_2___A mMotTorLim_TbtShiftForZeroMmotTh_XDS16_3___A mMotTorLim_TbtShiftForZeroMmotTh_XDS16_4___A mMotTorLim_TbtShiftForZeroMmotTh_XDS16_5___A sMotTorLim_EnableErrorInjection_XDU8 sMotTorLim_LimiterSwitch_XDU8 sMotTorLim_UseFilterOnDecrLimits_XDU8 sMotTorLim_UseSteeringTorqueOffset_XDU8 sMotTorLim_VibrationOnLimitsSwitch_XDU8 sMotTorLim_VibrationSwitch_XDU8 tMotTorLim_DelayToStartReduction_XDU16 tMotTorLim_DiagTime_XDU16 tMotTorLim_Time2StopGenRotSpeedExp_XDU8 tMotTorLim_VibrationCycleTime2NextCycle_XDU16 tMotTorLim_VibrationOnLimitsCycleTime2NextCycle_XDU16 xMotTorLim_FactExpandLimitsDepOnTbt_XAS16_0___A xMotTorLim_FactExpandLimitsDepOnTbt_XAS16_1___A xMotTorLim_FactExpandLimitsDepOnTbt_XAS16_2___A xMotTorLim_FactExpandLimitsDepOnTbt_XAS16_3___A xMotTorLim_FactExpandLimitsDepOnTbt_XAS16_4___A xMotTorLim_FactExpandLimitsDepOnTbt_XAS16_5___A xMotTorLim_FadeDepOnIntegrator_XAU16 xMotTorLim_FilterFactorOnDecrLimits_XDU16 xMotTorLim_Grad4RedRampDown_XAU16 xMotTorLim_Grad4RedRampUp_XAU16 xMotTorLim_Integ2StopFilterOnDecrLimits_XDU16 xMotTorLim_Integ2StopGenRotSpeedExp_XDU16 xMotTorLim_LowestReductionLevel_XDU16 xMotTorLim_PreFailedRedLvl_XDU16 xMotTorLim_PrePassedRedLvl_XDU16 xMotTorLim_VibrationCycleGrad4RampDown_XDU16 xMotTorLim_VibrationOnLimitsMinDeviation_XDU16 xMotTorLim_WeightIntDevForRampToAssist_XDU16 zMotTorLim_VibrationCycleCount2Reduction_XDU8 zMotTorLim_VibrationOnLimitsCycleCount2Reduction_XDU8 /end DEF_CHARACTERISTIC
 /begin IN_MEASUREMENT xMotTorLimI_WeightedIntegratedDeviation_xdu16 /end IN_MEASUREMENT
 /begin OUT_MEASUREMENT fMotTorLim_VibHlSetEventEntryTestCond_xdb fMotTorLim_VibrationActive_xdb mMotTorLim_AbsIntegratedDeviation_xdu16 mMotTorLim_ActLimCurveNegMMotY_xas16 mMotTorLim_ActLimCurveNegTBTX_xas16 mMotTorLim_ActLimCurvePosMMotY_xas16 mMotTorLim_ActLimCurvePosTBTX_xas16 mMotTorLim_ErrInjLimMotTor_xds16 mMotTorLim_IntegratedDeviation_xds32 mMotTorLim_LimitDueToGeneratedSpeed_xds16 mMotTorLim_LimMotTor4Compare_xds16 mMotTorLim_LowerLimit_xds16 mMotTorLim_TorqueForLimitation_xds16 mMotTorLim_TorsionBarTorque_xds16 mMotTorLim_UpperLimit_xds16 mMotTorLim_UsedLimit_xds16 nMotTorLim_AbsGeneratoricRotorSpeed_xds16 sMotTorLim_L1ErrLvl_xdu8 sMotTorLim_L1PrestorageData_xdu32 sMotTorLim_L2PrestorageData_xdu32 sMotTorLim_ReductionState_xdu8 sMotTorLim_VibErrLvl_xdu8 sMotTorLim_VibPrestorageData_xdu32 sMotTorLim_VibrationDetectionState_xdu8 sMotTorLim_VibrationOnLimitsDetectionState_xdu8 tMotTorLim_VibrationDetectionTimer_xdu16 tMotTorLim_VibrationOnLimitsDetectionTimer_xdu16 vMotTorLim_AbsSafeVehicleSpeed_xdu16 xMotTorLim_ReductionLevel_xdu16 xMotTorLim_TargetReductionLevelVibrationOnLimits_xdu16 xMotTorLim_TargetReductionLevelVibration_xdu16 yMotTorLim_L1PosVal_xds16 zMotTorLim_VibrationDetectionCycleCounter_xdu8 zMotTorLim_VibrationOnLimitsDetectionCycleCounter_xdu8 /end OUT_MEASUREMENT
/end FUNCTION
/begin FUNCTION MotorTorqueLimiterI "limitation of the motor torque - interface"
 /begin OUT_MEASUREMENT mMotTorLimI_ValidatedMotorTorque_xds16 sMotTorLimI_ErrLvl_Red_xdu8 sMotTorLimI_ErrLvl_xdu8 xMotTorLimI_WeightedIntegratedDeviation_xdu16 /end OUT_MEASUREMENT
/end FUNCTION
/begin FUNCTION MotorTorqueLimiterPlausi "Begrenzung des Motormoments - Level 2 Plausi"
 /begin DEF_CHARACTERISTIC mMotTorLim_GeneratoricModeLimit_XAF32_0___A mMotTorLim_GeneratoricModeLimit_XAF32_1___A mMotTorLim_GeneratoricModeLimit_XAF32_2___A mMotTorLim_GeneratoricModeLimit_XAF32_3___A mMotTorLim_GeneratoricModeLimit_XAF32_4___A mMotTorLim_GeneratoricModeLimit_XAF32_5___A mMotTorLim_L2MmotShiftForCalculatedLimits_XAF32_0___A mMotTorLim_L2MmotShiftForCalculatedLimits_XAF32_1___A mMotTorLim_L2MmotShiftForCalculatedLimits_XAF32_2___A mMotTorLim_L2MmotShiftForCalculatedLimits_XAF32_3___A mMotTorLim_L2MmotShiftForCalculatedLimits_XAF32_4___A mMotTorLim_L2MmotShiftForCalculatedLimits_XAF32_5___A xMotTorLim_L2FactExpandLimitsDepOnTbt_XAF32_0___A xMotTorLim_L2FactExpandLimitsDepOnTbt_XAF32_1___A xMotTorLim_L2FactExpandLimitsDepOnTbt_XAF32_2___A xMotTorLim_L2FactExpandLimitsDepOnTbt_XAF32_3___A xMotTorLim_L2FactExpandLimitsDepOnTbt_XAF32_4___A xMotTorLim_L2FactExpandLimitsDepOnTbt_XAF32_5___A /end DEF_CHARACTERISTIC
 /begin OUT_MEASUREMENT mMotTorLim_IntegratedDeviation_xdf32 mMotTorLim_L2AbsIntegratedDeviation_xdf32 mMotTorLim_L2LimitedMotorTorque_xdf32 mMotTorLim_L2LowerLimit_xdf32 mMotTorLim_L2NegMMotYActLimCurve_xaf32 mMotTorLim_L2NegTBTXActLimCurve_xaf32 mMotTorLim_L2PosMMotYActLimCurve_xaf32 mMotTorLim_L2PosTBTXActLimCurve_xaf32 mMotTorLim_L2TorqueForLimitation_xdf32 mMotTorLim_L2TorsionBarTorque_xdf32 mMotTorLim_L2UpperLimit_xdf32 nMotTorLim_AbsGeneratoricRotorSpeed_xdf32 vMotTorLim_L2AbsSafeVehicleSpeed_xdf32 xMotTorLim_L2WeightedIntegratedDeviation_xdf32 yMotTorLim_L2PosVal_xds16 /end OUT_MEASUREMENT
/end FUNCTION
/begin FUNCTION MotTorLim_UsableMMotLimiterI "limitation of the motor torque to the maximum possible motor torque from HWLib" /begin OUT_MEASUREMENT mMotTorLimI_MmotLimitedToUsable_xds16 /end OUT_MEASUREMENT /end FUNCTION
/begin FUNCTION NetworkManagement ""
 /begin OUT_MEASUREMENT fevent_VoltageHigh_xdu8 fevent_VoltageLow_xdu8 fNm_ValidWakeup_xdu8 sComControl_State_xdu8 sNmBsI_AppCommNmStackState_xdu8 /end OUT_MEASUREMENT
/end FUNCTION
/begin FUNCTION OnCenterConnection "Zusatzreibung"
 /begin DEF_CHARACTERISTIC fOCC_Enable_XDU8_00___A fOCC_Enable_XDU8_01___A fOCC_Enable_XDU8_02___A fOCC_Enable_XDU8_03___A fOCC_Enable_XDU8_04___A fOCC_Enable_XDU8_05___A fOCC_Enable_XDU8_06___A fOCC_Enable_XDU8_07___A fOCC_Enable_XDU8_08___A fOCC_Enable_XDU8_09___A fOCC_Enable_XDU8_10___A fOCC_Enable_XDU8_11___A fOCC_Enable_XDU8_12___A fOCC_Enable_XDU8_13___A fOCC_Enable_XDU8_14___A fOCC_Enable_XDU8_15___A fOCC_Enable_XDU8_16___A fOCC_Enable_XDU8_17___A fOCC_Enable_XDU8_18___A fOCC_Enable_XDU8_19___A fOCC_Enable_XDU8_20___A fOCC_Enable_XDU8_21___A fOCC_Enable_XDU8_22___A fOCC_Enable_XDU8_23___A fOCC_Enable_XDU8_24___A fOCC_Enable_XDU8_25___A fOCC_Enable_XDU8_26___A fOCC_Enable_XDU8_27___A fOCC_Enable_XDU8_28___A fOCC_Enable_XDU8_29___A fOCC_Enable_XDU8_30___A fOCC_Enable_XDU8_31___A fOCC_Enable_XDU8_32___A fOCC_Enable_XDU8_33___A fOCC_Enable_XDU8_34___A fOCC_Enable_XDU8_35___A kOCC_OccBaseFriction_XDU16_00___A kOCC_OccBaseFriction_XDU16_01___A kOCC_OccBaseFriction_XDU16_02___A kOCC_OccBaseFriction_XDU16_03___A kOCC_OccBaseFriction_XDU16_04___A kOCC_OccBaseFriction_XDU16_05___A kOCC_OccBaseFriction_XDU16_06___A kOCC_OccBaseFriction_XDU16_07___A kOCC_OccBaseFriction_XDU16_08___A kOCC_OccBaseFriction_XDU16_09___A kOCC_OccBaseFriction_XDU16_10___A kOCC_OccBaseFriction_XDU16_11___A kOCC_OccBaseFriction_XDU16_12___A kOCC_OccBaseFriction_XDU16_13___A kOCC_OccBaseFriction_XDU16_14___A kOCC_OccBaseFriction_XDU16_15___A kOCC_OccBaseFriction_XDU16_16___A kOCC_OccBaseFriction_XDU16_17___A kOCC_OccBaseFriction_XDU16_18___A kOCC_OccBaseFriction_XDU16_19___A kOCC_OccBaseFriction_XDU16_20___A kOCC_OccBaseFriction_XDU16_21___A kOCC_OccBaseFriction_XDU16_22___A kOCC_OccBaseFriction_XDU16_23___A kOCC_OccBaseFriction_XDU16_24___A kOCC_OccBaseFriction_XDU16_25___A kOCC_OccBaseFriction_XDU16_26___A kOCC_OccBaseFriction_XDU16_27___A kOCC_OccBaseFriction_XDU16_28___A kOCC_OccBaseFriction_XDU16_29___A kOCC_OccBaseFriction_XDU16_30___A kOCC_OccBaseFriction_XDU16_31___A kOCC_OccBaseFriction_XDU16_32___A kOCC_OccBaseFriction_XDU16_33___A kOCC_OccBaseFriction_XDU16_34___A kOCC_OccBaseFriction_XDU16_35___A mOCC_MaxAllowedTorque_XDU16 nOCC_OccDeadZone_XDU16 xOCC_OccFilterFactor_XDU16 xOCC_OccScalBaseFric_XAU16_00___A xOCC_OccScalBaseFric_XAU16_01___A xOCC_OccScalBaseFric_XAU16_02___A xOCC_OccScalBaseFric_XAU16_03___A xOCC_OccScalBaseFric_XAU16_04___A xOCC_OccScalBaseFric_XAU16_05___A xOCC_OccScalBaseFric_XAU16_06___A xOCC_OccScalBaseFric_XAU16_07___A xOCC_OccScalBaseFric_XAU16_08___A xOCC_OccScalBaseFric_XAU16_09___A xOCC_OccScalBaseFric_XAU16_10___A xOCC_OccScalBaseFric_XAU16_11___A xOCC_OccScalBaseFric_XAU16_12___A xOCC_OccScalBaseFric_XAU16_13___A xOCC_OccScalBaseFric_XAU16_14___A xOCC_OccScalBaseFric_XAU16_15___A xOCC_OccScalBaseFric_XAU16_16___A xOCC_OccScalBaseFric_XAU16_17___A xOCC_OccScalBaseFric_XAU16_18___A xOCC_OccScalBaseFric_XAU16_19___A xOCC_OccScalBaseFric_XAU16_20___A xOCC_OccScalBaseFric_XAU16_21___A xOCC_OccScalBaseFric_XAU16_22___A xOCC_OccScalBaseFric_XAU16_23___A xOCC_OccScalBaseFric_XAU16_24___A xOCC_OccScalBaseFric_XAU16_25___A xOCC_OccScalBaseFric_XAU16_26___A xOCC_OccScalBaseFric_XAU16_27___A xOCC_OccScalBaseFric_XAU16_28___A xOCC_OccScalBaseFric_XAU16_29___A xOCC_OccScalBaseFric_XAU16_30___A xOCC_OccScalBaseFric_XAU16_31___A xOCC_OccScalBaseFric_XAU16_32___A xOCC_OccScalBaseFric_XAU16_33___A xOCC_OccScalBaseFric_XAU16_34___A xOCC_OccScalBaseFric_XAU16_35___A /end DEF_CHARACTERISTIC
 /begin IN_MEASUREMENT vApplI_AbsVehicleSpeedFilt_xdu16 /end IN_MEASUREMENT
 /begin OUT_MEASUREMENT fOCC_Activated_xdu8 kOCC_OccFriction_xds16 /end OUT_MEASUREMENT
/end FUNCTION
/begin FUNCTION OnCenterConnectionI "OnCenterConnectionI" /begin OUT_MEASUREMENT mOCCI_MotorTorque_xds16 /end OUT_MEASUREMENT /end FUNCTION
/begin FUNCTION OsMonitoringInterface "Interfacegrößen der Komponente OsMonitoring"
 /begin OUT_MEASUREMENT sOsMonI_ErrLvl_Red_xdu8 sOsMonI_ErrLvl_xdu8 zOsMonI_HlAliveCounter_xdu8 /end OUT_MEASUREMENT
/end FUNCTION
/begin FUNCTION OversteerI "Interface Mess- und Applikationsgrößen Oversteer"
 /begin OUT_MEASUREMENT mOvStI_MotorTorque_xds16 xOvStI_ActiveDampingFactor_xdu16 xOvStI_ActiveReturnFuncFactor_xdu16 /end OUT_MEASUREMENT
/end FUNCTION
/begin FUNCTION OvStMain "Mess- und Applikationsgrößen Oversteer"
 /begin DEF_CHARACTERISTIC fOvSt_UseLiftForceComp_XDB fOvSt_UseOscRetTorque_XDB mOvSt_LiftingTorqueOnPinionAngle_XAU16 mOvSt_LimitRetTorque_XDU16 xOvSt_ActDampingFactorDepOnDegOversteer_XAU16 xOvSt_ActivateOversteer_XDU8 xOvSt_ActRetFuncFactorDepOnDegOversteer_XAU16 xOvSt_BankedCurveDZOffset_XDU16 xOvSt_BlendLiftingForceFact_XAU16 xOvSt_FilterFactOversteer_XDU16 xOvSt_FilterFactSAS_XDU16 xOvSt_FilterFactSideSlipVel_XDU16 xOvSt_FilterFactTBT_XDU16 xOvSt_LiftingForceOnVelocityFact_XAU16 xOvSt_RampDownGradDepOnSideSlipVel_XAU16 xOvSt_RetSpeedOnSideSlipVelocityFact_XAU16 xOvSt_TbtDepCtrlAmpFact_XAU16 xOvSt_VelDepCtrlAmpFact_XAF32 /end DEF_CHARACTERISTIC
 /begin IN_MEASUREMENT vVehSpI_AbsAvgVehSpd_xdu16 /end IN_MEASUREMENT
 /begin OUT_MEASUREMENT fOvSt_Activate_xdb fOvSt_RequestActivation_xdb mOvSt_FiltAbsDriverTorque_xdu16 mOvSt_LiftingForceComp_xds16 mOvSt_OscRetTorque_xds32 vOvStI_AbsVehicleSpeedFilt_xdf32 vOvSt_AbsSideSlipVelocityFilt_xdu16 vOvSt_AbsYawVelocity_xdu16 vOvSt_ReturnSpeed_xds16 vOvSt_SideSlipVelocityFilt_xds32 vOvSt_SpeedDiff_xds32 wOvSt_AbsBlendPinionAngle_xdu16 xOvSt_DegreeOfOversteerFilt_xdu16 xOvSt_RatioWheelAngle2SteerAngle_xdf32 /end OUT_MEASUREMENT
/end FUNCTION
/begin FUNCTION PADisturbanceCompSumI "PADisturbanceCompSum - interface" /begin OUT_MEASUREMENT mTrqSumI_DisturbanceComp_xds16 /end OUT_MEASUREMENT /end FUNCTION
/begin FUNCTION PAMotTrqSum "Interfaces der PAMotTrqSum SDK" /begin DEF_CHARACTERISTIC fPAMotSum_EnableLimitation_XDU8 /end DEF_CHARACTERISTIC /end FUNCTION
/begin FUNCTION ProductionServices_L_Adapter "Mess- und Applikationsgroessen ProductionServices_L_Adapter" /begin DEF_CHARACTERISTIC ProductionServices_L_Adapter_UseShutdownFlashState_XDB /end DEF_CHARACTERISTIC /begin OUT_MEASUREMENT sApplI_SystemState_xdu8 /end OUT_MEASUREMENT /end FUNCTION
/begin FUNCTION PullDriftCompensationI "Interface Pull Drift Compensation" /begin OUT_MEASUREMENT mPDCI_MotorTorqueOffset_xds16 /end OUT_MEASUREMENT /end FUNCTION
/begin FUNCTION PullDriftCompensationMain "Mess- und Applikationsgrößen PullDriftCompensation Main"
 /begin DEF_CHARACTERISTIC aPDC_MaxVehicleAcceleration4Learn_XDU16 fPDC_FctSwitch_XDB kPDC_LimitCompRackForce_XDU16 kPDC_MaxCompFrackLongTerm_XDU16 kPDC_MaxCompFrackShortTerm_XAU16 kPDC_MaxRateCompFrack_XDU16 kPDC_MinCompFrack4BigCrowningChangeDetection_XDU16 kPDC_MinCompFrack4CompFrackWrongDetection_XDU16 kPDC_RateCompFrackErrorRampOut_XDU16 kPDC_RateCompFrackNormalRampOut_XDU16 mPDC_DeadBandTorsionBarTorque_XDU16 mPDC_MaxTorsionBarTorque4Learn_XDU16 mPDC_MinTorsionBarTorque4BigCrowningChangeDetection_XDU16 mPDC_MinTorsionBarTorque4CompFrackWrongDetection_XDU16 mPDC_MinTorsionBarTorque4TurnDetection_XDU16 tPDC_MinTime4Active_XDU8 tPDC_MinTime4BigCrowningChangeDetection_XDU8 tPDC_MinTime4CompFrackWrongDetection_XDU16 tPDC_MinTime4Hold_XDU8 tPDC_MinTime4TurnDetection_XDU8 vPDC_MaxVehicleSpeed4Learn_XDU16 vPDC_MaxYawVelocity4Learn_XAU16 vPDC_MaxYawVelocity4Learn_XDU16 vPDC_MinVehicleSpeed4CompFrackWrongDetection_XDU16 vPDC_MinVehicleSpeed4Learn_XDU16 vPDC_MinVehicleSpeed4TurnDetection_XDU16 vPDC_MinYawVelocity4TurnDetection_XDU16 wPDC_MaxSteeringAngle4Learn_XDU16 wPDC_MinSteeringAngle4TurnDetection_XDU16 xPDC_CompFrackFactor_XAU16 xPDC_FastIntegrationFactorShortTerm_XDU16_0___A xPDC_FastIntegrationFactorShortTerm_XDU16_1___A xPDC_FastIntegrationFactorShortTerm_XDU16_2___A xPDC_FastIntegrationFactorShortTerm_XDU16_3___A xPDC_FastIntegrationFactorShortTerm_XDU16_4___A xPDC_FastIntegrationFactorShortTerm_XDU16_5___A xPDC_IntegrationFactorLongTerm_XDU16_0___A xPDC_IntegrationFactorLongTerm_XDU16_1___A xPDC_IntegrationFactorLongTerm_XDU16_2___A xPDC_IntegrationFactorLongTerm_XDU16_3___A xPDC_IntegrationFactorLongTerm_XDU16_4___A xPDC_IntegrationFactorLongTerm_XDU16_5___A xPDC_NormalIntegrationFactorShortTerm_XDU16_0___A xPDC_NormalIntegrationFactorShortTerm_XDU16_1___A xPDC_NormalIntegrationFactorShortTerm_XDU16_2___A xPDC_NormalIntegrationFactorShortTerm_XDU16_3___A xPDC_NormalIntegrationFactorShortTerm_XDU16_4___A xPDC_NormalIntegrationFactorShortTerm_XDU16_5___A xPDC_PT1FilterFactorTorsionBarTorque_XDU16 xPDC_PT1FilterFactorVehicleAcceleration_XDU16 xPDC_PT1FilterFactorYawVelocity_XDU16 /end DEF_CHARACTERISTIC
 /begin IN_MEASUREMENT vApplI_AbsVehicleSpeedFilt_xdu16 /end IN_MEASUREMENT
 /begin OUT_MEASUREMENT aPDC_VehicleAccelerationFilt_xds16 fPDC_CalcRackForce_LastPdcArbPas_xdb fPDC_EstStateIsActive_xdb fPDC_FunctionEnabled_xdb fPDC_JobResultOK_xdb fPDC_LastPdcArbitrationResultPassive_xdb fPDC_StateIsActive_xdb kPDC_LTIntCmpFrack_xds32 kPDC_RateLimitedCompFrack_xds32 kPDC_SatRackForce_xds16 kPDC_STIntCmpFrack_xds32 mPDC_TorsionBarTorqueFilt_xds16 sPDC_ActivationRequest_xdu8 sPDC_EstActivationRequest_xdu8 sPDC_EstCtrlState_xdu8 sPDC_EstFeatureState_xdu8 sPDC_MergedFctCoState_xdu8 sPDC_PdcCtrlState_xdu8 sPDC_PdcFeatureState_xdu8 sPDC_RampedIn_xdu8 sPDC_RampedOut_xdu8 sPDC_State_xdu8 tPDC_Timer4BigCrowningChangeDetection_xdu8 tPDC_Timer4CompFrackWrongDetection_xdu16 tPDC_Timer4Learn_xdu8 tPDC_Timer4TurnDetection_xdu8 vPDC_YawVelocityFilt_xds16 /end OUT_MEASUREMENT
/end FUNCTION
/begin FUNCTION RackForceI "Interfacegrößen RackForce" /begin OUT_MEASUREMENT xRackForceI_RatioD2C_xdu16 /end OUT_MEASUREMENT /end FUNCTION
/begin FUNCTION RackForceV2_ComfortAdaptI "Interfacegrößen RackForceV2_ComfortAdapt"
 /begin OUT_MEASUREMENT aRackForceI_AbsLatAccel_xdu16 vRackForceI_WindUpAdaption_xds32 /end OUT_MEASUREMENT
/end FUNCTION
/begin FUNCTION RackForceV2_ComfortI "Interfacegrößen RackForceV2_Comfort"
 /begin OUT_MEASUREMENT aRackForceI_AbsLatAccel_xdu32 kRackForceI_RackForceComfortRaw_xds16 kRackForceI_RackForceComfort_xds16 /end OUT_MEASUREMENT
/end FUNCTION
/begin FUNCTION RackForceV2_Dynamic "Mess- und Applikationsgrößen RackForceV2_Dynamic"
 /begin DEF_CHARACTERISTIC mRackForce_BaseFriction_XDU16 wRackForce_MaxMotVelFric_XDU16 xRackForce_FricFilterFact_XDU16 xRackForce_Ginv_N1_XDF32 xRackForce_Ginv_N2_XDF32 xRackForce_Ginv_N3_XDF32 xRackForce_LoadFactor_XDU16 xRackForce_MMOTFilterFact_XDU16 xRackForce_RotAccFilterFact_XDU16 xRackForce_TBTFilterFact_XDU16 /end DEF_CHARACTERISTIC
 /begin OUT_MEASUREMENT mRackForce_FrictionFilt_xds16 mRackForce_InertiaFilt_xds16 /end OUT_MEASUREMENT
/end FUNCTION
/begin FUNCTION RackForceV2_DynamicI "Interfacegrößen RackForceV2_Dynamic" /begin OUT_MEASUREMENT kRackForceI_RackForceSimple_xds16 /end OUT_MEASUREMENT /end FUNCTION
/begin FUNCTION RackPositionCorrectionSupp "RackPosition Correction Supp" /begin DEF_CHARACTERISTIC fRpCorr_LtStCorrActive_XDU8 /end DEF_CHARACTERISTIC /end FUNCTION
/begin FUNCTION RackPositionCorrectionSupp_Interface "RackPosition Correction Supp Interface kgt" /begin OUT_MEASUREMENT sRpCorrI_EnableCorrectionSupp_xdu8 /end OUT_MEASUREMENT /end FUNCTION
/begin FUNCTION RackPositionSynchronizationSupp_Interface "RackPosition Synchronization Supp Interface kgt"
 /begin OUT_MEASUREMENT sRpSyncI_SyncActSuppSuccess_xdu8 wRpSyncI_SyncActSuppIndexPosition_xds16 /end OUT_MEASUREMENT
/end FUNCTION
/begin FUNCTION RackPosMainSupp_Interface "RackPosition MainSupp Interface kgt" /begin OUT_MEASUREMENT wRackPoI_PinionAngleReal_xds16 /end OUT_MEASUREMENT /end FUNCTION
/begin FUNCTION RackPos_Correction "RackPos Correction kgt"
 /begin DEF_CHARACTERISTIC mRpCorr_LTATBT_XDU16 mRpCorr_LTMaxMotTorq_XDU16 mRpCorr_STMaxMotTorq_XDU16 mRpCorr_STMaxTBT_XDU16 sRpCorr_ConfigFlagsCorr_XDU8 tRpCorr_CycleTimeRpCorr_XDU8 tRpCorr_DetectionTimerLT_XDU8 tRpCorr_DetectionTimerST_XDU8 tRpCorr_LTimeIntegTime_XDU8 vRpCorr_STMinVehicleSpeed_XDU16 vRpCorr_VehicleSpeedWeight_XDU16 wRpCorr_LTACompIntegRange_XDU16 wRpCorr_LTACompMaxAngle_XDU16 wRpCorr_Resolution_XDU16 wRpCorr_STACompIntegRange_XDU16 wRpCorr_STACompMaxAngle_XDU16 xRpCorr_LTACompIntegFactor_XDU16 xRpCorr_STIntegrationFactor_XDU16 /end DEF_CHARACTERISTIC
 /begin OUT_MEASUREMENT fRpCorr_LearnCond_xdu8 fRpCorr_ResetAdaptiveData_xdu8 sRpCorr_JobResultOK_xdu8 sRpCorr_ResetCorrection_xdu8 tRpCorr_IntegTimedelay_xdu8 wRpCorr_LTIntegral_xds32 wRpCorr_STIntegral_xds32 xRpCorr_BlendFactorOld_xdu8 /end OUT_MEASUREMENT
/end FUNCTION
/begin FUNCTION RackPos_Correction_Interface "RackPos Correction Interface kgt"
 /begin OUT_MEASUREMENT wRpCorrI_RotAngLTCorrNVR_xds16 wRpCorrI_RotAngSTCorr_xds16 zRpCorrI_CalibCycleCounterLTNVR_xdu8 /end OUT_MEASUREMENT
/end FUNCTION
/begin RECORD_LAYOUT AblGLKLfl4 FNC_VALUES 3 FLOAT32_IEEE COLUMN_DIR DIRECT AXIS_PTS_X 2 FLOAT32_IEEE INDEX_INCR DIRECT NO_AXIS_PTS_X 1 ULONG /end RECORD_LAYOUT
/begin RECORD_LAYOUT AblGLKLsw FNC_VALUES 3 SWORD COLUMN_DIR DIRECT AXIS_PTS_X 2 SWORD INDEX_INCR DIRECT NO_AXIS_PTS_X 1 UWORD /end RECORD_LAYOUT
/begin RECORD_LAYOUT AblGLKLuw FNC_VALUES 3 UWORD COLUMN_DIR DIRECT AXIS_PTS_X 2 UWORD INDEX_INCR DIRECT NO_AXIS_PTS_X 1 UWORD /end RECORD_LAYOUT
/begin RECORD_LAYOUT AblGLKWBfl4 FNC_VALUES 1 FLOAT32_IEEE COLUMN_DIR DIRECT /end RECORD_LAYOUT
/begin RECORD_LAYOUT AblGLKWBsw FNC_VALUES 1 SWORD COLUMN_DIR DIRECT /end RECORD_LAYOUT
/begin RECORD_LAYOUT AblGLKWBub FNC_VALUES 1 UBYTE COLUMN_DIR DIRECT /end RECORD_LAYOUT
/begin RECORD_LAYOUT AblGLKWBuw FNC_VALUES 1 UWORD COLUMN_DIR DIRECT /end RECORD_LAYOUT
/begin RECORD_LAYOUT AblGLKWfl4 FNC_VALUES 1 FLOAT32_IEEE COLUMN_DIR DIRECT /end RECORD_LAYOUT
/begin RECORD_LAYOUT AblGLKWsw FNC_VALUES 1 SWORD COLUMN_DIR DIRECT /end RECORD_LAYOUT
/begin RECORD_LAYOUT AblGLKWub FNC_VALUES 1 UBYTE COLUMN_DIR DIRECT /end RECORD_LAYOUT
/begin RECORD_LAYOUT AblGLKWul FNC_VALUES 1 ULONG COLUMN_DIR DIRECT /end RECORD_LAYOUT
/begin RECORD_LAYOUT AblGLKWuw FNC_VALUES 1 UWORD COLUMN_DIR DIRECT /end RECORD_LAYOUT
/end MODULE
/end PROJECT
