ASAP2_VERSION 1 70
/begin PROJECT _GA1_103 "SCU3_B3_VAR_04"
/begin HEADER "" VERSION "GA1_103_C_03_00" PROJECT_NO _GA1_103 /end HEADER
/begin MODULE XCP_EPS_ECU "G08"
/begin MOD_COMMON "" BYTE_ORDER MSB_LAST ALIGNMENT_BYTE 1 ALIGNMENT_WORD 2 ALIGNMENT_LONG 4 ALIGNMENT_FLOAT32_IEEE 4 ALIGNMENT_FLOAT64_IEEE 8 /end MOD_COMMON
/begin CHARACTERISTIC fYROC_Resetcompvalue_XDU8 "Flag to reset the Yaw rate compensation value" VALUE 0x150AF4 AblGLKWub 1 BIT 0 1 FORMAT "%5.3" /end CHARACTERISTIC
/begin CHARACTERISTIC mOvrLdProt_HeavyImpactLimit_XDU16 "MaximalWert fuer Pulsendes Moment" VALUE 0x15067A AblGLKWuw 1023.98 RIGHTSH6NP 0 1023.984 FORMAT "%8.3" /end CHARACTERISTIC
/begin CHARACTERISTIC sYROC_NvWrConfigFlag_XDU8 "Flag to Configure Yaw rate compensation reset in NvM  0 --> Write in PostRun, 1 --> Immediate Write in dataflash" VALUE 0x150B1F AblGLKWub 1 BIT 0 1 FORMAT "%5.3" /end CHARACTERISTIC
/begin CHARACTERISTIC tVehSp_VehicleRunningDelay_XDU8 "Verzögerung für Fahrzeug-Fährt-Erkennung" VALUE 0x150B42 AblGLKWub 1000 TIMMS_10 0 1000 FORMAT "%5.0" /end CHARACTERISTIC
/begin CHARACTERISTIC vVehSp_AbsVehSpeedFiltInit_XDU16 "Initial value for vehicle speed vApplI_AbsVehicleSpeedFilt" VALUE 0x1508C2 AblGLKWuw 50 VFZHIGH 0 50 FORMAT "%8.5" /end CHARACTERISTIC
/begin CHARACTERISTIC vVehSp_MaxSpeedGradientNearStandStill_XDU8 "Maximaler Gradient für die Fahrzeuggeschwindigkeit im stillstandsnahen Bereich (km/h/10ms). Muss größer als alle anderen Geschwindigkeitsgradienten sein!" VALUE 0x150B4C AblGLKWub 3.984 VFZHIGH 0 3.984 FORMAT "%5.3" /end CHARACTERISTIC
/begin CHARACTERISTIC vVehSp_NearStandStillBorder_XDU16 "Grenzwert für Fahrzeug-Fährt-Erkennung" VALUE 0x1508C6 AblGLKWuw 500 VFZHIGH 0 500 FORMAT "%8.4" /end CHARACTERISTIC
/begin CHARACTERISTIC vVehSp_SubstituteSpeed_XDU16 "Substitute value for vehicle speed vApplI_AbsVehicleSpeedFilt" VALUE 0x1508C8 AblGLKWuw 500 VFZHIGH 0 500 FORMAT "%8.4" /end CHARACTERISTIC
/begin CHARACTERISTIC vVehSp_VehicleRunningBorder_XDU16 "Grenzwert für Fahrzeug-Fährt-Erkennung" VALUE 0x1508CA AblGLKWuw 500 VFZHIGH 0 500 FORMAT "%8.4" /end CHARACTERISTIC
/begin CHARACTERISTIC vYROC_NegYawRateCompThreshold_XDS16 "Gierrate" VALUE 0x1508CC AblGLKWsw 1 VGIER -1 0 FORMAT "%8.6" /end CHARACTERISTIC
/begin CHARACTERISTIC vYROC_PosYawRateCompThreshold_XDU16 "Gierrate" VALUE 0x1508CE AblGLKWuw 1 VGIER 0 1 FORMAT "%8.6" /end CHARACTERISTIC
/begin CHARACTERISTIC vYROC_VehicleSpeedThreshold_XDU16 "Geschwindichkeit des YawRateOffsetCompensation" VALUE 0x1508D0 AblGLKWuw 25 VFZHIGH 0 25 FORMAT "%8.5" /end CHARACTERISTIC
/begin CHARACTERISTIC xYROC_MaxYawRateCompValue_XDS16 "Gierrate" VALUE 0x150A82 AblGLKWsw 20 VGIER -10 10 FORMAT "%8.5" /end CHARACTERISTIC
/begin CHARACTERISTIC xYROC_MinYawRateCompValue_XDS16 "Gierrate" VALUE 0x150A84 AblGLKWsw 20 VGIER -10 10 FORMAT "%8.5" /end CHARACTERISTIC
/begin CHARACTERISTIC xYROC_YawRateCompFactor_XDF32 "Gierrate" VALUE 0x150514 AblGLKWfl4 1 ZU0 0 1 FORMAT "%10.8" /end CHARACTERISTIC
/begin CHARACTERISTIC zOvrLdProt_SwitchOffCounterHigh32_XDU32 "Grenze für Lenkung abschalten - obere 32 Bit" VALUE 0x150520 AblGLKWul 4.29497E+09 ZU0 0 4294967295 FORMAT "%13.2" /end CHARACTERISTIC
/begin CHARACTERISTIC zOvrLdProt_SwitchOffCounterLow32_XDU32 "Grenze für Lenkung abschalten - untere 32 Bit" VALUE 0x150524 AblGLKWul 4.29497E+09 ZU0 0 4294967295 FORMAT "%13.2" /end CHARACTERISTIC
/begin CHARACTERISTIC zOvrLdProt_WarningCounterHigh32_XDU32 "Grenze für Lenkung Warnung (gelbe Lampe) - obere 32 Bit" VALUE 0x150528 AblGLKWul 4.29497E+09 ZU0 0 4294967295 FORMAT "%13.2" /end CHARACTERISTIC
/begin CHARACTERISTIC zOvrLdProt_WarningCounterLow32_XDU32 "Grenze für Lenkung Warnung (gelbe Lampe) - untere 32 Bit" VALUE 0x15052C AblGLKWul 4.29497E+09 ZU0 0 4294967295 FORMAT "%13.2" /end CHARACTERISTIC
/begin CHARACTERISTIC yAraDiagI_HwIndexAraIsas_GDU32 "HwIndex for the ARA variant ISas" VALUE 0x112C60 rlValueul 4.29497E+09 NO_UNIT 0 4294967295 /end CHARACTERISTIC
/begin CHARACTERISTIC yIsasDiag_ControlledVddmrWakeupEnabled_GDE "CONF_SAS_INIT_EN_CTRL_VDDMR" VALUE 0x112C64 rlValueub 255 NO_UNIT 0 255 /end CHARACTERISTIC
/begin CHARACTERISTIC yIsasDiag_ExtensionSasWakeupEnabled_GDE "CONF_SAS_INIT_EN_EX_SAS_WUP" VALUE 0x112C65 rlValueub 255 NO_UNIT 0 255 /end CHARACTERISTIC
/begin CHARACTERISTIC yIsasDiag_FailureToleranceLevel_GDE "CONF_SAS_INIT_FTL" VALUE 0x112C66 rlValueub 255 NO_UNIT 0 255 /end CHARACTERISTIC
/begin CHARACTERISTIC yIsasDiag_HysteresisSinCos_GDU8 "SAS Hysteresis for sine and cosine. ASIC register: CONF_SAS_CMP_HYSxxx" VALUE 0x112C67 rlValueub 15 NO_UNIT 0 15 /end CHARACTERISTIC
/begin CHARACTERISTIC yIsasDiag_OtVddmrEnabled_GDE "CONF_OT_EN_OT_VDDMR" VALUE 0x112C68 rlValueub 255 NO_UNIT 0 255 /end CHARACTERISTIC
/begin CHARACTERISTIC yIsasDiag_PositionSensorMode_GDE "" VALUE 0x112C69 rlValueub 255 NO_UNIT 0 255 /end CHARACTERISTIC
/begin CHARACTERISTIC yIsasDiag_SasCounterFailureToleranceEnabled_GDE "CONF_SAS_INIT_CFT" VALUE 0x112C6A rlValueub 255 NO_UNIT 0 255 /end CHARACTERISTIC
/begin CHARACTERISTIC yIsasDiag_SasProcess_GDU8 "CONF_SAS_WUP_SASPROCESS" VALUE 0x112C6B rlValueub 15 NO_UNIT 0 15 /end CHARACTERISTIC
/begin CHARACTERISTIC yIsasDiag_SasTNextPeriod_GDE "CONF_SAS_INIT_CONF_SAS_TNEXT" VALUE 0x112C6C rlValueub 255 NO_UNIT 0 255 /end CHARACTERISTIC
/begin CHARACTERISTIC yIsasDiag_SasWait_GDU8 "CONF_SAS_WUP_SAS_WAIT" VALUE 0x112C6D rlValueub 15 NO_UNIT 0 15 /end CHARACTERISTIC
/begin CHARACTERISTIC yIsasDiag_SasWakeupEnabled_GDE "CONF_INIT_EN_SAS_WUP" VALUE 0x112C6E rlValueub 255 NO_UNIT 0 255 /end CHARACTERISTIC
/begin CHARACTERISTIC tCscAdc_MaxFailTime_GDU16 "Maximum time until diagnosis failure entry" VALUE 0x109478 rlValueuw 65535 T_MS 0 65535 /end CHARACTERISTIC
/begin CHARACTERISTIC uCscAdc_1V25RefVoltage_Level_Max_GDF32 "Upper limit of 1,25V referemce voltage" VALUE 0x10946C rlValuefl 10 VOLT_REAL 0 10 /end CHARACTERISTIC
/begin CHARACTERISTIC uCscAdc_1V25RefVoltage_Level_Min_GDF32 "Lower limit of 1,25V referemce voltage" VALUE 0x109470 rlValuefl 10 VOLT_REAL 0 10 /end CHARACTERISTIC
/begin CHARACTERISTIC uCscAdc_RefVoltage_Level_Max_GDF32 "Upper limit difference with Reference voltage" VALUE 0x109474 rlValuefl 10 VOLT_REAL 0 10 /end CHARACTERISTIC
/begin CHARACTERISTIC yCscAsic_SasWup_GAE "SasWup mapped tests" VAL_BLK 0x10947C rlValueub 255 NO_UNIT 0 255 NUMBER 5 /end CHARACTERISTIC
/begin CHARACTERISTIC tLatI_DelayPfbAvail_GDU8 "Delay for correct Pfb values" VALUE 0x109626 rlValueub 5 T_MS 0 5 /end CHARACTERISTIC
/begin CHARACTERISTIC tLatI_UpdateDiagTimeout_GDU16 "Update driver DIAG timeout" VALUE 0x109620 rlValueuw 100 T_MS 0 100 /end CHARACTERISTIC
/begin CHARACTERISTIC tLatI_WatchdogEnableDriverTimeout_GDU16 "Maximum time to enable or disable driver by System ASIC" VALUE 0x109622 rlValueuw 100 T_MS 0 100 /end CHARACTERISTIC
/begin CHARACTERISTIC yTstCoo_MaxDebounceVal_GDU16 "Maximum number of debounce value in percent" VALUE 0x109624 rlValueuw 254 NO_UNIT 1 255 /end CHARACTERISTIC
/begin CHARACTERISTIC tDriverVoltOnDelay_MDU16 "Delay after swtiching on driver voltage" VALUE 0x109628 rlValueuw 100 T_MS 0 100 /end CHARACTERISTIC
/begin CHARACTERISTIC yMocI_IpcDataLength_GDU8 "DataLength in Byte for IPC" VALUE 0x10BF44 rlValueub 2 NO_UNIT 0 2 /end CHARACTERISTIC
/begin CHARACTERISTIC yPhcI_IpcDataLength_GDU8 "Data length of IPC data" VALUE 0x10C32C rlValueub 255 NO_UNIT 0 255 /end CHARACTERISTIC
/begin CHARACTERISTIC cPhcCalc_MinTempDiff4OffsetMeas_GDU8 "Min. temperature difference that starts an offset measurement" VALUE 0x10C344 rlValueub 50 NO_UNIT 0 50 /end CHARACTERISTIC
/begin CHARACTERISTIC mPhcCalc_MaxMotTorque4OffsetMeas_GDF32 "Max. allowed motor torque to start offset measurement" VALUE 0x10C330 rlValuefl 0.5 NO_UNIT 0 0.5 /end CHARACTERISTIC
/begin CHARACTERISTIC mPhcCalc_MaxMotTorque4OffsetMeasStop_GDF32 "Min. Motor torque that stops an ongoing offset measurement" VALUE 0x10C334 rlValuefl 0.5 NO_UNIT 0 0.5 /end CHARACTERISTIC
/begin CHARACTERISTIC nPhcCalc_MaxSpeed4OffsetMeas_GDF32 "Max. allowed rotor speed for offset measurement" VALUE 0x10C338 rlValuefl 10000 NO_UNIT 0 10000 /end CHARACTERISTIC
/begin CHARACTERISTIC nPhcCalc_MaxSpeed4OffsetMeasStop_GDF32 "Min. rotor speed that stops the offset measurement" VALUE 0x10C33C rlValuefl 5000 NO_UNIT 0 5000 /end CHARACTERISTIC
/begin CHARACTERISTIC uPhc_OutputDriverVoltageLowLimit_GDF32 "Limit for undervoltage detection" VALUE 0x10C340 rlValuefl 9 VOLT_REAL 0 9 /end CHARACTERISTIC
/begin CHARACTERISTIC yPhcCalcI_DefaultMuxModeValue_GDU8 "Project default multiplexor scheme (mode) - enum is not possible in kon files" VALUE 0x10C345 rlValueub 19 NO_UNIT 0 19 /end CHARACTERISTIC
/begin CHARACTERISTIC iPhcGduCalc_FineCurrentThreshold_GDF32 "Threshold for measuring fine current (in A)" VALUE 0x10C350 rlValuefl 1000 CURR_REAL 0 1000 /end CHARACTERISTIC
/begin CHARACTERISTIC iPhcGduCalc_MiddleCurrentThreshold_GDF32 "Threshold for measuring middle current (in A)" VALUE 0x10C354 rlValuefl 1000 CURR_REAL 0 1000 /end CHARACTERISTIC
/begin CHARACTERISTIC iPhcGduCalc_RoughCurrentThreshold_GDF32 "Threshold for measuring rough current (in A)" VALUE 0x10C358 rlValuefl 1000 CURR_REAL 0 1000 /end CHARACTERISTIC
/begin CHARACTERISTIC xPhcGduCalc_ResolutionFine_MDF32 "Nominal resolution for fine current signal at ADC (in A/LSB)" VALUE 0x10C35C rlValuefl 1 NO_UNIT 0 1 /end CHARACTERISTIC
/begin CHARACTERISTIC xPhcGduCalc_ResolutionMiddle_MDF32 "Nominal resolution for middle current signal at ADC (in A/LSB)" VALUE 0x10C360 rlValuefl 1 NO_UNIT 0 1 /end CHARACTERISTIC
/begin CHARACTERISTIC xPhcGduCalc_ResolutionRough_MDF32 "Nominal resolution for rough current signal at ADC (in A/LSB)" VALUE 0x10C364 rlValuefl 1 NO_UNIT 0 1 /end CHARACTERISTIC
/begin CHARACTERISTIC xPhcGduCalc_ResolutionSuperFine_MDF32 "Nominal resolution for super fine current signal at ADC (in A/LSB)" VALUE 0x10C368 rlValuefl 1 NO_UNIT 0 1 /end CHARACTERISTIC
/begin CHARACTERISTIC yPhcGduCalc_FineCurrentPwmThreshold_GDS "Characteristic PWM-Threshold for fine current measurement (in %)" CURVE 0x10C370 rlCurvefl 100 NO_UNIT 0 100
 /begin AXIS_DESCR STD_AXIS iPhcGduCalc_CurrentVectorLength_gdf32 NO_UNIT 2 -3.40282346639E+38 4294967295 DEPOSIT ABSOLUTE /end AXIS_DESCR
/end CHARACTERISTIC
/begin CHARACTERISTIC yPhcGduCalc_MaxDiffToLastOffset_GDU16 "Max. allowed difference to previous offset measurement" VALUE 0x10C36C rlValueuw 4095 NO_UNIT 0 4095 /end CHARACTERISTIC
/begin CHARACTERISTIC yPhcGduCalc_MiddleCurrentPwmThreshold_GDS "Characteristic PWM-Threshold for middle current measurement (in %)" CURVE 0x10C384 rlCurvefl 100 NO_UNIT 0 100
 /begin AXIS_DESCR STD_AXIS iPhcGduCalc_CurrentVectorLength_gdf32 NO_UNIT 2 -3.40282346639E+38 4294967295 DEPOSIT ABSOLUTE /end AXIS_DESCR
/end CHARACTERISTIC
/begin CHARACTERISTIC yPhcGduCalc_RoughCurrentPwmThreshold_GDS "Characteristic PWM-Threshold for rough current measurement (in %)" CURVE 0x10C398 rlCurvefl 100 NO_UNIT 0 100
 /begin AXIS_DESCR STD_AXIS iPhcGduCalc_CurrentVectorLength_gdf32 NO_UNIT 2 -3.40282346639E+38 4294967295 DEPOSIT ABSOLUTE /end AXIS_DESCR
/end CHARACTERISTIC
/begin CHARACTERISTIC hPhcDiagI_MinPwm4CycOffs_GDU8 "" VALUE 0x10C3D2 rlValueub 100 NO_UNIT 0 100 /end CHARACTERISTIC
/begin CHARACTERISTIC hPhcGduDiag_CyclicOffsetErrorIncrementPct_GDU8 "Error counter increment (%) for cyclic offset to startup offset difference" VALUE 0x10C3D3 rlValueub 100 NO_UNIT 0 100 /end CHARACTERISTIC
/begin CHARACTERISTIC hPhcGduDiag_RangeErrorIncrementPct_GDU8 "Error counter increment (%) for out of range error" VALUE 0x10C3D4 rlValueub 100 NO_UNIT 0 100 /end CHARACTERISTIC
/begin CHARACTERISTIC iPhcDiagI_MaxPhaseCurrent_GDU16 "Max. allowed phase current for this project" VALUE 0x10C3CC rlValueuw 1000 CURR_INT 0 1000 /end CHARACTERISTIC
/begin CHARACTERISTIC yPhcGduDiag_CriticalOffsetIndicationDiff_GDU16 "Critical limit for difference between offset and cyclic offset - " VALUE 0x10C3CE rlValueuw 2048 NO_UNIT 0 2048 /end CHARACTERISTIC
/begin CHARACTERISTIC yPhcGduDiag_MaxCycOffs2StartupOffs_GAS16 "Max. allowed difference between cyclic and startup offset" VAL_BLK 0x10C3AC rlValuesw 2048 NO_UNIT 0 2048 NUMBER 4 /end CHARACTERISTIC
/begin CHARACTERISTIC yPhcGduDiag_MaxStartupOffs_GAU16 "Max. allowed startup offset" VAL_BLK 0x10C3B4 rlValueuw 4095 NO_UNIT 0 4095 NUMBER 4 /end CHARACTERISTIC
/begin CHARACTERISTIC yPhcGduDiag_MinCycOffs2StartupOffs_GAS16 "Min. allowed difference between cyclic and startup offset" VAL_BLK 0x10C3BC rlValuesw 2048 NO_UNIT -2048 0 NUMBER 4 /end CHARACTERISTIC
/begin CHARACTERISTIC yPhcGduDiag_MinOffsetIndicationDiff_GDU16 "Limit for difference between offset and cyclic offset" VALUE 0x10C3D0 rlValueuw 2048 NO_UNIT 0 2048 /end CHARACTERISTIC
/begin CHARACTERISTIC yPhcGduDiag_MinStartupOffs_GAU16 "Min. allowed startup offset" VAL_BLK 0x10C3C4 rlValueuw 4095 NO_UNIT 0 4095 NUMBER 4 /end CHARACTERISTIC
/begin CHARACTERISTIC iPhcPlausi_PlausiMarginAsic_GDU16 "Max. allowed difference between Shunt and AsicShunt measurement" VALUE 0x10C3F8 rlValueuw 1000 CURR_INT 0 1000 /end CHARACTERISTIC
/begin CHARACTERISTIC iPhcPlausi_PlausiMarginRdson_GDU16 "Max. allowed difference between Shunt and Rdson measurement" VALUE 0x10C3FA rlValueuw 1000 CURR_INT 0 1000 /end CHARACTERISTIC
/begin CHARACTERISTIC yPhcDiag_HwIndexCurrMeas_GDU32 "HW Index in NVshare for phase current measurement (PHC) - one hot encoded" VALUE 0x10C348 rlValueul 4.29497E+09 NO_UNIT 0 4294967295 /end CHARACTERISTIC
/begin CHARACTERISTIC yPhcDiagI_AdcValueMaxLimit_GDU16 "Max. allowed ADC value for Rdson/Asic-Shunt measurement (digits)" VALUE 0x10C34C rlValueuw 4095 NO_UNIT 0 4095 /end CHARACTERISTIC
/begin CHARACTERISTIC yPhcDiagI_AdcValueMinLimit_GDU16 "Min. allowed ADC value for Rdson/Asic-Shunt measurement (digits)" VALUE 0x10C34E rlValueuw 4095 NO_UNIT 0 4095 /end CHARACTERISTIC
/begin CHARACTERISTIC yPhcMuxDiag_TestVoltHighLimit_GAU16 "High limit [Digit] allowed for ASIC Mux test path voltage dependent on gain" VAL_BLK 0x10C3D8 rlValueuw 4095 NO_UNIT 0 4095 NUMBER 8 /end CHARACTERISTIC
/begin CHARACTERISTIC yPhcMuxDiag_TestVoltLowLimit_GAU16 "Low limit [Digit] allowed for ASIC Mux test path voltage dependent on gain" VAL_BLK 0x10C3E8 rlValueuw 4095 NO_UNIT 0 4095 NUMBER 8 /end CHARACTERISTIC
/begin CHARACTERISTIC hPhcAsicDiag_CyclicOffsetErrorIncrementPct_GDU8 "Error counter increment (%) for cyclic offset to startup offset difference" VALUE 0x10C2E8 rlValueub 100 NO_UNIT 0 100 /end CHARACTERISTIC
/begin CHARACTERISTIC hPhcAsicDiag_OffsetErrorIncrementPct_GDU8 "Error counter increment (%) for normal (computation) offset check" VALUE 0x10C2E9 rlValueub 100 NO_UNIT 0 100 /end CHARACTERISTIC
/begin CHARACTERISTIC hPhcAsicDiag_RangeErrorIncrementPct_GDU8 "Error counter increment (%) for range check" VALUE 0x10C2EA rlValueub 100 NO_UNIT 0 100 /end CHARACTERISTIC
/begin CHARACTERISTIC hPhcAsicDiag_StartupOffsetErrorIncrementPct_GDU8 "Error counter increment (%) for startup offset check" VALUE 0x10C2EB rlValueub 100 NO_UNIT 0 100 /end CHARACTERISTIC
/begin CHARACTERISTIC yPhcAsicDiag_CriticalOffsetIndicationDiff_GDU16 "Offset- cyc. offset exceeds this limit -> recalibration of offsets" VALUE 0x10C2E4 rlValueuw 2048 NO_UNIT 0 2048 /end CHARACTERISTIC
/begin CHARACTERISTIC yPhcAsicDiag_InputOffsetHighLimit_MAU16 "Upper limit [Digit] for Asic-Shunt offset dependent on gain" VAL_BLK 0x10C2EC rlValueuw 4095 NO_UNIT 0 4095 NUMBER 8 /end CHARACTERISTIC
/begin CHARACTERISTIC yPhcAsicDiag_InputOffsetLowLimit_MAU16 "Low limit [Digit] for Asic-Shunt offset dependent on gain" VAL_BLK 0x10C2FC rlValueuw 4095 NO_UNIT 0 4095 NUMBER 8 /end CHARACTERISTIC
/begin CHARACTERISTIC yPhcAsicDiag_MaxCycOffs2StartupOffs_MAS16 "Max. allowed difference between cyclic and startup offset dependent on gain" VAL_BLK 0x10C30C rlValuesw 2048 NO_UNIT 0 2048 NUMBER 8 /end CHARACTERISTIC
/begin CHARACTERISTIC yPhcAsicDiag_MinCycOffs2StartupOffs_MAS16 "Min. allowed difference between cyclic and startup offset dependent on gain" VAL_BLK 0x10C31C rlValuesw 2048 NO_UNIT -2048 0 NUMBER 8 /end CHARACTERISTIC
/begin CHARACTERISTIC yPhcAsicDiag_MinOffsetIndicationDiff_GDU16 "Offset- cyc. offset exceeds this limit -> possible recalibration of offsets" VALUE 0x10C2E6 rlValueuw 2048 NO_UNIT 0 2048 /end CHARACTERISTIC
/begin CHARACTERISTIC tDriverOv_RecoverTimeVoltageStable_MDU16 "Wait time in ms to reaktivate outputstage after overvoltage" VALUE 0x10CC40 rlValueuw 100 T_MS 0 100 /end CHARACTERISTIC
/begin CHARACTERISTIC zDriverOv_ErrorFilterIncrement_MDU8 "Error counter during over voltage" VALUE 0x10CC42 rlValueub 100 NO_UNIT 0 100 /end CHARACTERISTIC
/begin CHARACTERISTIC tDriverUv_RecoverTimeVoltageStable_GDU8 "Wait time in ms until the voltage recovers again" VALUE 0x10CC43 rlValueub 10 T_MS 0 10 /end CHARACTERISTIC
/begin CHARACTERISTIC cDrvDiag_MaxTempAfterFetError_GDU16 "Temperature limit while MOSFET SC  reaction (in degree celsius)" VALUE 0x10CC5C rlValueuw 150 TEMP_INT 0 150 /end CHARACTERISTIC
/begin CHARACTERISTIC nDrvDiagI_ThdRotSpeedConvSc2Oc_GDF32 "Threshold rotor speed" VALUE 0x10CC44 rlValuefl 2094 ANG_VEL_REAL -1047 1047 /end CHARACTERISTIC
/begin CHARACTERISTIC uDrvDiag_MaxVoltAfterFetError_GDF32 "Maximum voltage after a FET error was detected and system is in emergency operation" VALUE 0x10CC48 rlValuefl 35 VOLT_REAL 5 40 /end CHARACTERISTIC
/begin CHARACTERISTIC uDrvDiag_MinVoltAfterFetError_GDF32 "Minimum voltage after a FET error was detected and system is in emergency operation" VALUE 0x10CC4C rlValuefl 35 VOLT_REAL 5 40 /end CHARACTERISTIC
/begin CHARACTERISTIC uDrvDiagI_MaxLimitStableVoltage_GDF32 "Voltage limit for full functional powerstage driver (in V)" VALUE 0x10CC50 rlValuefl 28 VOLT_REAL 12 40 /end CHARACTERISTIC
/begin CHARACTERISTIC uDrvDiagI_MinLimitStableVoltage_GDF32 "Voltage limit for full functional powerstage driver (in V)" VALUE 0x10CC54 rlValuefl 10 VOLT_REAL 0 10 /end CHARACTERISTIC
/begin CHARACTERISTIC uDrvDiagI_ScVoltageDropLimit_GDF32 "Voltage drop limit for possible short while under voltage (in V)" VALUE 0x10CC58 rlValuefl 10 VOLT_REAL 0 10 /end CHARACTERISTIC
/begin CHARACTERISTIC iOpenPhase_IMaxOpenPhase_GDF32 "Threshold for open phase (in A)" VALUE 0x10CC60 rlValuefl 10 CURR_REAL 0 10 /end CHARACTERISTIC
/begin CHARACTERISTIC iOpenPhase_IMaxSumOppositePhases_GDF32 "Threshold for other phases (in A)" VALUE 0x10CC64 rlValuefl 10 CURR_REAL 0 10 /end CHARACTERISTIC
/begin CHARACTERISTIC iOpenPhase_IMinOppositePhase_GDF32 "Threshold for opposite phase (in A)" VALUE 0x10CC68 rlValuefl 10 CURR_REAL 0 10 /end CHARACTERISTIC
/begin CHARACTERISTIC mOpenPhase_MotorTorqueThreshold_GDF32 "Mininum torque for Open Phase Detection" VALUE 0x10CC6C rlValuefl 2 TORQ_REAL 0 2 /end CHARACTERISTIC
/begin CHARACTERISTIC nOpenPhase_MaxRotSpeed_GDF32 "Maximum rotor speed for diagnosis" VALUE 0x10CC70 rlValuefl 5000 NO_UNIT 0 5000 /end CHARACTERISTIC
/begin CHARACTERISTIC nOpenPhase_RotSpeedForDiagSelect_GDF32 "Threshold for rotor speed to select diag type (in 1/min)" VALUE 0x10CC74 rlValuefl 500 NO_UNIT 0 500 /end CHARACTERISTIC
/begin CHARACTERISTIC sOpenPhase_ErrorFilterIncrement_GDU8 "Error counter increment for Open Phase Detection" VALUE 0x10CC82 rlValueub 100 NO_UNIT 0 100 /end CHARACTERISTIC
/begin CHARACTERISTIC tOpenPhase_MaxCommonDetectionDuration_GDU16 "Maximum Duration for the common detection" VALUE 0x10CC7C rlValueuw 40 NO_UNIT 10 50 /end CHARACTERISTIC
/begin CHARACTERISTIC tOpenPhase_MaxDurationFailOp_GDU16 "Maximum Limp Duration (in s)" VALUE 0x10CC7E rlValueuw 65 T_S 0 65 /end CHARACTERISTIC
/begin CHARACTERISTIC tOpenPhase_ThresholdPwmPatternWaitTime_GDU16 "Wait time in PwmPattern to reduce actuator current" VALUE 0x10CC80 rlValueuw 7 NO_UNIT 3 10 /end CHARACTERISTIC
/begin CHARACTERISTIC wOpenPhase_AngleDeltaMin_GDF32 "Threshold for delta of rotor position (in rad)" VALUE 0x10CC78 rlValuefl 1 ANG_RAD_REAL 0 1 /end CHARACTERISTIC
/begin CHARACTERISTIC yMainFsa_ActCtrlCycErrorFilterDecrement_GDU8 "Filter Decrement in percentage" VALUE 0x10CC83 rlValueub 90 NO_UNIT 10 100 /end CHARACTERISTIC
/begin CHARACTERISTIC yMainFsa_ActCtrlCycErrorFilterIncrement_GDU8 "Filter Increment in percentage" VALUE 0x10CC84 rlValueub 90 NO_UNIT 10 100 /end CHARACTERISTIC
/begin CHARACTERISTIC yMainFsa_GduComErrorFilterDecrement_GDU8 "Filter Decrement in percentage" VALUE 0x10CC85 rlValueub 90 NO_UNIT 10 100 /end CHARACTERISTIC
/begin CHARACTERISTIC yMainFsa_GduComErrorFilterIncrement_GDU8 "Filter Increment in percentage" VALUE 0x10CC86 rlValueub 90 NO_UNIT 10 100 /end CHARACTERISTIC
/begin CHARACTERISTIC nPscCtrl_ThresholdRotSpeedPhaseCutOff_GDF32 "Maximum rotor speed for phase cut-off (in 1/min)" VALUE 0x10CC88 rlValuefl 5000 NO_UNIT 0 5000 /end CHARACTERISTIC
/begin CHARACTERISTIC nPscCtrl_ThresholdRotSpeedPscEnable_GDF32 "Maximum rotor speed for enabling phase cut-off FETs (in 1/min)" VALUE 0x10CC8C rlValuefl 5000 NO_UNIT 0 5000 /end CHARACTERISTIC
/begin CHARACTERISTIC tPscCtrl_DurationFsd_GDU16 "Maximum allowed time to Open phase cut-off FETs, in FSD mode" VALUE 0x10CC90 rlValueuw 100 T_MS 0 100 /end CHARACTERISTIC
/begin CHARACTERISTIC tPscCtrl_DurationSlowPhaseCutOff_GDU16 "Time to Open phase cut-off FETs, NOT in FSD mode" VALUE 0x10CC92 rlValueuw 100 T_MS 0 100 /end CHARACTERISTIC
/begin CHARACTERISTIC tPscCtrl_ThresholdDelayedTimeOut_GDU16 "3 seconds Timeout" VALUE 0x10CC94 rlValueuw 4000 T_MS 1000 5000 /end CHARACTERISTIC
/begin CHARACTERISTIC tPscCtrl_ThresholdLowRotorSpeed_GDU16 "Time which RotorSpeed has to be low to go further in PSFCtrl" VALUE 0x10CC96 rlValueuw 50 T_MS 50 100 /end CHARACTERISTIC
/begin CHARACTERISTIC tPscCtrl_WaitTimeStartPhaseCutOff_GDU16 "Wait until current in Motor -> 0A (in ms)" VALUE 0x10CC98 rlValueuw 20 T_MS 0 20 /end CHARACTERISTIC
/begin CHARACTERISTIC sPscDiag_ErrorFilterIncrement_MDU8 "Filter Increment in %" VALUE 0x10CC9A rlValueub 90 NO_UNIT 10 100 /end CHARACTERISTIC
/begin CHARACTERISTIC sPwmCheck_ErrorFilterIncrement_GDU8 "Filter Increment in percentage" VALUE 0x10CCB0 rlValueub 90 NO_UNIT 10 100 /end CHARACTERISTIC
/begin CHARACTERISTIC uPwmCheck_MinVoltForPfbMonitoring_GDF32 "Min allowed voltage for phase feedback monitoring" VALUE 0x10CC9C rlValuefl 40 NO_UNIT 0 40 /end CHARACTERISTIC
/begin CHARACTERISTIC yPwmCheck_MaxAllowedFadeOutDeviation_GDF32 "Maximal allowed deviation during Fadeout of PFB to the set-point (in percentage points)" VALUE 0x10CCA0 rlValuefl 100 NO_UNIT 0 100 /end CHARACTERISTIC
/begin CHARACTERISTIC yPwmCheck_MaxAllowedPfbDeviation_GDF32 "Maximal allowed deviation of PFB to the set-point (in percentage points)" VALUE 0x10CCA4 rlValuefl 100 NO_UNIT 0 100 /end CHARACTERISTIC
/begin CHARACTERISTIC yPwmCheck_MaxPwmForPfbMonitoring_GDF32 "Maximum PWM for monitoring of phase feedback" VALUE 0x10CCA8 rlValuefl 100 NO_UNIT 0 100 /end CHARACTERISTIC
/begin CHARACTERISTIC yPwmCheck_MinPwmForPfbMonitoring_GDF32 "Minimum PWM for monitoring of phase feedback" VALUE 0x10CCAC rlValuefl 100 NO_UNIT 0 100 /end CHARACTERISTIC
/begin CHARACTERISTIC xOsc_SwitchOffOutstage_GDU16 "Reduction factor where output stage will be switched off" VALUE 0x10CCF4 rlValueuw 100 PERCENT_INT 0 100 /end CHARACTERISTIC
/begin CHARACTERISTIC xOsc_SwitchOnOutstage_GDU16 "Reduction factor wherer output stage will be switched on" VALUE 0x10CCF6 rlValueuw 100 PERCENT_INT 0 100 /end CHARACTERISTIC
/begin CHARACTERISTIC xProt_DcLinkRedGradient_GDU16 "Dc link abs temeprature reduction max gradient" VALUE 0x10CCF8 rlValueuw 32768 NO_UNIT 0 32768 /end CHARACTERISTIC
/begin CHARACTERISTIC mToLiCo_DebounceThreshold_GDF32 "Torque hysteresis to avoid factor/torque bouncing in Nm" VALUE 0x10CCFC rlValuefl 0.5 TORQ_REAL 0 0.5 /end CHARACTERISTIC
/begin CHARACTERISTIC mToLiCoI_CogCompTorqLimit_GDF32 "limit for cogging torque value" VALUE 0x10CD00 rlValuefl 0.025 TORQ_REAL 0 0.025 /end CHARACTERISTIC
/begin CHARACTERISTIC tRpcCalc_MaxSearchTime_GDU16 "max search time for min/max values" VALUE 0x10CD34 rlValueuw 65534 T_MS 1 65535 /end CHARACTERISTIC
/begin CHARACTERISTIC tRpcCalc_TimeoutInit_GDU8 "max time for amplitude controller in init phase" VALUE 0x10CD36 rlValueub 199 T_MS 1 200 /end CHARACTERISTIC
/begin CHARACTERISTIC uRpcCalc_MaxOffset_GDF32 "Maximal allowed offset from controller to adjust sine and cosine" VALUE 0x10CD04 rlValuefl 0.099 VOLT_REAL 0.001 0.1 /end CHARACTERISTIC
/begin CHARACTERISTIC uRpcCalc_MaxVectorLenInit_GDF32 "Limit for amplitude controller in init phase" VALUE 0x10CD08 rlValuefl 0.099 VOLT_REAL 0.001 0.1 /end CHARACTERISTIC
/begin CHARACTERISTIC uRpcCalc_TurnPointArea_GDF32 "voltage band for min-max search in voltage" VALUE 0x10CD0C rlValuefl 1 VOLT_REAL -0.5 0.5 /end CHARACTERISTIC
/begin CHARACTERISTIC uRpcCalcI_NominalVecLen_GDF32 "Nominal vector length" VALUE 0x10CD10 rlValuefl 0.6 VOLT_REAL 0.9 1.5 /end CHARACTERISTIC
/begin CHARACTERISTIC wRpcCalc_LimitAngleComp_GDF32 "Limitation for compensated angle" VALUE 0x10CD14 rlValuefl 0.249651 ANG_RAD_REAL 0.000349 0.25 /end CHARACTERISTIC
/begin CHARACTERISTIC xRpcCalc_AmpControlFactor_GDF32 "Factor for  radius control (oldFactor was 0,004 180deg-> now 0,002 360deg)" VALUE 0x10CD18 rlValuefl 0.0499 NO_UNIT 0.0001 0.05 /end CHARACTERISTIC
/begin CHARACTERISTIC xRpcCalc_InitAmpControlFactor_GDF32 "Factor for  radius control in init phase" VALUE 0x10CD1C rlValuefl 0.499 NO_UNIT 0.001 0.5 /end CHARACTERISTIC
/begin CHARACTERISTIC xRpcCalc_MaxAmp_GDF32 "upper limit for Amplitude" VALUE 0x10CD20 rlValuefl 0.49 NO_UNIT 1.01 1.5 /end CHARACTERISTIC
/begin CHARACTERISTIC xRpcCalc_MaxRatio_GDF32 "Limit ratio between SinAmp and CosAmp" VALUE 0x10CD24 rlValuefl 0.9 NO_UNIT 0.1 1 /end CHARACTERISTIC
/begin CHARACTERISTIC xRpcCalc_MinAmp_GDF32 "lower limit for Amplitude" VALUE 0x10CD28 rlValuefl 0.4999 NO_UNIT 0.5 0.9999 /end CHARACTERISTIC
/begin CHARACTERISTIC xRpcCalc_OffsetControlFactor_GDF32 "Factor for offset control" VALUE 0x10CD2C rlValuefl 0.99 NO_UNIT 0.01 1 /end CHARACTERISTIC
/begin CHARACTERISTIC xRpcCalc_RatioControlFactor_GDF32 "Factor for ratio controller" VALUE 0x10CD30 rlValuefl 0.099 NO_UNIT 0.001 0.1 /end CHARACTERISTIC
/begin CHARACTERISTIC uRpcDiag_MaxOffsetHalfBridge_GDF32 "Max difference to nominal Offset" VALUE 0x112C70 rlValuefl 0.49 VOLT_REAL 0.01 0.5 /end CHARACTERISTIC
/begin CHARACTERISTIC uRpcDiag_MaxVectorLen_GDF32 "Max difference to nominal vector length" VALUE 0x112C74 rlValuefl 0.29 VOLT_REAL 0.01 0.3 /end CHARACTERISTIC
/begin CHARACTERISTIC yRpcDiag_HwIndexRps_GDU8 "Check of HW Level index for RPS" VALUE 0x112C78 rlValueub 255 NO_UNIT 0 255 /end CHARACTERISTIC
/begin CHARACTERISTIC xRpcFSA_DebounceFactorDown_GDU8 "Factor for back filtering RPC errors" VALUE 0x10CD37 rlValueub 0 NO_UNIT 1 1 /end CHARACTERISTIC
/begin CHARACTERISTIC xRpcFSA_DebounceFactorUp_GDU8 "Factor for filtering error" VALUE 0x10CD38 rlValueub 3 NO_UNIT 1 4 /end CHARACTERISTIC
/begin CHARACTERISTIC uRpcPlausi_MaxDiffRawSignals_GDF32 "Max difference Raw signals of SW Plausibilisation" VALUE 0x112C7C rlValuefl 0.1 VOLT_REAL 0 0.1 /end CHARACTERISTIC
/begin CHARACTERISTIC xRpcSpeedAcc_FilterFactorAcc_GDF32 "Filter factor of filtered rotor acceleration" VALUE 0x112C80 rlValuefl 0.89 NO_UNIT 0.1 0.99 /end CHARACTERISTIC
/begin CHARACTERISTIC xRpcSpeedAcc_FilterFactorSpeed_GDF32 "Filter factor of filtered rotor speed" VALUE 0x112C84 rlValuefl 0.9 NO_UNIT 0.1 1 /end CHARACTERISTIC
/begin CHARACTERISTIC wStcPasCalc_TorsBarMaxTwstAg_GDF32 "" VALUE 0x10CDB0 rlValuefl 9.5 ANG_RAD_REAL 0 9.5 /end CHARACTERISTIC
/begin CHARACTERISTIC wStcPasCalc_TorsBarSafeTwstAg_GDF32 "" VALUE 0x10CDB4 rlValuefl 7.5 ANG_RAD_REAL 0 7.5 /end CHARACTERISTIC
/begin CHARACTERISTIC xStcPasCalc_Pt1FildFactor_GDU8 "" VALUE 0x10CDC0 rlValueub 17 NO_UNIT 0 17 /end CHARACTERISTIC
/begin CHARACTERISTIC xStcPasCalc_StfnCorrnFactor_GDU16 "" VALUE 0x10CDB8 rlValueuw 1536 NO_UNIT 0 1536 /end CHARACTERISTIC
/begin CHARACTERISTIC yStcPasCalc_MaxPsblTorqueRd_GDU16 "" VALUE 0x10CDBA rlValueuw 1741 NO_UNIT 307 2048 /end CHARACTERISTIC
/begin CHARACTERISTIC yStcPasCalc_MinPsblTorqueRd_GDU16 "" VALUE 0x10CDBC rlValueuw 410 NO_UNIT 102 512 /end CHARACTERISTIC
/begin CHARACTERISTIC yStcPasCalc_NormalTorsBarStfn_GDU16 "" VALUE 0x10CDBE rlValueuw 3 TORQ_STIFF_INT 1 4 /end CHARACTERISTIC
/begin CHARACTERISTIC yStcPasCalc_RdArea_GDU8 "" VALUE 0x10CDC1 rlValueub 198 NO_UNIT 2 200 /end CHARACTERISTIC
/begin CHARACTERISTIC yStcPasCalc_RdToleranceArea_GDU8 "" VALUE 0x10CDC2 rlValueub 48 NO_UNIT 2 50 /end CHARACTERISTIC
/begin CHARACTERISTIC tStcPasDiag_UvRecoveryTime_GDU8 "" VALUE 0x10CDD2 rlValueub 237 T_MS 18 255 /end CHARACTERISTIC
/begin CHARACTERISTIC tStcPasDiagI_StartUpErrDeb_GDU16 "Debounce time for Open-circuit error " VALUE 0x10CDD0 rlValueuw 999 T_MS 1 1000 /end CHARACTERISTIC
/begin CHARACTERISTIC yStcPasDiag_HwIndexTorqInterface_GDU32 "Allowed hw indexes for the torque interface" VALUE 0x10CDC4 rlValueul 65535 NO_UNIT 0 65535 /end CHARACTERISTIC
/begin CHARACTERISTIC yStcPasDiag_Psi5HwIndexUc_GDU32 "microcontroller HwIndex for PSI5" VALUE 0x10CDC8 rlValueul 4.29497E+09 NO_UNIT 0 4294967295 /end CHARACTERISTIC
/begin CHARACTERISTIC yStcPasDiag_UartHwIndexUc_GDU32 "microcontroller HwIndex for UART" VALUE 0x10CDCC rlValueul 4.29497E+09 NO_UNIT 0 4294967295 /end CHARACTERISTIC
/begin CHARACTERISTIC zStcPasDiag_MaxConfigCount_GDU8 "Maximum configuration check count" VALUE 0x10CDD3 rlValueub 3 NO_UNIT 0 3 /end CHARACTERISTIC
/begin CHARACTERISTIC zStcPasDiag_MaxDmaFrameIndex_GDU8 "Maximun Frame index value from DMA" VALUE 0x10CDD4 rlValueub 32 NO_UNIT 64 96 /end CHARACTERISTIC
/begin CHARACTERISTIC zStcPasDiag_NoChangeErrCntThres_GDU8 "Debounce threshold for freezing dectection of sine and cosine amplitude." VALUE 0x10CDD5 rlValueub 49 NO_UNIT 1 50 /end CHARACTERISTIC
/begin CHARACTERISTIC zStcPasDiag_SkipSupplyDiag_GDU8 "Skip sensor supply diag at startup" VALUE 0x10CDD6 rlValueub 10 NO_UNIT 0 10 /end CHARACTERISTIC
/begin CHARACTERISTIC mStcPasFsa_SubTorsionBarTorque_GDS16 "" VALUE 0x10CE8C rlValuesw 16 TORQ_INT -8 8 /end CHARACTERISTIC
/begin CHARACTERISTIC yStcCommon_TbtSensMapping_GAE "This Variable is a look table for Torque Sensor HWINDEX vs Torque Sensor Type" VAL_BLK 0x10CEB4 rlValueub 255 NO_UNIT 0 255 NUMBER 13 /end CHARACTERISTIC
/begin CHARACTERISTIC tStcPasPlausi_FltDebTime_GDU8 "" VALUE 0x10CEC4 rlValueub 19 T_MS 1 20 /end CHARACTERISTIC
/begin CHARACTERISTIC yStcPasPlausi_SnsrSignalTolr_GDU8 "" VALUE 0x10CEC5 rlValueub 100 NO_UNIT 0 100 /end CHARACTERISTIC
/begin CHARACTERISTIC yFiltVolt_PT1FilterKFactor_MDF32 "k-Factor of PT1 Filter" VALUE 0x10CF58 rlValuefl 8 NO_UNIT 0 8 /end CHARACTERISTIC
/begin CHARACTERISTIC tStartUpChk_DebounceTime_MDU8 "StartUp debounce time if low or high voltage condition" VALUE 0x112C88 rlValueub 100 T_MS 0 100 /end CHARACTERISTIC
/begin CHARACTERISTIC uSupplyVolt_MaxSupplyDeviation_MDF32 "Maximum supply voltage deviation for limitation" VALUE 0x10CF60 rlValuefl 5 VOLT_REAL 0 5 /end CHARACTERISTIC
/begin CHARACTERISTIC uSvoCalc_MaxVoltageOffset_GDF32 "NV share value check" VALUE 0x10CF64 rlValuefl 10 VOLT_REAL 0 10 /end CHARACTERISTIC
/begin CHARACTERISTIC ySvoCalc_MinVoltageSlope_GDF32 "NV share value check" VALUE 0x10CF68 rlValuefl 100 NO_UNIT 0 100 /end CHARACTERISTIC
/begin CHARACTERISTIC uSvoDiag_LowVoltRangeForReset_MDF32 "Low voltage range during plausibilization of voltages" VALUE 0x10CF6C rlValuefl 30 VOLT_REAL 0 30 /end CHARACTERISTIC
/begin CHARACTERISTIC uSvoDiag_NormalVoltRange_MDF32 "Normal voltage range during plausibilization of voltages" VALUE 0x10CF70 rlValuefl 30 VOLT_REAL 0 30 /end CHARACTERISTIC
/begin CHARACTERISTIC ySvoFsa_DebounceCountDownFactor_MDF32 "Factor for 12 ms debounce count down time" VALUE 0x10CF74 rlValuefl 1 NO_UNIT 0 1 /end CHARACTERISTIC
/begin CHARACTERISTIC uU1V25_U1V25_Offset_MDF32 "U1V25 Offset" VALUE 0x10CF78 rlValuefl 100 VOLT_REAL 0 100 /end CHARACTERISTIC
/begin CHARACTERISTIC uLowVoltChk_LowOutputDriverVoltRange_MDF32 "Voltage range for low voltage status" VALUE 0x10CF5C rlValuefl 26 VOLT_REAL 4 30 /end CHARACTERISTIC
/begin CHARACTERISTIC xGpCalc_Pt1FilterCoeffA1_GDF32 "Discrete PT1 filter coefficient a1" VALUE 0x10CF84 rlValuefl 10 NO_UNIT -5 5 /end CHARACTERISTIC
/begin CHARACTERISTIC xGpCalc_Pt1FilterCoeffB0_GDF32 "Discrete PT1 filter coefficient a1" VALUE 0x10CF88 rlValuefl 10 NO_UNIT -5 5 /end CHARACTERISTIC
/begin CHARACTERISTIC xPcbCalc_Pt1FilterCoeffA1_GDF32 "Discrete PT1 filter coefficient a1" VALUE 0x10CF8C rlValuefl 10 NO_UNIT -5 5 /end CHARACTERISTIC
/begin CHARACTERISTIC xPcbCalc_Pt1FilterCoeffB0_GDF32 "Discrete PT1 filter coefficient a1" VALUE 0x10CF90 rlValuefl 10 NO_UNIT -5 5 /end CHARACTERISTIC
/begin CHARACTERISTIC yTecDiag_HwIndexTempSens_GDU8 "Check of HW Temperature sensor index for Tec" VALUE 0x10CF94 rlValueub 255 NO_UNIT 0 255 /end CHARACTERISTIC
/begin CHARACTERISTIC xUcCalc_Pt1FilterCoeffA1_GDF32 "Discrete PT1 filter coefficient a1" VALUE 0x10CF98 rlValuefl 10 NO_UNIT -5 5 /end CHARACTERISTIC
/begin CHARACTERISTIC xUcCalc_Pt1FilterCoeffB0_GDF32 "Discrete PT1 filter coefficient a1" VALUE 0x10CF9C rlValuefl 10 NO_UNIT -5 5 /end CHARACTERISTIC
/begin CHARACTERISTIC yActComServ_GduSpiComCsihBrsReg_GDU16 "GDU SPI communication CSIH Baudrate Register value" VALUE 0x10D0C0 rlValueuw 4095 NO_UNIT 0 4095 /end CHARACTERISTIC
/begin CHARACTERISTIC yActComServ_GduSpiComCsihClkPrescaler_GDE "GDU SPI communication Pre-Scaler Config" VALUE 0x10D0C2 rlValueuw 65535 NO_UNIT 0 65535 /end CHARACTERISTIC
/begin CHARACTERISTIC yActComServ_GduSpiComCsihCsConfig_GDU32 "GDU SPI communication CSIH Chipselect configuration" VALUE 0x10D0B8 rlValueul 4.29497E+09 NO_UNIT 0 4294967295 /end CHARACTERISTIC
/begin CHARACTERISTIC yActComServ_GduSpiComLenSpiFrame_GDU8 "GDU SPI communication SPI Frame length in bytes" VALUE 0x10D0C4 rlValueub 2 NO_UNIT 2 4 /end CHARACTERISTIC
/begin CHARACTERISTIC yActComServ_WrongMsgId_GAU16 "Return msg from GDU in case of SPI comm error" VAL_BLK 0x10D0BC rlValueuw 65535 NO_UNIT 0 65535 NUMBER 2 /end CHARACTERISTIC
/begin CHARACTERISTIC yActRegServ_AllowedNvShareIndex_GAU32 "Allowed bits for the GDU (L9906, L9907)" VAL_BLK 0x10D0C8 rlValueuw 65535 NO_UNIT 0 65535 NUMBER 2 /end CHARACTERISTIC
/begin CHARACTERISTIC yActRegServ_NumOfGduRegs_GAE "Number of registers in the GDU (L9906, L9907)" VAL_BLK 0x10D0CC rlValueub 255 NO_UNIT 0 255 NUMBER 2 /end CHARACTERISTIC
/begin CHARACTERISTIC yDriverConfI_GduSpiGainFine_GDU16 "Spi Message for GDU Gain Fine" VALUE 0x10D0CE rlValueuw 0 NO_UNIT 237 237 /end CHARACTERISTIC
/begin CHARACTERISTIC yDriverConfI_GduSpiGainMiddle_GDU16 "Spi Message for GDU Gain Middle" VALUE 0x10D0D0 rlValueuw 0 NO_UNIT 219 219 /end CHARACTERISTIC
/begin CHARACTERISTIC yDriverConfI_GduSpiGainRough_GDU16 "Spi Message for GDU Gain Rough" VALUE 0x10D0D2 rlValueuw 0 NO_UNIT 201 201 /end CHARACTERISTIC
/begin CHARACTERISTIC yDriverConfI_GduSpiGainSuperfine_GDU16 "Spi Message for GDU Gain Superfine" VALUE 0x10D0D4 rlValueuw 0 NO_UNIT 255 255 /end CHARACTERISTIC
/begin CHARACTERISTIC yAscComServ_AsicSpiComCsihBrsReg_GDU16 "ASIC SPI communication CSIH Baudrate Register value" VALUE 0x10D558 rlValueuw 4095 NO_UNIT 0 4095 /end CHARACTERISTIC
/begin CHARACTERISTIC yAscComServ_AsicSpiComCsihClkPrescaler_GDE "ASCI SPI communication Pre-Scaler Config" VALUE 0x10D55A rlValueuw 65535 NO_UNIT 0 65535 /end CHARACTERISTIC
/begin CHARACTERISTIC yAscComServ_AsicSpiComCsihCsConfig_GDU32 "ASIC SPI communication CSIH Chipselect configuration" VALUE 0x10D554 rlValueul 4.29497E+09 NO_UNIT 0 4294967295 /end CHARACTERISTIC
/begin CHARACTERISTIC yAscComServ_AsicSpiComLenSpiFrame_GDU8 "ASIC SPI communication SPI Frame length in bytes" VALUE 0x10D55C rlValueub 2 NO_UNIT 2 4 /end CHARACTERISTIC
/begin CHARACTERISTIC yAsic_Safety_HwIndexAsic_GDU32 "" VALUE 0x10D5B4 rlValueul 4.29497E+09 NO_UNIT 0 4294967295 /end CHARACTERISTIC
/begin CHARACTERISTIC yAsicSelftest_SwVoltBitmask_GAU16 "Holds SW voltage bit mask" VAL_BLK 0x10D6A8 rlValueuw 65535 NO_UNIT 0 65535 NUMBER 4 /end CHARACTERISTIC
/begin CHARACTERISTIC yCoreSafetServ_CoreSafetyCheckId_GAE "Holds core safety check identifiers" VAL_BLK 0x10D998 rlValueub 255 NO_UNIT 0 255 NUMBER 7 /end CHARACTERISTIC
/begin CHARACTERISTIC yInitServ_HwIndexMicrocontroller_GDU32 "" VALUE 0x10E59C rlValueul 4.29497E+09 NO_UNIT 0 4294967295 /end CHARACTERISTIC
/begin CHARACTERISTIC yDtsServ_DoOffsetMeasurementData_GAU16 "Value that decides which ADC ISR (Current/Offset) gets performed" VAL_BLK 0x10D9AC rlValueuw 1 NO_UNIT 0 1 NUMBER 8 /end CHARACTERISTIC
/begin CHARACTERISTIC yDtsServ_DtsEntering_GAU16 "Debug information about currently executed valley (binary: xxxx1xxx)" VAL_BLK 0x10D9BC rlValueuw 65535 NO_UNIT 0 65535 NUMBER 8 /end CHARACTERISTIC
/begin CHARACTERISTIC yDtsServ_DtsLeaving_GAU16 "Debug information removal of executed valley (binary: xxxx0xxx)" VAL_BLK 0x10D9CC rlValueuw 65535 NO_UNIT 0 65535 NUMBER 8 /end CHARACTERISTIC
/begin CHARACTERISTIC yDtsServ_DtsOne_GDU32 "" VALUE 0x10D9A0 rlValueul 0 NO_UNIT 1 1 /end CHARACTERISTIC
/begin CHARACTERISTIC yDtsServ_DtsZero_GDU32 "" VALUE 0x10D9A4 rlValueul 4.29497E+09 NO_UNIT 0 4294967295 /end CHARACTERISTIC
/begin CHARACTERISTIC yDtsServ_PeakInitChain_GAU32 "" VAL_BLK 0x10D9DC rlValueul 1.67764E+08 NO_UNIT 0 167763967 NUMBER 8 /end CHARACTERISTIC
/begin CHARACTERISTIC yDtsServ_StartPsdSpi_GDU8 "Enable Tx for Psd Spi in Valley 0" VALUE 0x10D9A8 rlValueub 255 NO_UNIT 0 255 /end CHARACTERISTIC
/begin CHARACTERISTIC yDtsServ_ValleyInitChain_GAU32 "inital value for valley chain" VAL_BLK 0x10D9FC rlValueul 1.67764E+08 NO_UNIT 0 167763967 NUMBER 8 /end CHARACTERISTIC
/begin CHARACTERISTIC yTrcvServI_HwIndexCanTrcv_GDU32 "" VALUE 0x10E5A0 rlValueul 4.29497E+09 NO_UNIT 0 4294967295 /end CHARACTERISTIC
/begin CHARACTERISTIC yTrcvServI_HwIndexFlexRayTrcv_GDU32 "HW Index for Flex Ray transceiver" VALUE 0x10E5A4 rlValueul 4.29497E+09 NO_UNIT 0 4294967295 /end CHARACTERISTIC
/begin CHARACTERISTIC ySensServHwCheck_HwIndexAsic_GDU32 "HW Index for ASIC" VALUE 0x112DBC rlValueul 4.29497E+09 NO_UNIT 1 4294967295 /end CHARACTERISTIC
/begin CHARACTERISTIC ySensServHwCheck_HwIndexCurrMeas_GDU32 "HW Index for Current Measurement" VALUE 0x112DC0 rlValueul 4.29497E+09 NO_UNIT 1 4294967295 /end CHARACTERISTIC
/begin CHARACTERISTIC ySensServHwCheck_HwIndexRps_GDU32 "HW Index for Rotor position sensor" VALUE 0x112DC4 rlValueul 4.29497E+09 NO_UNIT 1 4294967295 /end CHARACTERISTIC
/begin CHARACTERISTIC ySensServHwCheck_HwIndexTorqueInterface_GDU32 "HW Index for Torque Sensor" VALUE 0x112DC8 rlValueul 4.29497E+09 NO_UNIT 1 4294967295 /end CHARACTERISTIC
/begin CHARACTERISTIC ySensServStcPas_DmaTorqChnMap_GAE "" VAL_BLK 0x10E5C0 rlValueub 255 NO_UNIT 0 255 NUMBER 2 /end CHARACTERISTIC
/begin CHARACTERISTIC ySensServStcPas_SmplTimeDmaUartChnMap_GAE "" VAL_BLK 0x10E5C2 rlValueub 255 NO_UNIT 0 255 NUMBER 2 /end CHARACTERISTIC
/begin CHARACTERISTIC ySensServStcPas_UartTorqChnMap_GAE "" VAL_BLK 0x10E5C4 rlValueub 255 NO_UNIT 0 255 NUMBER 2 /end CHARACTERISTIC
/begin CHARACTERISTIC yAdcDrv_HwIndexAdcConfig_GDU32 "HW Index ID for ADC Configuration" VALUE 0x10E7D8 rlValueul 4.29497E+09 NO_UNIT 0 4294967295 /end CHARACTERISTIC
/begin CHARACTERISTIC yAdcDrv_HwIndexMicrocontroller_GDU32 "HW ID for uC Configuration" VALUE 0x10E7DC rlValueul 4.29497E+09 NO_UNIT 0 4294967295 /end CHARACTERISTIC
/begin CHARACTERISTIC yDioDrv_HwIndexMicrocontroller_GDU32 "HwIndex for microcontroller type" VALUE 0x10EC10 rlValueul 4.29497E+09 NO_UNIT 0 4294967295 /end CHARACTERISTIC
/begin CHARACTERISTIC yHwaDma_HwIndexMicrocontroller_GDU32 "" VALUE 0x10F06C rlValueul 4.29497E+09 NO_UNIT 0 4294967295 /end CHARACTERISTIC
/begin CHARACTERISTIC yHwaDts_HwIndexMicrocontroller_GDU32 "" VALUE 0x10F37C rlValueul 4.29497E+09 NO_UNIT 0 4294967295 /end CHARACTERISTIC
/begin CHARACTERISTIC yHwaGpt_HwIndexMicrocontroller_GDU32 "Configured microcontroller HW index for sublib variant" VALUE 0x10F3C0 rlValueul 4.29497E+09 NO_UNIT 0 4294967295 /end CHARACTERISTIC
/begin CHARACTERISTIC yHwaIcu_HwIndexMicrocontroller_GDU32 "" VALUE 0x112DCC rlValueul 4.29497E+09 NO_UNIT 0 4294967295 /end CHARACTERISTIC
/begin CHARACTERISTIC yCoreRegXsC_HwIndexMicrocontroller_GDU32 "HW index of microcontroller for HWA MCU HwIndex check" VALUE 0x111038 rlValueul 4.29497E+09 NO_UNIT 0 4294967295 /end CHARACTERISTIC
/begin CHARACTERISTIC yPwmConfig_HwIndexMicrocontroller_GDU32 "hardware index value" VALUE 0x111A64 rlValueul 4.29497E+09 NO_UNIT 0 4294967295 /end CHARACTERISTIC
/begin CHARACTERISTIC yHwaSpi_HwIndexMicrocontroller_GDU32 "Microcontroller HW index for unit CSIH" VALUE 0x111C34 rlValueul 4.29497E+09 NO_UNIT 0 4294967295 /end CHARACTERISTIC
/begin CHARACTERISTIC yUartDriver_HwIndexMicrocontroller_GDU32 "Microcontroller HW index for UART component" VALUE 0x111D98 rlValueul 4.29497E+09 NO_UNIT 0 4294967295 /end CHARACTERISTIC
/begin CHARACTERISTIC yTrcvCtrlI_HwIndexCanTrcv_GDU32 "HwIndex for Can Transceiver in CoHwServ" VALUE 0x11205C rlValueul 4.29497E+09 NO_UNIT 0 4294967295 /end CHARACTERISTIC
/begin CHARACTERISTIC yTrcvCtrlI_HwIndexFlexRayTrcv_GDU32 "HwIndex for FlexRay Transceiver" VALUE 0x112060 rlValueul 4.29497E+09 NO_UNIT 0 4294967295 /end CHARACTERISTIC
/begin CHARACTERISTIC yInitHdlr_AdcDtsIntNo_GDU16 "Contains the interrupt channel number of theDTS complete interrupt" VALUE 0x112056 rlValueuw 1024 NO_UNIT 0 1024 /end CHARACTERISTIC
/begin CHARACTERISTIC yInitHdlr_AsilRomDriveInitState_GDU32 "variable for checking ASIL ROM section initilization" VALUE 0x120000 rlValueul 4.29497E+09 NO_UNIT 0 4294967295 /end CHARACTERISTIC
/begin CHARACTERISTIC yInitHdlr_OsTmIntNo_GDU16 "Contains the interrupt channel number of the OS timer interrupt" VALUE 0x112058 rlValueuw 1024 NO_UNIT 0 1024 /end CHARACTERISTIC
/begin CHARACTERISTIC yInitHdlr_QmRomDriveInitState_GDU32 "variable for checking QM ROM section initilization" VALUE 0x120070 rlValueul 4.29497E+09 NO_UNIT 0 4294967295 /end CHARACTERISTIC
/begin CHARACTERISTIC yIfsDiagInt_ContinousMonitoring_GAU8 "Continuous or Non continuous monitoring" VAL_BLK 0x1205E8 rlValueub 255 NO_UNIT 0 255 NUMBER 211 /end CHARACTERISTIC
/begin CHARACTERISTIC yFaStCalc_ExtHealing_MAE "" VAL_BLK 0x11206C rlValueub 255 NO_UNIT 0 255 NUMBER 5 /end CHARACTERISTIC
/begin CHARACTERISTIC yFaStCalc_FadeOutRequest_MAU8 "Sepcifiy which functionality has Fadeout mode enabled" VAL_BLK 0x1120B0 rlValueub 255 NO_UNIT 0 255 NUMBER 13 /end CHARACTERISTIC
/begin CHARACTERISTIC yFaStCalc_MapExternalRequest_MAE "" VAL_BLK 0x112068 rlValueub 255 NO_UNIT 0 255 NUMBER 4 /end CHARACTERISTIC
/begin CHARACTERISTIC yFaStCalc_SpecialRequestsFailOpB_GAU8 "Sepcifiy which special request shall be used for every functionality in curent FailOpB state" VALUE 0x1120C0 rlValueub 255 NO_UNIT 0 255 NUMBER 13 /end CHARACTERISTIC
/begin CHARACTERISTIC xNvsMng_MotorNormFactorMax_GDF32 "upper limit calibration factor" VALUE 0x11226C rlValuefl 0.5 NO_UNIT 1 1.5 /end CHARACTERISTIC
/begin CHARACTERISTIC xNvsMng_MotorNormFactorMin_GDF32 "lower limit calibration factor" VALUE 0x112270 rlValuefl 0.499999 NO_UNIT 0.5 0.999999 /end CHARACTERISTIC
/begin CHARACTERISTIC yNvsMng_AllBlocks_GDU32 "" VALUE 0x112274 rlValueul 1.34021E+08 NO_UNIT 0 134021119 /end CHARACTERISTIC
/begin CHARACTERISTIC ySuCooI_AlwaysDoneSequences_DU32 "Sequence IDs which cannot be skipped, after a shutdown was requested" VALUE 0x12053C rlValueul 4.29497E+09 NO_UNIT 0 4294967295 /end CHARACTERISTIC
/begin CHARACTERISTIC bCurrCon_FosPsip_GDF32 "Psi_p for FOS" VALUE 0x140018 rlValuefl 0.02 NO_UNIT 0 0.02 /end CHARACTERISTIC
/begin CHARACTERISTIC bCurrCon_PreloadPsip_GDF32 "Psi_p" VALUE 0x14001C rlValuefl 0.099 NO_UNIT 0.001 0.1 /end CHARACTERISTIC
/begin CHARACTERISTIC bCurrCon_Psip_GDF32 "magnetic flux; assumed constant in decoupling" VALUE 0x140020 rlValuefl 0.099 NO_UNIT 0.001 0.1 /end CHARACTERISTIC
/begin CHARACTERISTIC bMcDiag_Psip_GDF32 "Psip for UCMP" VALUE 0x140024 rlValuefl 0.02 MAGN_FLUX_REAL 0 0.02 /end CHARACTERISTIC
/begin CHARACTERISTIC bReMoTo_PsiPm_GDS "permanent magnet flux over q current" CURVE 0x1402E4 rlCurvefl 0.999999 MAGN_FLUX_REAL 1E-06 1
 /begin AXIS_DESCR STD_AXIS iReMoTo_Iq_gdf32 CURR_REAL 5 -500 500 DEPOSIT ABSOLUTE /end AXIS_DESCR
/end CHARACTERISTIC
/begin CHARACTERISTIC cBaCuLi_RsRefTemp_GDF32 "reference temperature for resistor calculation" VALUE 0x140028 rlValuefl 20 NO_UNIT 10 30 /end CHARACTERISTIC
/begin CHARACTERISTIC cCoilCalc_RsRefTemp_GDF32 "Reference temperature for Rs" VALUE 0x14002C rlValuefl 30 NO_UNIT 0 30 /end CHARACTERISTIC
/begin CHARACTERISTIC cCoilCalc_SubstTemp_GDF32 "Substitute value for ECU temperature in case of invalid input signals" VALUE 0x140030 rlValuefl 255 NO_UNIT -70 185 /end CHARACTERISTIC
/begin CHARACTERISTIC cHwConf_GroundPlateTempSubst_GDF32 "substitute value for ground plate temperature(going to replace cSigProc_GroundplatetempSubst in an later steps)" VALUE 0x140034 rlValuefl 255 NO_UNIT -70 185 /end CHARACTERISTIC
/begin CHARACTERISTIC cSigProc_RsTemp0_GDF32 "reference temperature for strand resistor factor" VALUE 0x140038 rlValuefl 255 NO_UNIT -70 185 /end CHARACTERISTIC
/begin CHARACTERISTIC iBaCuLi_IdcMin_GDF32 "min Idc current" VALUE 0x14003C rlValuefl 195 CURR_REAL 5 200 /end CHARACTERISTIC
/begin CHARACTERISTIC iBaCuLi_IdcRedAcc_GDS "Reduction of battery current depending on acceleration" CURVE 0x140310 rlCurvefl 50 CURR_REAL 0 50
 /begin AXIS_DESCR STD_AXIS aBaCuLi_AbsRotAcc4IdcRed_gdf32 NO_UNIT 3 -500 500 DEPOSIT ABSOLUTE /end AXIS_DESCR
/end CHARACTERISTIC
/begin CHARACTERISTIC iHwConfI_MocOcV3FbCurrMax_GDF32 "limit value for feedback current OcV3" VALUE 0x140040 rlValuefl 10 CURR_REAL 0 10 /end CHARACTERISTIC
/begin CHARACTERISTIC iHwConfI_OcMaxCurrEff_GDF32 "Max. effective current in OC" VALUE 0x140044 rlValuefl 150 CURR_REAL 0 150 /end CHARACTERISTIC
/begin CHARACTERISTIC iHwConfI_PstMaxPhaseCurrent_GDF32 "Maximum allowed phase current." VALUE 0x140048 rlValuefl 500 CURR_REAL 0 500 /end CHARACTERISTIC
/begin CHARACTERISTIC iRefCurr_AppOpenCIsqRefPulsKenn_GDS "Isq-Ref-Pulse in critical section of broken phase" CURVE 0x14032C rlCurvefl 200 CURR_REAL 0 200
 /begin AXIS_DESCR STD_AXIS iRefCurr_IsqRefAbs4Oc_gdf32 CURR_REAL 5 0 500 DEPOSIT ABSOLUTE /end AXIS_DESCR
/end CHARACTERISTIC
/begin CHARACTERISTIC iRefCurr_IsdLowerLimit_GDS "minimum value of IsdRef due to rotor speed" CURVE 0x140358 rlCurvefl 2040 CURR_REAL -2040 0
 /begin AXIS_DESCR STD_AXIS nSigProcI_RotorSpeedFiltAbs_gdf32 NO_UNIT 5 -10000 10000 DEPOSIT ABSOLUTE /end AXIS_DESCR
/end CHARACTERISTIC
/begin CHARACTERISTIC iRefCurr_IsdUpperLimit_GDS "maximum value of IsdRef due to rotor speed" CURVE 0x140384 rlCurvefl 2040 CURR_REAL -2040 0
 /begin AXIS_DESCR STD_AXIS nSigProcI_RotorSpeedFiltAbs_gdf32 NO_UNIT 3 -10000 10000 DEPOSIT ABSOLUTE /end AXIS_DESCR
/end CHARACTERISTIC
/begin CHARACTERISTIC iRefCurr_IsqLimit_GDF32 "limitation of absolute IsqRef" VALUE 0x14004C rlValuefl 170 CURR_REAL 0 170 /end CHARACTERISTIC
/begin CHARACTERISTIC iRefCurr_IsRefLimit_GDF32 "limitation of absolute IsRef,used in IsqRefLimit()" VALUE 0x140050 rlValuefl 220 CURR_REAL 0 220 /end CHARACTERISTIC
/begin CHARACTERISTIC iSigProc_MaxPhaseCurrent_GDF32 "limit for phase currents" VALUE 0x140054 rlValuefl 500 CURR_REAL 0 500 /end CHARACTERISTIC
/begin CHARACTERISTIC mBoTo_MaxTorqueBoostOff_GDF32 "Output torque if boost is off in Nm" VALUE 0x140058 rlValuefl 15 TORQ_REAL 0 15 /end CHARACTERISTIC
/begin CHARACTERISTIC mBoTo_MaxTorqueBoostOn_GDF32 "Output torque if boost is on in Nm" VALUE 0x14005C rlValuefl 15 TORQ_REAL 0 15 /end CHARACTERISTIC
/begin CHARACTERISTIC mCaMaTo_MaxMechanicalAllowedTorque_GDF32 "Maximum allowed eps-motor torque, that will not damage the steering gear" VALUE 0x140060 rlValuefl 20 NO_UNIT 0 20 /end CHARACTERISTIC
/begin CHARACTERISTIC mCaMaTo_MaxMotorTorque_GDS "Maximum motor torque motoric mode in Nm" CURVE 0x1403A0 rlCurvefl 10 TORQ_REAL 0 10
 /begin AXIS_DESCR STD_AXIS nCaMaTo_AbsRotorSpeedWeight_gdf32 NO_UNIT 5 0 10000 DEPOSIT ABSOLUTE /end AXIS_DESCR
/end CHARACTERISTIC
/begin CHARACTERISTIC mCaMaTo_MaxMotorTorqueGeneratoric_GDS "Maximum motor torque generatoric mode in Nm" CURVE 0x1403CC rlCurvefl 10 TORQ_REAL 0 10
 /begin AXIS_DESCR STD_AXIS nCaMaTo_AbsRotorSpeedWeight_gdf32 NO_UNIT 5 0 10000 DEPOSIT ABSOLUTE /end AXIS_DESCR
/end CHARACTERISTIC
/begin CHARACTERISTIC mHwConfI_FricTorComp_GDS "Compensation motor torque for friction" CURVE 0x1403F8 rlCurvefl 2 TORQ_REAL -1 1
 /begin AXIS_DESCR STD_AXIS nSigProcI_RotorSpeedInternIsr_gdf32 NO_UNIT 3 -15000 15000 DEPOSIT ABSOLUTE /end AXIS_DESCR
/end CHARACTERISTIC
/begin CHARACTERISTIC mSigProc_AppShortCMref0Kenn_GDS "Rotor speed dependent compensation torque characteristic (M_Ref0 term in TRC equation)" CURVE 0x140414 rlCurvefl 31 TORQ_REAL 0 31
 /begin AXIS_DESCR STD_AXIS nSigProc_RotSpdFiltSc_1_Abs_gdf32 NO_UNIT 6 0 15000 DEPOSIT ABSOLUTE /end AXIS_DESCR
/end CHARACTERISTIC
/begin CHARACTERISTIC mSigProc_AppShortCMrefMax_GDF32 "max. reference torque in short circuit mode" VALUE 0x140064 rlValuefl 31 TORQ_REAL 0 31 /end CHARACTERISTIC
/begin CHARACTERISTIC mSigProc_EpsilonMref_GDF32 "no motor torque range in short circuit mode" VALUE 0x140068 rlValuefl 1 TORQ_REAL 0 1 /end CHARACTERISTIC
/begin CHARACTERISTIC mSigProc_MaxReqMotTorque_GDF32 "limit for requested motor torque" VALUE 0x14006C rlValuefl 20 TORQ_REAL 0 20 /end CHARACTERISTIC
/begin CHARACTERISTIC nBaCuLi_nRedAccIBattLim_GDS "Reduction of rotor speed depending on acceleration" CURVE 0x140448 rlCurvefl 2000 NO_UNIT -1000 1000
 /begin AXIS_DESCR STD_AXIS aBaCuLi_AbsRotAcc4nRed_gdf32 NO_UNIT 3 -500 500 DEPOSIT ABSOLUTE /end AXIS_DESCR
/end CHARACTERISTIC
/begin CHARACTERISTIC nBaCuLi_RpmTh4IdcAccRed_GDF32 "Untere Drehzahlschwelle fuer den Gewichtungsfaktor der beschleunigungsabhaengige Reduktion des Batteriestroms" VALUE 0x140070 rlValuefl 100 NO_UNIT 0 100 /end CHARACTERISTIC
/begin CHARACTERISTIC nBaCuLi_RpmTh4Mot_GDF32 "Untere Drehzahlschwelle fuer den Gewichtungsfaktor zwischen gemessenem Is und aus Torque berechnetem Is" VALUE 0x140074 rlValuefl 99 NO_UNIT 1 100 /end CHARACTERISTIC
/begin CHARACTERISTIC nBaCuLi_RpmTh4nAccRed_GDF32 "Untere Drehzahlschwelle fuer den Gewichtungsfaktor der beschleunigungsabhaengige Reduktion der Drehzahl" VALUE 0x140078 rlValuefl 100 NO_UNIT 0 100 /end CHARACTERISTIC
/begin CHARACTERISTIC nBaCuLi_RpmThGen_GDF32 "rpm threshold for generatoric operation mode" VALUE 0x14007C rlValuefl 199 NO_UNIT 1 200 /end CHARACTERISTIC
/begin CHARACTERISTIC nBaCuLi_RpmThMot_GDF32 "rpm threshold for motoric operation mode" VALUE 0x140080 rlValuefl 99 NO_UNIT 1 100 /end CHARACTERISTIC
/begin CHARACTERISTIC nCaMaTo_RpmWeightLimit_GDF32 "Motor speed limit to weight the rotor speed with the battery voltage in rpm" VALUE 0x140084 rlValuefl 10000 NO_UNIT 0 10000 /end CHARACTERISTIC
/begin CHARACTERISTIC nCaMaTo_RpmWeightRamp_GDF32 "ramp from calculated weight to RpmWeightFactMax within RpmWeightRamp" VALUE 0x140088 rlValuefl 9999 NO_UNIT 1 10000 /end CHARACTERISTIC
/begin CHARACTERISTIC nCoilCalc_RpmAlwCalcTh_GDF32 "Rotorspeed limit for generatoric mode detection" VALUE 0x14008C rlValuefl 100 NO_UNIT 0 100 /end CHARACTERISTIC
/begin CHARACTERISTIC nCoilCalc_RpmMaxCalcTh_GDF32 "Motor speed threshold for calculating the Temperature" VALUE 0x140090 rlValuefl 3000 NO_UNIT 0 3000 /end CHARACTERISTIC
/begin CHARACTERISTIC nCurrCon_n4Isd_GAS16 "Rotation speed as x-axis for the interpolation of the controller parameters in the d-current-controller if v_Fzg higher than vCurrCon_IsxKxVioVehSwitch_GDU16" VAL_BLK 0x1406B8 rlValuesw 10000 NO_UNIT 0 10000 NUMBER 5 /end CHARACTERISTIC
/begin CHARACTERISTIC nCurrCon_n4IsdLow_GAS16 "Rotation speed as x-axis for the interpolation of the controller parameters in the d-current-controller if v_Fzg lower than vCurrCon_IsxKxVioVehSwitch_GDU16" VAL_BLK 0x1406C4 rlValuesw 10000 NO_UNIT 0 10000 NUMBER 5 /end CHARACTERISTIC
/begin CHARACTERISTIC nCurrCon_n4Isq_GAS16 "Rotation speed as x-axis for the interpolation of the controller parameters in the q-current-controller if v_Fzg higher than vCurrCon_IsxKxVioVehSwitch_GDU16" VAL_BLK 0x1406D0 rlValuesw 10000 NO_UNIT 0 10000 NUMBER 5 /end CHARACTERISTIC
/begin CHARACTERISTIC nCurrCon_n4IsqLow_GAS16 "Rotation speed as x-axis for the interpolation of the controller parameters in the q-current-controller if v_Fzg lower than vCurrCon_IsxKxVioVehSwitch_GDU16" VAL_BLK 0x1406DC rlValuesw 10000 NO_UNIT 0 10000 NUMBER 5 /end CHARACTERISTIC
/begin CHARACTERISTIC nHwConfI_MDiffMaxNhighGen_GAF32 "Threshold allowing wider tolerance in generatoric high speed operation mode (0 FOC, 1 FOS) in rpm" VAL_BLK 0x140464 rlValuefl 4500 NO_UNIT 0 4500 NUMBER 3 /end CHARACTERISTIC
/begin CHARACTERISTIC nHwConfI_OcSinRampEnd_GDF32 "Above this reference current is without sinus" VALUE 0x140094 rlValuefl 10000 NO_UNIT 0 10000 /end CHARACTERISTIC
/begin CHARACTERISTIC nHwConfI_OcSinRampStart_GDF32 "Below this reference current are sinusoidal" VALUE 0x140098 rlValuefl 10000 NO_UNIT 0 10000 /end CHARACTERISTIC
/begin CHARACTERISTIC nHwConfI_OcTanModMax_GDF32 "upper bound for tan-modulation" VALUE 0x14009C rlValuefl 1000 NO_UNIT 0 1000 /end CHARACTERISTIC
/begin CHARACTERISTIC nHwConfI_OcTanModMin_GDF32 "lower bound for tan-modulation" VALUE 0x1400A0 rlValuefl 1000 NO_UNIT 0 1000 /end CHARACTERISTIC
/begin CHARACTERISTIC nMcDiag_RpmThresholdUcmp_GDF32 "rotor speed threshold in [RPM] - above threshold current derivatives are set to 0" VALUE 0x1400A4 rlValuefl 5000 NO_UNIT 0 5000 /end CHARACTERISTIC
/begin CHARACTERISTIC nMcState_HsSwitchOff_GDS "Voltage dependent reduction of HsSwitchOff Threshold" CURVE 0x140470 rlCurvefl 12000 NO_UNIT 3000 15000
 /begin AXIS_DESCR STD_AXIS uSvoI_OutputStageVoltageFilt_gdf32 VOLT_REAL 2 0 1000 DEPOSIT ABSOLUTE /end AXIS_DESCR
/end CHARACTERISTIC
/begin CHARACTERISTIC nMcState_HsSwitchOnHys_GDF32 "Hystersis in [rpm] for switch on after high speed switch off" VALUE 0x1400A8 rlValuefl 1500 NO_UNIT 0 1500 /end CHARACTERISTIC
/begin CHARACTERISTIC nRefCurr_AppOpenCRpmHysH_GDF32 "Upper bound Rpm-hysteresis for pulse isq-ref" VALUE 0x1400AC rlValuefl 1000 NO_UNIT 0 1000 /end CHARACTERISTIC
/begin CHARACTERISTIC nSigProc_AppShortCRpmHysHA_GDF32 "Threshold for AssistOpen: rotor speed in short circuit mode greater than threshold results in AssistOpen" VALUE 0x1400B0 rlValuefl 6000 NO_UNIT 0 6000 /end CHARACTERISTIC
/begin CHARACTERISTIC nSigProc_AppShortCRpmHysHB_GDF32 "Threshold for Open: rotor speed in short circuit mode greater than  threshold results in Open" VALUE 0x1400B4 rlValuefl 6000 NO_UNIT 0 6000 /end CHARACTERISTIC
/begin CHARACTERISTIC nSigProc_AppShortCRpmHysHC_GDF32 "Threshold for ASC: rotor speed in short circuit mode greater than  threshold results in ASC" VALUE 0x1400B8 rlValuefl 6000 NO_UNIT 0 6000 /end CHARACTERISTIC
/begin CHARACTERISTIC nSigProc_AppShortCRpmHysLB_GDF32 "Threshold for AssistASC: rotor speed in short circuit mode lower than threshold results in AssistASC" VALUE 0x1400BC rlValuefl 6000 NO_UNIT 0 6000 /end CHARACTERISTIC
/begin CHARACTERISTIC nSigProc_AppShortCRpmHysLC_GDF32 "Threshold for AssistOpen: rotor speed in short circuit mode lower than threshold results in AssistOpen" VALUE 0x1400C0 rlValuefl 6000 NO_UNIT 0 6000 /end CHARACTERISTIC
/begin CHARACTERISTIC nSigProc_AppShortCRpmHysLD_GDF32 "Threshold for Open: rotor speed in short circuit mode lower than threshold results in Open" VALUE 0x1400C4 rlValuefl 6000 NO_UNIT 0 6000 /end CHARACTERISTIC
/begin CHARACTERISTIC nSigProc_EpsilonRpm_GDF32 "stillstand range of rotor speed in short cirucit mode in [RPM]" VALUE 0x1400C8 rlValuefl 100 NO_UNIT 0 100 /end CHARACTERISTIC
/begin CHARACTERISTIC nSigProc_MaxRotorSpeed_GDF32 "limit for unfiltered rotor speed in [RPM]" VALUE 0x1400CC rlValuefl 15000 NO_UNIT 0 15000 /end CHARACTERISTIC
/begin CHARACTERISTIC nSigProc_MaxRotorSpeedFilt_GDF32 "limit for external filtered rotor speed in [RPM]" VALUE 0x1400D0 rlValuefl 15000 NO_UNIT 0 15000 /end CHARACTERISTIC
/begin CHARACTERISTIC nSigProc_RotorSpeedHybFacMaxRpm_GDF32 "Max rpm deviation threshold for hybrid factor calculation" VALUE 0x1400D4 rlValuefl 1000 RPM_REAL 0 1000 /end CHARACTERISTIC
/begin CHARACTERISTIC nSigProc_RotorSpeedHybFacMinRpm_GDF32 "Min rpm deviation threshold for hybrid factor calculation" VALUE 0x1400D8 rlValuefl 1000 RPM_REAL 0 1000 /end CHARACTERISTIC
/begin CHARACTERISTIC pCoilCalc_PLostCalcTh_GDF32 "Loss power limit for Ploss equal 0 detection" VALUE 0x1400DC rlValuefl 130 NO_UNIT 0 130 /end CHARACTERISTIC
/begin CHARACTERISTIC pCoilCalc_PowerCorrSat_GDF32 "Saturation value for calculated power correction" VALUE 0x1400E0 rlValuefl 200 NO_UNIT 0 200 /end CHARACTERISTIC
/begin CHARACTERISTIC pCoilCalc_PStatCalcTh_GDF32 "Power limit for stationary detection" VALUE 0x1400E4 rlValuefl 4.99 NO_UNIT 0.01 5 /end CHARACTERISTIC
/begin CHARACTERISTIC rBaCuLi_RsRef_GDF32 "reference resistor" VALUE 0x1400E8 rlValuefl 0.099 NO_UNIT 0.001 0.1 /end CHARACTERISTIC
/begin CHARACTERISTIC rCoilCalc_GradientLim_GDF32 "Gradient limit for value calculated coil resistor" VALUE 0x1400EC rlValuefl 0.00328 NO_UNIT 2E-05 0.0033 /end CHARACTERISTIC
/begin CHARACTERISTIC rCoilCalc_RcoilSatMax_GDF32 "Saturation value calculated coil resistor" VALUE 0x1400F0 rlValuefl 0.2499 NO_UNIT 0.0001 0.25 /end CHARACTERISTIC
/begin CHARACTERISTIC rCoilCalc_RcoilSatMin_GDF32 "Saturation value calculated coil resistor" VALUE 0x1400F4 rlValuefl 0.0999 NO_UNIT 0.0001 0.1 /end CHARACTERISTIC
/begin CHARACTERISTIC rCoilCalc_RsRef_GDF32 "Nominal value strang resistor" VALUE 0x1400F8 rlValuefl 0.099 NO_UNIT 0.001 0.1 /end CHARACTERISTIC
/begin CHARACTERISTIC rCurrCon_FosRs_GDF32 "Rs for FOS mode" VALUE 0x1400FC rlValuefl 0.099 NO_UNIT 0.001 0.1 /end CHARACTERISTIC
/begin CHARACTERISTIC rCurrCon_PreloadRs_GDF32 "Rs" VALUE 0x140100 rlValuefl 0.499 NO_UNIT 0.001 0.5 /end CHARACTERISTIC
/begin CHARACTERISTIC rCurrCon_Rs_GDF32 "Electric resistance. Constant; adjust via RsFactor" VALUE 0x140104 rlValuefl 0.499 NO_UNIT 0.001 0.5 /end CHARACTERISTIC
/begin CHARACTERISTIC rHwConfI_PstRs_GDF32 "Electric resistance in Ohm" VALUE 0x140108 rlValuefl 0.499 NO_UNIT 0.001 0.5 /end CHARACTERISTIC
/begin CHARACTERISTIC rMcDiag_Rs_GDF32 "Rs for UCMP" VALUE 0x14010C rlValuefl 0.099 NO_UNIT 0.001 0.1 /end CHARACTERISTIC
/begin CHARACTERISTIC rMcDiag_Rs4Rotpos_GDF32 "Rs for ROTPOS" VALUE 0x140110 rlValuefl 0.099 NO_UNIT 0.001 0.1 /end CHARACTERISTIC
/begin CHARACTERISTIC sBaCuLi_AsymFiltTorqueOff_GDU8 "Momenten-Filter on (0) oder off (1)" VALUE 0x1402B4 rlValueub 1 NO_UNIT 0 1 /end CHARACTERISTIC
/begin CHARACTERISTIC sCoilCalc_Enable1ms_GDU8 "Task swicth to select 1ms and 10ms cycle call" VALUE 0x1402B5 rlValueub 1 NO_UNIT 0 1 /end CHARACTERISTIC
/begin CHARACTERISTIC sMcPlausi_MocModeEnable_GDU8 "1:FOR, 2: Boost allowed, 4: SC available, 8: OC available, 16: FOS available" VALUE 0x1402B6 rlValueub 29 NO_UNIT 0 29 /end CHARACTERISTIC
/begin CHARACTERISTIC sSigProc_RpmRangeSelectSc_GDU8 "RPM range selector via bits: ASC always on, 0x1-AssisASC, 0x2-AssisOpen, 0x4-Open" VALUE 0x1402B7 rlValueub 8 NO_UNIT 0 8 /end CHARACTERISTIC
/begin CHARACTERISTIC tBaCuLi_AccTime_GDF32 "Time per calculation period" VALUE 0x140114 rlValuefl 0.005 NO_UNIT 0 0.005 /end CHARACTERISTIC
/begin CHARACTERISTIC tCurrCon_SampleTime_GDF32 "decouple sample time" VALUE 0x140118 rlValuefl 0.0049 NO_UNIT 0.0001 0.005 /end CHARACTERISTIC
/begin CHARACTERISTIC tMcDiag_RotposSampleTime_GDF32 "sample time for ROTPOS" VALUE 0x14011C rlValuefl 0.000999 NO_UNIT 1E-06 0.001 /end CHARACTERISTIC
/begin CHARACTERISTIC tMcDiag_TOffset_GDF32 "time offset for ROTPOS" VALUE 0x140120 rlValuefl 0.000999 NO_UNIT 1E-06 0.001 /end CHARACTERISTIC
/begin CHARACTERISTIC tMcDiag_TOffsetUCmp_GDF32 "time offset for UCMP" VALUE 0x140124 rlValuefl 0.040875 NO_UNIT -0.0204375 0.0204375 /end CHARACTERISTIC
/begin CHARACTERISTIC tReMoTo_CompIWMeasurement_GDS "char to fit temperature to difference between W and I measurement" CURVE 0x140484 rlCurvefl 0.001 NO_UNIT 0 0.001
 /begin AXIS_DESCR STD_AXIS cReMoTo_GroundPlateTemp_gdf32 NO_UNIT 2 -100 500 DEPOSIT ABSOLUTE /end AXIS_DESCR
/end CHARACTERISTIC
/begin CHARACTERISTIC tSigProc_AppShortCRpmFTConst_GDF32 "filter constant for rotor speed in short circuit mode" VALUE 0x140128 rlValuefl 0.99 NO_UNIT 0 0.99 /end CHARACTERISTIC
/begin CHARACTERISTIC tSigProc_CompIWMeasurement_GDS "char to fit temperature to difference between W and I measurement" CURVE 0x140498 rlCurvefl 0.001 NO_UNIT 0 0.001
 /begin AXIS_DESCR STD_AXIS cSigProc_GroundPlateTemp_gdf32 NO_UNIT 2 -70 285 DEPOSIT ABSOLUTE /end AXIS_DESCR
/end CHARACTERISTIC
/begin CHARACTERISTIC tVoltVec_AdjustTime_GDF32 "time compensation between signal-collection and PWM-vector" VALUE 0x14012C rlValuefl 0.002 NO_UNIT -0.001 0.001 /end CHARACTERISTIC
/begin CHARACTERISTIC tVoltVec_FosTOffset_GDF32 "time compensation for FOS/SC/OC operation" VALUE 0x140130 rlValuefl 0.00025 NO_UNIT 0 0.00025 /end CHARACTERISTIC
/begin CHARACTERISTIC tVoltVec_PwmOffsetTime_GDF32 "time offset between two calculated PWM triples" VALUE 0x140134 rlValuefl 0.001 NO_UNIT 0 0.001 /end CHARACTERISTIC
/begin CHARACTERISTIC uCaMaTo_MaxWeightVoltage_GDF32 "Max weight voltage in V" VALUE 0x140138 rlValuefl 63 VOLT_REAL 1 64 /end CHARACTERISTIC
/begin CHARACTERISTIC uCaMaTo_RatedVolt4MaxTorqLimit_GDF32 "Reference voltage for rotor-speed weighting in V" VALUE 0x14013C rlValuefl 22 VOLT_REAL 8 30 /end CHARACTERISTIC
/begin CHARACTERISTIC uHwConfI_VoltTempCorrValue_GDS "reduction of OutstageVolt over Temperature" CURVE 0x1404AC rlCurvefl 2 VOLT_REAL 0 2
 /begin AXIS_DESCR STD_AXIS cTecI_GroundPlateTemp_gdu8 TEMP_INT 3 -70 185 DEPOSIT ABSOLUTE /end AXIS_DESCR
/end CHARACTERISTIC
/begin CHARACTERISTIC uMcDiag_UCmpUmin_GDF32 "min. voltage for UCMP diagnosis" VALUE 0x140140 rlValuefl 100 VOLT_REAL 0 100 /end CHARACTERISTIC
/begin CHARACTERISTIC uSigProc_MaxOutstageVolt_GDF32 "upper limit for output stage voltage" VALUE 0x140144 rlValuefl 38 VOLT_REAL 10 48 /end CHARACTERISTIC
/begin CHARACTERISTIC uSigProc_MinOutstageVolt_GDF32 "lower limit for output stage voltage" VALUE 0x140148 rlValuefl 9 VOLT_REAL 1 10 /end CHARACTERISTIC
/begin CHARACTERISTIC vCurrCon_IsxKxVioVehSwitch_GDU16 "vehicle speed to switch between parking and default/highway parametrization" VALUE 0x1402B0 rlValueuw 100 VELOCITY 0 100 /end CHARACTERISTIC
/begin CHARACTERISTIC wHwConfI_CogCompPhase_GDF32 "" VALUE 0x14014C rlValuefl 4.29497E+09 NO_UNIT 0 4294967295 /end CHARACTERISTIC
/begin CHARACTERISTIC wHwConfI_OcThetaDiffMaxCurr_GDF32 "Angel difference to phase cut off to start reducing allowed current" VALUE 0x140150 rlValuefl 0.53 ANG_RAD_REAL 0 0.53 /end CHARACTERISTIC
/begin CHARACTERISTIC wHwConfI_OcThetaDiffMinCurr_GDF32 "Angel difference to phase cut off to set allowed current to zero" VALUE 0x140154 rlValuefl 0.25 ANG_RAD_REAL 0 0.25 /end CHARACTERISTIC
/begin CHARACTERISTIC wRefCurr_AppOpenCdTheta_GDF32 "To avoid wrong angle computation in case of tan = infinite" VALUE 0x140158 rlValuefl 0.53 ANG_RAD_REAL 0 0.53 /end CHARACTERISTIC
/begin CHARACTERISTIC xBaCuLi_IsdFltFac_GDF32 "Filter factor for abs Isd, 0 means Isd is not considered" VALUE 0x14015C rlValuefl 1 NO_UNIT 0 1 /end CHARACTERISTIC
/begin CHARACTERISTIC xBaCuLi_PLossFactorDeltaIBattLim_GDF32 "Korrekturfaktor auf Verlustleistung bei IBatt-Grad-Begrenzung" VALUE 0x140160 rlValuefl 29.9 NO_UNIT 0.1 30 /end CHARACTERISTIC
/begin CHARACTERISTIC xBaCuLi_PLossFactorIBattLimGen_GDF32 "Korrekturfaktor auf verlustleistung, generatorische" VALUE 0x140164 rlValuefl 60 NO_UNIT -30 30 /end CHARACTERISTIC
/begin CHARACTERISTIC xBaCuLi_PLossFactorIBattLimMot_GDF32 "Korrekturfaktor auf verlustleistung, motorisch" VALUE 0x140168 rlValuefl 29.9 NO_UNIT 0.1 30 /end CHARACTERISTIC
/begin CHARACTERISTIC xBaCuLi_RsTempCoeff_GDF32 "temperature coeff for resistor calculation" VALUE 0x14016C rlValuefl 0.004 NO_UNIT 0.001 0.005 /end CHARACTERISTIC
/begin CHARACTERISTIC xBoTo_IntegralStepDown_GDF32 "Step size for count down" VALUE 0x140170 rlValuefl 14.9 NO_UNIT 0.1 15 /end CHARACTERISTIC
/begin CHARACTERISTIC xBoTo_IntegralStepUp_GDF32 "Step size for count up" VALUE 0x140174 rlValuefl 14.9 NO_UNIT 0.1 15 /end CHARACTERISTIC
/begin CHARACTERISTIC xCoilCalc_Filt4EstPsiTemp_GDF32 "Factor for Rotor temperature filter" VALUE 0x140178 rlValuefl 1 NO_UNIT 0 1 /end CHARACTERISTIC
/begin CHARACTERISTIC xCoilCalc_MdepDeltaTemp_GDF32 "Factor representing temperature depending motor torque" VALUE 0x14017C rlValuefl 0.1 NO_UNIT -0.1 0 /end CHARACTERISTIC
/begin CHARACTERISTIC xCoilCalc_nFactor_GDS "Factor for low rotorspeed" CURVE 0x140778 rlCurvefl 1.9 NO_UNIT 0.1 2
 /begin AXIS_DESCR STD_AXIS nCoilCalc_RotSpdIntFiltAbs_gdf32 NO_UNIT 15 0 13000 DEPOSIT ABSOLUTE /end AXIS_DESCR
/end CHARACTERISTIC
/begin CHARACTERISTIC xCoilCalc_RsTempCoeffInv_GDF32 "Inverser temperature coefficient for strand resistor, calculation disabled bei 0" VALUE 0x140180 rlValuefl 100000 NO_UNIT 0 100000 /end CHARACTERISTIC
/begin CHARACTERISTIC xCoilCalc_SampleTimeFac_GDU8 "Filter factor to adjust filter constant between 10ms and 1ms" VALUE 0x1402B8 rlValueub 9 NO_UNIT 1 10 /end CHARACTERISTIC
/begin CHARACTERISTIC xCurrCon_AppFosLsdCoupleFak_GDF32 "coupled-inductance adjustment factor (Lsd in the term  Lsd*w*isd) (FOS)" VALUE 0x140184 rlValuefl 2 NO_UNIT 0 2 /end CHARACTERISTIC
/begin CHARACTERISTIC xCurrCon_AppFosLsdSelfFak_GDF32 "self-inductance adjustment factor (FOS)" VALUE 0x140188 rlValuefl 2 NO_UNIT 0 2 /end CHARACTERISTIC
/begin CHARACTERISTIC xCurrCon_AppFosLsqCoupleFak_GDF32 "coupled-inductance adjustment factor (Lsq in the term  Lsq*w*isq) (FOS)" VALUE 0x14018C rlValuefl 2 NO_UNIT 0 2 /end CHARACTERISTIC
/begin CHARACTERISTIC xCurrCon_AppFosLsqSelfFak_GDF32 "self-inductance adjustment factor (FOS)" VALUE 0x140190 rlValuefl 2 NO_UNIT 0 2 /end CHARACTERISTIC
/begin CHARACTERISTIC xCurrCon_AppFosPsiFak_GDF32 "PsiP adjustment factor (FOS)" VALUE 0x140194 rlValuefl 2 NO_UNIT 0 2 /end CHARACTERISTIC
/begin CHARACTERISTIC xCurrCon_AppFosRsFak_GDF32 "Rs adjustment factor (FOS)" VALUE 0x140198 rlValuefl 9.95 NO_UNIT 0.05 10 /end CHARACTERISTIC
/begin CHARACTERISTIC xCurrCon_IqIntegLimitLowSpd_GDF32 "lower bounardy for q-integrator at low speed" VALUE 0x14019C rlValuefl 2000 NO_UNIT 0 2000 /end CHARACTERISTIC
/begin CHARACTERISTIC xCurrCon_IsdKi_GAS16 "I-part d-current-controller if v_Fzg higher than vCurrCon_IsxKxVioVehSwitch_GDU16" VAL_BLK 0x1406E8 rlValuesw 20000 NO_UNIT 0 20000 NUMBER 5 /end CHARACTERISTIC
/begin CHARACTERISTIC xCurrCon_IsdKiLow_GAS16 "I-part d-current-controller if v_Fzg lower than vCurrCon_IsxKxVioVehSwitch_GDU16" VAL_BLK 0x1406F4 rlValuesw 20000 NO_UNIT 0 20000 NUMBER 5 /end CHARACTERISTIC
/begin CHARACTERISTIC xCurrCon_IsdKp_GAS16 "P-part d-current-controller if v_Fzg higher than vCurrCon_IsxKxVioVehSwitch_GDU16" VAL_BLK 0x140700 rlValuesw 20000 NO_UNIT 0 20000 NUMBER 5 /end CHARACTERISTIC
/begin CHARACTERISTIC xCurrCon_IsdKpLow_GAS16 "P-part d-current-controller if v_Fzg lower than vCurrCon_IsxKxVioVehSwitch_GDU16" VAL_BLK 0x14070C rlValuesw 20000 NO_UNIT 0 20000 NUMBER 5 /end CHARACTERISTIC
/begin CHARACTERISTIC xCurrCon_IsdKv_GAS16 "pre-control d-current-controller if v_Fzg higher than vCurrCon_IsxKxVioVehSwitch_GDU16" VAL_BLK 0x140718 rlValuesw 20000 NO_UNIT 0 20000 NUMBER 5 /end CHARACTERISTIC
/begin CHARACTERISTIC xCurrCon_IsdKvLow_GAS16 "pre-control d-current-controller if v_Fzg lower than vCurrCon_IsxKxVioVehSwitch_GDU16" VAL_BLK 0x140724 rlValuesw 20000 NO_UNIT 0 20000 NUMBER 5 /end CHARACTERISTIC
/begin CHARACTERISTIC xCurrCon_IsqKi_GAS16 "I-part q-current-controller if v_Fzg higher than vCurrCon_IsxKxVioVehSwitch_GDU16" VAL_BLK 0x140730 rlValuesw 20000 NO_UNIT 0 20000 NUMBER 5 /end CHARACTERISTIC
/begin CHARACTERISTIC xCurrCon_IsqKiLow_GAS16 "I-part q-current-controller if v_Fzg lower than vCurrCon_IsxKxVioVehSwitch_GDU16" VAL_BLK 0x14073C rlValuesw 20000 NO_UNIT 0 20000 NUMBER 5 /end CHARACTERISTIC
/begin CHARACTERISTIC xCurrCon_IsqKp_GAS16 "P-part q-current-controller if v_Fzg higher than vCurrCon_IsxKxVioVehSwitch_GDU16" VAL_BLK 0x140748 rlValuesw 20000 NO_UNIT 0 20000 NUMBER 5 /end CHARACTERISTIC
/begin CHARACTERISTIC xCurrCon_IsqKpLow_GAS16 "P-part q-current-controller if v_Fzg lower than vCurrCon_IsxKxVioVehSwitch_GDU16" VAL_BLK 0x140754 rlValuesw 20000 NO_UNIT 0 20000 NUMBER 5 /end CHARACTERISTIC
/begin CHARACTERISTIC xCurrCon_IsqKv_GAS16 "pre-control q-current-controller if v_Fzg higher than vCurrCon_IsxKxVioVehSwitch_GDU16" VAL_BLK 0x140760 rlValuesw 20000 NO_UNIT 0 20000 NUMBER 5 /end CHARACTERISTIC
/begin CHARACTERISTIC xCurrCon_IsqKvLow_GAS16 "pre-control q-current-controller if v_Fzg lower than vCurrCon_IsxKxVioVehSwitch_GDU16" VAL_BLK 0x14076C rlValuesw 20000 NO_UNIT 0 20000 NUMBER 5 /end CHARACTERISTIC
/begin CHARACTERISTIC xCurrCon_LimIntQIspare_GDF32 "q-integrator limitation reserve" VALUE 0x1401A0 rlValuefl 1000 NO_UNIT -500 500 /end CHARACTERISTIC
/begin CHARACTERISTIC xHwConfI_CogCompLimMotTorqFader_GDS "Fades out the cogging torque compensation dependent on torque" CURVE 0x1404C8 rlCurvefl 1 NO_UNIT 0 1
 /begin AXIS_DESCR STD_AXIS mMotOrComp_CoggStoreAbsMotorTrq_gdf32 NO_UNIT 3 0 12 DEPOSIT ABSOLUTE /end AXIS_DESCR
/end CHARACTERISTIC
/begin CHARACTERISTIC xHwConfI_CogCompRotSpeedFader_GDS "Fades out the cogging torque compensation dependent on rpm" CURVE 0x1404E4 rlCurvefl 1 NO_UNIT 0 1
 /begin AXIS_DESCR STD_AXIS nMotOrComp_CoggCompAbsRotSpeed_gdf32 RPM_REAL 3 0 10000 DEPOSIT ABSOLUTE /end AXIS_DESCR
/end CHARACTERISTIC
/begin CHARACTERISTIC xHwConfI_MaxCFactor_GDF32 "upper limit for motor torque calibration value" VALUE 0x1401A4 rlValuefl 0.2 NO_UNIT 1 1.2 /end CHARACTERISTIC
/begin CHARACTERISTIC xHwConfI_MinCFactor_GDF32 "lower limit for motor torque calibration value" VALUE 0x1401A8 rlValuefl 0.19 NO_UNIT 0.8 0.99 /end CHARACTERISTIC
/begin CHARACTERISTIC xHwConfI_NoAssistAtHighRpmFactor_GDS "Factor to disable or enable assistance torque at high rpm" CURVE 0x140500 rlCurvefl 1 NO_UNIT 0 1
 /begin AXIS_DESCR STD_AXIS nCaMaTo_AbsRotorSpeedWeight_gdf32 NO_UNIT 2 0 10000 DEPOSIT ABSOLUTE /end AXIS_DESCR
/end CHARACTERISTIC
/begin CHARACTERISTIC xHwConfI_OcFac4Fw_GDF32 "Factor to weight Isd againts Isq" VALUE 0x1401AC rlValuefl 3 NO_UNIT 0 3 /end CHARACTERISTIC
/begin CHARACTERISTIC xHwConfI_OcTanFac_GDF32 "Factor to hold torque between Tan- and Sin-Modulation Constant" VALUE 0x1401B0 rlValuefl 1 NO_UNIT 0.33 1.33 /end CHARACTERISTIC
/begin CHARACTERISTIC xHwConfI_PstPLossFactorIbatt_GAF32 "PLoss factor for battery current calculation" VAL_BLK 0x140000 rlValuefl 1.5 NO_UNIT 0.5 2 NUMBER 2 /end CHARACTERISTIC
/begin CHARACTERISTIC xRefCurr_IdDepIq_GDF32 "percantual value of IsqRef for calculation of IsdRef" VALUE 0x1401B4 rlValuefl 0.99 NO_UNIT 0 0.99 /end CHARACTERISTIC
/begin CHARACTERISTIC xRefCurr_InvPsi4IsdRef_GDS "Psip characteristic depending on IsqRef for Mref part. Value in 1/Vs" CURVE 0x140514 rlCurvefl 400 NO_UNIT 0 400
 /begin AXIS_DESCR STD_AXIS iMocI_IsqRef_gdf32 CURR_REAL 5 -500 500 DEPOSIT ABSOLUTE /end AXIS_DESCR
/end CHARACTERISTIC
/begin CHARACTERISTIC xRefCurr_InvPsi4MRef_GDS "Psip characteristic depending on IsqRef for Mref part. Value in 1/Vs" CURVE 0x140540 rlCurvefl 511 NO_UNIT 0 511
 /begin AXIS_DESCR STD_AXIS iMocI_IsqRef_gdf32 CURR_REAL 5 -500 500 DEPOSIT ABSOLUTE /end AXIS_DESCR
/end CHARACTERISTIC
/begin CHARACTERISTIC xRefCurr_UcyGen_GDS "Factor Ucy for IsdRef calculation in generator mode" CURVE 0x14056C rlCurvefl 2 NO_UNIT 0 2
 /begin AXIS_DESCR STD_AXIS nRefCurr_RotorSpeedIntern_gdf32 NO_UNIT 4 -1047 10000 DEPOSIT ABSOLUTE /end AXIS_DESCR
/end CHARACTERISTIC
/begin CHARACTERISTIC xRefCurr_UcyMot_GDS "Factor Ucy for IsdRef calculation in motor mode" CURVE 0x140590 rlCurvefl 2 NO_UNIT 0 2
 /begin AXIS_DESCR STD_AXIS nRefCurr_RotorSpeedIntern_gdf32 NO_UNIT 4 -1047 10000 DEPOSIT ABSOLUTE /end AXIS_DESCR
/end CHARACTERISTIC
/begin CHARACTERISTIC xSigProc_AppShortCMrefDownKFac_GDS "Factor to requested motor torque for soft transition between RPM ranges (X_M,Down term in TRC equation)" CURVE 0x1405B4 rlCurvefl 16 NO_UNIT -8 8
 /begin AXIS_DESCR STD_AXIS nSigProc_RotSpdFiltSc_1_Abs_gdf32 NO_UNIT 2 0 15000 DEPOSIT ABSOLUTE /end AXIS_DESCR
/end CHARACTERISTIC
/begin CHARACTERISTIC xSigProc_RotorSpeedHybFacMax_GDF32 "Max hybrid factor" VALUE 0x1401B8 rlValuefl 2 NO_UNIT 0 2 /end CHARACTERISTIC
/begin CHARACTERISTIC xSigProc_RotorSpeedHybFacMaxDiff_GDF32 "Max hybrid filter factor deviation" VALUE 0x1401BC rlValuefl 1 NO_UNIT 0 1 /end CHARACTERISTIC
/begin CHARACTERISTIC xSigProc_RotSpeedFltFac_GDF32 "PT1 filter factor for Rotorspeed" VALUE 0x1401C0 rlValuefl 1 NO_UNIT 0 1 /end CHARACTERISTIC
/begin CHARACTERISTIC xVoltVec_CircleLimit_GDF32 "limitation of voltage vector to avoid angle error" VALUE 0x1401C4 rlValuefl 1 NO_UNIT 0 1 /end CHARACTERISTIC
/begin CHARACTERISTIC xVoltVec_OrCompMaxAmp_GDF32 "limit amplitude for angle modulation" VALUE 0x1401C8 rlValuefl 0.4 NO_UNIT 0 0.4 /end CHARACTERISTIC
/begin CHARACTERISTIC yBaCuLi_PT1Isref2CT0T1_GDF32 "Filterkonstante des PT1-Filters der Sollspannung" VALUE 0x1401CC rlValuefl 10 NO_UNIT 0 10 /end CHARACTERISTIC
/begin CHARACTERISTIC yBaCuLi_PT1OmegaMechCT0T1_GDF32 "Filter constant of the mechanical speed PT1 filter" VALUE 0x1401D0 rlValuefl 10 NO_UNIT 0 10 /end CHARACTERISTIC
/begin CHARACTERISTIC yBaCuLi_PT1TorqueCT0T1_GDF32 "Filter constant of the PT1 filter of the moment (at the output)" VALUE 0x1401D4 rlValuefl 10 NO_UNIT 0 10 /end CHARACTERISTIC
/begin CHARACTERISTIC yBaCuLi_Torque2Current_GDF32 "Faktor um aus LocalLimitedMotortorque einen Phasenstrom zu berechnen" VALUE 0x1401D8 rlValuefl 99.999 NO_UNIT 0.001 100 /end CHARACTERISTIC
/begin CHARACTERISTIC yBoTo_MaxBoostIntegral_GDF32 "Maximum value for the boost integral" VALUE 0x1401DC rlValuefl 100 NO_UNIT 0 100 /end CHARACTERISTIC
/begin CHARACTERISTIC yCoilCalc_EfctArray_GDS "Voltage correction" CURVE 0x1407F4 rlCurvefl 31.8 NO_UNIT -15.9 15.9
 /begin AXIS_DESCR STD_AXIS iCoilCalc_IBattCorrected_gdf32 NO_UNIT 25 0 200 DEPOSIT ABSOLUTE /end AXIS_DESCR
/end CHARACTERISTIC
/begin CHARACTERISTIC yCoilCalc_EstRotPolynom_GAF32 "polynomial factor for temperature estimation" VAL_BLK 0x140008 rlValuefl 50 NO_UNIT 0 50 NUMBER 2 /end CHARACTERISTIC
/begin CHARACTERISTIC yCoilCalc_FiltFacRcoil_GDF32 "Factor for filter coil resistor" VALUE 0x1401E0 rlValuefl 1 NO_UNIT 0 1 /end CHARACTERISTIC
/begin CHARACTERISTIC yCoilCalc_FiltFacRotSpd_GDF32 "Factor for internal rotorspeed filter" VALUE 0x1401E4 rlValuefl 1 NO_UNIT 0 1 /end CHARACTERISTIC
/begin CHARACTERISTIC yCoilCalc_IdepN_GDF32 "Factor on rotorspeed for battery current correction" VALUE 0x1401E8 rlValuefl 0.2 NO_UNIT -0.1 0.1 /end CHARACTERISTIC
/begin CHARACTERISTIC yCoilCalc_MotorTempFiltConst_GDF32 "Factor for filter coil temperature" VALUE 0x1401EC rlValuefl 0.00195 NO_UNIT 0 0.00195 /end CHARACTERISTIC
/begin CHARACTERISTIC yCoilCalc_PLossCorr_GAF32 "Factor on rotorspeed for loss power calculation" VAL_BLK 0x140010 rlValuefl 0.2 NO_UNIT -0.1 0.1 NUMBER 2 /end CHARACTERISTIC
/begin CHARACTERISTIC yCurrCon_1DivTsdDivTsq_GDF32 "1/(Tsd*Tsq)" VALUE 0x1401F0 rlValuefl 500000 NO_UNIT 0 500000 /end CHARACTERISTIC
/begin CHARACTERISTIC yCurrCon_AbsMaxVal_GDF32 "Controller limitation" VALUE 0x1401F4 rlValuefl 5E+06 NO_UNIT 0 5000000 /end CHARACTERISTIC
/begin CHARACTERISTIC yCurrCon_FosLqDivT_GDF32 "FOS Lq div by delay." VALUE 0x1401F8 rlValuefl 0.5 NO_UNIT 0 0.5 /end CHARACTERISTIC
/begin CHARACTERISTIC yCurrCon_IntegLimit_GDF32 "limit for integrator" VALUE 0x1401FC rlValuefl 3.35544E+07 NO_UNIT 0 33554432 /end CHARACTERISTIC
/begin CHARACTERISTIC yCurrCon_IntegMax_GDF32 "Maximum for integrator" VALUE 0x140200 rlValuefl 5E+06 NO_UNIT 0 5000000 /end CHARACTERISTIC
/begin CHARACTERISTIC yCurrCon_Ld_GDF32 "Ld for FOS mode" VALUE 0x140204 rlValuefl 200 INDUCTANCE_REAL 0 200 /end CHARACTERISTIC
/begin CHARACTERISTIC yCurrCon_LdDivT_GDF32 "self-inductance (div by delay) for FOS mode" VALUE 0x140208 rlValuefl 0.2 NO_UNIT 0 0.2 /end CHARACTERISTIC
/begin CHARACTERISTIC yCurrCon_Lq_GDF32 "Lq for FOS mode" VALUE 0x14020C rlValuefl 200 INDUCTANCE_REAL 0 200 /end CHARACTERISTIC
/begin CHARACTERISTIC yCurrCon_LsdLsq_GDF32 "Lsd * Lsq" VALUE 0x140210 rlValuefl 2.5E-06 NO_UNIT 1E-12 2.5E-06 /end CHARACTERISTIC
/begin CHARACTERISTIC yCurrCon_Lsq_GDF32 "application value for Lsq in preload integ for mode switch" VALUE 0x140214 rlValuefl 0.000499 NO_UNIT 1E-06 0.0005 /end CHARACTERISTIC
/begin CHARACTERISTIC yCurrCon_PsiDivRs_GDF32 "Psi / Rs" VALUE 0x140218 rlValuefl 249.99 NO_UNIT 0.01 250 /end CHARACTERISTIC
/begin CHARACTERISTIC yCurrCon_Rs2_GDF32 "Rs^2" VALUE 0x14021C rlValuefl 0.012499 NO_UNIT 1E-06 0.0125 /end CHARACTERISTIC
/begin CHARACTERISTIC yCurrCon_T1TpT1_GDF32 "application value for inverse time constant FOS decouple" VALUE 0x140220 rlValuefl 1 NO_UNIT 0 1 /end CHARACTERISTIC
/begin CHARACTERISTIC yCurrCon_TsdDivRsSqt3_GDF32 "1000/(Rs*sqrt(3))" VALUE 0x140224 rlValuefl 0.2 NO_UNIT 0 0.2 /end CHARACTERISTIC
/begin CHARACTERISTIC yCurrCon_TTd_GDF32 "d-axis time delay in decouling" VALUE 0x140228 rlValuefl 99.9999 NO_UNIT 5E-05 100 /end CHARACTERISTIC
/begin CHARACTERISTIC yCurrCon_TTq_GDF32 "q-axis time delay in decouling" VALUE 0x14022C rlValuefl 99.9999 NO_UNIT 5E-05 100 /end CHARACTERISTIC
/begin CHARACTERISTIC yCurrCon_WsZeroGuard_GDF32 "Zero Guard to determine rotating direction." VALUE 0x140230 rlValuefl 499.9 NO_UNIT 0.1 500 /end CHARACTERISTIC
/begin CHARACTERISTIC yFuncLib_MinXY_GDF32 "invalid area for ATAN2 and CART2POL calculation" VALUE 0x140234 rlValuefl 0.01 NO_UNIT 0 0.01 /end CHARACTERISTIC
/begin CHARACTERISTIC yFuncLib_PwmMax_GDF32 "value for max. PWM" VALUE 0x140238 rlValuefl 1 NO_UNIT 0 1 /end CHARACTERISTIC
/begin CHARACTERISTIC yFuncLib_PwmMaxPMinD2_GDF32 "value for neutral PWM" VALUE 0x14023C rlValuefl 1 NO_UNIT 0 1 /end CHARACTERISTIC
/begin CHARACTERISTIC yFuncLib_PwmMin_GDF32 "value for min. PWM" VALUE 0x140240 rlValuefl 1 NO_UNIT 0 1 /end CHARACTERISTIC
/begin CHARACTERISTIC yHwConfI_CogCompAmp_GDF32 "amplitude of the compensation torque" VALUE 0x140244 rlValuefl 10 NO_UNIT 0 10 /end CHARACTERISTIC
/begin CHARACTERISTIC yHwConfI_CogCompOrder_GDF32 "Order which the cogging compensation shall compensate " VALUE 0x140248 rlValuefl 48 NO_UNIT 0 48 /end CHARACTERISTIC
/begin CHARACTERISTIC yHwConfI_CurrConFor4OCISpare_GDF32 "Additional I spare in OC-Mode" VALUE 0x14024C rlValuefl 800 NO_UNIT 0 800 /end CHARACTERISTIC
/begin CHARACTERISTIC yHwConfI_FocWorkInitState_GDU32 "variable for checking FOC ROM section initilization" VALUE 0x140250 rlValueul 4.29497E+09 NO_UNIT 0 4294967295 /end CHARACTERISTIC
/begin CHARACTERISTIC yHwConfI_Zp_GDF32 "number of polpairs" VALUE 0x140254 rlValuefl 9 NO_UNIT 1 10 /end CHARACTERISTIC
/begin CHARACTERISTIC yMcDiag_1DivTPhys_GDF32 "value: 1/Tphys" VALUE 0x140258 rlValuefl 5000 NO_UNIT 0 5000 /end CHARACTERISTIC
/begin CHARACTERISTIC yMcDiag_LsComp_GDF32 "compensation factor Ls for ROTPOS" VALUE 0x14025C rlValuefl 1.99 NO_UNIT 0 1.99 /end CHARACTERISTIC
/begin CHARACTERISTIC yMcDiag_Lsd_GDF32 "Lsd for ROTPOS" VALUE 0x140260 rlValuefl 200 INDUCTANCE_REAL 0 200 /end CHARACTERISTIC
/begin CHARACTERISTIC yMcDiag_Lsq_GDF32 "Lsq for ROTOPOS" VALUE 0x140264 rlValuefl 200 INDUCTANCE_REAL 0 200 /end CHARACTERISTIC
/begin CHARACTERISTIC yMcDiag_MeanLsdLsq_GDF32 "substitute value Lsx for ROTPOS, scaled by call cycle" VALUE 0x140268 rlValuefl 400000 INDUCTANCE_REAL 0 400000 /end CHARACTERISTIC
/begin CHARACTERISTIC yMcState_MocRevNr_GDU16 "revision number MOC - generated by script" VALUE 0x1402B2 rlValueuw 65535 NO_UNIT 0 65535 /end CHARACTERISTIC
/begin CHARACTERISTIC yPwmGen_NumPwmCalc_GDU8 "number of calculated PWM triples" VALUE 0x1402B9 rlValueub 7 NO_UNIT 1 8 /end CHARACTERISTIC
/begin CHARACTERISTIC yPwmGen_NumPwmRepetitions_GDU8 "number of repeated PWM triples" VALUE 0x1402BA rlValueub 7 NO_UNIT 1 8 /end CHARACTERISTIC
/begin CHARACTERISTIC yPwmGen_PwmScMax_GDF32 "value for max. PWM in short circuit case" VALUE 0x14026C rlValuefl 1 NO_UNIT 0 1 /end CHARACTERISTIC
/begin CHARACTERISTIC yPwmGen_PwmScMin_GDF32 "value for min. PWM in short circuit case" VALUE 0x140270 rlValuefl 1 NO_UNIT 0 1 /end CHARACTERISTIC
/begin CHARACTERISTIC yPwmGen_PwmSet4Diag_GDU8 "index of PWM triple for diag" VALUE 0x1402BB rlValueub 7 NO_UNIT 1 8 /end CHARACTERISTIC
/begin CHARACTERISTIC yPwmGen_ResetVector_GAF32 "PWM Vector for Reset. each value corresponds to one pwm set" VAL_BLK 0x1402C4 rlValuefl 1 NO_UNIT 0 1 NUMBER 8 /end CHARACTERISTIC
/begin CHARACTERISTIC yRefCurr_2Div3DivZp_GDF32 "(2/3)/Zp (Zp: Number of pole pairs)" VALUE 0x140274 rlValuefl 0.7 NO_UNIT 0 0.7 /end CHARACTERISTIC
/begin CHARACTERISTIC yRefCurr_2RsPsip_GDF32 "The product of 2 and Rs and Psip for IdRef calculation" VALUE 0x140278 rlValuefl 0.004 NO_UNIT 0 0.004 /end CHARACTERISTIC
/begin CHARACTERISTIC yRefCurr_FiltIsdSampleNumbers_GDU8 "nr of elements for average filtering of d-axis current" VALUE 0x1402BC rlValueub 31 NO_UNIT 0 31 /end CHARACTERISTIC
/begin CHARACTERISTIC yRefCurr_FiltIsqSampleNumbers_GDU8 "nr of elements for average filtering of q-axis current" VALUE 0x1402BD rlValueub 31 NO_UNIT 0 31 /end CHARACTERISTIC
/begin CHARACTERISTIC yRefCurr_ILsd_GDS "direct inductivity depending on direct current" CURVE 0x1405C8 rlCurvefl 1000 INDUCTANCE_REAL 0 1000
 /begin AXIS_DESCR STD_AXIS iMocI_IsdRef_gdf32 CURR_REAL 7 -500 500 DEPOSIT ABSOLUTE /end AXIS_DESCR
/end CHARACTERISTIC
/begin CHARACTERISTIC yRefCurr_ILsq_GDS "quadrature inductivity depending on quadrature current" CURVE 0x140604 rlCurvefl 1000 INDUCTANCE_REAL 0 1000
 /begin AXIS_DESCR STD_AXIS iMocI_IsqRef_gdf32 CURR_REAL 7 -500 500 DEPOSIT ABSOLUTE /end AXIS_DESCR
/end CHARACTERISTIC
/begin CHARACTERISTIC yRefCurr_Lsd2_GDF32 "squared Lsd for IdRef calculation" VALUE 0x14027C rlValuefl 9.99999E-07 NO_UNIT 1E-12 1E-06 /end CHARACTERISTIC
/begin CHARACTERISTIC yRefCurr_LsdPsip_GDF32 "The product of Lsd and Psip for IdRef calculation" VALUE 0x140280 rlValuefl 2E-06 NO_UNIT 0 2E-06 /end CHARACTERISTIC
/begin CHARACTERISTIC yRefCurr_Lsq2_GDF32 "Lsq raised to the power of 2 for IdRef calculation" VALUE 0x140284 rlValuefl 1E-06 NO_UNIT 0 1E-06 /end CHARACTERISTIC
/begin CHARACTERISTIC yRefCurr_Psip2_GDF32 "squared Psip for IdRef calculation" VALUE 0x140288 rlValuefl 0.0004 NO_UNIT 0 0.0004 /end CHARACTERISTIC
/begin CHARACTERISTIC yRefCurr_Rs2_GDF32 "squared Rs for IdRef calculation" VALUE 0x14028C rlValuefl 0.004999 NO_UNIT 1E-06 0.005 /end CHARACTERISTIC
/begin CHARACTERISTIC yRefCurr_RsMulLsdSubLsq_GDF32 "The product of Rs and ( Lsd - Lsq) for IdRef calculation" VALUE 0x140290 rlValuefl 0.002 NO_UNIT -0.001 0.001 /end CHARACTERISTIC
/begin CHARACTERISTIC yRefCurr_StepSizeGen2Mot_GDF32 "stepsize UcyFactor fading (generatoric > motoric)" VALUE 0x140294 rlValuefl 0.2 NO_UNIT 0 0.2 /end CHARACTERISTIC
/begin CHARACTERISTIC yRefCurr_StepSizeMot2Gen_GDF32 "stepsize UcyFactor fading (motoric > generatoric)" VALUE 0x140298 rlValuefl 0.2 NO_UNIT 0 0.2 /end CHARACTERISTIC
/begin CHARACTERISTIC yReMoTo_Ld_GDS "Inductivity in d axis depending on the d-current" CURVE 0x140640 rlCurvefl 1000 INDUCTANCE_REAL 0 1000
 /begin AXIS_DESCR STD_AXIS iReMoTo_Id_gdf32 CURR_REAL 7 -500 500 DEPOSIT ABSOLUTE /end AXIS_DESCR
/end CHARACTERISTIC
/begin CHARACTERISTIC yReMoTo_Lq_GDS "Inductivity in q axis depending on the q-current" CURVE 0x14067C rlCurvefl 1000 INDUCTANCE_REAL 0 1000
 /begin AXIS_DESCR STD_AXIS iReMoTo_Iq_gdf32 CURR_REAL 7 -500 500 DEPOSIT ABSOLUTE /end AXIS_DESCR
/end CHARACTERISTIC
/begin CHARACTERISTIC yReMoTo_Zp_GDU8 "number of pole pairs" VALUE 0x1402BE rlValueub 19 NO_UNIT 1 20 /end CHARACTERISTIC
/begin CHARACTERISTIC ySigProc_FiltUbattShiftVal_GDU8 "shift value for average filter output stage voltage" VALUE 0x1402BF rlValueub 5 NO_UNIT 0 5 /end CHARACTERISTIC
/begin CHARACTERISTIC ySigProc_MrefMulFak_GDF32 "Weighting factor in short circuit mode (X_M,Ref term in TRC equation)" VALUE 0x14029C rlValuefl 10 NO_UNIT 0 10 /end CHARACTERISTIC
/begin CHARACTERISTIC ySigProc_RsTempCoeff_GDF32 "temperature coefficient for strand resistor factor" VALUE 0x1402A0 rlValuefl 0.2 NO_UNIT 0 0.2 /end CHARACTERISTIC
/begin CHARACTERISTIC ySigProc_Zp_GDF32 "number of polpairs" VALUE 0x1402A4 rlValuefl 9 NO_UNIT 1 10 /end CHARACTERISTIC
/begin CHARACTERISTIC yVoltVec_NumPwmCalc_GDU8 "number of calculated PWM triples" VALUE 0x1402C0 rlValueub 7 NO_UNIT 1 8 /end CHARACTERISTIC
/begin CHARACTERISTIC zMcDiag_ActivationDelayAfterOff_GDU32 "Number of interupts between activation of MOC calc and McDiag" VALUE 0x1402A8 rlValueul 100 NO_UNIT 0 100 /end CHARACTERISTIC
/begin CHARACTERISTIC zMcPlausi_ActivationDelayAfterOff_GDU32 "Number of interupts between activation of MOC calc and McPlausi" VALUE 0x1402AC rlValueul 100 NO_UNIT 0 100 /end CHARACTERISTIC
/begin CHARACTERISTIC cHwConfI_OcV3CoilTempSubst_GDU16 "substitute value for motor coil temperature" VALUE 0x1409F0 rlValueuw 255 TEMP_INT -70 185 /end CHARACTERISTIC
/begin CHARACTERISTIC cHwConfI_OcV3EcuRefT0_GDU16 "Reference temperature for ECU resistance" VALUE 0x1409F2 rlValueuw 255 TEMP_INT -70 185 /end CHARACTERISTIC
/begin CHARACTERISTIC cHwConfI_OcV3MotCoilRefT0_GDU16 "Reference temperature for MOTOR resistance" VALUE 0x1409F4 rlValueuw 255 TEMP_INT -70 185 /end CHARACTERISTIC
/begin CHARACTERISTIC mMotOrComp_ActMaxMotorTorque_GDS "Maximal motor torque per part machine, dependent on absolute rotor speed only" CURVE 0x140A20 rlCurvesw 20 TORQ_INT -10 10
 /begin AXIS_DESCR STD_AXIS nMotOrComp_AbsRotorSpeedFilt_gds16 NO_UNIT 5 0 13000 DEPOSIT ABSOLUTE /end AXIS_DESCR
/end CHARACTERISTIC
/begin CHARACTERISTIC nHwConfI_OcV3VelReductionOn_GDF32 "rotor speed threshold for reducing feedback currents" VALUE 0x1409BC rlValuefl 1000 NO_UNIT 0 1000 /end CHARACTERISTIC
/begin CHARACTERISTIC nHwConfI_OcV3VelSwitchOff_GDF32 "Rotor speed threshold for setting feedback currents to 0A" VALUE 0x1409C0 rlValuefl 1000 NO_UNIT 0 1000 /end CHARACTERISTIC
/begin CHARACTERISTIC qHwConfI_PCLK_MHz_GDU16 "Peripheral Clock frequency" VALUE 0x112B10 rlValueuw 120 NO_UNIT 40 160 /end CHARACTERISTIC
/begin CHARACTERISTIC rHwConfI_AsymCompLossResPhaseU_GDF32 "Loss Resistor in PhaseU (mOhm)" VALUE 0x1409C4 rlValuefl 5 OHM_REAL 0 5 /end CHARACTERISTIC
/begin CHARACTERISTIC rHwConfI_AsymCompLossResPhaseV_GDF32 "Loss Resistor in PhaseV (mOhm)" VALUE 0x1409C8 rlValuefl 5 OHM_REAL 0 5 /end CHARACTERISTIC
/begin CHARACTERISTIC rHwConfI_AsymCompLossResPhaseW_GDF32 "Loss Resistor in PhaseW (mOhm)" VALUE 0x1409CC rlValuefl 5 OHM_REAL 0 5 /end CHARACTERISTIC
/begin CHARACTERISTIC rHwConfI_OcV3EcuRefR0_GDF32 "Reference value for ECU resistance at reference temperature" VALUE 0x1409D0 rlValuefl 0.1 NO_UNIT 0 0.1 /end CHARACTERISTIC
/begin CHARACTERISTIC rHwConfI_OcV3MotCoilRefR0_GDF32 "Reference value for MOTOR resistance at reference temperature" VALUE 0x1409D4 rlValuefl 0.1 NO_UNIT 0 0.1 /end CHARACTERISTIC
/begin CHARACTERISTIC sCoilCalc_TempSrcSelect_GDU8 "Selector for used temperature: 0-PCB, 1-PCU" VALUE 0x1409F8 rlValueub 1 NO_UNIT 0 1 /end CHARACTERISTIC
/begin CHARACTERISTIC sHwConfI_OcV3Enable_GDU8 "Enable switch for OrderCompV3  feedback calculation" VALUE 0x1409F9 rlValueub 1 NO_UNIT 0 1 /end CHARACTERISTIC
/begin CHARACTERISTIC sMotOrComp_Enable_GDU8 "MotOrComp enabler (0:disabled,default-1:enabled)" VALUE 0x1409FA rlValueub 1 NO_UNIT 0 1 /end CHARACTERISTIC
/begin CHARACTERISTIC tHwConfI_AsymCompAdjustTime_GDF32 "time offset to the middle of the PWM in (mys)" VALUE 0x1409D8 rlValuefl 1000 T_US 0 1000 /end CHARACTERISTIC
/begin CHARACTERISTIC tHwConfI_IpcRxBusyUsWaitTime_GDU16 "Busy wait time the MainRxProcessing function of IPC will wait for arrival of the complete TX data from the other care from the last millisecond" VALUE 0x112B12 rlValueuw 200 T_US 0 200 /end CHARACTERISTIC
/begin CHARACTERISTIC tHwConfI_OcV3IsrCycleTime_GDF32 "Cycle time of FOC calculation in Interrupt Service Routine (ISR)" VALUE 0x1409DC rlValuefl 0.0009 T_S 0.0001 0.001 /end CHARACTERISTIC
/begin CHARACTERISTIC tHwConfI_PhaseShiftAlu_GAF32 "Phase shift of Alu, [0] for negative moment, [1] for positive moment" VAL_BLK 0x1409A4 rlValuefl 2048 T_US -1024 1024 NUMBER 2 /end CHARACTERISTIC
/begin CHARACTERISTIC uMotOrComp_RefVolt_GAF32 "Reference voltage for characteristic curves" VAL_BLK 0x140A00 rlValuefl 24 VOLT_REAL 0 24 NUMBER 3 /end CHARACTERISTIC
/begin CHARACTERISTIC vMotOrComp_MaxOrderCompVehSpeed_GDU16 "Vehicle speed above which MotOrComp is deactivated" VALUE 0x1409F6 rlValueuw 255 VELOCITY 0 255 /end CHARACTERISTIC
/begin CHARACTERISTIC wMotOrComp_Amp0M0_GDS "compensation amplitude over rotor speed, Mref.le.M0" CURVE 0x140A38 rlCurvesw 65532 NO_UNIT -32766 32766
 /begin AXIS_DESCR STD_AXIS nMotOrComp_RotorSpeedFilt_gds16 NO_UNIT 14 -13000 13000 DEPOSIT ABSOLUTE /end AXIS_DESCR
/end CHARACTERISTIC
/begin CHARACTERISTIC wMotOrComp_Amp0M1_GDS "compensation amplitude over rotor speed, M0.le.Mref.le.M1" CURVE 0x140A74 rlCurvesw 65532 NO_UNIT -32766 32766
 /begin AXIS_DESCR STD_AXIS nMotOrComp_RotorSpeedFilt_gds16 NO_UNIT 14 -13000 13000 DEPOSIT ABSOLUTE /end AXIS_DESCR
/end CHARACTERISTIC
/begin CHARACTERISTIC wMotOrComp_Amp0M2_GDS "compensation amplitude over rotor speed, M1.le.Mref.le.M2" CURVE 0x140AB0 rlCurvesw 65532 NO_UNIT -32766 32766
 /begin AXIS_DESCR STD_AXIS nMotOrComp_RotorSpeedFilt_gds16 NO_UNIT 14 -13000 13000 DEPOSIT ABSOLUTE /end AXIS_DESCR
/end CHARACTERISTIC
/begin CHARACTERISTIC wMotOrComp_Amp0M3_GDS "compensation amplitude over rotor speed, M2.le.Mref.le.M3" CURVE 0x140AEC rlCurvesw 65532 NO_UNIT -32766 32766
 /begin AXIS_DESCR STD_AXIS nMotOrComp_RotorSpeedFilt_gds16 NO_UNIT 14 -13000 13000 DEPOSIT ABSOLUTE /end AXIS_DESCR
/end CHARACTERISTIC
/begin CHARACTERISTIC wMotOrComp_Amp0M4_GDS "compensation amplitude over rotor speed, M3.le.Mref.le.M4" CURVE 0x140B28 rlCurvesw 65532 NO_UNIT -32766 32766
 /begin AXIS_DESCR STD_AXIS nMotOrComp_RotorSpeedFilt_gds16 NO_UNIT 14 -13000 13000 DEPOSIT ABSOLUTE /end AXIS_DESCR
/end CHARACTERISTIC
/begin CHARACTERISTIC wMotOrComp_Amp0M5_GDS "compensation amplitude over rotor speed, M4.le.Mref.le.M5" CURVE 0x140B64 rlCurvesw 65532 NO_UNIT -32766 32766
 /begin AXIS_DESCR STD_AXIS nMotOrComp_RotorSpeedFilt_gds16 NO_UNIT 14 -13000 13000 DEPOSIT ABSOLUTE /end AXIS_DESCR
/end CHARACTERISTIC
/begin CHARACTERISTIC wMotOrComp_Amp0M6_GDS "compensation amplitude over rotor speed, M5.le.Mref.le.M6" CURVE 0x140BA0 rlCurvesw 65532 NO_UNIT -32766 32766
 /begin AXIS_DESCR STD_AXIS nMotOrComp_RotorSpeedFilt_gds16 NO_UNIT 14 -13000 13000 DEPOSIT ABSOLUTE /end AXIS_DESCR
/end CHARACTERISTIC
/begin CHARACTERISTIC wMotOrComp_Amp0M7_GDS "compensation amplitude over rotor speed, M6.le.Mref.le.M7" CURVE 0x140BDC rlCurvesw 65532 NO_UNIT -32766 32766
 /begin AXIS_DESCR STD_AXIS nMotOrComp_RotorSpeedFilt_gds16 NO_UNIT 14 -13000 13000 DEPOSIT ABSOLUTE /end AXIS_DESCR
/end CHARACTERISTIC
/begin CHARACTERISTIC wMotOrComp_Amp0M8_GDS "compensation amplitude over rotor speed, M7.le.Mref.le.M8" CURVE 0x140C18 rlCurvesw 65532 NO_UNIT -32766 32766
 /begin AXIS_DESCR STD_AXIS nMotOrComp_RotorSpeedFilt_gds16 NO_UNIT 14 -13000 13000 DEPOSIT ABSOLUTE /end AXIS_DESCR
/end CHARACTERISTIC
/begin CHARACTERISTIC wMotOrComp_Amp0M9_GDS "compensation amplitude over rotor speed, M8.le.Mref" CURVE 0x140C54 rlCurvesw 65532 NO_UNIT -32766 32766
 /begin AXIS_DESCR STD_AXIS nMotOrComp_RotorSpeedFilt_gds16 NO_UNIT 14 -13000 13000 DEPOSIT ABSOLUTE /end AXIS_DESCR
/end CHARACTERISTIC
/begin CHARACTERISTIC wMotOrComp_Amp1M0_GDS "compensation amplitude over rotor speed, voltage level 1" CURVE 0x140C90 rlCurvesw 65532 NO_UNIT -32766 32766
 /begin AXIS_DESCR STD_AXIS nMotOrComp_RotorSpeedFilt_gds16 NO_UNIT 14 -13000 13000 DEPOSIT ABSOLUTE /end AXIS_DESCR
/end CHARACTERISTIC
/begin CHARACTERISTIC wMotOrComp_Amp1M1_GDS "compensation amplitude over rotor speed, voltage level 1" CURVE 0x140CCC rlCurvesw 65532 NO_UNIT -32766 32766
 /begin AXIS_DESCR STD_AXIS nMotOrComp_RotorSpeedFilt_gds16 NO_UNIT 14 -13000 13000 DEPOSIT ABSOLUTE /end AXIS_DESCR
/end CHARACTERISTIC
/begin CHARACTERISTIC wMotOrComp_Amp1M2_GDS "compensation amplitude over rotor speed, voltage level 1" CURVE 0x140D08 rlCurvesw 65532 NO_UNIT -32766 32766
 /begin AXIS_DESCR STD_AXIS nMotOrComp_RotorSpeedFilt_gds16 NO_UNIT 14 -13000 13000 DEPOSIT ABSOLUTE /end AXIS_DESCR
/end CHARACTERISTIC
/begin CHARACTERISTIC wMotOrComp_Amp1M3_GDS "compensation amplitude over rotor speed, voltage level 1" CURVE 0x140D44 rlCurvesw 65532 NO_UNIT -32766 32766
 /begin AXIS_DESCR STD_AXIS nMotOrComp_RotorSpeedFilt_gds16 NO_UNIT 14 -13000 13000 DEPOSIT ABSOLUTE /end AXIS_DESCR
/end CHARACTERISTIC
/begin CHARACTERISTIC wMotOrComp_Amp1M4_GDS "compensation amplitude over rotor speed, voltage level 1" CURVE 0x140D80 rlCurvesw 65532 NO_UNIT -32766 32766
 /begin AXIS_DESCR STD_AXIS nMotOrComp_RotorSpeedFilt_gds16 NO_UNIT 14 -13000 13000 DEPOSIT ABSOLUTE /end AXIS_DESCR
/end CHARACTERISTIC
/begin CHARACTERISTIC wMotOrComp_Amp1M5_GDS "compensation amplitude over rotor speed, voltage level 1" CURVE 0x140DBC rlCurvesw 65532 NO_UNIT -32766 32766
 /begin AXIS_DESCR STD_AXIS nMotOrComp_RotorSpeedFilt_gds16 NO_UNIT 14 -13000 13000 DEPOSIT ABSOLUTE /end AXIS_DESCR
/end CHARACTERISTIC
/begin CHARACTERISTIC wMotOrComp_Amp1M6_GDS "compensation amplitude over rotor speed, voltage level 1" CURVE 0x140DF8 rlCurvesw 65532 NO_UNIT -32766 32766
 /begin AXIS_DESCR STD_AXIS nMotOrComp_RotorSpeedFilt_gds16 NO_UNIT 14 -13000 13000 DEPOSIT ABSOLUTE /end AXIS_DESCR
/end CHARACTERISTIC
/begin CHARACTERISTIC wMotOrComp_Amp1M7_GDS "compensation amplitude over rotor speed, voltage level 1" CURVE 0x140E34 rlCurvesw 65532 NO_UNIT -32766 32766
 /begin AXIS_DESCR STD_AXIS nMotOrComp_RotorSpeedFilt_gds16 NO_UNIT 14 -13000 13000 DEPOSIT ABSOLUTE /end AXIS_DESCR
/end CHARACTERISTIC
/begin CHARACTERISTIC wMotOrComp_Amp1M8_GDS "compensation amplitude over rotor speed, voltage level 1" CURVE 0x140E70 rlCurvesw 65532 NO_UNIT -32766 32766
 /begin AXIS_DESCR STD_AXIS nMotOrComp_RotorSpeedFilt_gds16 NO_UNIT 14 -13000 13000 DEPOSIT ABSOLUTE /end AXIS_DESCR
/end CHARACTERISTIC
/begin CHARACTERISTIC wMotOrComp_Amp1M9_GDS "compensation amplitude over rotor speed, voltage level 1" CURVE 0x140EAC rlCurvesw 65532 NO_UNIT -32766 32766
 /begin AXIS_DESCR STD_AXIS nMotOrComp_RotorSpeedFilt_gds16 NO_UNIT 14 -13000 13000 DEPOSIT ABSOLUTE /end AXIS_DESCR
/end CHARACTERISTIC
/begin CHARACTERISTIC wMotOrComp_Amp2M0_GDS "compensation amplitude over rotor speed, voltage level 2" CURVE 0x140EE8 rlCurvesw 65532 NO_UNIT -32766 32766
 /begin AXIS_DESCR STD_AXIS nMotOrComp_RotorSpeedFilt_gds16 NO_UNIT 14 -13000 13000 DEPOSIT ABSOLUTE /end AXIS_DESCR
/end CHARACTERISTIC
/begin CHARACTERISTIC wMotOrComp_Amp2M1_GDS "compensation amplitude over rotor speed, voltage level 2" CURVE 0x140F24 rlCurvesw 65532 NO_UNIT -32766 32766
 /begin AXIS_DESCR STD_AXIS nMotOrComp_RotorSpeedFilt_gds16 NO_UNIT 14 -13000 13000 DEPOSIT ABSOLUTE /end AXIS_DESCR
/end CHARACTERISTIC
/begin CHARACTERISTIC wMotOrComp_Amp2M2_GDS "compensation amplitude over rotor speed, voltage level 2" CURVE 0x140F60 rlCurvesw 65532 NO_UNIT -32766 32766
 /begin AXIS_DESCR STD_AXIS nMotOrComp_RotorSpeedFilt_gds16 NO_UNIT 14 -13000 13000 DEPOSIT ABSOLUTE /end AXIS_DESCR
/end CHARACTERISTIC
/begin CHARACTERISTIC wMotOrComp_Amp2M3_GDS "compensation amplitude over rotor speed, voltage level 2" CURVE 0x140F9C rlCurvesw 65532 NO_UNIT -32766 32766
 /begin AXIS_DESCR STD_AXIS nMotOrComp_RotorSpeedFilt_gds16 NO_UNIT 14 -13000 13000 DEPOSIT ABSOLUTE /end AXIS_DESCR
/end CHARACTERISTIC
/begin CHARACTERISTIC wMotOrComp_Amp2M4_GDS "compensation amplitude over rotor speed, voltage level 2" CURVE 0x140FD8 rlCurvesw 65532 NO_UNIT -32766 32766
 /begin AXIS_DESCR STD_AXIS nMotOrComp_RotorSpeedFilt_gds16 NO_UNIT 14 -13000 13000 DEPOSIT ABSOLUTE /end AXIS_DESCR
/end CHARACTERISTIC
/begin CHARACTERISTIC wMotOrComp_Amp2M5_GDS "compensation amplitude over rotor speed, voltage level 2" CURVE 0x141014 rlCurvesw 65532 NO_UNIT -32766 32766
 /begin AXIS_DESCR STD_AXIS nMotOrComp_RotorSpeedFilt_gds16 NO_UNIT 14 -13000 13000 DEPOSIT ABSOLUTE /end AXIS_DESCR
/end CHARACTERISTIC
/begin CHARACTERISTIC wMotOrComp_Amp2M6_GDS "compensation amplitude over rotor speed, voltage level 2" CURVE 0x141050 rlCurvesw 65532 NO_UNIT -32766 32766
 /begin AXIS_DESCR STD_AXIS nMotOrComp_RotorSpeedFilt_gds16 NO_UNIT 14 -13000 13000 DEPOSIT ABSOLUTE /end AXIS_DESCR
/end CHARACTERISTIC
/begin CHARACTERISTIC wMotOrComp_Amp2M7_GDS "compensation amplitude over rotor speed, voltage level 2" CURVE 0x14108C rlCurvesw 65532 NO_UNIT -32766 32766
 /begin AXIS_DESCR STD_AXIS nMotOrComp_RotorSpeedFilt_gds16 NO_UNIT 14 -13000 13000 DEPOSIT ABSOLUTE /end AXIS_DESCR
/end CHARACTERISTIC
/begin CHARACTERISTIC wMotOrComp_Amp2M8_GDS "compensation amplitude over rotor speed, voltage level 2" CURVE 0x1410C8 rlCurvesw 65532 NO_UNIT -32766 32766
 /begin AXIS_DESCR STD_AXIS nMotOrComp_RotorSpeedFilt_gds16 NO_UNIT 14 -13000 13000 DEPOSIT ABSOLUTE /end AXIS_DESCR
/end CHARACTERISTIC
/begin CHARACTERISTIC wMotOrComp_Amp2M9_GDS "compensation amplitude over rotor speed, voltage level 2" CURVE 0x141104 rlCurvesw 65532 NO_UNIT -32766 32766
 /begin AXIS_DESCR STD_AXIS nMotOrComp_RotorSpeedFilt_gds16 NO_UNIT 14 -13000 13000 DEPOSIT ABSOLUTE /end AXIS_DESCR
/end CHARACTERISTIC
/begin CHARACTERISTIC wMotOrComp_GradAmp0M0_GDS "gradient of compensation amplitude over rotor speed for Mref.le.M0" CURVE 0x141140 rlCurvesw 65532 NO_UNIT -32766 32766
 /begin AXIS_DESCR STD_AXIS nMotOrComp_RotorSpeedFilt_gds16 NO_UNIT 14 -13000 13000 DEPOSIT ABSOLUTE /end AXIS_DESCR
/end CHARACTERISTIC
/begin CHARACTERISTIC wMotOrComp_GradAmp0M1_GDS "gradient of compensation amplitude over rotor speed for M0.le.Mref.le.M1" CURVE 0x14117C rlCurvesw 65532 NO_UNIT -32766 32766
 /begin AXIS_DESCR STD_AXIS nMotOrComp_RotorSpeedFilt_gds16 NO_UNIT 14 -13000 13000 DEPOSIT ABSOLUTE /end AXIS_DESCR
/end CHARACTERISTIC
/begin CHARACTERISTIC wMotOrComp_GradAmp0M2_GDS "gradient of compensation amplitude over rotor speed for M1.le.Mref.le.M2" CURVE 0x1411B8 rlCurvesw 65532 NO_UNIT -32766 32766
 /begin AXIS_DESCR STD_AXIS nMotOrComp_RotorSpeedFilt_gds16 NO_UNIT 14 -13000 13000 DEPOSIT ABSOLUTE /end AXIS_DESCR
/end CHARACTERISTIC
/begin CHARACTERISTIC wMotOrComp_GradAmp0M3_GDS "gradient of compensation amplitude over rotor speed for M2.le.Mref.le.M3" CURVE 0x1411F4 rlCurvesw 65532 NO_UNIT -32766 32766
 /begin AXIS_DESCR STD_AXIS nMotOrComp_RotorSpeedFilt_gds16 NO_UNIT 14 -13000 13000 DEPOSIT ABSOLUTE /end AXIS_DESCR
/end CHARACTERISTIC
/begin CHARACTERISTIC wMotOrComp_GradAmp0M4_GDS "gradient of compensation amplitude over rotor speed for M3.le.Mref.le.M4" CURVE 0x141230 rlCurvesw 65532 NO_UNIT -32766 32766
 /begin AXIS_DESCR STD_AXIS nMotOrComp_RotorSpeedFilt_gds16 NO_UNIT 14 -13000 13000 DEPOSIT ABSOLUTE /end AXIS_DESCR
/end CHARACTERISTIC
/begin CHARACTERISTIC wMotOrComp_GradAmp0M5_GDS "gradient of compensation amplitude over rotor speed for M4.le.Mref.le.M5" CURVE 0x14126C rlCurvesw 65532 NO_UNIT -32766 32766
 /begin AXIS_DESCR STD_AXIS nMotOrComp_RotorSpeedFilt_gds16 NO_UNIT 14 -13000 13000 DEPOSIT ABSOLUTE /end AXIS_DESCR
/end CHARACTERISTIC
/begin CHARACTERISTIC wMotOrComp_GradAmp0M6_GDS "gradient of compensation amplitude over rotor speed for M5.le.Mref.le.M6" CURVE 0x1412A8 rlCurvesw 65532 NO_UNIT -32766 32766
 /begin AXIS_DESCR STD_AXIS nMotOrComp_RotorSpeedFilt_gds16 NO_UNIT 14 -13000 13000 DEPOSIT ABSOLUTE /end AXIS_DESCR
/end CHARACTERISTIC
/begin CHARACTERISTIC wMotOrComp_GradAmp0M7_GDS "gradient of compensation amplitude over rotor speed for M6.le.Mref.le.M7" CURVE 0x1412E4 rlCurvesw 65532 NO_UNIT -32766 32766
 /begin AXIS_DESCR STD_AXIS nMotOrComp_RotorSpeedFilt_gds16 NO_UNIT 14 -13000 13000 DEPOSIT ABSOLUTE /end AXIS_DESCR
/end CHARACTERISTIC
/begin CHARACTERISTIC wMotOrComp_GradAmp0M8_GDS "gradient of compensation amplitude over rotor speed for M7.le.Mref.le.M8" CURVE 0x141320 rlCurvesw 65532 NO_UNIT -32766 32766
 /begin AXIS_DESCR STD_AXIS nMotOrComp_RotorSpeedFilt_gds16 NO_UNIT 14 -13000 13000 DEPOSIT ABSOLUTE /end AXIS_DESCR
/end CHARACTERISTIC
/begin CHARACTERISTIC wMotOrComp_GradAmp0M9_GDS "gradient of compensation amplitude over rotor speed for M8.le.Mref" CURVE 0x14135C rlCurvesw 65532 NO_UNIT -32766 32766
 /begin AXIS_DESCR STD_AXIS nMotOrComp_RotorSpeedFilt_gds16 NO_UNIT 14 -13000 13000 DEPOSIT ABSOLUTE /end AXIS_DESCR
/end CHARACTERISTIC
/begin CHARACTERISTIC wMotOrComp_GradPhase0M0_GDS "gradient of compensation angle phase offset over rotor speed for Mref.le.M0" CURVE 0x141398 rlCurvesw 65532 NO_UNIT -32766 32766
 /begin AXIS_DESCR STD_AXIS nMotOrComp_RotorSpeedFilt_gds16 NO_UNIT 14 -13000 13000 DEPOSIT ABSOLUTE /end AXIS_DESCR
/end CHARACTERISTIC
/begin CHARACTERISTIC wMotOrComp_GradPhase0M1_GDS "gradient of compensation angle phase offset over rotor speed for M0.le.Mref.le.M1" CURVE 0x1413D4 rlCurvesw 65532 NO_UNIT -32766 32766
 /begin AXIS_DESCR STD_AXIS nMotOrComp_RotorSpeedFilt_gds16 NO_UNIT 14 -13000 13000 DEPOSIT ABSOLUTE /end AXIS_DESCR
/end CHARACTERISTIC
/begin CHARACTERISTIC wMotOrComp_GradPhase0M2_GDS "gradient of compensation angle phase offset over rotor speed for M1.le.Mref.le.M2" CURVE 0x141410 rlCurvesw 65532 NO_UNIT -32766 32766
 /begin AXIS_DESCR STD_AXIS nMotOrComp_RotorSpeedFilt_gds16 NO_UNIT 14 -13000 13000 DEPOSIT ABSOLUTE /end AXIS_DESCR
/end CHARACTERISTIC
/begin CHARACTERISTIC wMotOrComp_GradPhase0M3_GDS "gradient of compensation angle phase offset over rotor speed for M2.le.Mref.le.M3" CURVE 0x14144C rlCurvesw 65532 NO_UNIT -32766 32766
 /begin AXIS_DESCR STD_AXIS nMotOrComp_RotorSpeedFilt_gds16 NO_UNIT 14 -13000 13000 DEPOSIT ABSOLUTE /end AXIS_DESCR
/end CHARACTERISTIC
/begin CHARACTERISTIC wMotOrComp_GradPhase0M4_GDS "gradient of compensation angle phase offset over rotor speed for M3.le.Mref.le.M4" CURVE 0x141488 rlCurvesw 65532 NO_UNIT -32766 32766
 /begin AXIS_DESCR STD_AXIS nMotOrComp_RotorSpeedFilt_gds16 NO_UNIT 14 -13000 13000 DEPOSIT ABSOLUTE /end AXIS_DESCR
/end CHARACTERISTIC
/begin CHARACTERISTIC wMotOrComp_GradPhase0M5_GDS "gradient of compensation angle phase offset over rotor speed for M4.le.Mref.le.M5" CURVE 0x1414C4 rlCurvesw 65532 NO_UNIT -32766 32766
 /begin AXIS_DESCR STD_AXIS nMotOrComp_RotorSpeedFilt_gds16 NO_UNIT 14 -13000 13000 DEPOSIT ABSOLUTE /end AXIS_DESCR
/end CHARACTERISTIC
/begin CHARACTERISTIC wMotOrComp_GradPhase0M6_GDS "gradient of compensation angle phase offset over rotor speed for M5.le.Mref.le.M6" CURVE 0x141500 rlCurvesw 65532 NO_UNIT -32766 32766
 /begin AXIS_DESCR STD_AXIS nMotOrComp_RotorSpeedFilt_gds16 NO_UNIT 14 -13000 13000 DEPOSIT ABSOLUTE /end AXIS_DESCR
/end CHARACTERISTIC
/begin CHARACTERISTIC wMotOrComp_GradPhase0M7_GDS "gradient of compensation angle phase offset over rotor speed for M6.le.Mref.le.M7" CURVE 0x14153C rlCurvesw 65532 NO_UNIT -32766 32766
 /begin AXIS_DESCR STD_AXIS nMotOrComp_RotorSpeedFilt_gds16 NO_UNIT 14 -13000 13000 DEPOSIT ABSOLUTE /end AXIS_DESCR
/end CHARACTERISTIC
/begin CHARACTERISTIC wMotOrComp_GradPhase0M8_GDS "gradient of compensation angle phase offset over rotor speed for M7.le.Mref.le.M8" CURVE 0x141578 rlCurvesw 65532 NO_UNIT -32766 32766
 /begin AXIS_DESCR STD_AXIS nMotOrComp_RotorSpeedFilt_gds16 NO_UNIT 14 -13000 13000 DEPOSIT ABSOLUTE /end AXIS_DESCR
/end CHARACTERISTIC
/begin CHARACTERISTIC wMotOrComp_GradPhase0M9_GDS "gradient of compensation angle phase offset over rotor speed for M8.le.Mref" CURVE 0x1415B4 rlCurvesw 65532 NO_UNIT -32766 32766
 /begin AXIS_DESCR STD_AXIS nMotOrComp_RotorSpeedFilt_gds16 NO_UNIT 14 -13000 13000 DEPOSIT ABSOLUTE /end AXIS_DESCR
/end CHARACTERISTIC
/begin CHARACTERISTIC wMotOrComp_Phase0M0_GDS "compensation angle phase offset over rotor speed for Mref.le.M0" CURVE 0x1415F0 rlCurvesw 65532 NO_UNIT -32766 32766
 /begin AXIS_DESCR STD_AXIS nMotOrComp_RotorSpeedFilt_gds16 NO_UNIT 14 -13000 13000 DEPOSIT ABSOLUTE /end AXIS_DESCR
/end CHARACTERISTIC
/begin CHARACTERISTIC wMotOrComp_Phase0M1_GDS "compensation angle phase offset over rotor speed for M0.le.Mref.le.M1" CURVE 0x14162C rlCurvesw 65532 NO_UNIT -32766 32766
 /begin AXIS_DESCR STD_AXIS nMotOrComp_RotorSpeedFilt_gds16 NO_UNIT 14 -13000 13000 DEPOSIT ABSOLUTE /end AXIS_DESCR
/end CHARACTERISTIC
/begin CHARACTERISTIC wMotOrComp_Phase0M2_GDS "compensation angle phase offset over rotor speed for M1.le.Mref.le.M2" CURVE 0x141668 rlCurvesw 65532 NO_UNIT -32766 32766
 /begin AXIS_DESCR STD_AXIS nMotOrComp_RotorSpeedFilt_gds16 NO_UNIT 14 -13000 13000 DEPOSIT ABSOLUTE /end AXIS_DESCR
/end CHARACTERISTIC
/begin CHARACTERISTIC wMotOrComp_Phase0M3_GDS "compensation angle phase offset over rotor speed for M2.le.Mref.le.M3" CURVE 0x1416A4 rlCurvesw 65532 NO_UNIT -32766 32766
 /begin AXIS_DESCR STD_AXIS nMotOrComp_RotorSpeedFilt_gds16 NO_UNIT 14 -13000 13000 DEPOSIT ABSOLUTE /end AXIS_DESCR
/end CHARACTERISTIC
/begin CHARACTERISTIC wMotOrComp_Phase0M4_GDS "compensation angle phase offset over rotor speed for M3.le.Mref.le.M4" CURVE 0x1416E0 rlCurvesw 65532 NO_UNIT -32766 32766
 /begin AXIS_DESCR STD_AXIS nMotOrComp_RotorSpeedFilt_gds16 NO_UNIT 14 -13000 13000 DEPOSIT ABSOLUTE /end AXIS_DESCR
/end CHARACTERISTIC
/begin CHARACTERISTIC wMotOrComp_Phase0M5_GDS "compensation angle phase offset over rotor speed for M4.le.Mref.le.M5" CURVE 0x14171C rlCurvesw 65532 NO_UNIT -32766 32766
 /begin AXIS_DESCR STD_AXIS nMotOrComp_RotorSpeedFilt_gds16 NO_UNIT 14 -13000 13000 DEPOSIT ABSOLUTE /end AXIS_DESCR
/end CHARACTERISTIC
/begin CHARACTERISTIC wMotOrComp_Phase0M6_GDS "compensation angle phase offset over rotor speed for M5.le.Mref.le.M6" CURVE 0x141758 rlCurvesw 65532 NO_UNIT -32766 32766
 /begin AXIS_DESCR STD_AXIS nMotOrComp_RotorSpeedFilt_gds16 NO_UNIT 14 -13000 13000 DEPOSIT ABSOLUTE /end AXIS_DESCR
/end CHARACTERISTIC
/begin CHARACTERISTIC wMotOrComp_Phase0M7_GDS "compensation angle phase offset over rotor speed for M6.le.Mref.le.M7" CURVE 0x141794 rlCurvesw 65532 NO_UNIT -32766 32766
 /begin AXIS_DESCR STD_AXIS nMotOrComp_RotorSpeedFilt_gds16 NO_UNIT 14 -13000 13000 DEPOSIT ABSOLUTE /end AXIS_DESCR
/end CHARACTERISTIC
/begin CHARACTERISTIC wMotOrComp_Phase0M8_GDS "compensation angle phase offset over rotor speed for M7.le.Mref.le.M8" CURVE 0x1417D0 rlCurvesw 65532 NO_UNIT -32766 32766
 /begin AXIS_DESCR STD_AXIS nMotOrComp_RotorSpeedFilt_gds16 NO_UNIT 14 -13000 13000 DEPOSIT ABSOLUTE /end AXIS_DESCR
/end CHARACTERISTIC
/begin CHARACTERISTIC wMotOrComp_Phase0M9_GDS "compensation angle phase offset over rotor speed for M8.le.Mref" CURVE 0x14180C rlCurvesw 65532 NO_UNIT -32766 32766
 /begin AXIS_DESCR STD_AXIS nMotOrComp_RotorSpeedFilt_gds16 NO_UNIT 14 -13000 13000 DEPOSIT ABSOLUTE /end AXIS_DESCR
/end CHARACTERISTIC
/begin CHARACTERISTIC wMotOrComp_Phase1M0_GDS "compensation angle phase offset over rotor speed, phase level 1" CURVE 0x141848 rlCurvesw 65532 NO_UNIT -32766 32766
 /begin AXIS_DESCR STD_AXIS nMotOrComp_RotorSpeedFilt_gds16 NO_UNIT 14 -13000 13000 DEPOSIT ABSOLUTE /end AXIS_DESCR
/end CHARACTERISTIC
/begin CHARACTERISTIC wMotOrComp_Phase1M1_GDS "compensation angle phase offset over rotor speed, phase level 1" CURVE 0x141884 rlCurvesw 65532 NO_UNIT -32766 32766
 /begin AXIS_DESCR STD_AXIS nMotOrComp_RotorSpeedFilt_gds16 NO_UNIT 14 -13000 13000 DEPOSIT ABSOLUTE /end AXIS_DESCR
/end CHARACTERISTIC
/begin CHARACTERISTIC wMotOrComp_Phase1M2_GDS "compensation angle phase offset over rotor speed, phase level 1" CURVE 0x1418C0 rlCurvesw 65532 NO_UNIT -32766 32766
 /begin AXIS_DESCR STD_AXIS nMotOrComp_RotorSpeedFilt_gds16 NO_UNIT 14 -13000 13000 DEPOSIT ABSOLUTE /end AXIS_DESCR
/end CHARACTERISTIC
/begin CHARACTERISTIC wMotOrComp_Phase1M3_GDS "compensation angle phase offset over rotor speed, phase level 1" CURVE 0x1418FC rlCurvesw 65532 NO_UNIT -32766 32766
 /begin AXIS_DESCR STD_AXIS nMotOrComp_RotorSpeedFilt_gds16 NO_UNIT 14 -13000 13000 DEPOSIT ABSOLUTE /end AXIS_DESCR
/end CHARACTERISTIC
/begin CHARACTERISTIC wMotOrComp_Phase1M4_GDS "compensation angle phase offset over rotor speed, phase level 1" CURVE 0x141938 rlCurvesw 65532 NO_UNIT -32766 32766
 /begin AXIS_DESCR STD_AXIS nMotOrComp_RotorSpeedFilt_gds16 NO_UNIT 14 -13000 13000 DEPOSIT ABSOLUTE /end AXIS_DESCR
/end CHARACTERISTIC
/begin CHARACTERISTIC wMotOrComp_Phase1M5_GDS "compensation angle phase offset over rotor speed, phase level 1" CURVE 0x141974 rlCurvesw 65532 NO_UNIT -32766 32766
 /begin AXIS_DESCR STD_AXIS nMotOrComp_RotorSpeedFilt_gds16 NO_UNIT 14 -13000 13000 DEPOSIT ABSOLUTE /end AXIS_DESCR
/end CHARACTERISTIC
/begin CHARACTERISTIC wMotOrComp_Phase1M6_GDS "compensation angle phase offset over rotor speed, phase level 1" CURVE 0x1419B0 rlCurvesw 65532 NO_UNIT -32766 32766
 /begin AXIS_DESCR STD_AXIS nMotOrComp_RotorSpeedFilt_gds16 NO_UNIT 14 -13000 13000 DEPOSIT ABSOLUTE /end AXIS_DESCR
/end CHARACTERISTIC
/begin CHARACTERISTIC wMotOrComp_Phase1M7_GDS "compensation angle phase offset over rotor speed, phase level 1" CURVE 0x1419EC rlCurvesw 65532 NO_UNIT -32766 32766
 /begin AXIS_DESCR STD_AXIS nMotOrComp_RotorSpeedFilt_gds16 NO_UNIT 14 -13000 13000 DEPOSIT ABSOLUTE /end AXIS_DESCR
/end CHARACTERISTIC
/begin CHARACTERISTIC wMotOrComp_Phase1M8_GDS "compensation angle phase offset over rotor speed, phase level 1" CURVE 0x141A28 rlCurvesw 65532 NO_UNIT -32766 32766
 /begin AXIS_DESCR STD_AXIS nMotOrComp_RotorSpeedFilt_gds16 NO_UNIT 14 -13000 13000 DEPOSIT ABSOLUTE /end AXIS_DESCR
/end CHARACTERISTIC
/begin CHARACTERISTIC wMotOrComp_Phase1M9_GDS "compensation angle phase offset over rotor speed, phase level 1" CURVE 0x141A64 rlCurvesw 65532 NO_UNIT -32766 32766
 /begin AXIS_DESCR STD_AXIS nMotOrComp_RotorSpeedFilt_gds16 NO_UNIT 14 -13000 13000 DEPOSIT ABSOLUTE /end AXIS_DESCR
/end CHARACTERISTIC
/begin CHARACTERISTIC wMotOrComp_Phase2M0_GDS "compensation angle phase offset over rotor speed, phase level 2" CURVE 0x141AA0 rlCurvesw 65532 NO_UNIT -32766 32766
 /begin AXIS_DESCR STD_AXIS nMotOrComp_RotorSpeedFilt_gds16 NO_UNIT 14 -13000 13000 DEPOSIT ABSOLUTE /end AXIS_DESCR
/end CHARACTERISTIC
/begin CHARACTERISTIC wMotOrComp_Phase2M1_GDS "compensation angle phase offset over rotor speed, phase level 2" CURVE 0x141ADC rlCurvesw 65532 NO_UNIT -32766 32766
 /begin AXIS_DESCR STD_AXIS nMotOrComp_RotorSpeedFilt_gds16 NO_UNIT 14 -13000 13000 DEPOSIT ABSOLUTE /end AXIS_DESCR
/end CHARACTERISTIC
/begin CHARACTERISTIC wMotOrComp_Phase2M2_GDS "compensation angle phase offset over rotor speed, phase level 2" CURVE 0x141B18 rlCurvesw 65532 NO_UNIT -32766 32766
 /begin AXIS_DESCR STD_AXIS nMotOrComp_RotorSpeedFilt_gds16 NO_UNIT 14 -13000 13000 DEPOSIT ABSOLUTE /end AXIS_DESCR
/end CHARACTERISTIC
/begin CHARACTERISTIC wMotOrComp_Phase2M3_GDS "compensation angle phase offset over rotor speed, phase level 2" CURVE 0x141B54 rlCurvesw 65532 NO_UNIT -32766 32766
 /begin AXIS_DESCR STD_AXIS nMotOrComp_RotorSpeedFilt_gds16 NO_UNIT 14 -13000 13000 DEPOSIT ABSOLUTE /end AXIS_DESCR
/end CHARACTERISTIC
/begin CHARACTERISTIC wMotOrComp_Phase2M4_GDS "compensation angle phase offset over rotor speed, phase level 2" CURVE 0x141B90 rlCurvesw 65532 NO_UNIT -32766 32766
 /begin AXIS_DESCR STD_AXIS nMotOrComp_RotorSpeedFilt_gds16 NO_UNIT 14 -13000 13000 DEPOSIT ABSOLUTE /end AXIS_DESCR
/end CHARACTERISTIC
/begin CHARACTERISTIC wMotOrComp_Phase2M5_GDS "compensation angle phase offset over rotor speed, phase level 2" CURVE 0x141BCC rlCurvesw 65532 NO_UNIT -32766 32766
 /begin AXIS_DESCR STD_AXIS nMotOrComp_RotorSpeedFilt_gds16 NO_UNIT 14 -13000 13000 DEPOSIT ABSOLUTE /end AXIS_DESCR
/end CHARACTERISTIC
/begin CHARACTERISTIC wMotOrComp_Phase2M6_GDS "compensation angle phase offset over rotor speed, phase level 2" CURVE 0x141C08 rlCurvesw 65532 NO_UNIT -32766 32766
 /begin AXIS_DESCR STD_AXIS nMotOrComp_RotorSpeedFilt_gds16 NO_UNIT 14 -13000 13000 DEPOSIT ABSOLUTE /end AXIS_DESCR
/end CHARACTERISTIC
/begin CHARACTERISTIC wMotOrComp_Phase2M7_GDS "compensation angle phase offset over rotor speed, phase level 2" CURVE 0x141C44 rlCurvesw 65532 NO_UNIT -32766 32766
 /begin AXIS_DESCR STD_AXIS nMotOrComp_RotorSpeedFilt_gds16 NO_UNIT 14 -13000 13000 DEPOSIT ABSOLUTE /end AXIS_DESCR
/end CHARACTERISTIC
/begin CHARACTERISTIC wMotOrComp_Phase2M8_GDS "compensation angle phase offset over rotor speed, phase level 2" CURVE 0x141C80 rlCurvesw 65532 NO_UNIT -32766 32766
 /begin AXIS_DESCR STD_AXIS nMotOrComp_RotorSpeedFilt_gds16 NO_UNIT 14 -13000 13000 DEPOSIT ABSOLUTE /end AXIS_DESCR
/end CHARACTERISTIC
/begin CHARACTERISTIC wMotOrComp_Phase2M9_GDS "compensation angle phase offset over rotor speed, phase level 2" CURVE 0x141CBC rlCurvesw 65532 NO_UNIT -32766 32766
 /begin AXIS_DESCR STD_AXIS nMotOrComp_RotorSpeedFilt_gds16 NO_UNIT 14 -13000 13000 DEPOSIT ABSOLUTE /end AXIS_DESCR
/end CHARACTERISTIC
/begin CHARACTERISTIC xHwConfI_FactAmpSpeedXOrd_GAF32 "Factor for amplitude dependent on RotorSpeed. [0] for negative moment, [1] for positive moment" VAL_BLK 0x1409AC rlValuefl 0.0006666 NO_UNIT -0.0003333 0.0003333 NUMBER 2 /end CHARACTERISTIC
/begin CHARACTERISTIC xHwConfI_FactAmpSpeedYOrd_GAF32 "Factor for amplitude dependent on RotorSpeed. [0] for negative moment,[1] for positive moment" VAL_BLK 0x1409B4 rlValuefl 0.0006666 NO_UNIT -0.0003333 0.0003333 NUMBER 2 /end CHARACTERISTIC
/begin CHARACTERISTIC xHwConfI_OcV3EcuTempCoeff_GDF32 "Temperature coefficient for ECU resistance" VALUE 0x1409E0 rlValuefl 1 NO_UNIT 0 1 /end CHARACTERISTIC
/begin CHARACTERISTIC xHwConfI_OcV3MotCoilTempCoeff_GDF32 "Temperature coefficient for MOTOR resistance" VALUE 0x1409E4 rlValuefl 1 NO_UNIT 0 1 /end CHARACTERISTIC
/begin CHARACTERISTIC xMotOrComp_FullLoadFactor_GAU16 "percentage factor of maximum torque: Which characteristics should be used" VAL_BLK 0x140A0C rlValueuw 1 TORQ_INT 0 1 NUMBER 10 /end CHARACTERISTIC
/begin CHARACTERISTIC yHwConfI_AsicComChipselect_GDU8 "ASIC CSIH Chipselect " VALUE 0x112B22 rlValueub 7 NO_UNIT 0 7 /end CHARACTERISTIC
/begin CHARACTERISTIC yHwConfI_AsicComCsihUnit_GDU8 "CSIH-Unit which is used for the ASIC" VALUE 0x112B23 rlValueub 3 NO_UNIT 0 3 /end CHARACTERISTIC
/begin CHARACTERISTIC yHwConfI_AsymCompEnable_GDU8 "AsymCom Enabler (1 = On and 0 = off)" VALUE 0x1409FB rlValueub 1 NO_UNIT 0 1 /end CHARACTERISTIC
/begin CHARACTERISTIC yHwConfI_CanComChipselect_GDU8 "CanTrcv  CSIH Chipselect " VALUE 0x112B24 rlValueub 7 NO_UNIT 0 7 /end CHARACTERISTIC
/begin CHARACTERISTIC yHwConfI_CanComCsihUnit_GDU8 "CSIH-Unit which is used for the CAN Trcv" VALUE 0x112B25 rlValueub 3 NO_UNIT 0 3 /end CHARACTERISTIC
/begin CHARACTERISTIC yHwConfI_DmsHwChannelMap_GAE "Interface contains the information about the used VddPas_X regulator for the respective sensor channel" VAL_BLK 0x112B14 rlValueub 255 NO_UNIT 0 255 NUMBER 2 /end CHARACTERISTIC
/begin CHARACTERISTIC yHwConfI_DmsUartPsi5ChannelMap_GAE "Interface contains the information about the used Uart/Psi5 Channels for the respective sensor channel" VAL_BLK 0x112B16 rlValueub 255 NO_UNIT 0 255 NUMBER 2 /end CHARACTERISTIC
/begin CHARACTERISTIC yHwConfI_GduComChipselect_GDU8 "GDU CSIH Chipselect " VALUE 0x112B26 rlValueub 7 NO_UNIT 0 7 /end CHARACTERISTIC
/begin CHARACTERISTIC yHwConfI_GduComCsihUnit_GDU8 "CSIH-Unit which is used for the GDU" VALUE 0x112B27 rlValueub 3 NO_UNIT 0 3 /end CHARACTERISTIC
/begin CHARACTERISTIC yHwConfI_GduSpiCmd0Init_GDU16 "Initial value of CMD0 reg in L9906" VALUE 0x112B18 rlValueuw 65535 NO_UNIT 0 65535 /end CHARACTERISTIC
/begin CHARACTERISTIC yHwConfI_GduSpiCmd1Init_GDU16 "Initial value of CMD1 reg in L9906" VALUE 0x112B1A rlValueuw 65535 NO_UNIT 0 65535 /end CHARACTERISTIC
/begin CHARACTERISTIC yHwConfI_GduSpiCmd2Init_GDU16 "Initial value of CMD2 reg in L9906" VALUE 0x112B1C rlValueuw 65535 NO_UNIT 0 65535 /end CHARACTERISTIC
/begin CHARACTERISTIC yHwConfI_GduSpiCmd3Init_GDU16 "Initial value of CMD3 reg in L9906" VALUE 0x112B1E rlValueuw 65535 NO_UNIT 0 65535 /end CHARACTERISTIC
/begin CHARACTERISTIC yHwConfI_GduSpiCmd4Init_GDU16 "Initial value of CMD4 reg in L9906" VALUE 0x112B20 rlValueuw 65535 NO_UNIT 0 65535 /end CHARACTERISTIC
/begin CHARACTERISTIC yHwConfI_GduVariant_GDU8 "Value 0 is L9906 and value 1 is L9907" VALUE 0x112B28 rlValueub 1 NO_UNIT 0 1 /end CHARACTERISTIC
/begin CHARACTERISTIC yHwConfI_IndexSensInputThd_GDU8 "Index Sensor Input comparator threshold (0=96mV 1=192mV 2=HalfVddus)" VALUE 0x112B29 rlValueub 2 NO_UNIT 0 2 /end CHARACTERISTIC
/begin CHARACTERISTIC yHwConfI_IndexSensVoltageLvl_GDU8 "Index Supply Voltage Level (0=3.3V 1=5.0V)" VALUE 0x112B2A rlValueub 1 NO_UNIT 0 1 /end CHARACTERISTIC
/begin CHARACTERISTIC yHwConfI_KFactorJumpLimit_GDU32 "K-Jump limit of the angle sensor. Here 77 degree /5ms is equal to 15400 degree per second" VALUE 0x112B0C rlValueul 69800 NO_UNIT 200 70000 /end CHARACTERISTIC
/begin CHARACTERISTIC yHwConfI_OcV3AngleSelector_GDU8 "Index of used PWM set for angle select" VALUE 0x1409FC rlValueub 7 NO_UNIT 1 8 /end CHARACTERISTIC
/begin CHARACTERISTIC yHwConfI_OcV3Lsd_GDF32 "Inductivity direct axis" VALUE 0x1409E8 rlValuefl 99 INDUCTANCE_REAL 1 100 /end CHARACTERISTIC
/begin CHARACTERISTIC yHwConfI_OcV3Lsq_GDF32 "Inductivity quadrature axis" VALUE 0x1409EC rlValuefl 99 INDUCTANCE_REAL 1 100 /end CHARACTERISTIC
/begin CHARACTERISTIC yHwConfI_TpoSensAngleInvSwitch_GDU8 "TPO Steering angle inversion switch" VALUE 0x112B2B rlValueub 1 NO_UNIT 0 1 /end CHARACTERISTIC
/begin CHARACTERISTIC yMotOrComp_Order0_GDU8 "Order of harmonics to be compensated by MotOrComp" VALUE 0x1409FD rlValueub 20 NO_UNIT 0 20 /end CHARACTERISTIC
/begin CHARACTERISTIC zHwConfI_DmsSensChCount_GDU8 "interface contains how many DMS channel in each part machine" VALUE 0x112B2C rlValueub 1 NO_UNIT 1 2 /end CHARACTERISTIC
/begin CHARACTERISTIC cGpCalc_NTCLookUp_GDS "DBC NTC characteristic" CURVE 0x112950 rlCurveuw 254 TEMP_INT -70 184
 /begin AXIS_DESCR STD_AXIS yGpCalc_NTCRawValue_gdu16 NO_UNIT 12 0 65535 DEPOSIT ABSOLUTE /end AXIS_DESCR
/end CHARACTERISTIC
/begin CHARACTERISTIC cPcbCalc_NTCLookUp_GDS "PCB NTC characteristic" CURVE 0x112984 rlCurveuw 254 TEMP_INT -70 184
 /begin AXIS_DESCR STD_AXIS yPcbCalc_NTCRawValue_gdu16 NO_UNIT 12 0 65535 DEPOSIT ABSOLUTE /end AXIS_DESCR
/end CHARACTERISTIC
/begin CHARACTERISTIC cTecDiag_UcCalcTempMax_GDU8 "Lower limit temperature value of ?myC " VALUE 0x112948 rlValueub 220 TEMP_INT -70 150 /end CHARACTERISTIC
/begin CHARACTERISTIC cTecDiag_UcCalcTempMin_GDU8 "Lower limit temperature value of ?myC " VALUE 0x112949 rlValueub 220 TEMP_INT -70 150 /end CHARACTERISTIC
/begin CHARACTERISTIC cTecPlausi_DiffTempMax_GDS16 "Upper limit difference temperature plausi" VALUE 0x112934 rlValuesw 512 NO_UNIT -256 256 /end CHARACTERISTIC
/begin CHARACTERISTIC cTecPlausi_DiffTempMin_GDS16 "Lower limit difference temperature plausi" VALUE 0x112936 rlValuesw 512 NO_UNIT -256 256 /end CHARACTERISTIC
/begin CHARACTERISTIC cTecPlausi_PcbTempMax_GDU8 "Upper limit PCB temperature plausi" VALUE 0x11294A rlValueub 220 TEMP_INT -70 150 /end CHARACTERISTIC
/begin CHARACTERISTIC cTecPlausi_PcbTempMin_GDU8 "Lower limit PCB temperature plausi" VALUE 0x11294B rlValueub 220 TEMP_INT -70 150 /end CHARACTERISTIC
/begin CHARACTERISTIC cTecPlausi_UcTempMax_GDU8 "Upper limit ?myC temperature plausi" VALUE 0x11294C rlValueub 220 TEMP_INT -70 150 /end CHARACTERISTIC
/begin CHARACTERISTIC cTecPlausi_UcTempMin_GDU8 "Lower limit UC temperature plausi" VALUE 0x11294D rlValueub 220 TEMP_INT -70 150 /end CHARACTERISTIC
/begin CHARACTERISTIC rFetCalc_RdsOnOffset_GDF32 "Resistence offset RDS ON Ohm" VALUE 0x1408C0 rlValuefl 0.01 NO_UNIT 0 0.01 /end CHARACTERISTIC
/begin CHARACTERISTIC rFetCalc_RdsOnOffsetCo_GDF32 "Resistence offset RDS ON Ohm of cut off FET's" VALUE 0x1408C4 rlValuefl 0.01 NO_UNIT 0 0.01 /end CHARACTERISTIC
/begin CHARACTERISTIC rFetCalc_RdsOnOffsetRp_GDF32 "Resistance offset RDS ON Ohm of reverse polarity FET" VALUE 0x1408C8 rlValuefl 0.01 NO_UNIT 0 0.01 /end CHARACTERISTIC
/begin CHARACTERISTIC rFetCalc_SwitchShuntResistance1_GDF32 "Shunt resistance of switching loss" VALUE 0x1408CC rlValuefl 0.01 NO_UNIT 0 0.01 /end CHARACTERISTIC
/begin CHARACTERISTIC rFetCalc_SwitchShuntResistance2_GDF32 "Shunt resistance of switching loss" VALUE 0x1408D0 rlValuefl 0.01 NO_UNIT 0 0.01 /end CHARACTERISTIC
/begin CHARACTERISTIC rFetCalc_TempTransResist1Co_GAF32 "Temperature transfer resistance first PT1 for cut off FET" VAL_BLK 0x140904 rlValuefl 10 NO_UNIT 0 10 NUMBER 3 /end CHARACTERISTIC
/begin CHARACTERISTIC rFetCalc_TempTransResist1Hs_GAF32 "Temperature transfer resistance first PT1 for high side FET" VAL_BLK 0x140910 rlValuefl 10 NO_UNIT 0 10 NUMBER 3 /end CHARACTERISTIC
/begin CHARACTERISTIC rFetCalc_TempTransResist1Ls_GAF32 "Temperature transfer resistance first PT1 for low side FET" VAL_BLK 0x14091C rlValuefl 10 NO_UNIT 0 10 NUMBER 3 /end CHARACTERISTIC
/begin CHARACTERISTIC rFetCalc_TempTransResist1Rp_GDF32 "Temperature transfer resistance first PT1 for reverse polarity FET" VALUE 0x1408D4 rlValuefl 10 NO_UNIT 0 10 /end CHARACTERISTIC
/begin CHARACTERISTIC rFetCalc_TempTransResist2Co_GAF32 "Temperature transfer resistance second PT1 for cut off FET" VAL_BLK 0x140928 rlValuefl 10 NO_UNIT 0 10 NUMBER 3 /end CHARACTERISTIC
/begin CHARACTERISTIC rFetCalc_TempTransResist2Hs_GAF32 "Temperature transfer resistance second PT1 for high side FET" VAL_BLK 0x140934 rlValuefl 10 NO_UNIT 0 10 NUMBER 3 /end CHARACTERISTIC
/begin CHARACTERISTIC rFetCalc_TempTransResist2Ls_GAF32 "Temperature transfer resistance second PT1 for Low side FET" VAL_BLK 0x140940 rlValuefl 10 NO_UNIT 0 10 NUMBER 3 /end CHARACTERISTIC
/begin CHARACTERISTIC rFetCalc_TempTransResist2Rp_GDF32 "Temperature transfer resistance second PT1 for reverse polarity FET" VALUE 0x1408D8 rlValuefl 10 NO_UNIT 0 10 /end CHARACTERISTIC
/begin CHARACTERISTIC tCapCalc_FilterTime_GDF32 "Sampling time / (model time) for capacitor temperature" VALUE 0x11292C rlValuefl 0.001 NO_UNIT 0 0.001 /end CHARACTERISTIC
/begin CHARACTERISTIC tHwConfI_EmergencyOpDuration_GAU8 "Duration of SCU Emergency Operation Array. 0: FOS, 1: FOS_RAMP, 2: SC, 3: OC, 4: FADE_OUT, 5: RPC_SENSORLESS" VAL_BLK 0x1408F0 rlValueub 255 T_S 0 255 NUMBER 6 /end CHARACTERISTIC
/begin CHARACTERISTIC tHwConfI_OutStageTorqueOutputDelay_GDU8 "Delay, that is applied before enabling the torque output, after the output stage was enabled and it was disabled for more than 10ms before" VALUE 0x11294E rlValueub 20 T_MS 0 20 /end CHARACTERISTIC
/begin CHARACTERISTIC tTecDiag_OutOfRangeMax_GDU8 "Maximum time for out of range raw values" VALUE 0x11294F rlValueub 184 NO_UNIT 16 200 /end CHARACTERISTIC
/begin CHARACTERISTIC tTecPlausi_DiffMax_GDU16 "Maximum time for difference temperature of ?myC and PCB" VALUE 0x112938 rlValueuw 3998 NO_UNIT 2 4000 /end CHARACTERISTIC
/begin CHARACTERISTIC xFetCalc_FilterTime1Co_GAF32 "Sampling time / (R*C) first PT1 for cut off FET" VAL_BLK 0x14094C rlValuefl 0.8 NO_UNIT 0 0.8 NUMBER 3 /end CHARACTERISTIC
/begin CHARACTERISTIC xFetCalc_FilterTime1Hs_GAF32 "Sampling time / (R*C) first PT1 for high side FET" VAL_BLK 0x140958 rlValuefl 0.8 NO_UNIT 0 0.8 NUMBER 3 /end CHARACTERISTIC
/begin CHARACTERISTIC xFetCalc_FilterTime1Ls_GAF32 "Sampling time / (R*C) first PT1 for low side FET" VAL_BLK 0x140964 rlValuefl 0.8 NO_UNIT 0 0.8 NUMBER 3 /end CHARACTERISTIC
/begin CHARACTERISTIC xFetCalc_FilterTime1Rp_GDF32 "Sampling time / (R*C) first PT1 for reverse polarity FET" VALUE 0x1408DC rlValuefl 0.8 NO_UNIT 0 0.8 /end CHARACTERISTIC
/begin CHARACTERISTIC xFetCalc_FilterTime2Co_GAF32 "Sampling time / (R*C) second PT1 for cut off FET" VAL_BLK 0x140970 rlValuefl 0.8 NO_UNIT 0 0.8 NUMBER 3 /end CHARACTERISTIC
/begin CHARACTERISTIC xFetCalc_FilterTime2Hs_GAF32 "Sampling time / (R*C) second PT1 for high side FET" VAL_BLK 0x14097C rlValuefl 0.8 NO_UNIT 0 0.8 NUMBER 3 /end CHARACTERISTIC
/begin CHARACTERISTIC xFetCalc_FilterTime2Ls_GAF32 "Sampling time / (R*C) second PT1 for low side FET" VAL_BLK 0x140988 rlValuefl 0.8 NO_UNIT 0 0.8 NUMBER 3 /end CHARACTERISTIC
/begin CHARACTERISTIC xFetCalc_FilterTime2Rp_GDF32 "Sampling time / (R*C) second PT1 for reverse polarity FET" VALUE 0x1408E0 rlValuefl 0.8 NO_UNIT 0 0.8 /end CHARACTERISTIC
/begin CHARACTERISTIC xFetCalc_RdsOnGain_GDF32 "Resistence coefficient RDS ON Ohm/K" VALUE 0x1408E4 rlValuefl 0.0001 NO_UNIT 0 0.0001 /end CHARACTERISTIC
/begin CHARACTERISTIC xFetCalc_RdsOnGainCo_GDF32 "Resistence coefficient RDS ON Ohm/K of cut off FET's " VALUE 0x1408E8 rlValuefl 0.0001 NO_UNIT 0 0.0001 /end CHARACTERISTIC
/begin CHARACTERISTIC xFetCalc_RdsOnGainRp_GDF32 "Resistence coefficient RDS ON Ohm/K of reverse polarity FET" VALUE 0x1408EC rlValuefl 0.0001 NO_UNIT 0 0.0001 /end CHARACTERISTIC
/begin CHARACTERISTIC yCapCalc_TempSquaredCurrent_GDF32 "Gain factor of temperature model" VALUE 0x112930 rlValuefl 10 NO_UNIT 0 10 /end CHARACTERISTIC
/begin CHARACTERISTIC yHwConfI_AsicServTestErrReg_GDU16 "Test Register TEST_ERR configuration value" VALUE 0x11293A rlValueuw 65535 NO_UNIT 0 65535 /end CHARACTERISTIC
/begin CHARACTERISTIC yHwConfI_EmergencyOpAvail_GDU8 "Availability of SCU Emergency Operation Bits. 0: FOS, 1: FOS_RAMP, 2: SC, 3: OC, 4: FADE_OUT, 5: RPC_SENSORLESS" VALUE 0x140900 rlValueub 63 NO_UNIT 0 63 /end CHARACTERISTIC
/begin CHARACTERISTIC yHwConfI_EmergencyOpLevel_GAU8 "Support Level of SCU Emergency Operation Array. 0: FOS, 1: FOS_RAMP, 2: SC, 3: OC, 4: FADE_OUT, 5: RPC_SENSORLESS" VAL_BLK 0x1408F8 rlValueub 240 NO_UNIT 0 240 NUMBER 6 /end CHARACTERISTIC
/begin CHARACTERISTIC yHwConfI_EmergencyOpOcPlausiAvail_GDU8 "Availability of additional plausibility function for OC Mode" VALUE 0x140901 rlValueub 1 NO_UNIT 0 1 /end CHARACTERISTIC
/begin CHARACTERISTIC yHwConfI_TempProtFctAvail_GDU8 "Availability of SCU Temperature Protection Function Bits. 0: uC, 1: PCB, 2: DcLink, 3: FET, 4: GroundPlate, 5: MotCoil" VALUE 0x140902 rlValueub 63 NO_UNIT 0 63 /end CHARACTERISTIC
/begin CHARACTERISTIC yTecDiag_DbcNtcRawMax_GDU16 "Upper limit raw value temperature NTC DBC" VALUE 0x11293C rlValueuw 4095 NO_UNIT 0 4095 /end CHARACTERISTIC
/begin CHARACTERISTIC yTecDiag_DbcNtcRawMin_GDU16 "Lower limit raw value temperature NTC DBC" VALUE 0x11293E rlValueuw 4095 NO_UNIT 0 4095 /end CHARACTERISTIC
/begin CHARACTERISTIC yTecDiag_PcbNtcRawMax_GDU16 "Upper limit raw value temperature NTC PCB" VALUE 0x112940 rlValueuw 4095 NO_UNIT 0 4095 /end CHARACTERISTIC
/begin CHARACTERISTIC yTecDiag_PcbNtcRawMin_GDU16 "Lower limit raw value temperature NTC PCB" VALUE 0x112942 rlValueuw 4095 NO_UNIT 0 4095 /end CHARACTERISTIC
/begin CHARACTERISTIC yTecDiag_UcCalcRawMax_GDU16 "Upper limit raw value temperature ?myC" VALUE 0x112944 rlValueuw 18000 NO_UNIT 0 18000 /end CHARACTERISTIC
/begin CHARACTERISTIC yTecDiag_UcCalcRawMin_GDU16 "Lower limit raw value temperature ?myC " VALUE 0x112946 rlValueuw 18000 NO_UNIT 0 18000 /end CHARACTERISTIC
/begin CHARACTERISTIC rSupplyVolt_BusBarResistance_MDF32 "Resistance of the bus bar in mOhm" VALUE 0x112A18 rlValuefl 10 OHM_REAL 0 10 /end CHARACTERISTIC
/begin CHARACTERISTIC tHighVoltChk_HighVoltDebounceTime_MDU8 "Debounce time for setting high volt status" VALUE 0x112B06 rlValueub 100 NO_UNIT 0 100 /end CHARACTERISTIC
/begin CHARACTERISTIC tHighVoltChk_HighVoltRecoverTime_MDU16 "recover time after high voltage status" VALUE 0x112B00 rlValueuw 100 T_MS 0 100 /end CHARACTERISTIC
/begin CHARACTERISTIC tHighVoltChk_PreRegHighVoltDebounceTime_GDU32 "High volt debounce time for pre-regulator voltage" VALUE 0x112A1C rlValueul 100 T_MS 0 100 /end CHARACTERISTIC
/begin CHARACTERISTIC tHighVoltChk_PreRegVoltRecoverTime_GDU32 "High volt recovery time for pre-regulator voltage " VALUE 0x112A20 rlValueul 100 T_MS 0 100 /end CHARACTERISTIC
/begin CHARACTERISTIC tLowVoltChk_LowVoltDebounceTime_MDU8 "Debounce time for setting low volt status" VALUE 0x112B07 rlValueub 100 NO_UNIT 0 100 /end CHARACTERISTIC
/begin CHARACTERISTIC tLowVoltChk_LowVoltRecoverTime_MDU16 "recover time after low voltage status" VALUE 0x112B02 rlValueuw 100 T_MS 0 100 /end CHARACTERISTIC
/begin CHARACTERISTIC tLowVoltChk_PreRegLowVoltDebounceTime_GDU32 "Low volt debounce time for pre-regulator voltage" VALUE 0x112A24 rlValueul 100 T_MS 0 100 /end CHARACTERISTIC
/begin CHARACTERISTIC tLowVoltChk_PreRegVoltRecoverTime_GDU32 "Low volt recovery time for pre-regulator voltage" VALUE 0x112A28 rlValueul 100 T_MS 0 100 /end CHARACTERISTIC
/begin CHARACTERISTIC tVoltRipl_WaitTimeStartUpVoltStable_MDU16 "Time for stable voltage during start.up" VALUE 0x112B04 rlValueuw 100 T_MS 0 100 /end CHARACTERISTIC
/begin CHARACTERISTIC uDrvVolt_ChargePumpVoltLowerThreshold_GDF32 "Lower Threshold for Charge Pump Voltage" VALUE 0x112A2C rlValuefl 33 VOLT_REAL 0 33 /end CHARACTERISTIC
/begin CHARACTERISTIC uDrvVolt_PsdVccEnableLowerThreshold_GDF32 "Lower Threshold of PSD VCC Enable Voltage value" VALUE 0x112A30 rlValuefl 0.51 VOLT_REAL 3 3.51 /end CHARACTERISTIC
/begin CHARACTERISTIC uHighVoltChk_HighVoltageRange_MDF32 "Value for high voltage status" VALUE 0x112A34 rlValuefl 36 VOLT_REAL 14 50 /end CHARACTERISTIC
/begin CHARACTERISTIC uHighVoltChk_PreRegHighVoltThreshold_GDF32 "High Volt Threshold for Pre-Regulator Voltage" VALUE 0x112A38 rlValuefl 33 VOLT_REAL 0 33 /end CHARACTERISTIC
/begin CHARACTERISTIC uLowVoltChk_LowOutputStageVoltRange_MDF32 "Voltage range for low voltage status" VALUE 0x112A3C rlValuefl 26 VOLT_REAL 4 30 /end CHARACTERISTIC
/begin CHARACTERISTIC uLowVoltChk_PreRegLowVoltThreshold_GDF32 "Low Volt Threshold for Pre-Regulator Voltage" VALUE 0x112A40 rlValuefl 33 VOLT_REAL 0 33 /end CHARACTERISTIC
/begin CHARACTERISTIC uStartUpChk_StartupHighVoltRange_MDF32 "Maximum allowed voltage during StartUp" VALUE 0x112A44 rlValuefl 15 VOLT_REAL 15 30 /end CHARACTERISTIC
/begin CHARACTERISTIC uStartUpChk_StartupLowVoltRange_MDF32 "Minimum allowed voltage during StartUp" VALUE 0x112A48 rlValuefl 26 VOLT_REAL 4 30 /end CHARACTERISTIC
/begin CHARACTERISTIC uSvoDiag_CpGduLogicVoltHighThreshold_GDF32 "High volt threshold for GduLogic charge pump volt" VALUE 0x112A4C rlValuefl 18.2 VOLT_REAL 0 18.2 /end CHARACTERISTIC
/begin CHARACTERISTIC uSvoDiag_CpGduLogicVoltLowThreshold_GDF32 "Low volt threshold for GduLogic charge pump volt" VALUE 0x112A50 rlValuefl 18.2 VOLT_REAL 0 18.2 /end CHARACTERISTIC
/begin CHARACTERISTIC uSvoDiag_CpHighVoltRangeForDiag_GDF32 "High volt threshold for charge pump volt comparison" VALUE 0x112A54 rlValuefl 33 VOLT_REAL 0 33 /end CHARACTERISTIC
/begin CHARACTERISTIC uSvoDiag_CpLowVoltRangeForDiag_GDF32 "Low volt threshold for charge pump volt comparison" VALUE 0x112A58 rlValuefl 33 VOLT_REAL 0 33 /end CHARACTERISTIC
/begin CHARACTERISTIC uSvoDiag_CpMaxDiffVoltHigh1_GDF32 "Maximum difference of charge pump volt comparison check" VALUE 0x112A5C rlValuefl 33 VOLT_REAL 0 33 /end CHARACTERISTIC
/begin CHARACTERISTIC uSvoDiag_CpMaxDiffVoltHigh2_GDF32 "Maximum difference of charge pump volt comparison check" VALUE 0x112A60 rlValuefl 33 VOLT_REAL 0 33 /end CHARACTERISTIC
/begin CHARACTERISTIC uSvoDiag_CpMaxDiffVoltLow1_GDF32 "Maximum difference of charge pump volt comparison check" VALUE 0x112A64 rlValuefl 33 VOLT_REAL 0 33 /end CHARACTERISTIC
/begin CHARACTERISTIC uSvoDiag_CpMaxDiffVoltLow2_GDF32 "Maximum difference of charge pump volt comparison check" VALUE 0x112A68 rlValuefl 33 VOLT_REAL 0 33 /end CHARACTERISTIC
/begin CHARACTERISTIC uSvoDiag_CpMaxVoltRangeForDiag_GDF32 "Max volt threshold for charge pump volt comparison" VALUE 0x112A6C rlValuefl 33 VOLT_REAL 0 33 /end CHARACTERISTIC
/begin CHARACTERISTIC uSvoDiag_HighVoltRangeForDiag_MDF32 "High voltage range during plausibilization of voltages" VALUE 0x112A70 rlValuefl 30 VOLT_REAL 0 30 /end CHARACTERISTIC
/begin CHARACTERISTIC uSvoDiag_LowVoltRangeForDiag_MDF32 "Low voltage range during plausibilization of voltages" VALUE 0x112A74 rlValuefl 30 VOLT_REAL 0 30 /end CHARACTERISTIC
/begin CHARACTERISTIC uSvoDiag_MaxDiffDcLinkOutstageN1_MDF32 "Max. allowed neg. difference during normal volt" VALUE 0x112A78 rlValuefl 40 VOLT_REAL -30 10 /end CHARACTERISTIC
/begin CHARACTERISTIC uSvoDiag_MaxDiffDcLinkOutstageN2_MDF32 "Max. allowed neg. difference during high volt" VALUE 0x112A7C rlValuefl 40 VOLT_REAL -30 10 /end CHARACTERISTIC
/begin CHARACTERISTIC uSvoDiag_MaxDiffDcLinkOutstageP1_MDF32 "Max. allowed difference between DC-Link and outpustage voltage during normal volt" VALUE 0x112A80 rlValuefl 10 VOLT_REAL 0 10 /end CHARACTERISTIC
/begin CHARACTERISTIC uSvoDiag_MaxDiffDcLinkOutstageP2_MDF32 "Max. allowed difference between DC-Link and outpustage voltage during high volt" VALUE 0x112A84 rlValuefl 10 VOLT_REAL 0 10 /end CHARACTERISTIC
/begin CHARACTERISTIC uSvoDiag_MaxDiffDriverOutstageN1_MDF32 "Max. allowed neg. difference during normal volt" VALUE 0x112A88 rlValuefl 40 VOLT_REAL -30 10 /end CHARACTERISTIC
/begin CHARACTERISTIC uSvoDiag_MaxDiffDriverOutstageN2_MDF32 "Max. allowed neg. difference during high volt" VALUE 0x112A8C rlValuefl 40 VOLT_REAL -30 10 /end CHARACTERISTIC
/begin CHARACTERISTIC uSvoDiag_MaxDiffDriverOutstageP1_MDF32 "Max. allowed difference between driver and outpustage voltage during normal volt" VALUE 0x112A90 rlValuefl 10 VOLT_REAL 0 10 /end CHARACTERISTIC
/begin CHARACTERISTIC uSvoDiag_MaxDiffDriverOutstageP2_MDF32 "Max. allowed difference between driver and outputstage voltage during high volt" VALUE 0x112A94 rlValuefl 10 VOLT_REAL 0 10 /end CHARACTERISTIC
/begin CHARACTERISTIC uSvoDiag_MaxVoltRangeForDiag_MDF32 "Max. voltage range during plausibilization of voltages" VALUE 0x112A98 rlValuefl 30 VOLT_REAL 0 30 /end CHARACTERISTIC
/begin CHARACTERISTIC uSvoDiag_MinDiffGPPOutstage_MDF32 "Min. difference between GPP and Output Stage Voltage" VALUE 0x112A9C rlValuefl 10 VOLT_REAL 0 10 /end CHARACTERISTIC
/begin CHARACTERISTIC uSvoDiag_PreRegLowVoltRangeForDiag_GDF32 "Low voltage range during PreRegVolt range check" VALUE 0x112AA0 rlValuefl 30 VOLT_REAL 0 30 /end CHARACTERISTIC
/begin CHARACTERISTIC uSvoDiag_RemoteCompHighVoltThreshold_GDF32 "High volt threshold for comparsion check remote with local DcLinkVoltage" VALUE 0x112AA4 rlValuefl 33 VOLT_REAL 0 33 /end CHARACTERISTIC
/begin CHARACTERISTIC uSvoDiag_RemoteCompLowVoltThreshold_GDF32 "Low volt threshold for comparsion check remote with local DcLinkVoltage" VALUE 0x112AA8 rlValuefl 33 VOLT_REAL 0 33 /end CHARACTERISTIC
/begin CHARACTERISTIC uSvoDiag_RemoteCompMaxVoltThreshold_GDF32 "Max volt threshold for comparsion check remote with local DcLinkVoltage" VALUE 0x112AAC rlValuefl 33 VOLT_REAL 0 33 /end CHARACTERISTIC
/begin CHARACTERISTIC uSvoDiag_RemoteMaxDiffVoltHigh1_GDF32 "Maximum difference of remote and local voltage" VALUE 0x112AB0 rlValuefl 33 VOLT_REAL 0 33 /end CHARACTERISTIC
/begin CHARACTERISTIC uSvoDiag_RemoteMaxDiffVoltHigh2_GDF32 "Maximum difference of remote and local voltage" VALUE 0x112AB4 rlValuefl 33 VOLT_REAL 0 33 /end CHARACTERISTIC
/begin CHARACTERISTIC uSvoDiag_RemoteMaxDiffVoltLow1_GDF32 "Maximum difference of remote and local voltage" VALUE 0x112AB8 rlValuefl 38 VOLT_REAL -5 33 /end CHARACTERISTIC
/begin CHARACTERISTIC uSvoDiag_RemoteMaxDiffVoltLow2_GDF32 "Maximum difference of remote and local voltage" VALUE 0x112ABC rlValuefl 38 VOLT_REAL -5 33 /end CHARACTERISTIC
/begin CHARACTERISTIC uVoltRipl_StartupRippleVoltRange_MDF32 "Maximum allowed voltage ripple range during StartUp" VALUE 0x112AC0 rlValuefl 5 VOLT_REAL 1 6 /end CHARACTERISTIC
/begin CHARACTERISTIC xHwConfI_VBATC_k_Fact_GDF32 "VBAT_C transmission factor" VALUE 0x112AC4 rlValuefl 100 NO_UNIT 0 100 /end CHARACTERISTIC
/begin CHARACTERISTIC xHwConfI_VBATP_k_Fact_GDF32 "VBATP gain factor" VALUE 0x112AC8 rlValuefl 100 NO_UNIT 0 100 /end CHARACTERISTIC
/begin CHARACTERISTIC xHwConfI_VPFBx_k_Fact_GDF32 "Phase feedback voltage gain factor" VALUE 0x112ACC rlValuefl 100 NO_UNIT 0 100 /end CHARACTERISTIC
/begin CHARACTERISTIC yDrvVolt_k_CpGduLogic_GDF32 "GduLogic voltage Charge Pump Voltage Gain" VALUE 0x112AD0 rlValuefl 100 NO_UNIT 0 100 /end CHARACTERISTIC
/begin CHARACTERISTIC yDrvVolt_k_CPMESS_GDF32 "Charge Pump Voltage Gain" VALUE 0x112AD4 rlValuefl 100 NO_UNIT 0 100 /end CHARACTERISTIC
/begin CHARACTERISTIC yDrvVolt_k_PSDVCC_GDF32 "Output Driver Logic Voltage Gain" VALUE 0x112AD8 rlValuefl 100 NO_UNIT 0 100 /end CHARACTERISTIC
/begin CHARACTERISTIC yFiltVolt_FactorDeltaTimeToTau_MDF32 "Factor: (delta_t = 1 ms  / T = 10ms )" VALUE 0x112ADC rlValuefl 8 NO_UNIT 0 8 /end CHARACTERISTIC
/begin CHARACTERISTIC ySvoCalc_k_UKL15_GDF32 "Ignition Voltage transmission factor" VALUE 0x112AE0 rlValuefl 100 NO_UNIT 0 100 /end CHARACTERISTIC
/begin CHARACTERISTIC ySvoCalc_k_VBAT_FS_GDF32 "VBAT_FS transmission factor" VALUE 0x112AE4 rlValuefl 100 NO_UNIT 0 100 /end CHARACTERISTIC
/begin CHARACTERISTIC ySvoCalc_k_VBAT_P_GDF32 "K_VBAT_P factor for C3A Backup B sample" VALUE 0x112AE8 rlValuefl 1 NO_UNIT 10 11 /end CHARACTERISTIC
/begin CHARACTERISTIC ySvoCalc_kUGPP_Slope_GDF32 "GPP Voltage Slope" VALUE 0x112AEC rlValuefl 100 NO_UNIT 0 100 /end CHARACTERISTIC
/begin CHARACTERISTIC ySvoDiag_CpCompChkFilterTime_GDU8 "Prefilter time for CP voltage comparison check failure" VALUE 0x112B08 rlValueub 100 NO_UNIT 0 100 /end CHARACTERISTIC
/begin CHARACTERISTIC ySvoDiag_MinCyclesCpGduLogicOn_GDU8 "Minimum number of cycles for enabling GduLogic chargepump voltage" VALUE 0x112B09 rlValueub 50 NO_UNIT 0 50 /end CHARACTERISTIC
/begin CHARACTERISTIC ySvoDiag_MinCyclesCpOn_GDU32 "Min. number of cycles CP to be enabled for staring the comp check" VALUE 0x112AF0 rlValueul 100 NO_UNIT 0 100 /end CHARACTERISTIC
/begin CHARACTERISTIC ySvoFsa_DebounceCountUpFactor_MDF32 "Factor for 6 ms debounce count up time" VALUE 0x112AF4 rlValuefl 1 NO_UNIT 0 1 /end CHARACTERISTIC
/begin CHARACTERISTIC yU1V25_k_U1V25_MDF32 "U1V25 transmission factor" VALUE 0x112AF8 rlValuefl 100 NO_UNIT 0 100 /end CHARACTERISTIC
/begin CHARACTERISTIC yVoltReg_k_U_VOUTSR_GDF32 "Pre-Regulator Voltage Gain" VALUE 0x112AFC rlValuefl 100 NO_UNIT 0 100 /end CHARACTERISTIC
/begin CHARACTERISTIC cHwConfI_MinDeltaTempNvShare_GDF32 "The minimum difference between RT and HT temperatures in NVShare dead-time blocks to let the blocks be considered as valid" VALUE 0x1129F8 rlValuefl 170 NO_UNIT 10 180 /end CHARACTERISTIC
/begin CHARACTERISTIC cHwConfI_TempLowerBoundForDeadTimeCurve_GDS16 "The temperature lower bound in dead-time curve" VALUE 0x112A0C rlValuesw 70 NO_UNIT -70 0 /end CHARACTERISTIC
/begin CHARACTERISTIC cHwConfI_TempUpperBoundForDeadTimeCurve_GDS16 "The temperature higher bound in dead-time curve" VALUE 0x112A0E rlValuesw 50 NO_UNIT 100 150 /end CHARACTERISTIC
/begin CHARACTERISTIC sHwConfI_UseIndividualDeadTime_GDU8 "Use individual dead time for the NvShare | 0: Use single dead time from default data" VALUE 0x112A16 rlValueub 1 NO_UNIT 0 1 /end CHARACTERISTIC
/begin CHARACTERISTIC tHwConfI_AdcTriggerTime_GDF32 "ADC Trigger time in us" VALUE 0x1129FC rlValuefl 8 T_US -4 4 /end CHARACTERISTIC
/begin CHARACTERISTIC tHwConfI_DeadTimeLowerLimit_GDU16 "The minimum valid dead-time" VALUE 0x112A10 rlValueuw 600 T_NS 400 1000 /end CHARACTERISTIC
/begin CHARACTERISTIC tHwConfI_DeadTimeUpperLimit_GDU16 "The maximum valid dead-time" VALUE 0x112A12 rlValueuw 400 T_NS 1200 1600 /end CHARACTERISTIC
/begin CHARACTERISTIC tHwConfI_DeadTimeUpperNvShareLimit_GDU16 "The maximum acceptable NVShare dead-time values." VALUE 0x112A14 rlValueuw 350 T_NS 1500 1850 /end CHARACTERISTIC
/begin CHARACTERISTIC tHwConfI_MosfetDeadTimeNs_GDS "Deadtime Charatcteristic" CURVE 0x140994 rlCurveuw 1200 T_NS 400 1600
 /begin AXIS_DESCR STD_AXIS yPowOut_GpTempCalc_gdu16 TEMP_INT 3 -70 185 DEPOSIT ABSOLUTE /end AXIS_DESCR
/end CHARACTERISTIC
/begin CHARACTERISTIC yHwConfI_MaxCurveGradient_GDF32 "The maximum gradient of the dead-time values with regards to the RT and HT temperatures in NVShare dead-time blocks to let the blocks be considered valid" VALUE 0x112A00 rlValuefl 10 NO_UNIT 10 20 /end CHARACTERISTIC
/begin CHARACTERISTIC yHwConfI_MaxMeasPwm_GDF32 "The maximum PWM duty-cycle of the PWM-cycle that the phase current is captured by ADC" VALUE 0x112A04 rlValuefl 10 NO_UNIT 80 90 /end CHARACTERISTIC
/begin CHARACTERISTIC yHwConfI_MinCurveGradient_GDF32 "The minimum gradient between dead-time values with regards to the RT and HT temperatures in NVShare dead-time blocks to let the blocks be considered as valid" VALUE 0x112A08 rlValuefl 0.9 NO_UNIT 0.1 1 /end CHARACTERISTIC
/begin CHARACTERISTIC iFastPscChk_MaxCurrent_MDF32 "Max  phase current during LAT " VALUE 0x1129B8 rlValuefl 5 CURR_REAL 0 5 /end CHARACTERISTIC
/begin CHARACTERISTIC nLatI_MaxRotorSpeed_gdf32 "Maximum rotor speed during LAT [rad/s]" VALUE 0x1129BC rlValuefl 2000 ANG_VEL_REAL 0 2000 /end CHARACTERISTIC
/begin CHARACTERISTIC tDriverVoltOffDelay_MDU16 "Delay for switching off driver voltage" VALUE 0x1129EC rlValueuw 100 T_MS 0 100 /end CHARACTERISTIC
/begin CHARACTERISTIC tHwConfI_ClosePhasesDelay_GDU8 "Close phase separation FETs delay" VALUE 0x1129F4 rlValueub 20 T_MS 0 20 /end CHARACTERISTIC
/begin CHARACTERISTIC tHwConfI_OVDriverOnDelay_GDU8 "Delay for switching on driver voltage for Vcc OV Check" VALUE 0x1129F5 rlValueub 10 T_MS 0 10 /end CHARACTERISTIC
/begin CHARACTERISTIC tHwConfI_PhVoltChkInitialWaitTime_GDU16 "Initial wait time in ms for Phase voltage check." VALUE 0x1129EE rlValueuw 100 T_MS 0 100 /end CHARACTERISTIC
/begin CHARACTERISTIC tHwConfI_PhVoltChkStableTime_GDU16 "Stablisation time in ms for Phase voltage check" VALUE 0x1129F0 rlValueuw 100 T_MS 0 100 /end CHARACTERISTIC
/begin CHARACTERISTIC tHwConfI_SlowPscCheckMinDelay_GDU8 "Min delay where phase separation FETs must be still closed" VALUE 0x1129F6 rlValueub 20 T_MS 0 20 /end CHARACTERISTIC
/begin CHARACTERISTIC tHwConfI_SlowPscChkMaxDelay_GDU8 "Max delay where phase separation FETs must be opened" VALUE 0x1129F7 rlValueub 255 T_MS 0 255 /end CHARACTERISTIC
/begin CHARACTERISTIC tHwConfI_SupplyGcrWaitDelay_GDU16 "wait time for VB and GCR Settings" VALUE 0x1129F2 rlValueuw 100 T_MS 0 100 /end CHARACTERISTIC
/begin CHARACTERISTIC uDriverVoltOffMaxVal_MDF32 "Minimum voltage level after switching off driver voltage" VALUE 0x1129C0 rlValuefl 10 VOLT_REAL 0 10 /end CHARACTERISTIC
/begin CHARACTERISTIC uHwConfI_LatRefOutputStageVolt_GDF32 "Voltage value for normalization" VALUE 0x1129C4 rlValuefl 30 VOLT_REAL 0 30 /end CHARACTERISTIC
/begin CHARACTERISTIC uHwConfI_PhVoltChkOutstageMaxDiff_GDF32 "Maximum difference outstage voltage." VALUE 0x1129C8 rlValuefl 100 VOLT_REAL 0 100 /end CHARACTERISTIC
/begin CHARACTERISTIC uHwConfI_VccOnThreshold_GDF32 "Threshold of PSD VCC Enable Voltage Value" VALUE 0x1129CC rlValuefl 0.61 VOLT_REAL 2.9 3.51 /end CHARACTERISTIC
/begin CHARACTERISTIC yLatI_TestPwmMax_GDF32 "Maximum PWM" VALUE 0x1129D0 rlValuefl 100 NO_UNIT 0 100 /end CHARACTERISTIC
/begin CHARACTERISTIC yLatI_TestPwmMin_GDF32 "Minimum PWM" VALUE 0x1129D4 rlValuefl 100 NO_UNIT 0 100 /end CHARACTERISTIC
/begin CHARACTERISTIC yLatI_TestPwmNeutral_GDF32 "Neutral PWM" VALUE 0x1129D8 rlValuefl 100 NO_UNIT 0 100 /end CHARACTERISTIC
/begin CHARACTERISTIC ySigCoo_TestPwmHigh_MDF32 "High PWM" VALUE 0x1129DC rlValuefl 100 NO_UNIT 0 100 /end CHARACTERISTIC
/begin CHARACTERISTIC ySigCoo_TestPwmLow_MDF32 "Low PWM" VALUE 0x1129E0 rlValuefl 100 NO_UNIT 0 100 /end CHARACTERISTIC
/begin CHARACTERISTIC ySigCoo_TestPwmShoot_MDF32 "Test PWM for Shoot Through Check" VALUE 0x1129E4 rlValuefl 100 NO_UNIT 0 100 /end CHARACTERISTIC
/begin CHARACTERISTIC yTstCooI_MaxAllowedPwmPfbDifference_GDF32 "Maximum difference between PWM and phase feedback in percent" VALUE 0x1129E8 rlValuefl 10 NO_UNIT 0 10 /end CHARACTERISTIC
/begin CHARACTERISTIC cProt_DcLinkCapTempPoints_GAF32 "Temperatur points for capacitor delta temperature reduction" VAL_BLK 0x112B70 rlValuefl 100 NO_UNIT 0 100 NUMBER 5 /end CHARACTERISTIC
/begin CHARACTERISTIC iHwConfI_PstTestCurr_GAF32 "Amplitude test current 1 and 2" VAL_BLK 0x141CF8 rlValuefl 24 CURR_REAL 0 24 NUMBER 2 /end CHARACTERISTIC
/begin CHARACTERISTIC iMcDiag_UcmpLIsqRefDiagBorder_GDF32 "quadrature reference current threshold - above UCMP_LENGTH is evaluated" VALUE 0x141D28 rlValuefl 160 CURR_REAL 0 160 /end CHARACTERISTIC
/begin CHARACTERISTIC mHwConfI_PlausiAbsLimitAdd4Gen_GAF32 "Torque by which limits increased at hight rotor speed in generatoric mode (0: FOC, 1: FOS, 2: OC)" VAL_BLK 0x141DC0 rlValuefl 2 TORQ_REAL 0 2 NUMBER 3 /end CHARACTERISTIC
/begin CHARACTERISTIC mHwConfI_PlausiLimitMAbsMaxBlock_GAF32 "Absolut max. torque for limit of blocking (0: FOC, 1: FOS, 2: OC)" VAL_BLK 0x141DCC rlValuefl 24 TORQ_REAL -12 12 NUMBER 3 /end CHARACTERISTIC
/begin CHARACTERISTIC mHwConfI_PlausiLimitMHighBlock_GAF32 "Limit for blocking at full motor torque (0: FOC, 1: FOS, 2: OC)" VAL_BLK 0x141DD8 rlValuefl 12 TORQ_REAL 0 12 NUMBER 3 /end CHARACTERISTIC
/begin CHARACTERISTIC mHwConfI_PlausiLimitMHighUaf_GAF32 "Limit for UAF at full motor torque (0: FOC, 1: FOS, 2: OC)" VAL_BLK 0x141DE4 rlValuefl 12 TORQ_REAL 0 12 NUMBER 3 /end CHARACTERISTIC
/begin CHARACTERISTIC mHwConfI_PlausiLimitMZero_GAF32 "Allowed difference between requested torque and boundary for UAF and Block with zero request (0: FOC, 1: FOS, 2: OC)" VAL_BLK 0x141DF0 rlValuefl 12 TORQ_REAL 0 12 NUMBER 3 /end CHARACTERISTIC
/begin CHARACTERISTIC mHwConfI_PlausiMaxMDown_GAF32 "max allowed down integration (0: FOC, 1: FOS, 2: OC)" VAL_BLK 0x141DFC rlValuefl 12 TORQ_REAL 0 12 NUMBER 3 /end CHARACTERISTIC
/begin CHARACTERISTIC mMcPlausi_MaxInteg_GAF32 "Integral limit for error entry without reduction  (0: FOC, 1: FOS, 2: OC)" VAL_BLK 0x141E08 rlValuefl 50 TORQ_REAL 0 50 NUMBER 3 /end CHARACTERISTIC
/begin CHARACTERISTIC mMcPlausi_MaxIntegRedLimit_GAF32 "Min upper integral limit  (0: FOC, 1: FOS, 2: OC)" VAL_BLK 0x141E14 rlValuefl 50 TORQ_REAL 0 50 NUMBER 3 /end CHARACTERISTIC
/begin CHARACTERISTIC nHwConfI_PstMaxRotSpeed4Off_GDF32 "rpm threshold to abort the test" VALUE 0x141D2C rlValuefl 1000 RPM_REAL 0 1000 /end CHARACTERISTIC
/begin CHARACTERISTIC nHwConfI_PstMaxRotSpeed4On_GDF32 "rpm threshold to start the test" VALUE 0x141D30 rlValuefl 1000 RPM_REAL 0 1000 /end CHARACTERISTIC
/begin CHARACTERISTIC nMcDiag_RotAngleCompare_GDF32 "Activation threshold for ROTPOS in rpm" VALUE 0x141D34 rlValuefl 15000 NO_UNIT 0 15000 /end CHARACTERISTIC
/begin CHARACTERISTIC nMcDiag_RotUcmpAngle_GDF32 "Activation threshold for UCMP_ANGLE in rpm" VALUE 0x141D38 rlValuefl 6000 NO_UNIT 0 6000 /end CHARACTERISTIC
/begin CHARACTERISTIC nMcDiag_RotUcmpLength_GDF32 "Activation threshold for UCMP_LENGTH in rpm" VALUE 0x141D3C rlValuefl 6000 NO_UNIT 0 6000 /end CHARACTERISTIC
/begin CHARACTERISTIC rHwConfI_PstMaxImp_GDF32 "Maximum allowed impedance" VALUE 0x141D40 rlValuefl 1.999 NO_UNIT 0.001 2 /end CHARACTERISTIC
/begin CHARACTERISTIC rHwConfI_PstMaxImpDiff_GDF32 "Maximum allowed difference between both calculated impedance in Testcurrent 1 and 2." VALUE 0x141D44 rlValuefl 1.999 NO_UNIT 0.001 2 /end CHARACTERISTIC
/begin CHARACTERISTIC sHwConfI_CogCompEnable_GDU8 "enable/ disable cogging torque calculation " VALUE 0x120074 rlValueub 1 NO_UNIT 0 1 /end CHARACTERISTIC
/begin CHARACTERISTIC sMcPlausi_DelayRefCalibMotorTorque_GDU8 "Delay in Calibrated Requested Motor Torque (2: 2ms, 1: 1ms, 0: No)" VALUE 0x141DB4 rlValueub 2 NO_UNIT 0 2 /end CHARACTERISTIC
/begin CHARACTERISTIC tHwConfI_McDiagAngleCompareDebDelay_GDU8 "Time delay for showing maximum Debounce value in McDiag Rotor position. (ms)" VALUE 0x141DB5 rlValueub 200 T_MS 0 200 /end CHARACTERISTIC
/begin CHARACTERISTIC tHwConfI_McDiagAngleCompareTemporizeErrorTime_GDU16 "Time to temporize before actually triggering an McDiag Rotor position error. (ms)" VALUE 0x141D94 rlValueuw 100 T_MS 0 100 /end CHARACTERISTIC
/begin CHARACTERISTIC tHwConfI_McDiagUcmpAngleDebDelay_GDU8 "Time delay for showing maximum Debounce value in McDiag Ucmp Angle (ms)" VALUE 0x141DB6 rlValueub 200 T_MS 0 200 /end CHARACTERISTIC
/begin CHARACTERISTIC tHwConfI_McDiagUcmpAngTemporizeErrorTime_GDU16 "Time to temporize before actually triggering an McDiag Angle error. (ms)" VALUE 0x141D96 rlValueuw 100 T_MS 0 100 /end CHARACTERISTIC
/begin CHARACTERISTIC tHwConfI_McDiagUcmpLengthDebDelay_GDU8 "Time delay for showing maximum Debounce value in McDiag Ucmp Length. (ms)" VALUE 0x141DB7 rlValueub 200 T_MS 0 200 /end CHARACTERISTIC
/begin CHARACTERISTIC tHwConfI_McDiagUcmpLenTemporizeErrorTime_GDU16 "Time to temporize before actually triggering an McDiag Length error in ms" VALUE 0x141D98 rlValueuw 100 T_MS 0 100 /end CHARACTERISTIC
/begin CHARACTERISTIC tHwConfI_McPlausiDebDelay_GDU8 "Time delay for showing maximum Debounce delay in McPlausi. (ms)" VALUE 0x141DB8 rlValueub 200 T_MS 0 200 /end CHARACTERISTIC
/begin CHARACTERISTIC tHwConfI_PstSpeedMaxWaitTime_GDF32 "Waiting time for rotor speed below threshold" VALUE 0x141D48 rlValuefl 5 T_S 0 5 /end CHARACTERISTIC
/begin CHARACTERISTIC tHwConfI_PstTestTimeFall_GDF32 "Fall time back to zero current" VALUE 0x141D4C rlValuefl 0.019 T_S 0.001 0.02 /end CHARACTERISTIC
/begin CHARACTERISTIC tHwConfI_PstTestTimeHold_GAF32 "Time for test current 1" VAL_BLK 0x141D00 rlValuefl 0.485 T_S 0.015 0.5 NUMBER 2 /end CHARACTERISTIC
/begin CHARACTERISTIC tHwConfI_PstTestTimePostWait_GDF32 "Waiting time after test current falling" VALUE 0x141D50 rlValuefl 0.49 T_S 0.01 0.5 /end CHARACTERISTIC
/begin CHARACTERISTIC tHwConfI_PstTestTimePreWait_GDF32 "Waiting time before test current rising" VALUE 0x141D54 rlValuefl 0.49 T_S 0.01 0.5 /end CHARACTERISTIC
/begin CHARACTERISTIC tHwConfI_PstTestTimeRise_GDF32 "Rising time to next step" VALUE 0x141D58 rlValuefl 0.019 T_S 0.001 0.02 /end CHARACTERISTIC
/begin CHARACTERISTIC tHwConfI_RpcDebounceTime_GAU8 "Debounce time of RPC errors [0] HWLMON_ROTPOS1_SIGNAL_VECTOR [1] HWLMON_ROTPOS1_SIGNAL_OFFSET [2] HWLMON_ROTPOS2_SIGNAL_VECTOR not used in SingleRps [3] HWLMON_ROTPOS2_SIGNAL_OFFSET not used in SingleRps" VAL_BLK 0x112B30 rlValueub 18 T_MS 2 20 NUMBER 4 /end CHARACTERISTIC
/begin CHARACTERISTIC tMcPlausi_MaxIntegRedLimitWaitTime_GAU16 "Dead time for upper integral limit reduction  (0: FOC, 1: FOS, 2: OC)" VAL_BLK 0x141D9C rlValueuw 100 NO_UNIT 0 100 NUMBER 3 /end CHARACTERISTIC
/begin CHARACTERISTIC tMcPlausi_TemporizeErrorTime_GDU16 "Time to temporize before actually triggering an McPlausi error in ms" VALUE 0x141DA4 rlValueuw 100 T_MS 0 100 /end CHARACTERISTIC
/begin CHARACTERISTIC tOsc_SwitchOffOutstage_GDU16 "Switch off outputstage after time" VALUE 0x112B50 rlValueuw 5000 T_MS 0 5000 /end CHARACTERISTIC
/begin CHARACTERISTIC tProt_DcLinkCapBufferTime_GDU8 "Dc link cap buffer time" VALUE 0x112B64 rlValueub 200 NO_UNIT 0 200 /end CHARACTERISTIC
/begin CHARACTERISTIC tProt_OutOverVoltDebounceTime_GDS "Charakteristik curve for debounce timing in case of over voltage in 10ms steps" CURVE 0x112B84 rlCurvefl 2000 NO_UNIT 0 2000
 /begin AXIS_DESCR STD_AXIS uSvoI_OutputStageVoltage_gdf32 VOLT_REAL 6 0 1000 DEPOSIT ABSOLUTE /end AXIS_DESCR
/end CHARACTERISTIC
/begin CHARACTERISTIC tProt_SafetyRampTiming_GAU8 "Wait time until ramp down reduction factor (FOS,FOSRamp,SC,OC,Sensorless)" VAL_BLK 0x141DA8 rlValueub 255 NO_UNIT 0 255 NUMBER 6 /end CHARACTERISTIC
/begin CHARACTERISTIC tStcPasDiag_PasPtcolFltDeb_GDU8 "Debounce time for the Pas protocol errors" VALUE 0x112B65 rlValueub 19 T_MS 1 20 /end CHARACTERISTIC
/begin CHARACTERISTIC tStcPasDiag_RadiusFltDeb_GDU8 "Debounce time for radius eroor" VALUE 0x112B66 rlValueub 19 T_MS 1 20 /end CHARACTERISTIC
/begin CHARACTERISTIC tStcPasDiag_SnsrSplyCrticalFltDeb_GDU8 "DMSSensor supply critical filter debounce time" VALUE 0x112B67 rlValueub 8 T_MS 0 8 /end CHARACTERISTIC
/begin CHARACTERISTIC tStcPasDiag_SnsrSplyFltDeb_GDU8 "DMS sensor supply filter debounce time" VALUE 0x112B68 rlValueub 19 T_MS 1 20 /end CHARACTERISTIC
/begin CHARACTERISTIC tStcPasDiag_TorqueFltDeb_GDU8 "Debounce time for torque related error (torque gradient /max torque jump)" VALUE 0x112B69 rlValueub 20 T_MS 0 20 /end CHARACTERISTIC
/begin CHARACTERISTIC uHwConfI_McDiagMaxDiffUcmpD_GDS "allowed UCmp voltage difference in d-axis" CURVE 0x141E20 rlCurvefl 47.75 VOLT_REAL 0.25 48
 /begin AXIS_DESCR STD_AXIS nSigProcI_RotorSpeedFiltAbs_gdf32 NO_UNIT 4 -10000 10000 DEPOSIT ABSOLUTE /end AXIS_DESCR
/end CHARACTERISTIC
/begin CHARACTERISTIC uHwConfI_McDiagMaxDiffUcmpQ_GDS "allowed UCmp voltage difference in q-axis" CURVE 0x141E44 rlCurvefl 47 VOLT_REAL 1 48
 /begin AXIS_DESCR STD_AXIS nSigProcI_RotorSpeedFiltAbs_gdf32 NO_UNIT 4 -10000 10000 DEPOSIT ABSOLUTE /end AXIS_DESCR
/end CHARACTERISTIC
/begin CHARACTERISTIC uHwConfI_McDiagMaxIntegUcmpD_GDF32 "Error integral threshold for UCmp in d-axis" VALUE 0x141D5C rlValuefl 127.9 VOLT_REAL 0.1 128 /end CHARACTERISTIC
/begin CHARACTERISTIC uHwConfI_McDiagMaxIntegUcmpQ_GDF32 "Error integral threshold for UCmp in q-axis" VALUE 0x141D60 rlValuefl 127.9 VOLT_REAL 0.1 128 /end CHARACTERISTIC
/begin CHARACTERISTIC uHwConfI_PstMaxVoltDrop_GDF32 "Maximum allowed delta of measured voltage before and after the test." VALUE 0x141D64 rlValuefl 5 VOLT_REAL 0 5 /end CHARACTERISTIC
/begin CHARACTERISTIC uHwConfI_PstTestMinVolt_GDF32 "Voltage threshold. Directly abort the test to avoid reset." VALUE 0x141D68 rlValuefl 6 VOLT_REAL 9 15 /end CHARACTERISTIC
/begin CHARACTERISTIC uHwConfI_PstTestRobustMinVolt_GDF32 "Voltage threshold for robustness. Average last 10ms during test current." VALUE 0x141D6C rlValuefl 6 VOLT_REAL 9 15 /end CHARACTERISTIC
/begin CHARACTERISTIC uMcDiag_MaxDiffUcmpLength_GDS "allowed UCMP length difference" CURVE 0x141E68 rlCurvefl 512 VOLT_REAL 0 512
 /begin AXIS_DESCR STD_AXIS nSigProcI_RotorSpeedFiltAbs_gdf32 NO_UNIT 4 -10000 10000 DEPOSIT ABSOLUTE /end AXIS_DESCR
/end CHARACTERISTIC
/begin CHARACTERISTIC uMcDiag_MaxIntegUcmpLength_GDF32 "maximum integration value of UCMP length difference" VALUE 0x141D70 rlValuefl 500 VOLT_REAL 0 500 /end CHARACTERISTIC
/begin CHARACTERISTIC uSaf_SuddenLossMaxVoltage_GDF32 "Over voltage (e.g. load dump) where sudden loss is allowed" VALUE 0x112B34 rlValuefl 40 VOLT_REAL 0 40 /end CHARACTERISTIC
/begin CHARACTERISTIC uStcPasDiag_RealUVLowerThd_GDF32 "Undervoltage limit of ignition supply in STC" VALUE 0x112B38 rlValuefl 9 VOLT_REAL 1 10 /end CHARACTERISTIC
/begin CHARACTERISTIC uStcPasDiag_RealUVUpperThd_GDF32 "Undervoltage upper limit of ignition supply in STC to switch to normal" VALUE 0x112B3C rlValuefl 9 VOLT_REAL 1 10 /end CHARACTERISTIC
/begin CHARACTERISTIC wHwConfI_RpcHBrdgDiagMaxAngleDiff_GDF32 "Maximum angle difference between two channel in Half bridge operation mode. Default value is 4?." VALUE 0x112B40 rlValuefl 0.10472 NO_UNIT 0 0.10471976 /end CHARACTERISTIC
/begin CHARACTERISTIC wMcDiag_MaxDiffAngleCompare_GDF32 "allowed angle difference between rotor position and calculated angle in degree" VALUE 0x141D74 rlValuefl 2880 NO_UNIT 0 2880 /end CHARACTERISTIC
/begin CHARACTERISTIC wMcDiag_MaxDiffUcmpAngleGen_GDS "allowed UCMP angle difference in generatoric mode" CURVE 0x141E8C rlCurvefl 2880 NO_UNIT 0 2880
 /begin AXIS_DESCR STD_AXIS nSigProcI_RotorSpeedFiltAbs_gdf32 NO_UNIT 4 -10000 10000 DEPOSIT ABSOLUTE /end AXIS_DESCR
/end CHARACTERISTIC
/begin CHARACTERISTIC wMcDiag_MaxDiffUcmpAngleMot_GDS "allowed UCMP angle difference in motoric mode" CURVE 0x141EB0 rlCurvefl 2880 NO_UNIT 0 2880
 /begin AXIS_DESCR STD_AXIS nSigProcI_RotorSpeedFiltAbs_gdf32 NO_UNIT 4 -10000 10000 DEPOSIT ABSOLUTE /end AXIS_DESCR
/end CHARACTERISTIC
/begin CHARACTERISTIC wMcDiag_MaxIntegAngleCompare_GDF32 "maximum integration value of angle difference in degree" VALUE 0x141D78 rlValuefl 680 NO_UNIT 0 680 /end CHARACTERISTIC
/begin CHARACTERISTIC wMcDiag_MaxIntegUcmpAngle_GDF32 "maximum integration value of angle difference in degree" VALUE 0x141D7C rlValuefl 680 NO_UNIT 0 680 /end CHARACTERISTIC
/begin CHARACTERISTIC xHwConfI_PstMinBatCurrFac_GDF32 "Factor for calculation of minimum allowed battery current in dependency of reference battery current." VALUE 0x141D80 rlValuefl 1 NO_UNIT 0 1 /end CHARACTERISTIC
/begin CHARACTERISTIC xHwConfI_ScuTypRotOrCompAmpFactNeg_GAF32 "Amplitude factor compensation value valid for negative LimitedMotorTorque" VAL_BLK 0x141D08 rlValuefl 0.000174533 NO_UNIT 0 0.000174533 NUMBER 2 /end CHARACTERISTIC
/begin CHARACTERISTIC xHwConfI_ScuTypRotOrCompAmpFactPos_GAF32 "Amplitude factor compensation value valid for positive LimitedMotorTorque" VAL_BLK 0x141D10 rlValuefl 0.000174533 NO_UNIT 0 0.000174533 NUMBER 2 /end CHARACTERISTIC
/begin CHARACTERISTIC xHwConfI_ScuTypRotOrCompPhaseNeg_GAF32 "Amplitude factor compensation value valid for negative LimitedMotorTorque" VAL_BLK 0x141D18 rlValuefl 6.28318 NO_UNIT 0 6.28318 NUMBER 2 /end CHARACTERISTIC
/begin CHARACTERISTIC xHwConfI_ScuTypRotOrCompPhasePos_GAF32 "Phase compensation value valid for positive LimitedMotorTorque" VAL_BLK 0x141D20 rlValuefl 6.28318 NO_UNIT 0 6.28318 NUMBER 2 /end CHARACTERISTIC
/begin CHARACTERISTIC xMcPlausi_MaxIntegRedGrad_GAF32 "Reduction gradient of the upper integral limit  (0: FOC, 1: FOS, 2: OC)" VAL_BLK 0x141ED4 rlValuefl 15 NO_UNIT 0 15 NUMBER 3 /end CHARACTERISTIC
/begin CHARACTERISTIC xProt_DcLinkCapErrSubst_GDU16 "Substitute value for invalid signal of capacitor temperature" VALUE 0x112B52 rlValueuw 100 PERCENT_INT 0 100 /end CHARACTERISTIC
/begin CHARACTERISTIC xProt_DcLinkCapRedCurve1_GDS "Power reduction factor due to overtemperature of capacitor" CURVE 0x120004 rlCurveuw 100 PERCENT_INT 0 100
 /begin AXIS_DESCR STD_AXIS cTecI_DcLinkCapTemp_gdu8 TEMP_INT 5 -70 185 DEPOSIT ABSOLUTE /end AXIS_DESCR
/end CHARACTERISTIC
/begin CHARACTERISTIC xProt_DcLinkCapRedLess_GDU16 "Capacitor reduction less limit" VALUE 0x112B54 rlValueuw 100 PERCENT_INT 0 100 /end CHARACTERISTIC
/begin CHARACTERISTIC xProt_FetCorrFilt_GDF32 "filter constant for gain correction" VALUE 0x141D84 rlValuefl 1 NO_UNIT 0 1 /end CHARACTERISTIC
/begin CHARACTERISTIC xProt_FetCorrTrans_GDF32 "Transition constant for gain correction" VALUE 0x141D88 rlValuefl 10 NO_UNIT 0 10 /end CHARACTERISTIC
/begin CHARACTERISTIC xProt_FetErrSubst_GDU16 "Substitute value for invalid signal of FET temperature" VALUE 0x112B56 rlValueuw 100 PERCENT_INT 0 100 /end CHARACTERISTIC
/begin CHARACTERISTIC xProt_FetIPartTemp_GDU8 "Factor for I part at temperature" VALUE 0x112B6A rlValueub 200 NO_UNIT 0 200 /end CHARACTERISTIC
/begin CHARACTERISTIC xProt_FetLimStartTemp_GDS "Temperature at which FET protection starts" CURVE 0x112BEC rlCurveuw 200 NO_UNIT 0 200
 /begin AXIS_DESCR STD_AXIS cTecI_GroundPlateTemp_gdu8 TEMP_INT 3 -70 185 DEPOSIT ABSOLUTE /end AXIS_DESCR
/end CHARACTERISTIC
/begin CHARACTERISTIC xProt_FetPPartTemp_GDU8 "Factor for P part at temperature" VALUE 0x112B6B rlValueub 200 NO_UNIT 0 200 /end CHARACTERISTIC
/begin CHARACTERISTIC xProt_MotCoilRedCurve_GDS "Charakteristic curve for the actual target reduktion factor, dependig on temperature" CURVE 0x12001C rlCurveuw 100 PERCENT_INT 0 100
 /begin AXIS_DESCR STD_AXIS cTecI_CoilTemp_gdu16 TEMP_INT 2 -70 350 DEPOSIT ABSOLUTE /end AXIS_DESCR
/end CHARACTERISTIC
/begin CHARACTERISTIC xProt_MotErrSubst_GDU16 "Substitute value for invalid signal of mot temperature" VALUE 0x112B58 rlValueuw 100 PERCENT_INT 0 100 /end CHARACTERISTIC
/begin CHARACTERISTIC xProt_OutTempErrSubst_GDU16 "Substitute value for invalid signal of DBC temperature sensor" VALUE 0x112B5A rlValueuw 100 PERCENT_INT 0 100 /end CHARACTERISTIC
/begin CHARACTERISTIC xProt_OutTempRedCurve_GDS "Power reduction factor due to overtemperature of DBC" CURVE 0x120028 rlCurveuw 100 PERCENT_INT 0 100
 /begin AXIS_DESCR STD_AXIS cTecI_OutstageTemp_gdu8 TEMP_INT 5 -70 185 DEPOSIT ABSOLUTE /end AXIS_DESCR
/end CHARACTERISTIC
/begin CHARACTERISTIC xProt_PcbErrSubst_GDU16 "Substitute value for invalid signal of DBC temperature sensor" VALUE 0x112B5C rlValueuw 100 PERCENT_INT 0 100 /end CHARACTERISTIC
/begin CHARACTERISTIC xProt_PcbRedCurve_GDS "Power reduction factor due to overtemperature of PCB" CURVE 0x120040 rlCurveuw 100 PERCENT_INT 0 100
 /begin AXIS_DESCR STD_AXIS cHwlI_BoardTemp_gdu8 TEMP_INT 5 -70 185 DEPOSIT ABSOLUTE /end AXIS_DESCR
/end CHARACTERISTIC
/begin CHARACTERISTIC xProt_SafetyRampLevel_GAU16 "Reduction level after wait time (FOS,FOSRamp,SC,OC,Sensorless)" VAL_BLK 0x141EE0 rlValueuw 100 PERCENT_INT 0 100 NUMBER 6 /end CHARACTERISTIC
/begin CHARACTERISTIC xProt_SafetyRampSensorLessLevel_GDU16 "Safety ramp reduction level RPC sensor less " VALUE 0x141DB0 rlValueuw 100 PERCENT_INT 0 100 /end CHARACTERISTIC
/begin CHARACTERISTIC xProt_UcErrSubst_GDU16 "Substitute value for invalid signal of myC temperature" VALUE 0x112B5E rlValueuw 100 PERCENT_INT 0 100 /end CHARACTERISTIC
/begin CHARACTERISTIC xProt_UcRedCurve_GDS "Power reduction factor due to overtemperature of controller" CURVE 0x120058 rlCurveuw 100 PERCENT_INT 0 100
 /begin AXIS_DESCR STD_AXIS cHwlI_UcTemp_gdu8 TEMP_INT 5 -70 185 DEPOSIT ABSOLUTE /end AXIS_DESCR
/end CHARACTERISTIC
/begin CHARACTERISTIC yDith_DitheringFactor_MDF32 "Delta Dithering in %" VALUE 0x112B44 rlValuefl 15 NO_UNIT 0 15 /end CHARACTERISTIC
/begin CHARACTERISTIC yHwConfI_IndivRotOrCompSwitch_GDU8 "0=Off, 1=individual compensation, 2=individual compensation with temperature dependency, 3=same as 2+ Current denpend 1st Ord" VALUE 0x141DB9 rlValueub 3 NO_UNIT 0 3 /end CHARACTERISTIC
/begin CHARACTERISTIC yHwConfI_McDiagUcmpEvalSelect_GDU32 "McDiag UCmp Evaluation Selector. 0: Length and Angle; 1: d-and q-axis" VALUE 0x141D8C rlValueul 1 NO_UNIT 0 1 /end CHARACTERISTIC
/begin CHARACTERISTIC yHwConfI_MoCoCoAdFinishedSelect_GDU8 "AdFinished Selection, 2kHz: typical 1, 4kHz typical 3" VALUE 0x141DBA rlValueub 7 NO_UNIT 0 7 /end CHARACTERISTIC
/begin CHARACTERISTIC yHwConfI_MoCoCoNumOfISR_GDU8 "Num of ISR, to reset the counter. 2 for 2kHz, 4 for 4kHz" VALUE 0x141DBB rlValueub 7 NO_UNIT 0 7 /end CHARACTERISTIC
/begin CHARACTERISTIC yHwConfI_PstAvgCnt_GDU8 "Counter for average calculation of current or voltage" VALUE 0x141DBC rlValueub 9 NO_UNIT 1 10 /end CHARACTERISTIC
/begin CHARACTERISTIC yHwConfI_PstTestMaxRep_GDU8 "Counter for maximum test repetitions in case of implausible results." VALUE 0x141DBD rlValueub 9 NO_UNIT 1 10 /end CHARACTERISTIC
/begin CHARACTERISTIC yHwConfI_ScuTypRotOrCompEnable_GDU8 "0=Type dependent compensation switched off, use other types of compensation, 1=Use type dependent compensation" VALUE 0x141DBE rlValueub 1 NO_UNIT 0 1 /end CHARACTERISTIC
/begin CHARACTERISTIC yMomc_MaxTorqueGradient_GDF32 "max torque gradient [Nm/ms]" VALUE 0x141D90 rlValuefl 9.99 TORQ_GRAD_REAL 0.01 10 /end CHARACTERISTIC
/begin CHARACTERISTIC yProt_DcLinkCapRedSpeed_GDF32 "Reduction speed of variable temperature points in K/s" VALUE 0x112B48 rlValuefl 5 NO_UNIT 0 5 /end CHARACTERISTIC
/begin CHARACTERISTIC yProt_FosSafetyRampActivation_GDU16 "de-\\activate the ramp for FOS mode " VALUE 0x112B60 rlValueuw 1 NO_UNIT 0 1 /end CHARACTERISTIC
/begin CHARACTERISTIC yProt_OcSafetyRampActivation_GDU16 "de-\\activate the ramp for OC mode" VALUE 0x112B62 rlValueuw 1 NO_UNIT 0 1 /end CHARACTERISTIC
/begin CHARACTERISTIC yProt_OutOverVoltGradient_GDS "Charakteristik curve of gradients for down/up ramp of motor torque " CURVE 0x112BB8 rlCurvefl 360448 PERCENT_GRAD_INT -327680 32768
 /begin AXIS_DESCR STD_AXIS uSvoI_OutputStageVoltage_gdf32 VOLT_REAL 6 0 1000 DEPOSIT ABSOLUTE /end AXIS_DESCR
/end CHARACTERISTIC
/begin CHARACTERISTIC yProt_RampToSensorlessLevelAtRpc1stError_GDU8 "1 = activates ramping too sensorless level at fisrt rotor position error " VALUE 0x112B6C rlValueub 1 NO_UNIT 0 1 /end CHARACTERISTIC
/begin CHARACTERISTIC ySvoCalc_MaxVoltageSlope_GDF32 "NV share value check" VALUE 0x112B4C rlValuefl 100 NO_UNIT 0 100 /end CHARACTERISTIC
/begin CHARACTERISTIC zMcDiag_LengthActivationCounter_GDU16 "counter limit for quadrature reference current above threshold - above UCMP_LENGTH is evaluated" VALUE 0x141DB2 rlValueuw 5000 NO_UNIT 0 5000 /end CHARACTERISTIC
/begin CHARACTERISTIC zPhcPlausi_PlausiMarginMaxCount_GDU8 "Tolerated number of plausi limit violations before error entry" VALUE 0x112B6D rlValueub 255 NO_UNIT 0 255 /end CHARACTERISTIC
/begin MEASUREMENT fLdTrk_DataLossChecked_xdu8 "Flag indicates that DataLossCompensation was done in current ignition cycle" UBYTE ZU0 1 100 0 1 FORMAT "%5.3" ECU_ADDRESS 0xFEBE989D /end MEASUREMENT
/begin MEASUREMENT fOvrLdProtI_HeavyImpactOccurred_xdb "Flag: Das Impact Schneckenrad-Moment ist über dem Max-Wert" UWORD ZU0 1 100 0 1 BIT_MASK 0x1 FORMAT "%5.3" ECU_ADDRESS 0xFEBE98B7 /end MEASUREMENT
/begin MEASUREMENT fYROC_NvMWriteError_xdb "Shows write error has detected" UBYTE BIT 1 100 0 1 BIT_MASK 0x1 FORMAT "%5.3" ECU_ADDRESS 0xFEBE98F7 /end MEASUREMENT
/begin MEASUREMENT fYROC_UDSResetRequested_xdb "Set as 1 if UDS Reset is requested" UWORD STATUS 1 100 0 1 BIT_MASK 0x1 FORMAT "%5.3" ECU_ADDRESS 0xFEBE98F8 /end MEASUREMENT
/begin MEASUREMENT mLdTrkI_MaxWormWheelTorque_xdu16 "Maximales Impact Moment Schneckenrads" UWORD RIGHTSH6NP 1 100 0 400 FORMAT "%8.4" ECU_ADDRESS 0xFEBE94EE /end MEASUREMENT
/begin MEASUREMENT mLdTrkI_WormWheelTorque_xds16 "WormWheelTorque in 1ms berechnet" SWORD RIGHTSH6NP 1 100 -400 400 FORMAT "%8.4" ECU_ADDRESS 0xFEBE94F0 /end MEASUREMENT
/begin MEASUREMENT sLdTrkI_ErrLvl_Red_xdu8 "Error Level Redundant LoadTracking" UBYTE ZU0 1 100 0 1 FORMAT "%5.3" ECU_ADDRESS 0xFEBE4293 /end MEASUREMENT
/begin MEASUREMENT sLdTrkI_ErrLvl_xdu8 "Error Level LoadTracking" UBYTE ZU0 1 100 0 1 FORMAT "%5.3" ECU_ADDRESS 0xFEBE99BC /end MEASUREMENT
/begin MEASUREMENT sLdTrkI_ReadJobResultOK_xdu8 "Job Result: 0-noResult, 1-DataOk 2-DataCorrupted" UBYTE ZU0 1 100 0 2 FORMAT "%5.3" ECU_ADDRESS 0xFEBE99BD /end MEASUREMENT
/begin MEASUREMENT sLdTrkI_ResetState_xdu8 "Toggle flag to detect if the block was written at the end of the last ignition cycle" UBYTE ZU0 1 100 0 255 FORMAT "%5.1" ECU_ADDRESS 0xFEBE99BE /end MEASUREMENT
/begin MEASUREMENT sLdTrkI_WriteJobResultOK_xdu8 "Write Job Result: 0-noResult, 1-DataOk 2-DataCorrupted" UBYTE ZU0 1 100 0 2 FORMAT "%5.3" ECU_ADDRESS 0xFEBE99BF /end MEASUREMENT
/begin MEASUREMENT sLdTrk_JobResultOK_xdu8 "Job Result: 0-noResult, 1-DataOk 2-DataCorrupted" UBYTE ZU0 1 100 0 2 FORMAT "%5.3" ECU_ADDRESS 0xFEBE99C0 /end MEASUREMENT
/begin MEASUREMENT sLdTrk_WWDT_NvMTriggerWrite_xdu8 "Trigger to write NvM data" UBYTE ZU0 1 100 0 1 FORMAT "%5.3" ECU_ADDRESS 0xFEBE99C1 /end MEASUREMENT
/begin MEASUREMENT sLdTrk_WWDT_NvWriteState_xdu8 "Status des NvMWrite Aktion" UBYTE ZU0 1 100 0 3 FORMAT "%5.3" ECU_ADDRESS 0xFEBE99C2 /end MEASUREMENT
/begin MEASUREMENT sOvrLdProtI_ErrLvl_Red_xdu8 "ErrorLevel des Schneckenrad-Schutzes" UBYTE ZU0 1 100 0 2 FORMAT "%5.3" ECU_ADDRESS 0xFEBE42A2 /end MEASUREMENT
/begin MEASUREMENT sOvrLdProtI_ErrLvl_xdu8 "ErrorLevel des Schneckenrad-Schutzes" UBYTE ZU0 1 100 0 2 FORMAT "%5.3" ECU_ADDRESS 0xFEBE99E1 /end MEASUREMENT
/begin MEASUREMENT sOvrLdProtI_WormWheelDamageState_xdu8 "Status der Schneckenrad-Schädiung - 0 kein Schaden, 1 niedriger Schaden, 2 hoher Schaden" UBYTE ZU0 1 100 0 4 FORMAT "%5.3" ECU_ADDRESS 0xFEBE99E2 /end MEASUREMENT
/begin MEASUREMENT sOvrLdProt_JobResultOK_xdu8 "Job Result: 0-noResult, 1-DataOk 2-DataCorrupted" UBYTE ZU0 1 100 0 2 FORMAT "%5.3" ECU_ADDRESS 0xFEBE99E3 /end MEASUREMENT
/begin MEASUREMENT sOvrLdProt_LockedWriteJobResultOK_xdu8 "Write Job Result: 0-noResult, 1-DataOk 2-DataCorrupted" UBYTE ZU0 1 100 0 2 FORMAT "%5.3" ECU_ADDRESS 0xFEBE99E4 /end MEASUREMENT
/begin MEASUREMENT sOvrLdProt_NvWriteState_xdu8 "Status des NvMWrite Aktion" UBYTE ZU0 1 100 0 1 FORMAT "%5.3" ECU_ADDRESS 0xFEBE99E5 /end MEASUREMENT
/begin MEASUREMENT sOvrLdProt_StartupCheckState_xdu8 "Status des Startup Checks der Schneckenrad Schädiung: 0-start up check nicht durchgeführt, 1-start up check durchgeführt" UBYTE ZU0 1 100 0 255 FORMAT "%5.1" ECU_ADDRESS 0xFEBE99E6 /end MEASUREMENT
/begin MEASUREMENT sYROC_JobResultOk_xdu8 " To check status of JobResult and Service ID of YawRateOffsetCompensation" UBYTE ZU0 1 100 0 2 FORMAT "%5.3" ECU_ADDRESS 0xFEBE9A40 /end MEASUREMENT
/begin MEASUREMENT sYROC_NvWriteState_xdu8 "State of Write chart (0-Ready;1-Request is pushed ; 2- Error shall be locked)" UBYTE ZU0 1 100 0 3 FORMAT "%5.3" ECU_ADDRESS 0xFEBE9A41 /end MEASUREMENT
/begin MEASUREMENT tVehSp_VehicleRunningTimer_xdu8 "Timer für Fahrzeug-Fährt-Erkennung" UBYTE TIMMS_10 1 100 0 1000 FORMAT "%5.0" ECU_ADDRESS 0xFEBE9A49 /end MEASUREMENT
/begin MEASUREMENT vVehSp_LastAbsSafeNssVehSpd_xds16 "Value of vApplI_AbsSafeNssVehicleSpeed_xdu16 in previous cycle" SWORD VFZHIGH 1 100 0 500 FORMAT "%8.4" ECU_ADDRESS 0xFEBE96A6 /end MEASUREMENT
/begin MEASUREMENT vVehSp_LastAbsVehSpeedFilt_xds16 "Value of vApplI_AbsVehicleSpeedFilt_xdu16 in previous cycle" SWORD VFZHIGH 1 100 0 500 FORMAT "%8.4" ECU_ADDRESS 0xFEBE96A8 /end MEASUREMENT
/begin MEASUREMENT yeeYawRateCompVal_xds16 "YROC comp value" SWORD VGIER 1 100 -163.84 163.835 FORMAT "%8.4" ECU_ADDRESS 0xFEBE97DE /end MEASUREMENT
/begin MEASUREMENT yLdTrkI_DataLossCount_xdu16 "Zähler Datenverlusten aufgrund von Batterieabriss" UWORD ZU0 1 100 0 65535 FORMAT "%8.2" ECU_ADDRESS 0xFEBE97E4 /end MEASUREMENT
/begin MEASUREMENT yLdTrkI_WormWheelImpDamageH_xdu32 "Schneckenradschaedigung für Impact-Damage für High-UInt32" ULONG ZU0 1 100 0 4294967295 FORMAT "%13.2" ECU_ADDRESS 0xFEBE92D0 /end MEASUREMENT
/begin MEASUREMENT yLdTrkI_WormWheelImpDamage_xdu32 "Schneckenradschaedigung für Impact-Damage für Low-UInt32" ULONG ZU0 1 100 0 4294967295 FORMAT "%13.2" ECU_ADDRESS 0xFEBE92D4 /end MEASUREMENT
/begin MEASUREMENT yLdTrkI_WormWheelRotDamageH_xdu32 "Schneckenradschaedigung für Rotioanal-Damage für High-UInt32" ULONG ZU0 1 100 0 4294967295 FORMAT "%13.2" ECU_ADDRESS 0xFEBE92D8 /end MEASUREMENT
/begin MEASUREMENT yLdTrkI_WormWheelRotDamage_xdu32 "Schneckenradschaedigung für Rotational-Damage für Low-UInt32" ULONG ZU0 1 100 0 4294967295 FORMAT "%13.2" ECU_ADDRESS 0xFEBE92DC /end MEASUREMENT
/begin MEASUREMENT yOvrLdProtI_WormWheelDamageSumH_xdu32 "Gesamt Schneckenradschaedigung high" ULONG ZU0 1 100 0 4294967295 FORMAT "%13.2" ECU_ADDRESS 0xFEBE92F4 /end MEASUREMENT
/begin MEASUREMENT yOvrLdProtI_WormWheelDamageSum_xdu32 "Gesamt Schneckenradschaedigung low" ULONG ZU0 1 100 0 4294967295 FORMAT "%13.2" ECU_ADDRESS 0xFEBE92F8 /end MEASUREMENT
/begin MEASUREMENT zYROC_JobcallCounter_xdu16 "Jobcallback Counter" UWORD ZU0 1 100 0 65535 FORMAT "%8.2" ECU_ADDRESS 0xFEBE9832 /end MEASUREMENT
/begin MEASUREMENT iAncI_MotOrCompFbIsdIsr_gdf32 "OcV3 Isd feedback current" FLOAT32_IEEE CURR_REAL 1 100 -200 200 ECU_ADDRESS 0xFEBEC8B8 /end MEASUREMENT
/begin MEASUREMENT iAncI_MotOrCompFbIsqIsr_gdf32 "OcV3 Isq feedback current" FLOAT32_IEEE CURR_REAL 1 100 -200 200 ECU_ADDRESS 0xFEBEC8BC /end MEASUREMENT
/begin MEASUREMENT iMotOrComp_FbIsdCompIsr_gdf32 "Calculated unlimited feedback current Isd" FLOAT32_IEEE NO_UNIT 1 100 0 20 ECU_ADDRESS 0xFEBEE9D8 /end MEASUREMENT
/begin MEASUREMENT iMotOrComp_FbIsqCompIsr_gdf32 "Calculated unlimited feedback current Isq" FLOAT32_IEEE NO_UNIT 1 100 0 20 ECU_ADDRESS 0xFEBEE9DC /end MEASUREMENT
/begin MEASUREMENT mMotOrComp_CoggStoreAbsMotorTrq_gdf32 "Stores the LimitedMotorTorque parameter of  mAncI_MotOrCoggingComp_f32 " FLOAT32_IEEE NO_UNIT 1 100 0 12 ECU_ADDRESS 0xFEBEE9E0 /end MEASUREMENT
/begin MEASUREMENT nMotOrComp_AbsRotorSpeedFilt_gds16 "abolute of filtered rotor speed, data type left to signed to allow interpolation" SWORD NO_UNIT 1 100 0 13000 ECU_ADDRESS 0xFEBEEA10 /end MEASUREMENT
/begin MEASUREMENT nMotOrComp_CoggCompAbsRotSpeed_gdf32 "Absolute rotor speed in rpm" FLOAT32_IEEE RPM_REAL 1 100 0 10000 ECU_ADDRESS 0xFEBEE9E4 /end MEASUREMENT
/begin MEASUREMENT nMotOrComp_RotorSpeedFilt_gds16 "filtered rotor speed, converted for easier interpolation access" SWORD NO_UNIT 1 100 -13000 13000 ECU_ADDRESS 0xFEBEEA12 /end MEASUREMENT
/begin MEASUREMENT rMotOrComp_FbEcuMotRes_gdf32 "Resistance of Ecu plus motor coil" FLOAT32_IEEE NO_UNIT 1 100 0 0.2 ECU_ADDRESS 0xFEBEE9E8 /end MEASUREMENT
/begin MEASUREMENT sMotOrComp_FbInitDone_gdu8 "Flag indicating that function was called at least once" UBYTE NO_UNIT 1 100 0 1 ECU_ADDRESS 0xFEBEEA14 /end MEASUREMENT
/begin MEASUREMENT uMotOrComp_FbUsd4OCIsr_gdf32 "Required voltage for OrderComp - direct axis" FLOAT32_IEEE NO_UNIT 1 100 -12 12 ECU_ADDRESS 0xFEBEE9EC /end MEASUREMENT
/begin MEASUREMENT uMotOrComp_FbUsq4OCIsr_gdf32 "Required voltage for OrderComp - quadrature axis" FLOAT32_IEEE NO_UNIT 1 100 -12 12 ECU_ADDRESS 0xFEBEE9F0 /end MEASUREMENT
/begin MEASUREMENT wAncI_MotOrCompAmp_gdf32 "Amplitude for compensation of motor harmonic" FLOAT32_IEEE ANG_RAD_REAL 1 100 -0.123 0.123 ECU_ADDRESS 0xFEBEE9F4 /end MEASUREMENT
/begin MEASUREMENT wAncI_MotOrCompPhase_gdf32 "Phase for compensation of motor harmonic" FLOAT32_IEEE ANG_RAD_REAL 1 100 -6.3 6.3 ECU_ADDRESS 0xFEBEE9F8 /end MEASUREMENT
/begin MEASUREMENT yAncI_MotOrCompOrder_gdu8 "(Electric) Order of motor harmonics compensation" UBYTE NO_UNIT 1 100 0 10 ECU_ADDRESS 0xFEBEEA15 /end MEASUREMENT
/begin MEASUREMENT yMotOrComp_FbLsd_gdf32 "Mirrored Rom value to Ram" FLOAT32_IEEE INDUCTANCE_REAL 1 100 1 100 ECU_ADDRESS 0xFEBEE9FC /end MEASUREMENT
/begin MEASUREMENT yMotOrComp_FbLsq_gdf32 "Mirrored Rom value to Ram" FLOAT32_IEEE INDUCTANCE_REAL 1 100 1 100 ECU_ADDRESS 0xFEBEEA00 /end MEASUREMENT
/begin MEASUREMENT yMotOrComp_FbTsDivLsd_gdf32 "Cycle Time divided by inductivity direct axis" FLOAT32_IEEE NO_UNIT 1 100 0 1000 ECU_ADDRESS 0xFEBEEA04 /end MEASUREMENT
/begin MEASUREMENT yMotOrComp_FbTsDivLsq_gdf32 "Cycle Time divided by inductivity quadrature axis" FLOAT32_IEEE NO_UNIT 1 100 0 1000 ECU_ADDRESS 0xFEBEEA08 /end MEASUREMENT
/begin MEASUREMENT yMotOrComp_IdIqRelation_gdf32 "Relation of Id and Iq" FLOAT32_IEEE NO_UNIT 1 100 -1047 1047 ECU_ADDRESS 0xFEBEEA0C /end MEASUREMENT
/begin MEASUREMENT cRotOrComp_SaveTemperature_gdu8 "Save the Ground Plate Temperature" UBYTE NO_UNIT 1 100 0 255 ECU_ADDRESS 0xFEBEEBBC /end MEASUREMENT
/begin MEASUREMENT iRotOrComp_AlphaBetaAbs_gdf32 "calculated currents in Alpha-beta system" FLOAT32_IEEE CURR_REAL 1 100 0 200 ECU_ADDRESS 0xFEBEEBA4 /end MEASUREMENT
/begin MEASUREMENT wRotOrComp_AlphaBetaAngle_gdf32 "calculated current angle in Alpha-beta system" FLOAT32_IEEE ANG_RAD_REAL 1 100 0 6.28319 ECU_ADDRESS 0xFEBEEBA8 /end MEASUREMENT
/begin MEASUREMENT wRotOrComp_Phase1OrdConst_gaf32 "Phase position non linearity error- sensor 1st order" FLOAT32_IEEE ANG_RAD_REAL 1 100 0 6.28318 ECU_ADDRESS 0xFEBEEB34 MATRIX_DIM 2 1 1 /end MEASUREMENT
/begin MEASUREMENT wRotOrComp_Phase1OrdCurr_gaf32 "Phase of current dependent first order" FLOAT32_IEEE ANG_RAD_REAL 1 100 0 6.28318 ECU_ADDRESS 0xFEBEEB3C MATRIX_DIM 2 1 1 /end MEASUREMENT
/begin MEASUREMENT wRotOrComp_Phase2Ord_gaf32 "Phase position non linearity error- sensor 2nd order" FLOAT32_IEEE ANG_RAD_REAL 1 100 0 6.28318 ECU_ADDRESS 0xFEBEEB44 MATRIX_DIM 2 1 1 /end MEASUREMENT
/begin MEASUREMENT wRotOrComp_Phase4Ord_gaf32 "Phase position non linearity error - sensor chip 4th order" FLOAT32_IEEE ANG_RAD_REAL 1 100 0 6.28318 ECU_ADDRESS 0xFEBEEB4C MATRIX_DIM 2 1 1 /end MEASUREMENT
/begin MEASUREMENT wRotOrComp_PhaseShiftGndPlate_gdf32 "Calculated phase shift (Ground plate)" FLOAT32_IEEE ANG_RAD_REAL 1 100 0 6.28319 ECU_ADDRESS 0xFEBEEBAC /end MEASUREMENT
/begin MEASUREMENT wRotOrComp_PhaseXOrd_gaf32 "Phase position interference field order X. order X=(pole pairs-1)" FLOAT32_IEEE ANG_RAD_REAL 1 100 0 6.28318 ECU_ADDRESS 0xFEBEEB54 MATRIX_DIM 2 1 1 /end MEASUREMENT
/begin MEASUREMENT wRotOrComp_PhaseYOrd_gaf32 "Phase position interference field order Y. order Y=(pole pairs +1)" FLOAT32_IEEE ANG_RAD_REAL 1 100 0 6.28318 ECU_ADDRESS 0xFEBEEB5C MATRIX_DIM 2 1 1 /end MEASUREMENT
/begin MEASUREMENT xRotOrComp_Amp2Ord_gaf32 "Amplitude non linearity error- sensor 2nd order" FLOAT32_IEEE NO_UNIT 1 100 0 0.25 ECU_ADDRESS 0xFEBEEB64 MATRIX_DIM 2 1 1 /end MEASUREMENT
/begin MEASUREMENT xRotOrComp_Amp4Ord_gaf32 "Amplitude non linearity error - sensor chip 4th order" FLOAT32_IEEE NO_UNIT 1 100 0 0.25 ECU_ADDRESS 0xFEBEEB6C MATRIX_DIM 2 1 1 /end MEASUREMENT
/begin MEASUREMENT xRotOrComp_AmpFactor1OrdConst_gaf32 "Amplitude factor constant non linearity error- sensor 1st order" FLOAT32_IEEE NO_UNIT 1 100 0 0.25 ECU_ADDRESS 0xFEBEEB74 MATRIX_DIM 2 1 1 /end MEASUREMENT
/begin MEASUREMENT xRotOrComp_AmpFactor1OrdCurr_gaf32 "Amplitude factor non linearity error- sensor 1st order" FLOAT32_IEEE NO_UNIT 1 100 0 0.25 ECU_ADDRESS 0xFEBEEB7C MATRIX_DIM 2 1 1 /end MEASUREMENT
/begin MEASUREMENT xRotOrComp_AmpFactorXOrd_gaf32 "Amplitude factor interference field order X. order X=(pole pairs-1)" FLOAT32_IEEE NO_UNIT 1 100 0 0.25 ECU_ADDRESS 0xFEBEEB84 MATRIX_DIM 2 1 1 /end MEASUREMENT
/begin MEASUREMENT xRotOrComp_AmpFactorXOrdVT_gaf32 "Amplitude factor interference field order X with Temperature during teach in. order X=(pole pairs-1)" FLOAT32_IEEE NO_UNIT 1 100 0 0.25 ECU_ADDRESS 0xFEBEEB8C MATRIX_DIM 2 1 1 /end MEASUREMENT
/begin MEASUREMENT xRotOrComp_AmpFactorYOrd_gaf32 "Amplitude factor interference field order Y. order Y=(pole pairs +1)" FLOAT32_IEEE NO_UNIT 1 100 0 0.25 ECU_ADDRESS 0xFEBEEB94 MATRIX_DIM 2 1 1 /end MEASUREMENT
/begin MEASUREMENT xRotOrComp_AmpFactorYOrdVT_gaf32 "Amplitude factor interference field order Y with Temperature during teach in. order Y=(pole pairs +1)" FLOAT32_IEEE NO_UNIT 1 100 0 0.25 ECU_ADDRESS 0xFEBEEB9C MATRIX_DIM 2 1 1 /end MEASUREMENT
/begin MEASUREMENT xRotOrComp_FactAmpSpeedXOrd_gdf32 "Calculated factor dependent on rotor speed" FLOAT32_IEEE NO_UNIT 1 100 -1 1 ECU_ADDRESS 0xFEBEEBB0 /end MEASUREMENT
/begin MEASUREMENT xRotOrComp_FactAmpSpeedYOrd_gdf32 "Calculated factor dependent on rotor speed" FLOAT32_IEEE NO_UNIT 1 100 -1 1 ECU_ADDRESS 0xFEBEEBB4 /end MEASUREMENT
/begin MEASUREMENT xRotOrComp_VtempMagnet_gdf32 "calculated temperature of the ground plate" FLOAT32_IEEE NO_UNIT 1 100 0 3 ECU_ADDRESS 0xFEBEEBB8 /end MEASUREMENT
/begin MEASUREMENT yRotOrComp_TwoPntCalibAvailable_gdu8 "Set to one if parameter from two point calibration are available" UBYTE NO_UNIT 1 100 0 1 ECU_ADDRESS 0xFEBEEBBD /end MEASUREMENT
/begin MEASUREMENT yEcuOrComp_CorrectionValue_gaf32 "Measurement variable of the correction value of AsymComp for Phase U, V, W" FLOAT32_IEEE NO_UNIT 1 100 0 100 ECU_ADDRESS 0xFEBEEB28 MATRIX_DIM 3 1 1 /end MEASUREMENT
/begin MEASUREMENT sAraIndex_AsicDiagFlags_gde "" ULONG NO_UNIT 1 100 0 4294967295 ECU_ADDRESS 0xFEBEC934 /end MEASUREMENT
/begin MEASUREMENT sAraIndex_FirstErrorAsicDiagFlags_gde "" ULONG NO_UNIT 1 100 0 4294967295 ECU_ADDRESS 0xFEBEC938 /end MEASUREMENT
/begin MEASUREMENT sHwlI_IndexSensSignalState_gde "Validity state of the index sensor signal" UWORD NO_UNIT 1 100 0 65535 ECU_ADDRESS 0xFEBEC93C /end MEASUREMENT
/begin MEASUREMENT yAraIndex_StateMachine_gde "" UBYTE NO_UNIT 1 100 0 255 ECU_ADDRESS 0xFEBEC93E /end MEASUREMENT
/begin MEASUREMENT yHwlI_IndexSensSignal_gdu8 "Signal of index sensor" UBYTE NO_UNIT 1 100 0 1 ECU_ADDRESS 0xFEBEC93F /end MEASUREMENT
/begin MEASUREMENT sAraDiagI_AraSelftestsDiagFlags_gde "" ULONG NO_UNIT 1 100 0 4294967295 ECU_ADDRESS 0xFEBEC940 /end MEASUREMENT
/begin MEASUREMENT sAraDiagI_AsicRpcDiagFlags_gde "ASIC SAS status flags" ULONG NO_UNIT 1 100 0 4294967295 ECU_ADDRESS 0xFEBEC944 /end MEASUREMENT
/begin MEASUREMENT sAraDiagI_AsicStandbyDiagFlags_gde "" ULONG NO_UNIT 1 100 0 4294967295 ECU_ADDRESS 0xFEBEC948 /end MEASUREMENT
/begin MEASUREMENT sAraDiagI_CurrentAsicDiagFlags_gde "" ULONG NO_UNIT 1 100 0 4294967295 ECU_ADDRESS 0xFEBEC94C /end MEASUREMENT
/begin MEASUREMENT sAraDiagI_DiagStatus_gde "" UWORD NO_UNIT 1 100 0 65535 ECU_ADDRESS 0xFEBEC954 /end MEASUREMENT
/begin MEASUREMENT sAraI_FaultIndicationState_gde "Functionality state of ARA" UBYTE NO_UNIT 1 100 0 255 ECU_ADDRESS 0xFEBEC95C /end MEASUREMENT
/begin MEASUREMENT sHwlI_AbsRotbasedAngleDetails_gdu32 "Additional information to the internal steering angle (counter, flags)" ULONG NO_UNIT 1 100 0 65535 ECU_ADDRESS 0xFEBEC950 /end MEASUREMENT
/begin MEASUREMENT sHwlI_AbsRotbasedAngleState_gde "Validity state of the internal absolute steering angle" UWORD NO_UNIT 1 100 0 65535 ECU_ADDRESS 0xFEBEC956 /end MEASUREMENT
/begin MEASUREMENT sISasDiag_AraAnglePermInvalid_gde "Steering-Angle permanently invalidated indication" UBYTE NO_UNIT 1 100 0 255 ECU_ADDRESS 0xFEBEC95D /end MEASUREMENT
/begin MEASUREMENT yAraDiagI_AsicSasStatemachine_gde "ASIC SAS Statemachine" UBYTE NO_UNIT 1 100 0 255 ECU_ADDRESS 0xFEBEC95E /end MEASUREMENT
/begin MEASUREMENT zAraDiagI_AsicCounterCos_gds16 "" SWORD NO_UNIT 1 100 -32768 32767 ECU_ADDRESS 0xFEBEC958 /end MEASUREMENT
/begin MEASUREMENT zAraDiagI_AsicCounterSin_gds16 "" SWORD NO_UNIT 1 100 -32768 32767 ECU_ADDRESS 0xFEBEC95A /end MEASUREMENT
/begin MEASUREMENT sAraRotCalcI_Status_gde "MultiturnCalc status" UBYTE NO_UNIT 1 100 0 255 ECU_ADDRESS 0xFEBEC96C /end MEASUREMENT
/begin MEASUREMENT wAraRotCalc_PreviousSensorPosition_gdf32 "Rotor sensor postion of the previos ms cycle" FLOAT32_IEEE ANG_RAD_REAL 1 100 -3.40282346639E+38 6.283185 ECU_ADDRESS 0xFEBEC960 /end MEASUREMENT
/begin MEASUREMENT wHwlI_AbsRotbasedAngle_gdf32 "Absolute steering angle of the internal steering angle sensor. Variable range is defined by wExtInI_MaxAbsRotbasedAngle_GDF32." FLOAT32_IEEE ANG_RAD_REAL 1 100 -750 750 ECU_ADDRESS 0xFEBEC964 /end MEASUREMENT
/begin MEASUREMENT yAraCalcStateMachine_gde "" UBYTE NO_UNIT 1 100 0 255 ECU_ADDRESS 0xFEBEC96D /end MEASUREMENT
/begin MEASUREMENT zAraRotCalcI_AngleOverflowCounter_gdu16 "" UWORD NO_UNIT 1 100 0 65535 ECU_ADDRESS 0xFEBEC968 /end MEASUREMENT
/begin MEASUREMENT zAraRotCalcI_StartedFromZeroCounter_gdu16 "" UWORD NO_UNIT 1 100 0 65535 ECU_ADDRESS 0xFEBEC96A /end MEASUREMENT
/begin MEASUREMENT sCscAdcI_AdcDiagStatusFsa_gde "ADC diagnosis status bit " UBYTE NO_UNIT 1 100 0 255 ECU_ADDRESS 0xFEBECAD8 /end MEASUREMENT
/begin MEASUREMENT sCscAsicI_AsicDiagStatusFsa_gde "Asic Diagnosis Status" UWORD NO_UNIT 1 100 0 65535 ECU_ADDRESS 0xFEBECAFC /end MEASUREMENT
/begin MEASUREMENT yCscAsic_AreAllSuCooCheckDone_gde "SuCoo Check status" UBYTE NO_UNIT 1 100 0 255 ECU_ADDRESS 0xFEBECB00 /end MEASUREMENT
/begin MEASUREMENT yCscAsic_AscCommDiagStatus_gde "Asic Comm Diag status" UBYTE NO_UNIT 1 100 0 255 ECU_ADDRESS 0xFEBECB01 /end MEASUREMENT
/begin MEASUREMENT yCscAsic_AscFault_gde "Asic Fault info" UBYTE NO_UNIT 1 100 0 255 ECU_ADDRESS 0xFEBECB02 /end MEASUREMENT
/begin MEASUREMENT yCscAsic_AsicErrorFlags_gde "Asic Error Flags" UBYTE NO_UNIT 1 100 0 255 ECU_ADDRESS 0xFEBECB03 /end MEASUREMENT
/begin MEASUREMENT yCscAsic_McuErrTimeStamp_gdu32 "Mcu Error Timestamp" ULONG NO_UNIT 1 100 0 4294967295 ECU_ADDRESS 0xFEBECAE0 /end MEASUREMENT
/begin MEASUREMENT yCscAsic_PsEnDiagStatus_gde "PsEn Status" UBYTE NO_UNIT 1 100 0 255 ECU_ADDRESS 0xFEBECB04 /end MEASUREMENT
/begin MEASUREMENT yCscAsic_SeqDependentFlag_gau16 "Flag for dependent startup tests" UWORD NO_UNIT 1 100 0 65535 ECU_ADDRESS 0xFEBECB0C MATRIX_DIM 12 1 1 /end MEASUREMENT
/begin MEASUREMENT yCscAsic_SeqIdFinished_gdu32 "Status of finished test sequence" ULONG NO_UNIT 1 100 0 4294967295 ECU_ADDRESS 0xFEBECAE4 /end MEASUREMENT
/begin MEASUREMENT yCscAsic_SeqIdStarted_gdu32 "Status of started test sequence" ULONG NO_UNIT 1 100 0 4294967295 ECU_ADDRESS 0xFEBECAE8 /end MEASUREMENT
/begin MEASUREMENT yCscAsic_StrtUpTestFinished_gau32 "Status of started test " ULONG NO_UNIT 1 100 0 4294967295 ECU_ADDRESS 0xFEBECB24 MATRIX_DIM 12 1 1 /end MEASUREMENT
/begin MEASUREMENT yCscAsic_StrtUpTestStarted_gau32 "Status of finished test " ULONG NO_UNIT 1 100 0 4294967295 ECU_ADDRESS 0xFEBECB54 MATRIX_DIM 12 1 1 /end MEASUREMENT
/begin MEASUREMENT yCscAsic_SuCooSeqStarted_gdu32 "SuCoo Sequence Started Info" ULONG NO_UNIT 1 100 0 4294967295 ECU_ADDRESS 0xFEBECAEC /end MEASUREMENT
/begin MEASUREMENT yCscAsic_SuppVoltInError_gdu8 "Supply voltage error status" UBYTE NO_UNIT 1 100 0 255 ECU_ADDRESS 0xFEBECB05 /end MEASUREMENT
/begin MEASUREMENT yCscAsic_UndervoltageDetected_gde "Undervoltage status" UBYTE NO_UNIT 1 100 0 255 ECU_ADDRESS 0xFEBECBC8 MATRIX_DIM 12 1 1 /end MEASUREMENT
/begin MEASUREMENT zCscAsic_AscCommDebounceCntr_gdu8 "Asic Comm Debounce Counter" UBYTE NO_UNIT 1 100 0 255 ECU_ADDRESS 0xFEBECB06 /end MEASUREMENT
/begin MEASUREMENT zCscAsic_HlAliveErrCtr_gdu8 "Hl alive counter info" UBYTE NO_UNIT 1 100 0 255 ECU_ADDRESS 0xFEBECB07 /end MEASUREMENT
/begin MEASUREMENT zCscAsic_HlAliveMissedCallCtr_gdu8 "Hl alive missed call counter info" UBYTE NO_UNIT 1 100 0 255 ECU_ADDRESS 0xFEBECB08 /end MEASUREMENT
/begin MEASUREMENT zCscAsic_PsEnDebounceCntr_gdu8 "PsEn Debounce Counter" UBYTE NO_UNIT 1 100 0 255 ECU_ADDRESS 0xFEBECB09 /end MEASUREMENT
/begin COMPU_METHOD BIT "" RAT_FUNC "%6.2" "Bitanzeige" COEFFS 0 1 0 0 0 1 /end COMPU_METHOD
/begin COMPU_METHOD RIGHTSH6NP "" RAT_FUNC "%6.4" "" COEFFS 0 64 0 0 0 1 /end COMPU_METHOD
/begin COMPU_METHOD STATUS "" RAT_FUNC "%6.2" "Status" COEFFS 0 1 0 0 0 1 /end COMPU_METHOD
/begin COMPU_METHOD TIMMS_10 "" RAT_FUNC "%6.1" "ms" COEFFS 0 0.1 0 0 0 1 /end COMPU_METHOD
/begin COMPU_METHOD VFZHIGH "" RAT_FUNC "%6.4" "km/h" COEFFS 0 64 0 0 0 1 /end COMPU_METHOD
/begin COMPU_METHOD VGIER "" RAT_FUNC "%6.4" "Â°/s" COEFFS 0 200 0 0 0 1 /end COMPU_METHOD
/begin COMPU_METHOD ZU0 "" RAT_FUNC "%6.2" "" COEFFS 0 1 0 0 0 1 /end COMPU_METHOD
/begin COMPU_METHOD defaultAscii "" RAT_FUNC "%6.2" "" COEFFS 0 1 0 0 0 1 /end COMPU_METHOD
/begin COMPU_METHOD ANG_RAD_REAL "angle in rad for float values" RAT_FUNC "%4.5" "rad" COEFFS 0 1 0 0 0 1 /end COMPU_METHOD
/begin COMPU_METHOD ANG_VEL_REAL "angular velocity in rad/s for float values" RAT_FUNC "%4.5" "rad/s" COEFFS 0 1 0 0 0 1 /end COMPU_METHOD
/begin COMPU_METHOD CURR_REAL "current in A for float values" RAT_FUNC "%4.5" "A" COEFFS 0 1 0 0 0 1 /end COMPU_METHOD
/begin COMPU_METHOD CURR_INT "current in A for integer values" RAT_FUNC "%4.5" "A" COEFFS 0 16 0 0 0 1 /end COMPU_METHOD
/begin COMPU_METHOD INDUCTANCE_REAL "inductance in ÂµH for float values" RAT_FUNC "%4.5" "ÂµH" COEFFS 0 1E-06 0 0 0 1 /end COMPU_METHOD
/begin COMPU_METHOD LEN_REAL "length in m for float values" RAT_FUNC "%4.5" "m" COEFFS 0 1 0 0 0 1 /end COMPU_METHOD
/begin COMPU_METHOD MAGN_FLUX_REAL "magnetic flux in Vs for float values" RAT_FUNC "%4.5" "Vs" COEFFS 0 1 0 0 0 1 /end COMPU_METHOD
/begin COMPU_METHOD NO_UNIT "no physical assignment" RAT_FUNC "%4.5" "-" COEFFS 0 1 0 0 0 1 /end COMPU_METHOD
/begin COMPU_METHOD OHM_REAL "resistance in mâ„¦ for float values" RAT_FUNC "%4.5" "mâ„¦" COEFFS 0 0.001 0 0 0 1 /end COMPU_METHOD
/begin COMPU_METHOD PERCENT_INT "percentage in %  for integer values" RAT_FUNC "%4.5" "%" COEFFS 0 327.68 0 0 0 1 /end COMPU_METHOD
/begin COMPU_METHOD PERCENT_GRAD_INT "percent gradient in %/s for integer values" RAT_FUNC "%4.5" "%/s" COEFFS 0 327.68 0 0 0 1 /end COMPU_METHOD
/begin COMPU_METHOD RPM_REAL "rotation frequency in rpm for float values" RAT_FUNC "%4.5" "rpm" COEFFS 0 1 0 0 0 1 /end COMPU_METHOD
/begin COMPU_METHOD T_S "time in s for integer values" RAT_FUNC "%4.5" "s" COEFFS 0 1 0 0 0 1 /end COMPU_METHOD
/begin COMPU_METHOD T_MS "time in ms for integer values" RAT_FUNC "%4.5" "ms" COEFFS 0 1 0 0 0 1 /end COMPU_METHOD
/begin COMPU_METHOD T_US "time in Âµs for integer values" RAT_FUNC "%4.5" "Âµs" COEFFS 0 1 0 0 0 1 /end COMPU_METHOD
/begin COMPU_METHOD T_NS "time in ns for integer values" RAT_FUNC "%4.5" "ns" COEFFS 0 1 0 0 0 1 /end COMPU_METHOD
/begin COMPU_METHOD TORQ_INT "torque in Nm for integer values" RAT_FUNC "%4.5" "Nm" COEFFS 0 1024 0 0 0 1 /end COMPU_METHOD
/begin COMPU_METHOD TORQ_REAL "torque in Nm  for float values" RAT_FUNC "%4.5" "Nm" COEFFS 0 1 0 0 0 1 /end COMPU_METHOD
/begin COMPU_METHOD TORQ_GRAD_REAL "torque gradient in Nm/ms for float values" RAT_FUNC "%4.5" "Nm/ms" COEFFS 0 1 0 0 0 1 /end COMPU_METHOD
/begin COMPU_METHOD TORQ_STIFF_INT "torque stiffness in Nm/Â° for integer values" RAT_FUNC "%4.5" "Nm/Â°" COEFFS 0 1024 0 0 0 1 /end COMPU_METHOD
/begin COMPU_METHOD TEMP_INT "temperature in Â°C for integer values" RAT_FUNC "%4.5" "Â°C" COEFFS 0 1 70 0 0 1 /end COMPU_METHOD
/begin COMPU_METHOD VELOCITY "velocity in km/h for integer values" RAT_FUNC "%4.5" "km/h" COEFFS 0 64 0 0 0 1 /end COMPU_METHOD
/begin COMPU_METHOD VOLT_REAL "voltage in V for float values" RAT_FUNC "%4.5" "V" COEFFS 0 1 0 0 0 1 /end COMPU_METHOD
/begin COMPU_METHOD POWER_REAL "power in W for float values" RAT_FUNC "%4.5" "W" COEFFS 0 1 0 0 0 1 /end COMPU_METHOD
/begin COMPU_METHOD PERCENT_PER_S "FktH=32768.0 / 100.0 * phys + 0.0;" RAT_FUNC "%4.5" "%/s" COEFFS 0 327.68 0 0 0 1 /end COMPU_METHOD
/begin COMPU_METHOD MILEAGE "FktH=1.0 / 16.0 * phys + 0.0;" RAT_FUNC "%4.5" "km" COEFFS 0 0.0625 0 0 0 1 /end COMPU_METHOD
/begin COMPU_VTAB VERB_SYSTEM_STATE "VERB_SYSTEM_STATE" TAB_VERB 10 0 "undefined" 1 "NMWait" 2 "KL30Wait" 3 "PreDrive" 4 "DriveDown" 5 "DriveUp" 6 "PostRun" 7 "Off" 8 "Error" 9 "Flash" /end COMPU_VTAB
/begin FUNCTION WormWheelDamageTracker_Interface "WormWheelDamageTracker Interface"
 /begin OUT_MEASUREMENT mLdTrkI_MaxWormWheelTorque_xdu16 mLdTrkI_WormWheelTorque_xds16 sLdTrkI_ErrLvl_Red_xdu8 sLdTrkI_ErrLvl_xdu8 sLdTrkI_ReadJobResultOK_xdu8 sLdTrkI_ResetState_xdu8 sLdTrkI_WriteJobResultOK_xdu8 yLdTrkI_DataLossCount_xdu16 yLdTrkI_WormWheelImpDamageH_xdu32 yLdTrkI_WormWheelImpDamage_xdu32 yLdTrkI_WormWheelRotDamageH_xdu32 yLdTrkI_WormWheelRotDamage_xdu32 /end OUT_MEASUREMENT
/end FUNCTION
/begin FUNCTION WormWheelDamage_Tracker "WormWheelDamage_Tracker"
 /begin OUT_MEASUREMENT fLdTrk_DataLossChecked_xdu8 sLdTrk_JobResultOK_xdu8 sLdTrk_WWDT_NvMTriggerWrite_xdu8 sLdTrk_WWDT_NvWriteState_xdu8 /end OUT_MEASUREMENT
/end FUNCTION
/begin FUNCTION WormWheelProtection "Schneckenrad-Schutz"
 /begin DEF_CHARACTERISTIC mOvrLdProt_HeavyImpactLimit_XDU16 zOvrLdProt_SwitchOffCounterHigh32_XDU32 zOvrLdProt_SwitchOffCounterLow32_XDU32 zOvrLdProt_WarningCounterHigh32_XDU32 zOvrLdProt_WarningCounterLow32_XDU32 /end DEF_CHARACTERISTIC
 /begin OUT_MEASUREMENT sOvrLdProt_JobResultOK_xdu8 sOvrLdProt_LockedWriteJobResultOK_xdu8 sOvrLdProt_NvWriteState_xdu8 sOvrLdProt_StartupCheckState_xdu8 /end OUT_MEASUREMENT
/end FUNCTION
/begin FUNCTION WormWheelProtectionInterface "Schneckenrad-Schutz - interface"
 /begin OUT_MEASUREMENT fOvrLdProtI_HeavyImpactOccurred_xdb sOvrLdProtI_ErrLvl_Red_xdu8 sOvrLdProtI_ErrLvl_xdu8 sOvrLdProtI_WormWheelDamageState_xdu8 yOvrLdProtI_WormWheelDamageSumH_xdu32 yOvrLdProtI_WormWheelDamageSum_xdu32 /end OUT_MEASUREMENT
/end FUNCTION
/begin FUNCTION Wrapper4Old "Wrapper 4 legacy interfaces"
 /begin DEF_CHARACTERISTIC tVehSp_VehicleRunningDelay_XDU8 vVehSp_AbsVehSpeedFiltInit_XDU16 vVehSp_MaxSpeedGradientNearStandStill_XDU8 vVehSp_NearStandStillBorder_XDU16 vVehSp_SubstituteSpeed_XDU16 vVehSp_VehicleRunningBorder_XDU16 /end DEF_CHARACTERISTIC
 /begin OUT_MEASUREMENT tVehSp_VehicleRunningTimer_xdu8 vVehSp_LastAbsSafeNssVehSpd_xds16 vVehSp_LastAbsVehSpeedFilt_xds16 /end OUT_MEASUREMENT
/end FUNCTION
/begin FUNCTION Wrapper4OldI "Wrapper 4 legacy interfaces - interface" /end FUNCTION
/begin FUNCTION YawRateOffsetCompensation "YawRateOffsetCompensation"
 /begin DEF_CHARACTERISTIC fYROC_Resetcompvalue_XDU8 sYROC_NvWrConfigFlag_XDU8 vYROC_NegYawRateCompThreshold_XDS16 vYROC_PosYawRateCompThreshold_XDU16 vYROC_VehicleSpeedThreshold_XDU16 xYROC_MaxYawRateCompValue_XDS16 xYROC_MinYawRateCompValue_XDS16 xYROC_YawRateCompFactor_XDF32 /end DEF_CHARACTERISTIC
 /begin OUT_MEASUREMENT fYROC_NvMWriteError_xdb sYROC_JobResultOk_xdu8 sYROC_NvWriteState_xdu8 yeeYawRateCompVal_xds16 zYROC_JobcallCounter_xdu16 /end OUT_MEASUREMENT
/end FUNCTION
/begin FUNCTION YawRateOffsetCompensationSupp "YawRateOffsetCompensationSupp" /begin OUT_MEASUREMENT fYROC_UDSResetRequested_xdb /end OUT_MEASUREMENT /end FUNCTION
/begin RECORD_LAYOUT AblGLKWfl4 FNC_VALUES 1 FLOAT32_IEEE COLUMN_DIR DIRECT /end RECORD_LAYOUT
/begin RECORD_LAYOUT AblGLKWsw FNC_VALUES 1 SWORD COLUMN_DIR DIRECT /end RECORD_LAYOUT
/begin RECORD_LAYOUT AblGLKWub FNC_VALUES 1 UBYTE COLUMN_DIR DIRECT /end RECORD_LAYOUT
/begin RECORD_LAYOUT AblGLKWul FNC_VALUES 1 ULONG COLUMN_DIR DIRECT /end RECORD_LAYOUT
/begin RECORD_LAYOUT AblGLKWuw FNC_VALUES 1 UWORD COLUMN_DIR DIRECT /end RECORD_LAYOUT
/begin RECORD_LAYOUT rlCurvefl FNC_VALUES 3 FLOAT32_IEEE COLUMN_DIR DIRECT AXIS_PTS_X 2 FLOAT32_IEEE INDEX_INCR DIRECT NO_AXIS_PTS_X 1 UBYTE /end RECORD_LAYOUT
/begin RECORD_LAYOUT rlCurvesw FNC_VALUES 3 SWORD COLUMN_DIR DIRECT AXIS_PTS_X 2 SWORD INDEX_INCR DIRECT NO_AXIS_PTS_X 1 UBYTE /end RECORD_LAYOUT
/begin RECORD_LAYOUT rlCurveuw FNC_VALUES 3 UWORD COLUMN_DIR DIRECT AXIS_PTS_X 2 UWORD INDEX_INCR DIRECT NO_AXIS_PTS_X 1 UBYTE /end RECORD_LAYOUT
/begin RECORD_LAYOUT rlValuefl FNC_VALUES 1 FLOAT32_IEEE COLUMN_DIR DIRECT /end RECORD_LAYOUT
/begin RECORD_LAYOUT rlValuesw FNC_VALUES 1 SWORD COLUMN_DIR DIRECT /end RECORD_LAYOUT
/begin RECORD_LAYOUT rlValueub FNC_VALUES 1 UBYTE COLUMN_DIR DIRECT /end RECORD_LAYOUT
/begin RECORD_LAYOUT rlValueul FNC_VALUES 1 ULONG COLUMN_DIR DIRECT /end RECORD_LAYOUT
/begin RECORD_LAYOUT rlValueuw FNC_VALUES 1 UWORD COLUMN_DIR DIRECT /end RECORD_LAYOUT
/end MODULE
/end PROJECT
