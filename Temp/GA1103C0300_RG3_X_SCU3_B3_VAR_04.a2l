/*
© by ASAM e.V., 2017
AML for the protocol layer specific parameters
Any use is limited to the scope described in the ASAM license terms.
This file is distributable in accordance with the ASAM license terms.
See www.asam.net/license.html for further details.
*/
ASAP2_VERSION 1 70
/begin PROJECT _GA1_103 "SCU3_B3_VAR_04"
/begin HEADER "" VERSION "GA1_103_C_03_00" PROJECT_NO _GA1_103 /end HEADER
/begin MODULE XCP_EPS_ECU "G08"
/begin MOD_COMMON "" BYTE_ORDER MSB_LAST ALIGNMENT_BYTE 1 ALIGNMENT_WORD 2 ALIGNMENT_LONG 4 ALIGNMENT_FLOAT32_IEEE 4 ALIGNMENT_FLOAT64_IEEE 8 /end MOD_COMMON
/* Definitions for XCP */
/begin IF_DATA XCPplus 0x0102
 /begin PAG 0x06 FREEZE_SUPPORTED /end PAG
 /begin PGM PGM_MODE_ABSOLUTE 0x00 0x00 /end PGM
 /begin XCP_ON_CAN /************************ start of CAN *********************/ 0x0104 /* XCP on CAN version */ CAN_ID_MASTER 0x9FF0004B /* CMD/STIM CAN-ID */ /* master -> slave */ CAN_ID_SLAVE 0x9FF0004C /* RES/ERR/EV/SERV/DAQ CAN-ID */ /* slave -> master */ /* Bit31= 1: extended identifier */ BAUDRATE 500000 /* BAUDRATE [Hz] */ SAMPLE_POINT 80 /* sample point */ /* [% complete bit time] */ BTL_CYCLES 20 /* BTL_CYCLES */ /* [slots per bit time] */ SJW 2 /* length synchr. segment */ /* [BTL_CYCLES] */ MAX_BUS_LOAD 100 /* maximum available bus */ MEASUREMENT_SPLIT_ALLOWED /* Supports splitting of measurements to increase payload */ /************************* end of CAN **********************/ /*************** start of PROTOCOL_LAYER *******************/
  /begin PROTOCOL_LAYER /* At MODULE */ 0x0104 /* XCP protocol layer version */ 250 /* T1 [ms] */ 250 /* T2 [ms] */ 0 /* T3 [ms] */ 0 /* T4 [ms] */ 0 /* T5 [ms] */ 0 /* T6 [ms] */ 0 /* T7 [ms] */ 8 /* MAX_CTO */ 8 /* MAX_DTO default for DAQ and STIM */ BYTE_ORDER_MSB_LAST /* BYTE_ORDER: INTEL */ ADDRESS_GRANULARITY_BYTE /* ADDRESS_GRANULARITY */ OPTIONAL_CMD GET_COMM_MODE_INFO OPTIONAL_CMD GET_ID OPTIONAL_CMD SET_MTA OPTIONAL_CMD UPLOAD OPTIONAL_CMD SHORT_UPLOAD OPTIONAL_CMD BUILD_CHECKSUM OPTIONAL_CMD USER_CMD OPTIONAL_CMD DOWNLOAD OPTIONAL_CMD DOWNLOAD_NEXT OPTIONAL_CMD DOWNLOAD_MAX OPTIONAL_CMD MODIFY_BITS OPTIONAL_CMD SET_CAL_PAGE OPTIONAL_CMD GET_CAL_PAGE OPTIONAL_CMD GET_PAG_PROCESSOR_INFO OPTIONAL_CMD GET_SEGMENT_INFO OPTIONAL_CMD GET_PAGE_INFO OPTIONAL_CMD COPY_CAL_PAGE OPTIONAL_CMD CLEAR_DAQ_LIST OPTIONAL_CMD SET_DAQ_PTR OPTIONAL_CMD WRITE_DAQ OPTIONAL_CMD SET_DAQ_LIST_MODE OPTIONAL_CMD GET_DAQ_LIST_MODE OPTIONAL_CMD START_STOP_DAQ_LIST OPTIONAL_CMD START_STOP_SYNCH OPTIONAL_CMD GET_DAQ_CLOCK OPTIONAL_CMD READ_DAQ OPTIONAL_CMD GET_DAQ_PROCESSOR_INFO OPTIONAL_CMD GET_DAQ_RESOLUTION_INFO OPTIONAL_CMD GET_DAQ_EVENT_INFO OPTIONAL_CMD FREE_DAQ OPTIONAL_CMD ALLOC_DAQ OPTIONAL_CMD ALLOC_ODT OPTIONAL_CMD ALLOC_ODT_ENTRY COMMUNICATION_MODE_SUPPORTED /* optional modes supported */ BLOCK SLAVE /* Slave Block Mode supported */ MASTER /* Master Block Mode supported */ 255 /* MAX_BS */ 0 /* MIN_ST */ /end PROTOCOL_LAYER
  /***************** end of PROTOCOL_LAYER *******************/ /********************* start of DAQ ************************/
  /begin DAQ /* DAQ supported, at MODULE*/ DYNAMIC /* DAQ_CONFIG_TYPE */ 65535 /* MAX_DAQ */ 4 /* MAX_EVENT_CHANNEL */ 0 /* MIN_DAQ */ OPTIMISATION_TYPE_DEFAULT /* OPTIMISATION_TYPE */ ADDRESS_EXTENSION_FREE /* ADDRESS_EXTENSION */ IDENTIFICATION_FIELD_TYPE_ABSOLUTE /* IDENTIFICATION_FIELD */ GRANULARITY_ODT_ENTRY_SIZE_DAQ_BYTE /* GRANULARITY_ODT_ENTRY_SIZE_DAQ */ 255 /* MAX_ODT_ENTRY_SIZE_DAQ */ OVERLOAD_INDICATION_EVENT /* OVERLOAD_INDICATION */ PRESCALER_SUPPORTED
   /begin TIMESTAMP_SUPPORTED 1 /* TIMESTAMP_TICKS */ SIZE_DWORD /* TIMESTAMP_SIZE */ UNIT_1US /* RESOLUTION OF TIMESTAMP */ /end TIMESTAMP_SUPPORTED
   /begin DAQ_MEMORY_CONSUMPTION 1495 /* DAQ_MEMORY_LIMIT: in Elements[AG] */ 46 /* DAQ_SIZE: number of elements[AG] per DAQ list */ 6 /* ODT_SIZE: number of elements[AG] per ODT */ 5 /* ODT_ENTRY_SIZE: number of elements[AG] per ODT_entry */ 2 /* ODT_DAQ_BUFFER_ELEMENT_SIZE: number of */ /* payload elements[AG]*factor = sizeof(send buffer)[AG] */ 0 /* ODT_STIM_BUFFER_ELEMENT_SIZE: number of */ /* payload elements[AG]*factor = sizeof(receive buffer)[AG] */
    /begin BUFFER_RESERVE /* default for all EVENTs */ 0 /* ODT_DAQ_BUFFER_ELEMENT_RESERVE in % of */ /* ODT_DAQ_BUFFER_ELEMENT_SIZE */ 0 /* ODT_STIM_BUFFER_ELEMENT_RESERVE in % of */ /* ODT_STIM_BUFFER_ELEMENT_SIZE */ /end BUFFER_RESERVE
   /end DAQ_MEMORY_CONSUMPTION
   /******************* start of EVENT ************************/
   /begin EVENT "2ms time synchronous" "2_ms" 1 DAQ 1 2 6 7 /begin MIN_CYCLE_TIME /* Configuration with 0-0 not allowed */ 5 6 /end MIN_CYCLE_TIME /end EVENT
   /begin EVENT "10ms time synchronous" "10_ms" 2 DAQ 1 10 6 6 /end EVENT
   /begin EVENT "100ms time synchronous" "100_ms" 3 DAQ 1 100 6 5 /end EVENT
   /********************* end of EVENT ************************/ /end DAQ
  /********************* end of DAQ **************************/ TRANSPORT_LAYER_INSTANCE "CAN_0_PL0" /end XCP_ON_CAN
/end IF_DATA
/begin MOD_PAR "SBK" VERSION "GA1_103_C_03_00" CUSTOMER_NO "__" USER "GDUMMY" PHONE_NO "GDUMMY" ECU "ZFLS IBK" CPU_TYPE "NEC PhoenixFS" /* DRIVE calibration block */
 /begin MEMORY_SEGMENT DRIVE_ROM "Drive calibration ROM block for initialization" DATA FLASH INTERN 0x0014A000 0x1FF0 -1 -1 -1 -1 -1
  /begin IF_DATA XCPplus 0x0102
   /begin SEGMENT 0x00 0x02 0x00 0x00 0x00
    /begin PAGE 0x0 ECU_ACCESS_DONT_CARE XCP_READ_ACCESS_DONT_CARE XCP_WRITE_ACCESS_NOT_ALLOWED /end PAGE
    /begin PAGE 0x1 ECU_ACCESS_DONT_CARE XCP_READ_ACCESS_DONT_CARE XCP_WRITE_ACCESS_DONT_CARE /end PAGE
    /begin ADDRESS_MAPPING 0x0014A000 0xFEEDC000 0x1FF0 /end ADDRESS_MAPPING
   /end SEGMENT
  /end IF_DATA
 /end MEMORY_SEGMENT
 /* SYSTEM calibration block */
 /begin MEMORY_SEGMENT SYSTEM_ROM "System calibration ROM block for initialization" DATA FLASH INTERN 0x00150400 0x1FF0 -1 -1 -1 -1 -1
  /begin IF_DATA XCPplus 0x0102
   /begin SEGMENT 0x01 0x02 0x00 0x00 0x00
    /begin PAGE 0x0 ECU_ACCESS_DONT_CARE XCP_READ_ACCESS_DONT_CARE XCP_WRITE_ACCESS_NOT_ALLOWED /end PAGE
    /begin PAGE 0x1 ECU_ACCESS_DONT_CARE XCP_READ_ACCESS_DONT_CARE XCP_WRITE_ACCESS_DONT_CARE /end PAGE
    /begin ADDRESS_MAPPING 0x00150400 0xFEEDE000 0x1FF0 /end ADDRESS_MAPPING
   /end SEGMENT
  /end IF_DATA
 /end MEMORY_SEGMENT
 /* TUNING calibration block */
 /begin MEMORY_SEGMENT TUNING_ROM "Tuning calibration ROM block for initialization" DATA FLASH INTERN 0x00158000 0xFFF0 -1 -1 -1 -1 -1
  /begin IF_DATA XCPplus 0x0102
   /begin SEGMENT 0x02 0x02 0x00 0x00 0x00
    /begin PAGE 0x0 ECU_ACCESS_DONT_CARE XCP_READ_ACCESS_DONT_CARE XCP_WRITE_ACCESS_NOT_ALLOWED /end PAGE
    /begin PAGE 0x1 ECU_ACCESS_DONT_CARE XCP_READ_ACCESS_DONT_CARE XCP_WRITE_ACCESS_DONT_CARE /end PAGE
    /begin ADDRESS_MAPPING 0x00158000 0xFEEE0000 0xFFF0 /end ADDRESS_MAPPING
   /end SEGMENT
  /end IF_DATA
 /end MEMORY_SEGMENT
 /* FOC calibration block */
 /begin MEMORY_SEGMENT FOC_ROM "FOC calibration ROM block for initialization" DATA FLASH INTERN 0x00140000 0x1FF0 -1 -1 -1 -1 -1
  /begin IF_DATA XCPplus 0x0102
   /begin SEGMENT 0x03 0x02 0x00 0x00 0x00
    /begin PAGE 0x0 ECU_ACCESS_DONT_CARE XCP_READ_ACCESS_DONT_CARE XCP_WRITE_ACCESS_NOT_ALLOWED /end PAGE
    /begin PAGE 0x1 ECU_ACCESS_DONT_CARE XCP_READ_ACCESS_DONT_CARE XCP_WRITE_ACCESS_DONT_CARE /end PAGE
    /begin ADDRESS_MAPPING 0x00140000 0xFEEDA000 0x1FF0 /end ADDRESS_MAPPING
   /end SEGMENT
  /end IF_DATA
 /end MEMORY_SEGMENT
 /* HWL calibration block */
 /begin MEMORY_SEGMENT HWL "HWL calibration block" DATA FLASH INTERN 0x00120000 13312 -1 -1 -1 -1 -1
  /begin IF_DATA XCPplus 0x0102
   /begin SEGMENT 0x04 0x02 0x00 0x00 0x00
    /begin PAGE 0x0 ECU_ACCESS_WITH_XCP_ONLY XCP_READ_ACCESS_WITH_ECU_ONLY XCP_WRITE_ACCESS_NOT_ALLOWED /end PAGE
    /begin PAGE 0x1 ECU_ACCESS_WITH_XCP_ONLY XCP_READ_ACCESS_WITH_ECU_ONLY XCP_WRITE_ACCESS_WITH_ECU_ONLY /end PAGE
    /begin ADDRESS_MAPPING 0x00120000 0xFEEF0000 13312 /end ADDRESS_MAPPING
   /end SEGMENT
  /end IF_DATA
 /end MEMORY_SEGMENT
 /* Definitions for MEMORY_SEGMENT Measurement data */ /* Values are defined in damos_variables.mak */
 /begin MEMORY_SEGMENT Meas "Measurement data" VARIABLES RAM INTERN 0xFEBE0000 0x20000 -1 -1 -1 -1 -1
  /begin IF_DATA XCPplus 0x0102
   /begin SEGMENT 0x05 0x01 0x00 0x00 0x00
    /begin PAGE 0x0 ECU_ACCESS_WITH_XCP_ONLY XCP_READ_ACCESS_WITH_ECU_ONLY XCP_WRITE_ACCESS_NOT_ALLOWED /end PAGE
   /end SEGMENT
  /end IF_DATA
 /end MEMORY_SEGMENT
 /* Definitions for MEMORY_SEGMENT Code */ /* Values are defined in damos_variables.mak */
 /begin MEMORY_SEGMENT Code "" CODE FLASH INTERN 0x00000000 0x10FFFF -1 -1 -1 -1 -1 /end MEMORY_SEGMENT
 /begin MEMORY_SEGMENT Code "NoCalib section for Drive" CODE FLASH INTERN 0x00148000 0x400 -1 -1 -1 -1 -1 /end MEMORY_SEGMENT
 /begin MEMORY_SEGMENT Code "NoCalib section for System" CODE FLASH INTERN 0x00150000 0x400 -1 -1 -1 -1 -1 /end MEMORY_SEGMENT
/end MOD_PAR
/begin CHARACTERISTIC aAhaDet_AccLimit_XDU16 "Grenzwert für max. Beschl. pro Schrittweite" VALUE 0x150530 AblGLKWuw 20 VFZHIGH 0 20 FORMAT "%8.5" /end CHARACTERISTIC
/begin CHARACTERISTIC aAhaDet_MaxAbsLateralAccel_XDU16 "Schwelle der Querbeschleunigung für Geradeauserkennung" VALUE 0x150532 AblGLKWuw 1 AFZ 0 1 FORMAT "%8.6" /end CHARACTERISTIC
/begin CHARACTERISTIC mActDamp_MaxMotorTorqueDepOnRotorSpeed_XAU16 "limitation of active return torque depending on rotor speed" CURVE 0x150FF0 AblGLKLuw 1 MMOT 0 1 FORMAT "%8.6"
 /begin AXIS_DESCR STD_AXIS nActDamp_AbsRotorSpeedFilt_xdu16 VROT 2 0 13000 FORMAT "%3.0" DEPOSIT ABSOLUTE /end AXIS_DESCR
/end CHARACTERISTIC
/begin CHARACTERISTIC mActIn_InertiaMax_XAU16 "Maximalwert für Trägheit bei Handmomentenregelung" CURVE 0x150FFC AblGLKLuw 10 TBTHIGH 0 10 FORMAT "%8.5"
 /begin AXIS_DESCR STD_AXIS vApplI_AbsVehicleSpeedFilt_xdu16 VFZHIGH 4 0 400 FORMAT "%8.4" DEPOSIT ABSOLUTE /end AXIS_DESCR
/end CHARACTERISTIC
/begin CHARACTERISTIC mActRet_MaxMotorTorqueDepOnSteeringAngle_XAU16 "limitation of active return torque depending on steering angle" CURVE 0x151010 AblGLKLuw 3 MMOT 0 3 FORMAT "%8.6"
 /begin AXIS_DESCR STD_AXIS wApplI_AbsSteeringAngle_xdu16 SA_10 5 0 1000 FORMAT "%8.3" DEPOSIT ABSOLUTE /end AXIS_DESCR
/end CHARACTERISTIC
/begin CHARACTERISTIC mActRet_MaxMotorTorqueDepOnVehSpeed_XAU16 "limitation of active return torque depending on vehicle speed" CURVE 0x151028 AblGLKLuw 3 MMOT 0 3 FORMAT "%8.6"
 /begin AXIS_DESCR STD_AXIS vVehSpI_AbsMaxSafeVehSpd_xdu16 VFZHIGH 5 0 500 FORMAT "%8.4" DEPOSIT ABSOLUTE /end AXIS_DESCR
/end CHARACTERISTIC
/begin CHARACTERISTIC mActRet_MaxMotorTorque_XDU8 "limitation of active return torque" VALUE 0x150AF6 AblGLKWub 3 MMOT_RSH6 0 3 FORMAT "%5.3" /end CHARACTERISTIC
/begin CHARACTERISTIC mActRet_MaxTBT4ShutDown_XDU8 "maximum torsion bar torque to allow active return torque" VALUE 0x150AF7 AblGLKWub 15 TBT_RSH4 0 15 FORMAT "%5.2" /end CHARACTERISTIC
/begin CHARACTERISTIC mAhaDet_TorqueLimit_XDU16 "Grenzwert des Lenkradmoments für Geradeausfahrt" VALUE 0x150596 AblGLKWuw 10 TBTHIGH 0 10 FORMAT "%8.5" /end CHARACTERISTIC
/begin CHARACTERISTIC tAhaDet_AheadDetectionTimer_XDU8 "Ahead detection Erkennungszeit" VALUE 0x150B20 AblGLKWub 2.5 TIMSEC 0 2.5 FORMAT "%5.3" /end CHARACTERISTIC
/begin CHARACTERISTIC vActRet_NominalSteeringSpeed_XAU16_00___A "nominal steering angle return speed depending on vehicle speed and steering angle" MAP 0x16000C AblGLKFuw 1500 SAS_8 0 1500 FORMAT "%8.3"
 /begin AXIS_DESCR STD_AXIS vVehSpI_AbsAvgVehSpd_xdu16 VFZHIGH 6 0 500 FORMAT "%8.4" DEPOSIT ABSOLUTE /end AXIS_DESCR
 /begin AXIS_DESCR STD_AXIS wApplI_AbsSteeringAngle_xdu16 SA_10 13 0 1000 FORMAT "%8.3" DEPOSIT ABSOLUTE /end AXIS_DESCR
/end CHARACTERISTIC
/begin CHARACTERISTIC vActRet_NominalSteeringSpeed_XAU16_01___A "nominal steering angle return speed depending on vehicle speed and steering angle" MAP 0x1600D0 AblGLKFuw 1500 SAS_8 0 1500 FORMAT "%8.3"
 /begin AXIS_DESCR STD_AXIS vVehSpI_AbsAvgVehSpd_xdu16 VFZHIGH 6 0 500 FORMAT "%8.4" DEPOSIT ABSOLUTE /end AXIS_DESCR
 /begin AXIS_DESCR STD_AXIS wApplI_AbsSteeringAngle_xdu16 SA_10 13 0 1000 FORMAT "%8.3" DEPOSIT ABSOLUTE /end AXIS_DESCR
/end CHARACTERISTIC
/begin CHARACTERISTIC vActRet_NominalSteeringSpeed_XAU16_02___A "nominal steering angle return speed depending on vehicle speed and steering angle" MAP 0x160194 AblGLKFuw 1500 SAS_8 0 1500 FORMAT "%8.3"
 /begin AXIS_DESCR STD_AXIS vVehSpI_AbsAvgVehSpd_xdu16 VFZHIGH 6 0 500 FORMAT "%8.4" DEPOSIT ABSOLUTE /end AXIS_DESCR
 /begin AXIS_DESCR STD_AXIS wApplI_AbsSteeringAngle_xdu16 SA_10 13 0 1000 FORMAT "%8.3" DEPOSIT ABSOLUTE /end AXIS_DESCR
/end CHARACTERISTIC
/begin CHARACTERISTIC vActRet_NominalSteeringSpeed_XAU16_03___A "nominal steering angle return speed depending on vehicle speed and steering angle" MAP 0x160258 AblGLKFuw 1500 SAS_8 0 1500 FORMAT "%8.3"
 /begin AXIS_DESCR STD_AXIS vVehSpI_AbsAvgVehSpd_xdu16 VFZHIGH 6 0 500 FORMAT "%8.4" DEPOSIT ABSOLUTE /end AXIS_DESCR
 /begin AXIS_DESCR STD_AXIS wApplI_AbsSteeringAngle_xdu16 SA_10 13 0 1000 FORMAT "%8.3" DEPOSIT ABSOLUTE /end AXIS_DESCR
/end CHARACTERISTIC
/begin CHARACTERISTIC vActRet_NominalSteeringSpeed_XAU16_04___A "nominal steering angle return speed depending on vehicle speed and steering angle" MAP 0x16031C AblGLKFuw 1500 SAS_8 0 1500 FORMAT "%8.3"
 /begin AXIS_DESCR STD_AXIS vVehSpI_AbsAvgVehSpd_xdu16 VFZHIGH 6 0 500 FORMAT "%8.4" DEPOSIT ABSOLUTE /end AXIS_DESCR
 /begin AXIS_DESCR STD_AXIS wApplI_AbsSteeringAngle_xdu16 SA_10 13 0 1000 FORMAT "%8.3" DEPOSIT ABSOLUTE /end AXIS_DESCR
/end CHARACTERISTIC
/begin CHARACTERISTIC vActRet_NominalSteeringSpeed_XAU16_05___A "nominal steering angle return speed depending on vehicle speed and steering angle" MAP 0x1603E0 AblGLKFuw 1500 SAS_8 0 1500 FORMAT "%8.3"
 /begin AXIS_DESCR STD_AXIS vVehSpI_AbsAvgVehSpd_xdu16 VFZHIGH 6 0 500 FORMAT "%8.4" DEPOSIT ABSOLUTE /end AXIS_DESCR
 /begin AXIS_DESCR STD_AXIS wApplI_AbsSteeringAngle_xdu16 SA_10 13 0 1000 FORMAT "%8.3" DEPOSIT ABSOLUTE /end AXIS_DESCR
/end CHARACTERISTIC
/begin CHARACTERISTIC vActRet_NominalSteeringSpeed_XAU16_06___A "nominal steering angle return speed depending on vehicle speed and steering angle" MAP 0x1604A4 AblGLKFuw 1500 SAS_8 0 1500 FORMAT "%8.3"
 /begin AXIS_DESCR STD_AXIS vVehSpI_AbsAvgVehSpd_xdu16 VFZHIGH 6 0 500 FORMAT "%8.4" DEPOSIT ABSOLUTE /end AXIS_DESCR
 /begin AXIS_DESCR STD_AXIS wApplI_AbsSteeringAngle_xdu16 SA_10 13 0 1000 FORMAT "%8.3" DEPOSIT ABSOLUTE /end AXIS_DESCR
/end CHARACTERISTIC
/begin CHARACTERISTIC vActRet_NominalSteeringSpeed_XAU16_07___A "nominal steering angle return speed depending on vehicle speed and steering angle" MAP 0x160568 AblGLKFuw 1500 SAS_8 0 1500 FORMAT "%8.3"
 /begin AXIS_DESCR STD_AXIS vVehSpI_AbsAvgVehSpd_xdu16 VFZHIGH 6 0 500 FORMAT "%8.4" DEPOSIT ABSOLUTE /end AXIS_DESCR
 /begin AXIS_DESCR STD_AXIS wApplI_AbsSteeringAngle_xdu16 SA_10 13 0 1000 FORMAT "%8.3" DEPOSIT ABSOLUTE /end AXIS_DESCR
/end CHARACTERISTIC
/begin CHARACTERISTIC vActRet_NominalSteeringSpeed_XAU16_08___A "nominal steering angle return speed depending on vehicle speed and steering angle" MAP 0x16062C AblGLKFuw 1500 SAS_8 0 1500 FORMAT "%8.3"
 /begin AXIS_DESCR STD_AXIS vVehSpI_AbsAvgVehSpd_xdu16 VFZHIGH 6 0 500 FORMAT "%8.4" DEPOSIT ABSOLUTE /end AXIS_DESCR
 /begin AXIS_DESCR STD_AXIS wApplI_AbsSteeringAngle_xdu16 SA_10 13 0 1000 FORMAT "%8.3" DEPOSIT ABSOLUTE /end AXIS_DESCR
/end CHARACTERISTIC
/begin CHARACTERISTIC vActRet_NominalSteeringSpeed_XAU16_09___A "nominal steering angle return speed depending on vehicle speed and steering angle" MAP 0x1606F0 AblGLKFuw 1500 SAS_8 0 1500 FORMAT "%8.3"
 /begin AXIS_DESCR STD_AXIS vVehSpI_AbsAvgVehSpd_xdu16 VFZHIGH 6 0 500 FORMAT "%8.4" DEPOSIT ABSOLUTE /end AXIS_DESCR
 /begin AXIS_DESCR STD_AXIS wApplI_AbsSteeringAngle_xdu16 SA_10 13 0 1000 FORMAT "%8.3" DEPOSIT ABSOLUTE /end AXIS_DESCR
/end CHARACTERISTIC
/begin CHARACTERISTIC vActRet_NominalSteeringSpeed_XAU16_10___A "nominal steering angle return speed depending on vehicle speed and steering angle" MAP 0x1607B4 AblGLKFuw 1500 SAS_8 0 1500 FORMAT "%8.3"
 /begin AXIS_DESCR STD_AXIS vVehSpI_AbsAvgVehSpd_xdu16 VFZHIGH 6 0 500 FORMAT "%8.4" DEPOSIT ABSOLUTE /end AXIS_DESCR
 /begin AXIS_DESCR STD_AXIS wApplI_AbsSteeringAngle_xdu16 SA_10 13 0 1000 FORMAT "%8.3" DEPOSIT ABSOLUTE /end AXIS_DESCR
/end CHARACTERISTIC
/begin CHARACTERISTIC vActRet_NominalSteeringSpeed_XAU16_11___A "nominal steering angle return speed depending on vehicle speed and steering angle" MAP 0x160878 AblGLKFuw 1500 SAS_8 0 1500 FORMAT "%8.3"
 /begin AXIS_DESCR STD_AXIS vVehSpI_AbsAvgVehSpd_xdu16 VFZHIGH 6 0 500 FORMAT "%8.4" DEPOSIT ABSOLUTE /end AXIS_DESCR
 /begin AXIS_DESCR STD_AXIS wApplI_AbsSteeringAngle_xdu16 SA_10 13 0 1000 FORMAT "%8.3" DEPOSIT ABSOLUTE /end AXIS_DESCR
/end CHARACTERISTIC
/begin CHARACTERISTIC vActRet_NominalSteeringSpeed_XAU16_12___A "nominal steering angle return speed depending on vehicle speed and steering angle" MAP 0x16093C AblGLKFuw 1500 SAS_8 0 1500 FORMAT "%8.3"
 /begin AXIS_DESCR STD_AXIS vVehSpI_AbsAvgVehSpd_xdu16 VFZHIGH 6 0 500 FORMAT "%8.4" DEPOSIT ABSOLUTE /end AXIS_DESCR
 /begin AXIS_DESCR STD_AXIS wApplI_AbsSteeringAngle_xdu16 SA_10 13 0 1000 FORMAT "%8.3" DEPOSIT ABSOLUTE /end AXIS_DESCR
/end CHARACTERISTIC
/begin CHARACTERISTIC vActRet_NominalSteeringSpeed_XAU16_13___A "nominal steering angle return speed depending on vehicle speed and steering angle" MAP 0x160A00 AblGLKFuw 1500 SAS_8 0 1500 FORMAT "%8.3"
 /begin AXIS_DESCR STD_AXIS vVehSpI_AbsAvgVehSpd_xdu16 VFZHIGH 6 0 500 FORMAT "%8.4" DEPOSIT ABSOLUTE /end AXIS_DESCR
 /begin AXIS_DESCR STD_AXIS wApplI_AbsSteeringAngle_xdu16 SA_10 13 0 1000 FORMAT "%8.3" DEPOSIT ABSOLUTE /end AXIS_DESCR
/end CHARACTERISTIC
/begin CHARACTERISTIC vActRet_NominalSteeringSpeed_XAU16_14___A "nominal steering angle return speed depending on vehicle speed and steering angle" MAP 0x160AC4 AblGLKFuw 1500 SAS_8 0 1500 FORMAT "%8.3"
 /begin AXIS_DESCR STD_AXIS vVehSpI_AbsAvgVehSpd_xdu16 VFZHIGH 6 0 500 FORMAT "%8.4" DEPOSIT ABSOLUTE /end AXIS_DESCR
 /begin AXIS_DESCR STD_AXIS wApplI_AbsSteeringAngle_xdu16 SA_10 13 0 1000 FORMAT "%8.3" DEPOSIT ABSOLUTE /end AXIS_DESCR
/end CHARACTERISTIC
/begin CHARACTERISTIC vActRet_NominalSteeringSpeed_XAU16_15___A "nominal steering angle return speed depending on vehicle speed and steering angle" MAP 0x160B88 AblGLKFuw 1500 SAS_8 0 1500 FORMAT "%8.3"
 /begin AXIS_DESCR STD_AXIS vVehSpI_AbsAvgVehSpd_xdu16 VFZHIGH 6 0 500 FORMAT "%8.4" DEPOSIT ABSOLUTE /end AXIS_DESCR
 /begin AXIS_DESCR STD_AXIS wApplI_AbsSteeringAngle_xdu16 SA_10 13 0 1000 FORMAT "%8.3" DEPOSIT ABSOLUTE /end AXIS_DESCR
/end CHARACTERISTIC
/begin CHARACTERISTIC vActRet_NominalSteeringSpeed_XAU16_16___A "nominal steering angle return speed depending on vehicle speed and steering angle" MAP 0x160C4C AblGLKFuw 1500 SAS_8 0 1500 FORMAT "%8.3"
 /begin AXIS_DESCR STD_AXIS vVehSpI_AbsAvgVehSpd_xdu16 VFZHIGH 6 0 500 FORMAT "%8.4" DEPOSIT ABSOLUTE /end AXIS_DESCR
 /begin AXIS_DESCR STD_AXIS wApplI_AbsSteeringAngle_xdu16 SA_10 13 0 1000 FORMAT "%8.3" DEPOSIT ABSOLUTE /end AXIS_DESCR
/end CHARACTERISTIC
/begin CHARACTERISTIC vActRet_NominalSteeringSpeed_XAU16_17___A "nominal steering angle return speed depending on vehicle speed and steering angle" MAP 0x160D10 AblGLKFuw 1500 SAS_8 0 1500 FORMAT "%8.3"
 /begin AXIS_DESCR STD_AXIS vVehSpI_AbsAvgVehSpd_xdu16 VFZHIGH 6 0 500 FORMAT "%8.4" DEPOSIT ABSOLUTE /end AXIS_DESCR
 /begin AXIS_DESCR STD_AXIS wApplI_AbsSteeringAngle_xdu16 SA_10 13 0 1000 FORMAT "%8.3" DEPOSIT ABSOLUTE /end AXIS_DESCR
/end CHARACTERISTIC
/begin CHARACTERISTIC vActRet_NominalSteeringSpeed_XAU16_18___A "nominal steering angle return speed depending on vehicle speed and steering angle" MAP 0x160DD4 AblGLKFuw 1500 SAS_8 0 1500 FORMAT "%8.3"
 /begin AXIS_DESCR STD_AXIS vVehSpI_AbsAvgVehSpd_xdu16 VFZHIGH 6 0 500 FORMAT "%8.4" DEPOSIT ABSOLUTE /end AXIS_DESCR
 /begin AXIS_DESCR STD_AXIS wApplI_AbsSteeringAngle_xdu16 SA_10 13 0 1000 FORMAT "%8.3" DEPOSIT ABSOLUTE /end AXIS_DESCR
/end CHARACTERISTIC
/begin CHARACTERISTIC vActRet_NominalSteeringSpeed_XAU16_19___A "nominal steering angle return speed depending on vehicle speed and steering angle" MAP 0x160E98 AblGLKFuw 1500 SAS_8 0 1500 FORMAT "%8.3"
 /begin AXIS_DESCR STD_AXIS vVehSpI_AbsAvgVehSpd_xdu16 VFZHIGH 6 0 500 FORMAT "%8.4" DEPOSIT ABSOLUTE /end AXIS_DESCR
 /begin AXIS_DESCR STD_AXIS wApplI_AbsSteeringAngle_xdu16 SA_10 13 0 1000 FORMAT "%8.3" DEPOSIT ABSOLUTE /end AXIS_DESCR
/end CHARACTERISTIC
/begin CHARACTERISTIC vActRet_NominalSteeringSpeed_XAU16_20___A "nominal steering angle return speed depending on vehicle speed and steering angle" MAP 0x160F5C AblGLKFuw 1500 SAS_8 0 1500 FORMAT "%8.3"
 /begin AXIS_DESCR STD_AXIS vVehSpI_AbsAvgVehSpd_xdu16 VFZHIGH 6 0 500 FORMAT "%8.4" DEPOSIT ABSOLUTE /end AXIS_DESCR
 /begin AXIS_DESCR STD_AXIS wApplI_AbsSteeringAngle_xdu16 SA_10 13 0 1000 FORMAT "%8.3" DEPOSIT ABSOLUTE /end AXIS_DESCR
/end CHARACTERISTIC
/begin CHARACTERISTIC vActRet_NominalSteeringSpeed_XAU16_21___A "nominal steering angle return speed depending on vehicle speed and steering angle" MAP 0x161020 AblGLKFuw 1500 SAS_8 0 1500 FORMAT "%8.3"
 /begin AXIS_DESCR STD_AXIS vVehSpI_AbsAvgVehSpd_xdu16 VFZHIGH 6 0 500 FORMAT "%8.4" DEPOSIT ABSOLUTE /end AXIS_DESCR
 /begin AXIS_DESCR STD_AXIS wApplI_AbsSteeringAngle_xdu16 SA_10 13 0 1000 FORMAT "%8.3" DEPOSIT ABSOLUTE /end AXIS_DESCR
/end CHARACTERISTIC
/begin CHARACTERISTIC vActRet_NominalSteeringSpeed_XAU16_22___A "nominal steering angle return speed depending on vehicle speed and steering angle" MAP 0x1610E4 AblGLKFuw 1500 SAS_8 0 1500 FORMAT "%8.3"
 /begin AXIS_DESCR STD_AXIS vVehSpI_AbsAvgVehSpd_xdu16 VFZHIGH 6 0 500 FORMAT "%8.4" DEPOSIT ABSOLUTE /end AXIS_DESCR
 /begin AXIS_DESCR STD_AXIS wApplI_AbsSteeringAngle_xdu16 SA_10 13 0 1000 FORMAT "%8.3" DEPOSIT ABSOLUTE /end AXIS_DESCR
/end CHARACTERISTIC
/begin CHARACTERISTIC vActRet_NominalSteeringSpeed_XAU16_23___A "nominal steering angle return speed depending on vehicle speed and steering angle" MAP 0x1611A8 AblGLKFuw 1500 SAS_8 0 1500 FORMAT "%8.3"
 /begin AXIS_DESCR STD_AXIS vVehSpI_AbsAvgVehSpd_xdu16 VFZHIGH 6 0 500 FORMAT "%8.4" DEPOSIT ABSOLUTE /end AXIS_DESCR
 /begin AXIS_DESCR STD_AXIS wApplI_AbsSteeringAngle_xdu16 SA_10 13 0 1000 FORMAT "%8.3" DEPOSIT ABSOLUTE /end AXIS_DESCR
/end CHARACTERISTIC
/begin CHARACTERISTIC vActRet_NominalSteeringSpeed_XAU16_24___A "nominal steering angle return speed depending on vehicle speed and steering angle" MAP 0x16126C AblGLKFuw 1500 SAS_8 0 1500 FORMAT "%8.3"
 /begin AXIS_DESCR STD_AXIS vVehSpI_AbsAvgVehSpd_xdu16 VFZHIGH 6 0 500 FORMAT "%8.4" DEPOSIT ABSOLUTE /end AXIS_DESCR
 /begin AXIS_DESCR STD_AXIS wApplI_AbsSteeringAngle_xdu16 SA_10 13 0 1000 FORMAT "%8.3" DEPOSIT ABSOLUTE /end AXIS_DESCR
/end CHARACTERISTIC
/begin CHARACTERISTIC vActRet_NominalSteeringSpeed_XAU16_25___A "nominal steering angle return speed depending on vehicle speed and steering angle" MAP 0x161330 AblGLKFuw 1500 SAS_8 0 1500 FORMAT "%8.3"
 /begin AXIS_DESCR STD_AXIS vVehSpI_AbsAvgVehSpd_xdu16 VFZHIGH 6 0 500 FORMAT "%8.4" DEPOSIT ABSOLUTE /end AXIS_DESCR
 /begin AXIS_DESCR STD_AXIS wApplI_AbsSteeringAngle_xdu16 SA_10 13 0 1000 FORMAT "%8.3" DEPOSIT ABSOLUTE /end AXIS_DESCR
/end CHARACTERISTIC
/begin CHARACTERISTIC vActRet_NominalSteeringSpeed_XAU16_26___A "nominal steering angle return speed depending on vehicle speed and steering angle" MAP 0x1613F4 AblGLKFuw 1500 SAS_8 0 1500 FORMAT "%8.3"
 /begin AXIS_DESCR STD_AXIS vVehSpI_AbsAvgVehSpd_xdu16 VFZHIGH 6 0 500 FORMAT "%8.4" DEPOSIT ABSOLUTE /end AXIS_DESCR
 /begin AXIS_DESCR STD_AXIS wApplI_AbsSteeringAngle_xdu16 SA_10 13 0 1000 FORMAT "%8.3" DEPOSIT ABSOLUTE /end AXIS_DESCR
/end CHARACTERISTIC
/begin CHARACTERISTIC vActRet_NominalSteeringSpeed_XAU16_27___A "nominal steering angle return speed depending on vehicle speed and steering angle" MAP 0x1614B8 AblGLKFuw 1500 SAS_8 0 1500 FORMAT "%8.3"
 /begin AXIS_DESCR STD_AXIS vVehSpI_AbsAvgVehSpd_xdu16 VFZHIGH 6 0 500 FORMAT "%8.4" DEPOSIT ABSOLUTE /end AXIS_DESCR
 /begin AXIS_DESCR STD_AXIS wApplI_AbsSteeringAngle_xdu16 SA_10 13 0 1000 FORMAT "%8.3" DEPOSIT ABSOLUTE /end AXIS_DESCR
/end CHARACTERISTIC
/begin CHARACTERISTIC vActRet_NominalSteeringSpeed_XAU16_28___A "nominal steering angle return speed depending on vehicle speed and steering angle" MAP 0x16157C AblGLKFuw 1500 SAS_8 0 1500 FORMAT "%8.3"
 /begin AXIS_DESCR STD_AXIS vVehSpI_AbsAvgVehSpd_xdu16 VFZHIGH 6 0 500 FORMAT "%8.4" DEPOSIT ABSOLUTE /end AXIS_DESCR
 /begin AXIS_DESCR STD_AXIS wApplI_AbsSteeringAngle_xdu16 SA_10 13 0 1000 FORMAT "%8.3" DEPOSIT ABSOLUTE /end AXIS_DESCR
/end CHARACTERISTIC
/begin CHARACTERISTIC vActRet_NominalSteeringSpeed_XAU16_29___A "nominal steering angle return speed depending on vehicle speed and steering angle" MAP 0x161640 AblGLKFuw 1500 SAS_8 0 1500 FORMAT "%8.3"
 /begin AXIS_DESCR STD_AXIS vVehSpI_AbsAvgVehSpd_xdu16 VFZHIGH 6 0 500 FORMAT "%8.4" DEPOSIT ABSOLUTE /end AXIS_DESCR
 /begin AXIS_DESCR STD_AXIS wApplI_AbsSteeringAngle_xdu16 SA_10 13 0 1000 FORMAT "%8.3" DEPOSIT ABSOLUTE /end AXIS_DESCR
/end CHARACTERISTIC
/begin CHARACTERISTIC vActRet_NominalSteeringSpeed_XAU16_30___A "nominal steering angle return speed depending on vehicle speed and steering angle" MAP 0x161704 AblGLKFuw 1500 SAS_8 0 1500 FORMAT "%8.3"
 /begin AXIS_DESCR STD_AXIS vVehSpI_AbsAvgVehSpd_xdu16 VFZHIGH 6 0 500 FORMAT "%8.4" DEPOSIT ABSOLUTE /end AXIS_DESCR
 /begin AXIS_DESCR STD_AXIS wApplI_AbsSteeringAngle_xdu16 SA_10 13 0 1000 FORMAT "%8.3" DEPOSIT ABSOLUTE /end AXIS_DESCR
/end CHARACTERISTIC
/begin CHARACTERISTIC vActRet_NominalSteeringSpeed_XAU16_31___A "nominal steering angle return speed depending on vehicle speed and steering angle" MAP 0x1617C8 AblGLKFuw 1500 SAS_8 0 1500 FORMAT "%8.3"
 /begin AXIS_DESCR STD_AXIS vVehSpI_AbsAvgVehSpd_xdu16 VFZHIGH 6 0 500 FORMAT "%8.4" DEPOSIT ABSOLUTE /end AXIS_DESCR
 /begin AXIS_DESCR STD_AXIS wApplI_AbsSteeringAngle_xdu16 SA_10 13 0 1000 FORMAT "%8.3" DEPOSIT ABSOLUTE /end AXIS_DESCR
/end CHARACTERISTIC
/begin CHARACTERISTIC vActRet_NominalSteeringSpeed_XAU16_32___A "nominal steering angle return speed depending on vehicle speed and steering angle" MAP 0x16188C AblGLKFuw 1500 SAS_8 0 1500 FORMAT "%8.3"
 /begin AXIS_DESCR STD_AXIS vVehSpI_AbsAvgVehSpd_xdu16 VFZHIGH 6 0 500 FORMAT "%8.4" DEPOSIT ABSOLUTE /end AXIS_DESCR
 /begin AXIS_DESCR STD_AXIS wApplI_AbsSteeringAngle_xdu16 SA_10 13 0 1000 FORMAT "%8.3" DEPOSIT ABSOLUTE /end AXIS_DESCR
/end CHARACTERISTIC
/begin CHARACTERISTIC vActRet_NominalSteeringSpeed_XAU16_33___A "nominal steering angle return speed depending on vehicle speed and steering angle" MAP 0x161950 AblGLKFuw 1500 SAS_8 0 1500 FORMAT "%8.3"
 /begin AXIS_DESCR STD_AXIS vVehSpI_AbsAvgVehSpd_xdu16 VFZHIGH 6 0 500 FORMAT "%8.4" DEPOSIT ABSOLUTE /end AXIS_DESCR
 /begin AXIS_DESCR STD_AXIS wApplI_AbsSteeringAngle_xdu16 SA_10 13 0 1000 FORMAT "%8.3" DEPOSIT ABSOLUTE /end AXIS_DESCR
/end CHARACTERISTIC
/begin CHARACTERISTIC vActRet_NominalSteeringSpeed_XAU16_34___A "nominal steering angle return speed depending on vehicle speed and steering angle" MAP 0x161A14 AblGLKFuw 1500 SAS_8 0 1500 FORMAT "%8.3"
 /begin AXIS_DESCR STD_AXIS vVehSpI_AbsAvgVehSpd_xdu16 VFZHIGH 6 0 500 FORMAT "%8.4" DEPOSIT ABSOLUTE /end AXIS_DESCR
 /begin AXIS_DESCR STD_AXIS wApplI_AbsSteeringAngle_xdu16 SA_10 13 0 1000 FORMAT "%8.3" DEPOSIT ABSOLUTE /end AXIS_DESCR
/end CHARACTERISTIC
/begin CHARACTERISTIC vActRet_NominalSteeringSpeed_XAU16_35___A "nominal steering angle return speed depending on vehicle speed and steering angle" MAP 0x161AD8 AblGLKFuw 1500 SAS_8 0 1500 FORMAT "%8.3"
 /begin AXIS_DESCR STD_AXIS vVehSpI_AbsAvgVehSpd_xdu16 VFZHIGH 6 0 500 FORMAT "%8.4" DEPOSIT ABSOLUTE /end AXIS_DESCR
 /begin AXIS_DESCR STD_AXIS wApplI_AbsSteeringAngle_xdu16 SA_10 13 0 1000 FORMAT "%8.3" DEPOSIT ABSOLUTE /end AXIS_DESCR
/end CHARACTERISTIC
/begin CHARACTERISTIC vAhaDet_FrontESPvLimit_XDU16 "maximale Differenz zwischen Raddrehzahlen VA und VehicleSpeedFilt-Signal fuer Geradeauserkennung" VALUE 0x15081A AblGLKWuw 20 VFZHIGH 0 20 FORMAT "%8.5" /end CHARACTERISTIC
/begin CHARACTERISTIC vAhaDet_FrontRearRotationLimit_XDU16 "maximale Raddrehzahldifferenz zwischen Vorder- und Hinterachse fuer Geradeauserkennung" VALUE 0x15081C AblGLKWuw 20 VFZHIGH 0 20 FORMAT "%8.5" /end CHARACTERISTIC
/begin CHARACTERISTIC vAhaDet_LeftRightRotationLimit_XDU16 "maximale Raddrehzahldifferenz zwischen linker und rechter Seite, damit wsaAngleWheel_xds16 berechnet wird" VALUE 0x15081E AblGLKWuw 20 VFZHIGH 0 20 FORMAT "%8.5" /end CHARACTERISTIC
/begin CHARACTERISTIC vAhaDet_MaxAbsYawVelocity_XDU16 "Schwelle der Gierrate für Geradeauserkennung" VALUE 0x150820 AblGLKWuw 30 VGIER 0 30 FORMAT "%8.5" /end CHARACTERISTIC
/begin CHARACTERISTIC vAhaDet_MinRotationLimit_XDU16 "alle 4 Raddrehzahl muessen oberhalb dieser Schwelle sein fuer Geradeauserkennung" VALUE 0x150822 AblGLKWuw 19 VFZHIGH 1 20 FORMAT "%8.5" /end CHARACTERISTIC
/begin CHARACTERISTIC vAhaDet_MinVehicleSpeed_XDU16 "Schwelle Fahrzeuggeschwindigkeit für grundlegende Geradeauserkennung" VALUE 0x150824 AblGLKWuw 255 VFZHIGH 0 255 FORMAT "%8.4" /end CHARACTERISTIC
/begin CHARACTERISTIC vAhaDet_StAnSpeedLimit_XDU16 "Maximale Lenkradwinkelgeschwindigkeit" VALUE 0x150826 AblGLKWuw 1200 SAS_8 0 1200 FORMAT "%8.3" /end CHARACTERISTIC
/begin CHARACTERISTIC xActDamp_FactorDepOnDriverTorque_XAU16_00___A "active damping factor depending on driver torque" CURVE 0x15BA4C AblGLKLuw 2 RIGHTSH10NP 0 2 FORMAT "%8.6"
 /begin AXIS_DESCR STD_AXIS mApplI_AbsDriverTorque_xdu16 TBTHIGH 4 0 25 FORMAT "%8.5" DEPOSIT ABSOLUTE /end AXIS_DESCR
/end CHARACTERISTIC
/begin CHARACTERISTIC xActDamp_FactorDepOnDriverTorque_XAU16_01___A "active damping factor depending on driver torque" CURVE 0x15BA60 AblGLKLuw 2 RIGHTSH10NP 0 2 FORMAT "%8.6"
 /begin AXIS_DESCR STD_AXIS mApplI_AbsDriverTorque_xdu16 TBTHIGH 4 0 25 FORMAT "%8.5" DEPOSIT ABSOLUTE /end AXIS_DESCR
/end CHARACTERISTIC
/begin CHARACTERISTIC xActDamp_FactorDepOnDriverTorque_XAU16_02___A "active damping factor depending on driver torque" CURVE 0x15BA74 AblGLKLuw 2 RIGHTSH10NP 0 2 FORMAT "%8.6"
 /begin AXIS_DESCR STD_AXIS mApplI_AbsDriverTorque_xdu16 TBTHIGH 4 0 25 FORMAT "%8.5" DEPOSIT ABSOLUTE /end AXIS_DESCR
/end CHARACTERISTIC
/begin CHARACTERISTIC xActDamp_FactorDepOnDriverTorque_XAU16_03___A "active damping factor depending on driver torque" CURVE 0x15BA88 AblGLKLuw 2 RIGHTSH10NP 0 2 FORMAT "%8.6"
 /begin AXIS_DESCR STD_AXIS mApplI_AbsDriverTorque_xdu16 TBTHIGH 4 0 25 FORMAT "%8.5" DEPOSIT ABSOLUTE /end AXIS_DESCR
/end CHARACTERISTIC
/begin CHARACTERISTIC xActDamp_FactorDepOnDriverTorque_XAU16_04___A "active damping factor depending on driver torque" CURVE 0x15BA9C AblGLKLuw 2 RIGHTSH10NP 0 2 FORMAT "%8.6"
 /begin AXIS_DESCR STD_AXIS mApplI_AbsDriverTorque_xdu16 TBTHIGH 4 0 25 FORMAT "%8.5" DEPOSIT ABSOLUTE /end AXIS_DESCR
/end CHARACTERISTIC
/begin CHARACTERISTIC xActDamp_FactorDepOnDriverTorque_XAU16_05___A "active damping factor depending on driver torque" CURVE 0x15BAB0 AblGLKLuw 2 RIGHTSH10NP 0 2 FORMAT "%8.6"
 /begin AXIS_DESCR STD_AXIS mApplI_AbsDriverTorque_xdu16 TBTHIGH 4 0 25 FORMAT "%8.5" DEPOSIT ABSOLUTE /end AXIS_DESCR
/end CHARACTERISTIC
/begin CHARACTERISTIC xActDamp_FactorDepOnDriverTorque_XAU16_06___A "active damping factor depending on driver torque" CURVE 0x15BAC4 AblGLKLuw 2 RIGHTSH10NP 0 2 FORMAT "%8.6"
 /begin AXIS_DESCR STD_AXIS mApplI_AbsDriverTorque_xdu16 TBTHIGH 4 0 25 FORMAT "%8.5" DEPOSIT ABSOLUTE /end AXIS_DESCR
/end CHARACTERISTIC
/begin CHARACTERISTIC xActDamp_FactorDepOnDriverTorque_XAU16_07___A "active damping factor depending on driver torque" CURVE 0x15BAD8 AblGLKLuw 2 RIGHTSH10NP 0 2 FORMAT "%8.6"
 /begin AXIS_DESCR STD_AXIS mApplI_AbsDriverTorque_xdu16 TBTHIGH 4 0 25 FORMAT "%8.5" DEPOSIT ABSOLUTE /end AXIS_DESCR
/end CHARACTERISTIC
/begin CHARACTERISTIC xActDamp_FactorDepOnDriverTorque_XAU16_08___A "active damping factor depending on driver torque" CURVE 0x15BAEC AblGLKLuw 2 RIGHTSH10NP 0 2 FORMAT "%8.6"
 /begin AXIS_DESCR STD_AXIS mApplI_AbsDriverTorque_xdu16 TBTHIGH 4 0 25 FORMAT "%8.5" DEPOSIT ABSOLUTE /end AXIS_DESCR
/end CHARACTERISTIC
/begin CHARACTERISTIC xActDamp_FactorDepOnDriverTorque_XAU16_09___A "active damping factor depending on driver torque" CURVE 0x15BB00 AblGLKLuw 2 RIGHTSH10NP 0 2 FORMAT "%8.6"
 /begin AXIS_DESCR STD_AXIS mApplI_AbsDriverTorque_xdu16 TBTHIGH 4 0 25 FORMAT "%8.5" DEPOSIT ABSOLUTE /end AXIS_DESCR
/end CHARACTERISTIC
/begin CHARACTERISTIC xActDamp_FactorDepOnDriverTorque_XAU16_10___A "active damping factor depending on driver torque" CURVE 0x15BB14 AblGLKLuw 2 RIGHTSH10NP 0 2 FORMAT "%8.6"
 /begin AXIS_DESCR STD_AXIS mApplI_AbsDriverTorque_xdu16 TBTHIGH 4 0 25 FORMAT "%8.5" DEPOSIT ABSOLUTE /end AXIS_DESCR
/end CHARACTERISTIC
/begin CHARACTERISTIC xActDamp_FactorDepOnDriverTorque_XAU16_11___A "active damping factor depending on driver torque" CURVE 0x15BB28 AblGLKLuw 2 RIGHTSH10NP 0 2 FORMAT "%8.6"
 /begin AXIS_DESCR STD_AXIS mApplI_AbsDriverTorque_xdu16 TBTHIGH 4 0 25 FORMAT "%8.5" DEPOSIT ABSOLUTE /end AXIS_DESCR
/end CHARACTERISTIC
/begin CHARACTERISTIC xActDamp_FactorDepOnDriverTorque_XAU16_12___A "active damping factor depending on driver torque" CURVE 0x15BB3C AblGLKLuw 2 RIGHTSH10NP 0 2 FORMAT "%8.6"
 /begin AXIS_DESCR STD_AXIS mApplI_AbsDriverTorque_xdu16 TBTHIGH 4 0 25 FORMAT "%8.5" DEPOSIT ABSOLUTE /end AXIS_DESCR
/end CHARACTERISTIC
/begin CHARACTERISTIC xActDamp_FactorDepOnDriverTorque_XAU16_13___A "active damping factor depending on driver torque" CURVE 0x15BB50 AblGLKLuw 2 RIGHTSH10NP 0 2 FORMAT "%8.6"
 /begin AXIS_DESCR STD_AXIS mApplI_AbsDriverTorque_xdu16 TBTHIGH 4 0 25 FORMAT "%8.5" DEPOSIT ABSOLUTE /end AXIS_DESCR
/end CHARACTERISTIC
/begin CHARACTERISTIC xActDamp_FactorDepOnDriverTorque_XAU16_14___A "active damping factor depending on driver torque" CURVE 0x15BB64 AblGLKLuw 2 RIGHTSH10NP 0 2 FORMAT "%8.6"
 /begin AXIS_DESCR STD_AXIS mApplI_AbsDriverTorque_xdu16 TBTHIGH 4 0 25 FORMAT "%8.5" DEPOSIT ABSOLUTE /end AXIS_DESCR
/end CHARACTERISTIC
/begin CHARACTERISTIC xActDamp_FactorDepOnDriverTorque_XAU16_15___A "active damping factor depending on driver torque" CURVE 0x15BB78 AblGLKLuw 2 RIGHTSH10NP 0 2 FORMAT "%8.6"
 /begin AXIS_DESCR STD_AXIS mApplI_AbsDriverTorque_xdu16 TBTHIGH 4 0 25 FORMAT "%8.5" DEPOSIT ABSOLUTE /end AXIS_DESCR
/end CHARACTERISTIC
/begin CHARACTERISTIC xActDamp_FactorDepOnDriverTorque_XAU16_16___A "active damping factor depending on driver torque" CURVE 0x15BB8C AblGLKLuw 2 RIGHTSH10NP 0 2 FORMAT "%8.6"
 /begin AXIS_DESCR STD_AXIS mApplI_AbsDriverTorque_xdu16 TBTHIGH 4 0 25 FORMAT "%8.5" DEPOSIT ABSOLUTE /end AXIS_DESCR
/end CHARACTERISTIC
/begin CHARACTERISTIC xActDamp_FactorDepOnDriverTorque_XAU16_17___A "active damping factor depending on driver torque" CURVE 0x15BBA0 AblGLKLuw 2 RIGHTSH10NP 0 2 FORMAT "%8.6"
 /begin AXIS_DESCR STD_AXIS mApplI_AbsDriverTorque_xdu16 TBTHIGH 4 0 25 FORMAT "%8.5" DEPOSIT ABSOLUTE /end AXIS_DESCR
/end CHARACTERISTIC
/begin CHARACTERISTIC xActDamp_FactorDepOnDriverTorque_XAU16_18___A "active damping factor depending on driver torque" CURVE 0x15BBB4 AblGLKLuw 2 RIGHTSH10NP 0 2 FORMAT "%8.6"
 /begin AXIS_DESCR STD_AXIS mApplI_AbsDriverTorque_xdu16 TBTHIGH 4 0 25 FORMAT "%8.5" DEPOSIT ABSOLUTE /end AXIS_DESCR
/end CHARACTERISTIC
/begin CHARACTERISTIC xActDamp_FactorDepOnDriverTorque_XAU16_19___A "active damping factor depending on driver torque" CURVE 0x15BBC8 AblGLKLuw 2 RIGHTSH10NP 0 2 FORMAT "%8.6"
 /begin AXIS_DESCR STD_AXIS mApplI_AbsDriverTorque_xdu16 TBTHIGH 4 0 25 FORMAT "%8.5" DEPOSIT ABSOLUTE /end AXIS_DESCR
/end CHARACTERISTIC
/begin CHARACTERISTIC xActDamp_FactorDepOnDriverTorque_XAU16_20___A "active damping factor depending on driver torque" CURVE 0x15BBDC AblGLKLuw 2 RIGHTSH10NP 0 2 FORMAT "%8.6"
 /begin AXIS_DESCR STD_AXIS mApplI_AbsDriverTorque_xdu16 TBTHIGH 4 0 25 FORMAT "%8.5" DEPOSIT ABSOLUTE /end AXIS_DESCR
/end CHARACTERISTIC
/begin CHARACTERISTIC xActDamp_FactorDepOnDriverTorque_XAU16_21___A "active damping factor depending on driver torque" CURVE 0x15BBF0 AblGLKLuw 2 RIGHTSH10NP 0 2 FORMAT "%8.6"
 /begin AXIS_DESCR STD_AXIS mApplI_AbsDriverTorque_xdu16 TBTHIGH 4 0 25 FORMAT "%8.5" DEPOSIT ABSOLUTE /end AXIS_DESCR
/end CHARACTERISTIC
/begin CHARACTERISTIC xActDamp_FactorDepOnDriverTorque_XAU16_22___A "active damping factor depending on driver torque" CURVE 0x15BC04 AblGLKLuw 2 RIGHTSH10NP 0 2 FORMAT "%8.6"
 /begin AXIS_DESCR STD_AXIS mApplI_AbsDriverTorque_xdu16 TBTHIGH 4 0 25 FORMAT "%8.5" DEPOSIT ABSOLUTE /end AXIS_DESCR
/end CHARACTERISTIC
/begin CHARACTERISTIC xActDamp_FactorDepOnDriverTorque_XAU16_23___A "active damping factor depending on driver torque" CURVE 0x15BC18 AblGLKLuw 2 RIGHTSH10NP 0 2 FORMAT "%8.6"
 /begin AXIS_DESCR STD_AXIS mApplI_AbsDriverTorque_xdu16 TBTHIGH 4 0 25 FORMAT "%8.5" DEPOSIT ABSOLUTE /end AXIS_DESCR
/end CHARACTERISTIC
/begin CHARACTERISTIC xActDamp_FactorDepOnDriverTorque_XAU16_24___A "active damping factor depending on driver torque" CURVE 0x15BC2C AblGLKLuw 2 RIGHTSH10NP 0 2 FORMAT "%8.6"
 /begin AXIS_DESCR STD_AXIS mApplI_AbsDriverTorque_xdu16 TBTHIGH 4 0 25 FORMAT "%8.5" DEPOSIT ABSOLUTE /end AXIS_DESCR
/end CHARACTERISTIC
/begin CHARACTERISTIC xActDamp_FactorDepOnDriverTorque_XAU16_25___A "active damping factor depending on driver torque" CURVE 0x15BC40 AblGLKLuw 2 RIGHTSH10NP 0 2 FORMAT "%8.6"
 /begin AXIS_DESCR STD_AXIS mApplI_AbsDriverTorque_xdu16 TBTHIGH 4 0 25 FORMAT "%8.5" DEPOSIT ABSOLUTE /end AXIS_DESCR
/end CHARACTERISTIC
/begin CHARACTERISTIC xActDamp_FactorDepOnDriverTorque_XAU16_26___A "active damping factor depending on driver torque" CURVE 0x15BC54 AblGLKLuw 2 RIGHTSH10NP 0 2 FORMAT "%8.6"
 /begin AXIS_DESCR STD_AXIS mApplI_AbsDriverTorque_xdu16 TBTHIGH 4 0 25 FORMAT "%8.5" DEPOSIT ABSOLUTE /end AXIS_DESCR
/end CHARACTERISTIC
/begin CHARACTERISTIC xActDamp_FactorDepOnDriverTorque_XAU16_27___A "active damping factor depending on driver torque" CURVE 0x15BC68 AblGLKLuw 2 RIGHTSH10NP 0 2 FORMAT "%8.6"
 /begin AXIS_DESCR STD_AXIS mApplI_AbsDriverTorque_xdu16 TBTHIGH 4 0 25 FORMAT "%8.5" DEPOSIT ABSOLUTE /end AXIS_DESCR
/end CHARACTERISTIC
/begin CHARACTERISTIC xActDamp_FactorDepOnDriverTorque_XAU16_28___A "active damping factor depending on driver torque" CURVE 0x15BC7C AblGLKLuw 2 RIGHTSH10NP 0 2 FORMAT "%8.6"
 /begin AXIS_DESCR STD_AXIS mApplI_AbsDriverTorque_xdu16 TBTHIGH 4 0 25 FORMAT "%8.5" DEPOSIT ABSOLUTE /end AXIS_DESCR
/end CHARACTERISTIC
/begin CHARACTERISTIC xActDamp_FactorDepOnDriverTorque_XAU16_29___A "active damping factor depending on driver torque" CURVE 0x15BC90 AblGLKLuw 2 RIGHTSH10NP 0 2 FORMAT "%8.6"
 /begin AXIS_DESCR STD_AXIS mApplI_AbsDriverTorque_xdu16 TBTHIGH 4 0 25 FORMAT "%8.5" DEPOSIT ABSOLUTE /end AXIS_DESCR
/end CHARACTERISTIC
/begin CHARACTERISTIC xActDamp_FactorDepOnDriverTorque_XAU16_30___A "active damping factor depending on driver torque" CURVE 0x15BCA4 AblGLKLuw 2 RIGHTSH10NP 0 2 FORMAT "%8.6"
 /begin AXIS_DESCR STD_AXIS mApplI_AbsDriverTorque_xdu16 TBTHIGH 4 0 25 FORMAT "%8.5" DEPOSIT ABSOLUTE /end AXIS_DESCR
/end CHARACTERISTIC
/begin CHARACTERISTIC xActDamp_FactorDepOnDriverTorque_XAU16_31___A "active damping factor depending on driver torque" CURVE 0x15BCB8 AblGLKLuw 2 RIGHTSH10NP 0 2 FORMAT "%8.6"
 /begin AXIS_DESCR STD_AXIS mApplI_AbsDriverTorque_xdu16 TBTHIGH 4 0 25 FORMAT "%8.5" DEPOSIT ABSOLUTE /end AXIS_DESCR
/end CHARACTERISTIC
/begin CHARACTERISTIC xActDamp_FactorDepOnDriverTorque_XAU16_32___A "active damping factor depending on driver torque" CURVE 0x15BCCC AblGLKLuw 2 RIGHTSH10NP 0 2 FORMAT "%8.6"
 /begin AXIS_DESCR STD_AXIS mApplI_AbsDriverTorque_xdu16 TBTHIGH 4 0 25 FORMAT "%8.5" DEPOSIT ABSOLUTE /end AXIS_DESCR
/end CHARACTERISTIC
/begin CHARACTERISTIC xActDamp_FactorDepOnDriverTorque_XAU16_33___A "active damping factor depending on driver torque" CURVE 0x15BCE0 AblGLKLuw 2 RIGHTSH10NP 0 2 FORMAT "%8.6"
 /begin AXIS_DESCR STD_AXIS mApplI_AbsDriverTorque_xdu16 TBTHIGH 4 0 25 FORMAT "%8.5" DEPOSIT ABSOLUTE /end AXIS_DESCR
/end CHARACTERISTIC
/begin CHARACTERISTIC xActDamp_FactorDepOnDriverTorque_XAU16_34___A "active damping factor depending on driver torque" CURVE 0x15BCF4 AblGLKLuw 2 RIGHTSH10NP 0 2 FORMAT "%8.6"
 /begin AXIS_DESCR STD_AXIS mApplI_AbsDriverTorque_xdu16 TBTHIGH 4 0 25 FORMAT "%8.5" DEPOSIT ABSOLUTE /end AXIS_DESCR
/end CHARACTERISTIC
/begin CHARACTERISTIC xActDamp_FactorDepOnDriverTorque_XAU16_35___A "active damping factor depending on driver torque" CURVE 0x15BD08 AblGLKLuw 2 RIGHTSH10NP 0 2 FORMAT "%8.6"
 /begin AXIS_DESCR STD_AXIS mApplI_AbsDriverTorque_xdu16 TBTHIGH 4 0 25 FORMAT "%8.5" DEPOSIT ABSOLUTE /end AXIS_DESCR
/end CHARACTERISTIC
/begin CHARACTERISTIC xActDamp_FactorDepOnSteerAngle_XAU16_00___A "active damping factor depending on steering angle" CURVE 0x15BD1C AblGLKLuw 1.5 RIGHTSH10NP 0 1.5 FORMAT "%8.6"
 /begin AXIS_DESCR STD_AXIS wApplI_AbsSteeringAngle_xdu16 SA_10 5 0 1000 FORMAT "%8.3" DEPOSIT ABSOLUTE /end AXIS_DESCR
/end CHARACTERISTIC
/begin CHARACTERISTIC xActDamp_FactorDepOnSteerAngle_XAU16_01___A "active damping factor depending on steering angle" CURVE 0x15BD34 AblGLKLuw 1.5 RIGHTSH10NP 0 1.5 FORMAT "%8.6"
 /begin AXIS_DESCR STD_AXIS wApplI_AbsSteeringAngle_xdu16 SA_10 5 0 1000 FORMAT "%8.3" DEPOSIT ABSOLUTE /end AXIS_DESCR
/end CHARACTERISTIC
/begin CHARACTERISTIC xActDamp_FactorDepOnSteerAngle_XAU16_02___A "active damping factor depending on steering angle" CURVE 0x15BD4C AblGLKLuw 1.5 RIGHTSH10NP 0 1.5 FORMAT "%8.6"
 /begin AXIS_DESCR STD_AXIS wApplI_AbsSteeringAngle_xdu16 SA_10 5 0 1000 FORMAT "%8.3" DEPOSIT ABSOLUTE /end AXIS_DESCR
/end CHARACTERISTIC
/begin CHARACTERISTIC xActDamp_FactorDepOnSteerAngle_XAU16_03___A "active damping factor depending on steering angle" CURVE 0x15BD64 AblGLKLuw 1.5 RIGHTSH10NP 0 1.5 FORMAT "%8.6"
 /begin AXIS_DESCR STD_AXIS wApplI_AbsSteeringAngle_xdu16 SA_10 5 0 1000 FORMAT "%8.3" DEPOSIT ABSOLUTE /end AXIS_DESCR
/end CHARACTERISTIC
/begin CHARACTERISTIC xActDamp_FactorDepOnSteerAngle_XAU16_04___A "active damping factor depending on steering angle" CURVE 0x15BD7C AblGLKLuw 1.5 RIGHTSH10NP 0 1.5 FORMAT "%8.6"
 /begin AXIS_DESCR STD_AXIS wApplI_AbsSteeringAngle_xdu16 SA_10 5 0 1000 FORMAT "%8.3" DEPOSIT ABSOLUTE /end AXIS_DESCR
/end CHARACTERISTIC
/begin CHARACTERISTIC xActDamp_FactorDepOnSteerAngle_XAU16_05___A "active damping factor depending on steering angle" CURVE 0x15BD94 AblGLKLuw 1.5 RIGHTSH10NP 0 1.5 FORMAT "%8.6"
 /begin AXIS_DESCR STD_AXIS wApplI_AbsSteeringAngle_xdu16 SA_10 5 0 1000 FORMAT "%8.3" DEPOSIT ABSOLUTE /end AXIS_DESCR
/end CHARACTERISTIC
/begin CHARACTERISTIC xActDamp_FactorDepOnSteerAngle_XAU16_06___A "active damping factor depending on steering angle" CURVE 0x15BDAC AblGLKLuw 1.5 RIGHTSH10NP 0 1.5 FORMAT "%8.6"
 /begin AXIS_DESCR STD_AXIS wApplI_AbsSteeringAngle_xdu16 SA_10 5 0 1000 FORMAT "%8.3" DEPOSIT ABSOLUTE /end AXIS_DESCR
/end CHARACTERISTIC
/begin CHARACTERISTIC xActDamp_FactorDepOnSteerAngle_XAU16_07___A "active damping factor depending on steering angle" CURVE 0x15BDC4 AblGLKLuw 1.5 RIGHTSH10NP 0 1.5 FORMAT "%8.6"
 /begin AXIS_DESCR STD_AXIS wApplI_AbsSteeringAngle_xdu16 SA_10 5 0 1000 FORMAT "%8.3" DEPOSIT ABSOLUTE /end AXIS_DESCR
/end CHARACTERISTIC
/begin CHARACTERISTIC xActDamp_FactorDepOnSteerAngle_XAU16_08___A "active damping factor depending on steering angle" CURVE 0x15BDDC AblGLKLuw 1.5 RIGHTSH10NP 0 1.5 FORMAT "%8.6"
 /begin AXIS_DESCR STD_AXIS wApplI_AbsSteeringAngle_xdu16 SA_10 5 0 1000 FORMAT "%8.3" DEPOSIT ABSOLUTE /end AXIS_DESCR
/end CHARACTERISTIC
/begin CHARACTERISTIC xActDamp_FactorDepOnSteerAngle_XAU16_09___A "active damping factor depending on steering angle" CURVE 0x15BDF4 AblGLKLuw 1.5 RIGHTSH10NP 0 1.5 FORMAT "%8.6"
 /begin AXIS_DESCR STD_AXIS wApplI_AbsSteeringAngle_xdu16 SA_10 5 0 1000 FORMAT "%8.3" DEPOSIT ABSOLUTE /end AXIS_DESCR
/end CHARACTERISTIC
/begin CHARACTERISTIC xActDamp_FactorDepOnSteerAngle_XAU16_10___A "active damping factor depending on steering angle" CURVE 0x15BE0C AblGLKLuw 1.5 RIGHTSH10NP 0 1.5 FORMAT "%8.6"
 /begin AXIS_DESCR STD_AXIS wApplI_AbsSteeringAngle_xdu16 SA_10 5 0 1000 FORMAT "%8.3" DEPOSIT ABSOLUTE /end AXIS_DESCR
/end CHARACTERISTIC
/begin CHARACTERISTIC xActDamp_FactorDepOnSteerAngle_XAU16_11___A "active damping factor depending on steering angle" CURVE 0x15BE24 AblGLKLuw 1.5 RIGHTSH10NP 0 1.5 FORMAT "%8.6"
 /begin AXIS_DESCR STD_AXIS wApplI_AbsSteeringAngle_xdu16 SA_10 5 0 1000 FORMAT "%8.3" DEPOSIT ABSOLUTE /end AXIS_DESCR
/end CHARACTERISTIC
/begin CHARACTERISTIC xActDamp_FactorDepOnSteerAngle_XAU16_12___A "active damping factor depending on steering angle" CURVE 0x15BE3C AblGLKLuw 1.5 RIGHTSH10NP 0 1.5 FORMAT "%8.6"
 /begin AXIS_DESCR STD_AXIS wApplI_AbsSteeringAngle_xdu16 SA_10 5 0 1000 FORMAT "%8.3" DEPOSIT ABSOLUTE /end AXIS_DESCR
/end CHARACTERISTIC
/begin CHARACTERISTIC xActDamp_FactorDepOnSteerAngle_XAU16_13___A "active damping factor depending on steering angle" CURVE 0x15BE54 AblGLKLuw 1.5 RIGHTSH10NP 0 1.5 FORMAT "%8.6"
 /begin AXIS_DESCR STD_AXIS wApplI_AbsSteeringAngle_xdu16 SA_10 5 0 1000 FORMAT "%8.3" DEPOSIT ABSOLUTE /end AXIS_DESCR
/end CHARACTERISTIC
/begin CHARACTERISTIC xActDamp_FactorDepOnSteerAngle_XAU16_14___A "active damping factor depending on steering angle" CURVE 0x15BE6C AblGLKLuw 1.5 RIGHTSH10NP 0 1.5 FORMAT "%8.6"
 /begin AXIS_DESCR STD_AXIS wApplI_AbsSteeringAngle_xdu16 SA_10 5 0 1000 FORMAT "%8.3" DEPOSIT ABSOLUTE /end AXIS_DESCR
/end CHARACTERISTIC
/begin CHARACTERISTIC xActDamp_FactorDepOnSteerAngle_XAU16_15___A "active damping factor depending on steering angle" CURVE 0x15BE84 AblGLKLuw 1.5 RIGHTSH10NP 0 1.5 FORMAT "%8.6"
 /begin AXIS_DESCR STD_AXIS wApplI_AbsSteeringAngle_xdu16 SA_10 5 0 1000 FORMAT "%8.3" DEPOSIT ABSOLUTE /end AXIS_DESCR
/end CHARACTERISTIC
/begin CHARACTERISTIC xActDamp_FactorDepOnSteerAngle_XAU16_16___A "active damping factor depending on steering angle" CURVE 0x15BE9C AblGLKLuw 1.5 RIGHTSH10NP 0 1.5 FORMAT "%8.6"
 /begin AXIS_DESCR STD_AXIS wApplI_AbsSteeringAngle_xdu16 SA_10 5 0 1000 FORMAT "%8.3" DEPOSIT ABSOLUTE /end AXIS_DESCR
/end CHARACTERISTIC
/begin CHARACTERISTIC xActDamp_FactorDepOnSteerAngle_XAU16_17___A "active damping factor depending on steering angle" CURVE 0x15BEB4 AblGLKLuw 1.5 RIGHTSH10NP 0 1.5 FORMAT "%8.6"
 /begin AXIS_DESCR STD_AXIS wApplI_AbsSteeringAngle_xdu16 SA_10 5 0 1000 FORMAT "%8.3" DEPOSIT ABSOLUTE /end AXIS_DESCR
/end CHARACTERISTIC
/begin CHARACTERISTIC xActDamp_FactorDepOnSteerAngle_XAU16_18___A "active damping factor depending on steering angle" CURVE 0x15BECC AblGLKLuw 1.5 RIGHTSH10NP 0 1.5 FORMAT "%8.6"
 /begin AXIS_DESCR STD_AXIS wApplI_AbsSteeringAngle_xdu16 SA_10 5 0 1000 FORMAT "%8.3" DEPOSIT ABSOLUTE /end AXIS_DESCR
/end CHARACTERISTIC
/begin CHARACTERISTIC xActDamp_FactorDepOnSteerAngle_XAU16_19___A "active damping factor depending on steering angle" CURVE 0x15BEE4 AblGLKLuw 1.5 RIGHTSH10NP 0 1.5 FORMAT "%8.6"
 /begin AXIS_DESCR STD_AXIS wApplI_AbsSteeringAngle_xdu16 SA_10 5 0 1000 FORMAT "%8.3" DEPOSIT ABSOLUTE /end AXIS_DESCR
/end CHARACTERISTIC
/begin CHARACTERISTIC xActDamp_FactorDepOnSteerAngle_XAU16_20___A "active damping factor depending on steering angle" CURVE 0x15BEFC AblGLKLuw 1.5 RIGHTSH10NP 0 1.5 FORMAT "%8.6"
 /begin AXIS_DESCR STD_AXIS wApplI_AbsSteeringAngle_xdu16 SA_10 5 0 1000 FORMAT "%8.3" DEPOSIT ABSOLUTE /end AXIS_DESCR
/end CHARACTERISTIC
/begin CHARACTERISTIC xActDamp_FactorDepOnSteerAngle_XAU16_21___A "active damping factor depending on steering angle" CURVE 0x15BF14 AblGLKLuw 1.5 RIGHTSH10NP 0 1.5 FORMAT "%8.6"
 /begin AXIS_DESCR STD_AXIS wApplI_AbsSteeringAngle_xdu16 SA_10 5 0 1000 FORMAT "%8.3" DEPOSIT ABSOLUTE /end AXIS_DESCR
/end CHARACTERISTIC
/begin CHARACTERISTIC xActDamp_FactorDepOnSteerAngle_XAU16_22___A "active damping factor depending on steering angle" CURVE 0x15BF2C AblGLKLuw 1.5 RIGHTSH10NP 0 1.5 FORMAT "%8.6"
 /begin AXIS_DESCR STD_AXIS wApplI_AbsSteeringAngle_xdu16 SA_10 5 0 1000 FORMAT "%8.3" DEPOSIT ABSOLUTE /end AXIS_DESCR
/end CHARACTERISTIC
/begin CHARACTERISTIC xActDamp_FactorDepOnSteerAngle_XAU16_23___A "active damping factor depending on steering angle" CURVE 0x15BF44 AblGLKLuw 1.5 RIGHTSH10NP 0 1.5 FORMAT "%8.6"
 /begin AXIS_DESCR STD_AXIS wApplI_AbsSteeringAngle_xdu16 SA_10 5 0 1000 FORMAT "%8.3" DEPOSIT ABSOLUTE /end AXIS_DESCR
/end CHARACTERISTIC
/begin CHARACTERISTIC xActDamp_FactorDepOnSteerAngle_XAU16_24___A "active damping factor depending on steering angle" CURVE 0x15BF5C AblGLKLuw 1.5 RIGHTSH10NP 0 1.5 FORMAT "%8.6"
 /begin AXIS_DESCR STD_AXIS wApplI_AbsSteeringAngle_xdu16 SA_10 5 0 1000 FORMAT "%8.3" DEPOSIT ABSOLUTE /end AXIS_DESCR
/end CHARACTERISTIC
/begin CHARACTERISTIC xActDamp_FactorDepOnSteerAngle_XAU16_25___A "active damping factor depending on steering angle" CURVE 0x15BF74 AblGLKLuw 1.5 RIGHTSH10NP 0 1.5 FORMAT "%8.6"
 /begin AXIS_DESCR STD_AXIS wApplI_AbsSteeringAngle_xdu16 SA_10 5 0 1000 FORMAT "%8.3" DEPOSIT ABSOLUTE /end AXIS_DESCR
/end CHARACTERISTIC
/begin CHARACTERISTIC xActDamp_FactorDepOnSteerAngle_XAU16_26___A "active damping factor depending on steering angle" CURVE 0x15BF8C AblGLKLuw 1.5 RIGHTSH10NP 0 1.5 FORMAT "%8.6"
 /begin AXIS_DESCR STD_AXIS wApplI_AbsSteeringAngle_xdu16 SA_10 5 0 1000 FORMAT "%8.3" DEPOSIT ABSOLUTE /end AXIS_DESCR
/end CHARACTERISTIC
/begin CHARACTERISTIC xActDamp_FactorDepOnSteerAngle_XAU16_27___A "active damping factor depending on steering angle" CURVE 0x15BFA4 AblGLKLuw 1.5 RIGHTSH10NP 0 1.5 FORMAT "%8.6"
 /begin AXIS_DESCR STD_AXIS wApplI_AbsSteeringAngle_xdu16 SA_10 5 0 1000 FORMAT "%8.3" DEPOSIT ABSOLUTE /end AXIS_DESCR
/end CHARACTERISTIC
/begin CHARACTERISTIC xActDamp_FactorDepOnSteerAngle_XAU16_28___A "active damping factor depending on steering angle" CURVE 0x15BFBC AblGLKLuw 1.5 RIGHTSH10NP 0 1.5 FORMAT "%8.6"
 /begin AXIS_DESCR STD_AXIS wApplI_AbsSteeringAngle_xdu16 SA_10 5 0 1000 FORMAT "%8.3" DEPOSIT ABSOLUTE /end AXIS_DESCR
/end CHARACTERISTIC
/begin CHARACTERISTIC xActDamp_FactorDepOnSteerAngle_XAU16_29___A "active damping factor depending on steering angle" CURVE 0x15BFD4 AblGLKLuw 1.5 RIGHTSH10NP 0 1.5 FORMAT "%8.6"
 /begin AXIS_DESCR STD_AXIS wApplI_AbsSteeringAngle_xdu16 SA_10 5 0 1000 FORMAT "%8.3" DEPOSIT ABSOLUTE /end AXIS_DESCR
/end CHARACTERISTIC
/begin CHARACTERISTIC xActDamp_FactorDepOnSteerAngle_XAU16_30___A "active damping factor depending on steering angle" CURVE 0x15BFEC AblGLKLuw 1.5 RIGHTSH10NP 0 1.5 FORMAT "%8.6"
 /begin AXIS_DESCR STD_AXIS wApplI_AbsSteeringAngle_xdu16 SA_10 5 0 1000 FORMAT "%8.3" DEPOSIT ABSOLUTE /end AXIS_DESCR
/end CHARACTERISTIC
/begin CHARACTERISTIC xActDamp_FactorDepOnSteerAngle_XAU16_31___A "active damping factor depending on steering angle" CURVE 0x15C004 AblGLKLuw 1.5 RIGHTSH10NP 0 1.5 FORMAT "%8.6"
 /begin AXIS_DESCR STD_AXIS wApplI_AbsSteeringAngle_xdu16 SA_10 5 0 1000 FORMAT "%8.3" DEPOSIT ABSOLUTE /end AXIS_DESCR
/end CHARACTERISTIC
/begin CHARACTERISTIC xActDamp_FactorDepOnSteerAngle_XAU16_32___A "active damping factor depending on steering angle" CURVE 0x15C01C AblGLKLuw 1.5 RIGHTSH10NP 0 1.5 FORMAT "%8.6"
 /begin AXIS_DESCR STD_AXIS wApplI_AbsSteeringAngle_xdu16 SA_10 5 0 1000 FORMAT "%8.3" DEPOSIT ABSOLUTE /end AXIS_DESCR
/end CHARACTERISTIC
/begin CHARACTERISTIC xActDamp_FactorDepOnSteerAngle_XAU16_33___A "active damping factor depending on steering angle" CURVE 0x15C034 AblGLKLuw 1.5 RIGHTSH10NP 0 1.5 FORMAT "%8.6"
 /begin AXIS_DESCR STD_AXIS wApplI_AbsSteeringAngle_xdu16 SA_10 5 0 1000 FORMAT "%8.3" DEPOSIT ABSOLUTE /end AXIS_DESCR
/end CHARACTERISTIC
/begin CHARACTERISTIC xActDamp_FactorDepOnSteerAngle_XAU16_34___A "active damping factor depending on steering angle" CURVE 0x15C04C AblGLKLuw 1.5 RIGHTSH10NP 0 1.5 FORMAT "%8.6"
 /begin AXIS_DESCR STD_AXIS wApplI_AbsSteeringAngle_xdu16 SA_10 5 0 1000 FORMAT "%8.3" DEPOSIT ABSOLUTE /end AXIS_DESCR
/end CHARACTERISTIC
/begin CHARACTERISTIC xActDamp_FactorDepOnSteerAngle_XAU16_35___A "active damping factor depending on steering angle" CURVE 0x15C064 AblGLKLuw 1.5 RIGHTSH10NP 0 1.5 FORMAT "%8.6"
 /begin AXIS_DESCR STD_AXIS wApplI_AbsSteeringAngle_xdu16 SA_10 5 0 1000 FORMAT "%8.3" DEPOSIT ABSOLUTE /end AXIS_DESCR
/end CHARACTERISTIC
/begin CHARACTERISTIC xActDamp_FactorDepOnVehSpeed_XAU16_00___A "active damping factor depending on vehicle speed" CURVE 0x15C07C AblGLKLuw 2 RIGHTSH10NP 0 2 FORMAT "%8.6"
 /begin AXIS_DESCR STD_AXIS vVehSpI_AbsAvgVehSpd_xdu16 VFZHIGH 4 0 500 FORMAT "%8.4" DEPOSIT ABSOLUTE /end AXIS_DESCR
/end CHARACTERISTIC
/begin CHARACTERISTIC xActDamp_FactorDepOnVehSpeed_XAU16_01___A "active damping factor depending on vehicle speed" CURVE 0x15C090 AblGLKLuw 2 RIGHTSH10NP 0 2 FORMAT "%8.6"
 /begin AXIS_DESCR STD_AXIS vVehSpI_AbsAvgVehSpd_xdu16 VFZHIGH 4 0 500 FORMAT "%8.4" DEPOSIT ABSOLUTE /end AXIS_DESCR
/end CHARACTERISTIC
/begin CHARACTERISTIC xActDamp_FactorDepOnVehSpeed_XAU16_02___A "active damping factor depending on vehicle speed" CURVE 0x15C0A4 AblGLKLuw 2 RIGHTSH10NP 0 2 FORMAT "%8.6"
 /begin AXIS_DESCR STD_AXIS vVehSpI_AbsAvgVehSpd_xdu16 VFZHIGH 4 0 500 FORMAT "%8.4" DEPOSIT ABSOLUTE /end AXIS_DESCR
/end CHARACTERISTIC
/begin CHARACTERISTIC xActDamp_FactorDepOnVehSpeed_XAU16_03___A "active damping factor depending on vehicle speed" CURVE 0x15C0B8 AblGLKLuw 2 RIGHTSH10NP 0 2 FORMAT "%8.6"
 /begin AXIS_DESCR STD_AXIS vVehSpI_AbsAvgVehSpd_xdu16 VFZHIGH 4 0 500 FORMAT "%8.4" DEPOSIT ABSOLUTE /end AXIS_DESCR
/end CHARACTERISTIC
/begin CHARACTERISTIC xActDamp_FactorDepOnVehSpeed_XAU16_04___A "active damping factor depending on vehicle speed" CURVE 0x15C0CC AblGLKLuw 2 RIGHTSH10NP 0 2 FORMAT "%8.6"
 /begin AXIS_DESCR STD_AXIS vVehSpI_AbsAvgVehSpd_xdu16 VFZHIGH 4 0 500 FORMAT "%8.4" DEPOSIT ABSOLUTE /end AXIS_DESCR
/end CHARACTERISTIC
/begin CHARACTERISTIC xActDamp_FactorDepOnVehSpeed_XAU16_05___A "active damping factor depending on vehicle speed" CURVE 0x15C0E0 AblGLKLuw 2 RIGHTSH10NP 0 2 FORMAT "%8.6"
 /begin AXIS_DESCR STD_AXIS vVehSpI_AbsAvgVehSpd_xdu16 VFZHIGH 4 0 500 FORMAT "%8.4" DEPOSIT ABSOLUTE /end AXIS_DESCR
/end CHARACTERISTIC
/begin CHARACTERISTIC xActDamp_FactorDepOnVehSpeed_XAU16_06___A "active damping factor depending on vehicle speed" CURVE 0x15C0F4 AblGLKLuw 2 RIGHTSH10NP 0 2 FORMAT "%8.6"
 /begin AXIS_DESCR STD_AXIS vVehSpI_AbsAvgVehSpd_xdu16 VFZHIGH 4 0 500 FORMAT "%8.4" DEPOSIT ABSOLUTE /end AXIS_DESCR
/end CHARACTERISTIC
/begin CHARACTERISTIC xActDamp_FactorDepOnVehSpeed_XAU16_07___A "active damping factor depending on vehicle speed" CURVE 0x15C108 AblGLKLuw 2 RIGHTSH10NP 0 2 FORMAT "%8.6"
 /begin AXIS_DESCR STD_AXIS vVehSpI_AbsAvgVehSpd_xdu16 VFZHIGH 4 0 500 FORMAT "%8.4" DEPOSIT ABSOLUTE /end AXIS_DESCR
/end CHARACTERISTIC
/begin CHARACTERISTIC xActDamp_FactorDepOnVehSpeed_XAU16_08___A "active damping factor depending on vehicle speed" CURVE 0x15C11C AblGLKLuw 2 RIGHTSH10NP 0 2 FORMAT "%8.6"
 /begin AXIS_DESCR STD_AXIS vVehSpI_AbsAvgVehSpd_xdu16 VFZHIGH 4 0 500 FORMAT "%8.4" DEPOSIT ABSOLUTE /end AXIS_DESCR
/end CHARACTERISTIC
/begin CHARACTERISTIC xActDamp_FactorDepOnVehSpeed_XAU16_09___A "active damping factor depending on vehicle speed" CURVE 0x15C130 AblGLKLuw 2 RIGHTSH10NP 0 2 FORMAT "%8.6"
 /begin AXIS_DESCR STD_AXIS vVehSpI_AbsAvgVehSpd_xdu16 VFZHIGH 4 0 500 FORMAT "%8.4" DEPOSIT ABSOLUTE /end AXIS_DESCR
/end CHARACTERISTIC
/begin CHARACTERISTIC xActDamp_FactorDepOnVehSpeed_XAU16_10___A "active damping factor depending on vehicle speed" CURVE 0x15C144 AblGLKLuw 2 RIGHTSH10NP 0 2 FORMAT "%8.6"
 /begin AXIS_DESCR STD_AXIS vVehSpI_AbsAvgVehSpd_xdu16 VFZHIGH 4 0 500 FORMAT "%8.4" DEPOSIT ABSOLUTE /end AXIS_DESCR
/end CHARACTERISTIC
/begin CHARACTERISTIC xActDamp_FactorDepOnVehSpeed_XAU16_11___A "active damping factor depending on vehicle speed" CURVE 0x15C158 AblGLKLuw 2 RIGHTSH10NP 0 2 FORMAT "%8.6"
 /begin AXIS_DESCR STD_AXIS vVehSpI_AbsAvgVehSpd_xdu16 VFZHIGH 4 0 500 FORMAT "%8.4" DEPOSIT ABSOLUTE /end AXIS_DESCR
/end CHARACTERISTIC
/begin CHARACTERISTIC xActDamp_FactorDepOnVehSpeed_XAU16_12___A "active damping factor depending on vehicle speed" CURVE 0x15C16C AblGLKLuw 2 RIGHTSH10NP 0 2 FORMAT "%8.6"
 /begin AXIS_DESCR STD_AXIS vVehSpI_AbsAvgVehSpd_xdu16 VFZHIGH 4 0 500 FORMAT "%8.4" DEPOSIT ABSOLUTE /end AXIS_DESCR
/end CHARACTERISTIC
/begin CHARACTERISTIC xActDamp_FactorDepOnVehSpeed_XAU16_13___A "active damping factor depending on vehicle speed" CURVE 0x15C180 AblGLKLuw 2 RIGHTSH10NP 0 2 FORMAT "%8.6"
 /begin AXIS_DESCR STD_AXIS vVehSpI_AbsAvgVehSpd_xdu16 VFZHIGH 4 0 500 FORMAT "%8.4" DEPOSIT ABSOLUTE /end AXIS_DESCR
/end CHARACTERISTIC
/begin CHARACTERISTIC xActDamp_FactorDepOnVehSpeed_XAU16_14___A "active damping factor depending on vehicle speed" CURVE 0x15C194 AblGLKLuw 2 RIGHTSH10NP 0 2 FORMAT "%8.6"
 /begin AXIS_DESCR STD_AXIS vVehSpI_AbsAvgVehSpd_xdu16 VFZHIGH 4 0 500 FORMAT "%8.4" DEPOSIT ABSOLUTE /end AXIS_DESCR
/end CHARACTERISTIC
/begin CHARACTERISTIC xActDamp_FactorDepOnVehSpeed_XAU16_15___A "active damping factor depending on vehicle speed" CURVE 0x15C1A8 AblGLKLuw 2 RIGHTSH10NP 0 2 FORMAT "%8.6"
 /begin AXIS_DESCR STD_AXIS vVehSpI_AbsAvgVehSpd_xdu16 VFZHIGH 4 0 500 FORMAT "%8.4" DEPOSIT ABSOLUTE /end AXIS_DESCR
/end CHARACTERISTIC
/begin CHARACTERISTIC xActDamp_FactorDepOnVehSpeed_XAU16_16___A "active damping factor depending on vehicle speed" CURVE 0x15C1BC AblGLKLuw 2 RIGHTSH10NP 0 2 FORMAT "%8.6"
 /begin AXIS_DESCR STD_AXIS vVehSpI_AbsAvgVehSpd_xdu16 VFZHIGH 4 0 500 FORMAT "%8.4" DEPOSIT ABSOLUTE /end AXIS_DESCR
/end CHARACTERISTIC
/begin CHARACTERISTIC xActDamp_FactorDepOnVehSpeed_XAU16_17___A "active damping factor depending on vehicle speed" CURVE 0x15C1D0 AblGLKLuw 2 RIGHTSH10NP 0 2 FORMAT "%8.6"
 /begin AXIS_DESCR STD_AXIS vVehSpI_AbsAvgVehSpd_xdu16 VFZHIGH 4 0 500 FORMAT "%8.4" DEPOSIT ABSOLUTE /end AXIS_DESCR
/end CHARACTERISTIC
/begin CHARACTERISTIC xActDamp_FactorDepOnVehSpeed_XAU16_18___A "active damping factor depending on vehicle speed" CURVE 0x15C1E4 AblGLKLuw 2 RIGHTSH10NP 0 2 FORMAT "%8.6"
 /begin AXIS_DESCR STD_AXIS vVehSpI_AbsAvgVehSpd_xdu16 VFZHIGH 4 0 500 FORMAT "%8.4" DEPOSIT ABSOLUTE /end AXIS_DESCR
/end CHARACTERISTIC
/begin CHARACTERISTIC xActDamp_FactorDepOnVehSpeed_XAU16_19___A "active damping factor depending on vehicle speed" CURVE 0x15C1F8 AblGLKLuw 2 RIGHTSH10NP 0 2 FORMAT "%8.6"
 /begin AXIS_DESCR STD_AXIS vVehSpI_AbsAvgVehSpd_xdu16 VFZHIGH 4 0 500 FORMAT "%8.4" DEPOSIT ABSOLUTE /end AXIS_DESCR
/end CHARACTERISTIC
/begin CHARACTERISTIC xActDamp_FactorDepOnVehSpeed_XAU16_20___A "active damping factor depending on vehicle speed" CURVE 0x15C20C AblGLKLuw 2 RIGHTSH10NP 0 2 FORMAT "%8.6"
 /begin AXIS_DESCR STD_AXIS vVehSpI_AbsAvgVehSpd_xdu16 VFZHIGH 4 0 500 FORMAT "%8.4" DEPOSIT ABSOLUTE /end AXIS_DESCR
/end CHARACTERISTIC
/begin CHARACTERISTIC xActDamp_FactorDepOnVehSpeed_XAU16_21___A "active damping factor depending on vehicle speed" CURVE 0x15C220 AblGLKLuw 2 RIGHTSH10NP 0 2 FORMAT "%8.6"
 /begin AXIS_DESCR STD_AXIS vVehSpI_AbsAvgVehSpd_xdu16 VFZHIGH 4 0 500 FORMAT "%8.4" DEPOSIT ABSOLUTE /end AXIS_DESCR
/end CHARACTERISTIC
/begin CHARACTERISTIC xActDamp_FactorDepOnVehSpeed_XAU16_22___A "active damping factor depending on vehicle speed" CURVE 0x15C234 AblGLKLuw 2 RIGHTSH10NP 0 2 FORMAT "%8.6"
 /begin AXIS_DESCR STD_AXIS vVehSpI_AbsAvgVehSpd_xdu16 VFZHIGH 4 0 500 FORMAT "%8.4" DEPOSIT ABSOLUTE /end AXIS_DESCR
/end CHARACTERISTIC
/begin CHARACTERISTIC xActDamp_FactorDepOnVehSpeed_XAU16_23___A "active damping factor depending on vehicle speed" CURVE 0x15C248 AblGLKLuw 2 RIGHTSH10NP 0 2 FORMAT "%8.6"
 /begin AXIS_DESCR STD_AXIS vVehSpI_AbsAvgVehSpd_xdu16 VFZHIGH 4 0 500 FORMAT "%8.4" DEPOSIT ABSOLUTE /end AXIS_DESCR
/end CHARACTERISTIC
/begin CHARACTERISTIC xActDamp_FactorDepOnVehSpeed_XAU16_24___A "active damping factor depending on vehicle speed" CURVE 0x15C25C AblGLKLuw 2 RIGHTSH10NP 0 2 FORMAT "%8.6"
 /begin AXIS_DESCR STD_AXIS vVehSpI_AbsAvgVehSpd_xdu16 VFZHIGH 4 0 500 FORMAT "%8.4" DEPOSIT ABSOLUTE /end AXIS_DESCR
/end CHARACTERISTIC
/begin CHARACTERISTIC xActDamp_FactorDepOnVehSpeed_XAU16_25___A "active damping factor depending on vehicle speed" CURVE 0x15C270 AblGLKLuw 2 RIGHTSH10NP 0 2 FORMAT "%8.6"
 /begin AXIS_DESCR STD_AXIS vVehSpI_AbsAvgVehSpd_xdu16 VFZHIGH 4 0 500 FORMAT "%8.4" DEPOSIT ABSOLUTE /end AXIS_DESCR
/end CHARACTERISTIC
/begin CHARACTERISTIC xActDamp_FactorDepOnVehSpeed_XAU16_26___A "active damping factor depending on vehicle speed" CURVE 0x15C284 AblGLKLuw 2 RIGHTSH10NP 0 2 FORMAT "%8.6"
 /begin AXIS_DESCR STD_AXIS vVehSpI_AbsAvgVehSpd_xdu16 VFZHIGH 4 0 500 FORMAT "%8.4" DEPOSIT ABSOLUTE /end AXIS_DESCR
/end CHARACTERISTIC
/begin CHARACTERISTIC xActDamp_FactorDepOnVehSpeed_XAU16_27___A "active damping factor depending on vehicle speed" CURVE 0x15C298 AblGLKLuw 2 RIGHTSH10NP 0 2 FORMAT "%8.6"
 /begin AXIS_DESCR STD_AXIS vVehSpI_AbsAvgVehSpd_xdu16 VFZHIGH 4 0 500 FORMAT "%8.4" DEPOSIT ABSOLUTE /end AXIS_DESCR
/end CHARACTERISTIC
/begin CHARACTERISTIC xActDamp_FactorDepOnVehSpeed_XAU16_28___A "active damping factor depending on vehicle speed" CURVE 0x15C2AC AblGLKLuw 2 RIGHTSH10NP 0 2 FORMAT "%8.6"
 /begin AXIS_DESCR STD_AXIS vVehSpI_AbsAvgVehSpd_xdu16 VFZHIGH 4 0 500 FORMAT "%8.4" DEPOSIT ABSOLUTE /end AXIS_DESCR
/end CHARACTERISTIC
/begin CHARACTERISTIC xActDamp_FactorDepOnVehSpeed_XAU16_29___A "active damping factor depending on vehicle speed" CURVE 0x15C2C0 AblGLKLuw 2 RIGHTSH10NP 0 2 FORMAT "%8.6"
 /begin AXIS_DESCR STD_AXIS vVehSpI_AbsAvgVehSpd_xdu16 VFZHIGH 4 0 500 FORMAT "%8.4" DEPOSIT ABSOLUTE /end AXIS_DESCR
/end CHARACTERISTIC
/begin CHARACTERISTIC xActDamp_FactorDepOnVehSpeed_XAU16_30___A "active damping factor depending on vehicle speed" CURVE 0x15C2D4 AblGLKLuw 2 RIGHTSH10NP 0 2 FORMAT "%8.6"
 /begin AXIS_DESCR STD_AXIS vVehSpI_AbsAvgVehSpd_xdu16 VFZHIGH 4 0 500 FORMAT "%8.4" DEPOSIT ABSOLUTE /end AXIS_DESCR
/end CHARACTERISTIC
/begin CHARACTERISTIC xActDamp_FactorDepOnVehSpeed_XAU16_31___A "active damping factor depending on vehicle speed" CURVE 0x15C2E8 AblGLKLuw 2 RIGHTSH10NP 0 2 FORMAT "%8.6"
 /begin AXIS_DESCR STD_AXIS vVehSpI_AbsAvgVehSpd_xdu16 VFZHIGH 4 0 500 FORMAT "%8.4" DEPOSIT ABSOLUTE /end AXIS_DESCR
/end CHARACTERISTIC
/begin CHARACTERISTIC xActDamp_FactorDepOnVehSpeed_XAU16_32___A "active damping factor depending on vehicle speed" CURVE 0x15C2FC AblGLKLuw 2 RIGHTSH10NP 0 2 FORMAT "%8.6"
 /begin AXIS_DESCR STD_AXIS vVehSpI_AbsAvgVehSpd_xdu16 VFZHIGH 4 0 500 FORMAT "%8.4" DEPOSIT ABSOLUTE /end AXIS_DESCR
/end CHARACTERISTIC
/begin CHARACTERISTIC xActDamp_FactorDepOnVehSpeed_XAU16_33___A "active damping factor depending on vehicle speed" CURVE 0x15C310 AblGLKLuw 2 RIGHTSH10NP 0 2 FORMAT "%8.6"
 /begin AXIS_DESCR STD_AXIS vVehSpI_AbsAvgVehSpd_xdu16 VFZHIGH 4 0 500 FORMAT "%8.4" DEPOSIT ABSOLUTE /end AXIS_DESCR
/end CHARACTERISTIC
/begin CHARACTERISTIC xActDamp_FactorDepOnVehSpeed_XAU16_34___A "active damping factor depending on vehicle speed" CURVE 0x15C324 AblGLKLuw 2 RIGHTSH10NP 0 2 FORMAT "%8.6"
 /begin AXIS_DESCR STD_AXIS vVehSpI_AbsAvgVehSpd_xdu16 VFZHIGH 4 0 500 FORMAT "%8.4" DEPOSIT ABSOLUTE /end AXIS_DESCR
/end CHARACTERISTIC
/begin CHARACTERISTIC xActDamp_FactorDepOnVehSpeed_XAU16_35___A "active damping factor depending on vehicle speed" CURVE 0x15C338 AblGLKLuw 2 RIGHTSH10NP 0 2 FORMAT "%8.6"
 /begin AXIS_DESCR STD_AXIS vVehSpI_AbsAvgVehSpd_xdu16 VFZHIGH 4 0 500 FORMAT "%8.4" DEPOSIT ABSOLUTE /end AXIS_DESCR
/end CHARACTERISTIC
/begin CHARACTERISTIC xActDamp_FactorGrad_XDU16 "Maximum gradient of vehicle speed and steering angle dependent factor. Primarily done to ramp to substitute value. [factor/cycle] (BE AWARE: depends on CycleTime)" VALUE 0x150946 AblGLKWuw 0.999023 RIGHTSH10NP 0.0009765625 1 FORMAT "%8.6" /end CHARACTERISTIC
/begin CHARACTERISTIC xActDamp_TorqueDepOnRotorSpeed_XAU16_00___A "active damping torque depending on rotor speed" CURVE 0x15C34C AblGLKLuw 2 RIGHTSH10NP 0 2 FORMAT "%8.6"
 /begin AXIS_DESCR STD_AXIS nActDamp_AbsRotorSpeedFilt_xdu16 VROT 4 0 13000 FORMAT "%3.0" DEPOSIT ABSOLUTE /end AXIS_DESCR
/end CHARACTERISTIC
/begin CHARACTERISTIC xActDamp_TorqueDepOnRotorSpeed_XAU16_01___A "active damping torque depending on rotor speed" CURVE 0x15C360 AblGLKLuw 2 RIGHTSH10NP 0 2 FORMAT "%8.6"
 /begin AXIS_DESCR STD_AXIS nActDamp_AbsRotorSpeedFilt_xdu16 VROT 4 0 13000 FORMAT "%3.0" DEPOSIT ABSOLUTE /end AXIS_DESCR
/end CHARACTERISTIC
/begin CHARACTERISTIC xActDamp_TorqueDepOnRotorSpeed_XAU16_02___A "active damping torque depending on rotor speed" CURVE 0x15C374 AblGLKLuw 2 RIGHTSH10NP 0 2 FORMAT "%8.6"
 /begin AXIS_DESCR STD_AXIS nActDamp_AbsRotorSpeedFilt_xdu16 VROT 4 0 13000 FORMAT "%3.0" DEPOSIT ABSOLUTE /end AXIS_DESCR
/end CHARACTERISTIC
/begin CHARACTERISTIC xActDamp_TorqueDepOnRotorSpeed_XAU16_03___A "active damping torque depending on rotor speed" CURVE 0x15C388 AblGLKLuw 2 RIGHTSH10NP 0 2 FORMAT "%8.6"
 /begin AXIS_DESCR STD_AXIS nActDamp_AbsRotorSpeedFilt_xdu16 VROT 4 0 13000 FORMAT "%3.0" DEPOSIT ABSOLUTE /end AXIS_DESCR
/end CHARACTERISTIC
/begin CHARACTERISTIC xActDamp_TorqueDepOnRotorSpeed_XAU16_04___A "active damping torque depending on rotor speed" CURVE 0x15C39C AblGLKLuw 2 RIGHTSH10NP 0 2 FORMAT "%8.6"
 /begin AXIS_DESCR STD_AXIS nActDamp_AbsRotorSpeedFilt_xdu16 VROT 4 0 13000 FORMAT "%3.0" DEPOSIT ABSOLUTE /end AXIS_DESCR
/end CHARACTERISTIC
/begin CHARACTERISTIC xActDamp_TorqueDepOnRotorSpeed_XAU16_05___A "active damping torque depending on rotor speed" CURVE 0x15C3B0 AblGLKLuw 2 RIGHTSH10NP 0 2 FORMAT "%8.6"
 /begin AXIS_DESCR STD_AXIS nActDamp_AbsRotorSpeedFilt_xdu16 VROT 4 0 13000 FORMAT "%3.0" DEPOSIT ABSOLUTE /end AXIS_DESCR
/end CHARACTERISTIC
/begin CHARACTERISTIC xActDamp_TorqueDepOnRotorSpeed_XAU16_06___A "active damping torque depending on rotor speed" CURVE 0x15C3C4 AblGLKLuw 2 RIGHTSH10NP 0 2 FORMAT "%8.6"
 /begin AXIS_DESCR STD_AXIS nActDamp_AbsRotorSpeedFilt_xdu16 VROT 4 0 13000 FORMAT "%3.0" DEPOSIT ABSOLUTE /end AXIS_DESCR
/end CHARACTERISTIC
/begin CHARACTERISTIC xActDamp_TorqueDepOnRotorSpeed_XAU16_07___A "active damping torque depending on rotor speed" CURVE 0x15C3D8 AblGLKLuw 2 RIGHTSH10NP 0 2 FORMAT "%8.6"
 /begin AXIS_DESCR STD_AXIS nActDamp_AbsRotorSpeedFilt_xdu16 VROT 4 0 13000 FORMAT "%3.0" DEPOSIT ABSOLUTE /end AXIS_DESCR
/end CHARACTERISTIC
/begin CHARACTERISTIC xActDamp_TorqueDepOnRotorSpeed_XAU16_08___A "active damping torque depending on rotor speed" CURVE 0x15C3EC AblGLKLuw 2 RIGHTSH10NP 0 2 FORMAT "%8.6"
 /begin AXIS_DESCR STD_AXIS nActDamp_AbsRotorSpeedFilt_xdu16 VROT 4 0 13000 FORMAT "%3.0" DEPOSIT ABSOLUTE /end AXIS_DESCR
/end CHARACTERISTIC
/begin CHARACTERISTIC xActDamp_TorqueDepOnRotorSpeed_XAU16_09___A "active damping torque depending on rotor speed" CURVE 0x15C400 AblGLKLuw 2 RIGHTSH10NP 0 2 FORMAT "%8.6"
 /begin AXIS_DESCR STD_AXIS nActDamp_AbsRotorSpeedFilt_xdu16 VROT 4 0 13000 FORMAT "%3.0" DEPOSIT ABSOLUTE /end AXIS_DESCR
/end CHARACTERISTIC
/begin CHARACTERISTIC xActDamp_TorqueDepOnRotorSpeed_XAU16_10___A "active damping torque depending on rotor speed" CURVE 0x15C414 AblGLKLuw 2 RIGHTSH10NP 0 2 FORMAT "%8.6"
 /begin AXIS_DESCR STD_AXIS nActDamp_AbsRotorSpeedFilt_xdu16 VROT 4 0 13000 FORMAT "%3.0" DEPOSIT ABSOLUTE /end AXIS_DESCR
/end CHARACTERISTIC
/begin CHARACTERISTIC xActDamp_TorqueDepOnRotorSpeed_XAU16_11___A "active damping torque depending on rotor speed" CURVE 0x15C428 AblGLKLuw 2 RIGHTSH10NP 0 2 FORMAT "%8.6"
 /begin AXIS_DESCR STD_AXIS nActDamp_AbsRotorSpeedFilt_xdu16 VROT 4 0 13000 FORMAT "%3.0" DEPOSIT ABSOLUTE /end AXIS_DESCR
/end CHARACTERISTIC
/begin CHARACTERISTIC xActDamp_TorqueDepOnRotorSpeed_XAU16_12___A "active damping torque depending on rotor speed" CURVE 0x15C43C AblGLKLuw 2 RIGHTSH10NP 0 2 FORMAT "%8.6"
 /begin AXIS_DESCR STD_AXIS nActDamp_AbsRotorSpeedFilt_xdu16 VROT 4 0 13000 FORMAT "%3.0" DEPOSIT ABSOLUTE /end AXIS_DESCR
/end CHARACTERISTIC
/begin CHARACTERISTIC xActDamp_TorqueDepOnRotorSpeed_XAU16_13___A "active damping torque depending on rotor speed" CURVE 0x15C450 AblGLKLuw 2 RIGHTSH10NP 0 2 FORMAT "%8.6"
 /begin AXIS_DESCR STD_AXIS nActDamp_AbsRotorSpeedFilt_xdu16 VROT 4 0 13000 FORMAT "%3.0" DEPOSIT ABSOLUTE /end AXIS_DESCR
/end CHARACTERISTIC
/begin CHARACTERISTIC xActDamp_TorqueDepOnRotorSpeed_XAU16_14___A "active damping torque depending on rotor speed" CURVE 0x15C464 AblGLKLuw 2 RIGHTSH10NP 0 2 FORMAT "%8.6"
 /begin AXIS_DESCR STD_AXIS nActDamp_AbsRotorSpeedFilt_xdu16 VROT 4 0 13000 FORMAT "%3.0" DEPOSIT ABSOLUTE /end AXIS_DESCR
/end CHARACTERISTIC
/begin CHARACTERISTIC xActDamp_TorqueDepOnRotorSpeed_XAU16_15___A "active damping torque depending on rotor speed" CURVE 0x15C478 AblGLKLuw 2 RIGHTSH10NP 0 2 FORMAT "%8.6"
 /begin AXIS_DESCR STD_AXIS nActDamp_AbsRotorSpeedFilt_xdu16 VROT 4 0 13000 FORMAT "%3.0" DEPOSIT ABSOLUTE /end AXIS_DESCR
/end CHARACTERISTIC
/begin CHARACTERISTIC xActDamp_TorqueDepOnRotorSpeed_XAU16_16___A "active damping torque depending on rotor speed" CURVE 0x15C48C AblGLKLuw 2 RIGHTSH10NP 0 2 FORMAT "%8.6"
 /begin AXIS_DESCR STD_AXIS nActDamp_AbsRotorSpeedFilt_xdu16 VROT 4 0 13000 FORMAT "%3.0" DEPOSIT ABSOLUTE /end AXIS_DESCR
/end CHARACTERISTIC
/begin CHARACTERISTIC xActDamp_TorqueDepOnRotorSpeed_XAU16_17___A "active damping torque depending on rotor speed" CURVE 0x15C4A0 AblGLKLuw 2 RIGHTSH10NP 0 2 FORMAT "%8.6"
 /begin AXIS_DESCR STD_AXIS nActDamp_AbsRotorSpeedFilt_xdu16 VROT 4 0 13000 FORMAT "%3.0" DEPOSIT ABSOLUTE /end AXIS_DESCR
/end CHARACTERISTIC
/begin CHARACTERISTIC xActDamp_TorqueDepOnRotorSpeed_XAU16_18___A "active damping torque depending on rotor speed" CURVE 0x15C4B4 AblGLKLuw 2 RIGHTSH10NP 0 2 FORMAT "%8.6"
 /begin AXIS_DESCR STD_AXIS nActDamp_AbsRotorSpeedFilt_xdu16 VROT 4 0 13000 FORMAT "%3.0" DEPOSIT ABSOLUTE /end AXIS_DESCR
/end CHARACTERISTIC
/begin CHARACTERISTIC xActDamp_TorqueDepOnRotorSpeed_XAU16_19___A "active damping torque depending on rotor speed" CURVE 0x15C4C8 AblGLKLuw 2 RIGHTSH10NP 0 2 FORMAT "%8.6"
 /begin AXIS_DESCR STD_AXIS nActDamp_AbsRotorSpeedFilt_xdu16 VROT 4 0 13000 FORMAT "%3.0" DEPOSIT ABSOLUTE /end AXIS_DESCR
/end CHARACTERISTIC
/begin CHARACTERISTIC xActDamp_TorqueDepOnRotorSpeed_XAU16_20___A "active damping torque depending on rotor speed" CURVE 0x15C4DC AblGLKLuw 2 RIGHTSH10NP 0 2 FORMAT "%8.6"
 /begin AXIS_DESCR STD_AXIS nActDamp_AbsRotorSpeedFilt_xdu16 VROT 4 0 13000 FORMAT "%3.0" DEPOSIT ABSOLUTE /end AXIS_DESCR
/end CHARACTERISTIC
/begin CHARACTERISTIC xActDamp_TorqueDepOnRotorSpeed_XAU16_21___A "active damping torque depending on rotor speed" CURVE 0x15C4F0 AblGLKLuw 2 RIGHTSH10NP 0 2 FORMAT "%8.6"
 /begin AXIS_DESCR STD_AXIS nActDamp_AbsRotorSpeedFilt_xdu16 VROT 4 0 13000 FORMAT "%3.0" DEPOSIT ABSOLUTE /end AXIS_DESCR
/end CHARACTERISTIC
/begin CHARACTERISTIC xActDamp_TorqueDepOnRotorSpeed_XAU16_22___A "active damping torque depending on rotor speed" CURVE 0x15C504 AblGLKLuw 2 RIGHTSH10NP 0 2 FORMAT "%8.6"
 /begin AXIS_DESCR STD_AXIS nActDamp_AbsRotorSpeedFilt_xdu16 VROT 4 0 13000 FORMAT "%3.0" DEPOSIT ABSOLUTE /end AXIS_DESCR
/end CHARACTERISTIC
/begin CHARACTERISTIC xActDamp_TorqueDepOnRotorSpeed_XAU16_23___A "active damping torque depending on rotor speed" CURVE 0x15C518 AblGLKLuw 2 RIGHTSH10NP 0 2 FORMAT "%8.6"
 /begin AXIS_DESCR STD_AXIS nActDamp_AbsRotorSpeedFilt_xdu16 VROT 4 0 13000 FORMAT "%3.0" DEPOSIT ABSOLUTE /end AXIS_DESCR
/end CHARACTERISTIC
/begin CHARACTERISTIC xActDamp_TorqueDepOnRotorSpeed_XAU16_24___A "active damping torque depending on rotor speed" CURVE 0x15C52C AblGLKLuw 2 RIGHTSH10NP 0 2 FORMAT "%8.6"
 /begin AXIS_DESCR STD_AXIS nActDamp_AbsRotorSpeedFilt_xdu16 VROT 4 0 13000 FORMAT "%3.0" DEPOSIT ABSOLUTE /end AXIS_DESCR
/end CHARACTERISTIC
/begin CHARACTERISTIC xActDamp_TorqueDepOnRotorSpeed_XAU16_25___A "active damping torque depending on rotor speed" CURVE 0x15C540 AblGLKLuw 2 RIGHTSH10NP 0 2 FORMAT "%8.6"
 /begin AXIS_DESCR STD_AXIS nActDamp_AbsRotorSpeedFilt_xdu16 VROT 4 0 13000 FORMAT "%3.0" DEPOSIT ABSOLUTE /end AXIS_DESCR
/end CHARACTERISTIC
/begin CHARACTERISTIC xActDamp_TorqueDepOnRotorSpeed_XAU16_26___A "active damping torque depending on rotor speed" CURVE 0x15C554 AblGLKLuw 2 RIGHTSH10NP 0 2 FORMAT "%8.6"
 /begin AXIS_DESCR STD_AXIS nActDamp_AbsRotorSpeedFilt_xdu16 VROT 4 0 13000 FORMAT "%3.0" DEPOSIT ABSOLUTE /end AXIS_DESCR
/end CHARACTERISTIC
/begin CHARACTERISTIC xActDamp_TorqueDepOnRotorSpeed_XAU16_27___A "active damping torque depending on rotor speed" CURVE 0x15C568 AblGLKLuw 2 RIGHTSH10NP 0 2 FORMAT "%8.6"
 /begin AXIS_DESCR STD_AXIS nActDamp_AbsRotorSpeedFilt_xdu16 VROT 4 0 13000 FORMAT "%3.0" DEPOSIT ABSOLUTE /end AXIS_DESCR
/end CHARACTERISTIC
/begin CHARACTERISTIC xActDamp_TorqueDepOnRotorSpeed_XAU16_28___A "active damping torque depending on rotor speed" CURVE 0x15C57C AblGLKLuw 2 RIGHTSH10NP 0 2 FORMAT "%8.6"
 /begin AXIS_DESCR STD_AXIS nActDamp_AbsRotorSpeedFilt_xdu16 VROT 4 0 13000 FORMAT "%3.0" DEPOSIT ABSOLUTE /end AXIS_DESCR
/end CHARACTERISTIC
/begin CHARACTERISTIC xActDamp_TorqueDepOnRotorSpeed_XAU16_29___A "active damping torque depending on rotor speed" CURVE 0x15C590 AblGLKLuw 2 RIGHTSH10NP 0 2 FORMAT "%8.6"
 /begin AXIS_DESCR STD_AXIS nActDamp_AbsRotorSpeedFilt_xdu16 VROT 4 0 13000 FORMAT "%3.0" DEPOSIT ABSOLUTE /end AXIS_DESCR
/end CHARACTERISTIC
/begin CHARACTERISTIC xActDamp_TorqueDepOnRotorSpeed_XAU16_30___A "active damping torque depending on rotor speed" CURVE 0x15C5A4 AblGLKLuw 2 RIGHTSH10NP 0 2 FORMAT "%8.6"
 /begin AXIS_DESCR STD_AXIS nActDamp_AbsRotorSpeedFilt_xdu16 VROT 4 0 13000 FORMAT "%3.0" DEPOSIT ABSOLUTE /end AXIS_DESCR
/end CHARACTERISTIC
/begin CHARACTERISTIC xActDamp_TorqueDepOnRotorSpeed_XAU16_31___A "active damping torque depending on rotor speed" CURVE 0x15C5B8 AblGLKLuw 2 RIGHTSH10NP 0 2 FORMAT "%8.6"
 /begin AXIS_DESCR STD_AXIS nActDamp_AbsRotorSpeedFilt_xdu16 VROT 4 0 13000 FORMAT "%3.0" DEPOSIT ABSOLUTE /end AXIS_DESCR
/end CHARACTERISTIC
/begin CHARACTERISTIC xActDamp_TorqueDepOnRotorSpeed_XAU16_32___A "active damping torque depending on rotor speed" CURVE 0x15C5CC AblGLKLuw 2 RIGHTSH10NP 0 2 FORMAT "%8.6"
 /begin AXIS_DESCR STD_AXIS nActDamp_AbsRotorSpeedFilt_xdu16 VROT 4 0 13000 FORMAT "%3.0" DEPOSIT ABSOLUTE /end AXIS_DESCR
/end CHARACTERISTIC
/begin CHARACTERISTIC xActDamp_TorqueDepOnRotorSpeed_XAU16_33___A "active damping torque depending on rotor speed" CURVE 0x15C5E0 AblGLKLuw 2 RIGHTSH10NP 0 2 FORMAT "%8.6"
 /begin AXIS_DESCR STD_AXIS nActDamp_AbsRotorSpeedFilt_xdu16 VROT 4 0 13000 FORMAT "%3.0" DEPOSIT ABSOLUTE /end AXIS_DESCR
/end CHARACTERISTIC
/begin CHARACTERISTIC xActDamp_TorqueDepOnRotorSpeed_XAU16_34___A "active damping torque depending on rotor speed" CURVE 0x15C5F4 AblGLKLuw 2 RIGHTSH10NP 0 2 FORMAT "%8.6"
 /begin AXIS_DESCR STD_AXIS nActDamp_AbsRotorSpeedFilt_xdu16 VROT 4 0 13000 FORMAT "%3.0" DEPOSIT ABSOLUTE /end AXIS_DESCR
/end CHARACTERISTIC
/begin CHARACTERISTIC xActDamp_TorqueDepOnRotorSpeed_XAU16_35___A "active damping torque depending on rotor speed" CURVE 0x15C608 AblGLKLuw 2 RIGHTSH10NP 0 2 FORMAT "%8.6"
 /begin AXIS_DESCR STD_AXIS nActDamp_AbsRotorSpeedFilt_xdu16 VROT 4 0 13000 FORMAT "%3.0" DEPOSIT ABSOLUTE /end AXIS_DESCR
/end CHARACTERISTIC
/begin CHARACTERISTIC xActIn_InertiaFact_XAS16_00___A "Fahrzeuggeschwindigkeitsabhängiger Faktor Trägheit" CURVE 0x15C61C AblGLKLsw 20 RIGHTSH10NP -10 10 FORMAT "%8.5"
 /begin AXIS_DESCR STD_AXIS vApplI_AbsVehicleSpeedFilt_xdu16 VFZHIGH 4 0 400 FORMAT "%8.4" DEPOSIT ABSOLUTE /end AXIS_DESCR
/end CHARACTERISTIC
/begin CHARACTERISTIC xActIn_InertiaFact_XAS16_01___A "Fahrzeuggeschwindigkeitsabhängiger Faktor Trägheit" CURVE 0x15C630 AblGLKLsw 20 RIGHTSH10NP -10 10 FORMAT "%8.5"
 /begin AXIS_DESCR STD_AXIS vApplI_AbsVehicleSpeedFilt_xdu16 VFZHIGH 4 0 400 FORMAT "%8.4" DEPOSIT ABSOLUTE /end AXIS_DESCR
/end CHARACTERISTIC
/begin CHARACTERISTIC xActIn_InertiaFact_XAS16_02___A "Fahrzeuggeschwindigkeitsabhängiger Faktor Trägheit" CURVE 0x15C644 AblGLKLsw 20 RIGHTSH10NP -10 10 FORMAT "%8.5"
 /begin AXIS_DESCR STD_AXIS vApplI_AbsVehicleSpeedFilt_xdu16 VFZHIGH 4 0 400 FORMAT "%8.4" DEPOSIT ABSOLUTE /end AXIS_DESCR
/end CHARACTERISTIC
/begin CHARACTERISTIC xActIn_InertiaFact_XAS16_03___A "Fahrzeuggeschwindigkeitsabhängiger Faktor Trägheit" CURVE 0x15C658 AblGLKLsw 20 RIGHTSH10NP -10 10 FORMAT "%8.5"
 /begin AXIS_DESCR STD_AXIS vApplI_AbsVehicleSpeedFilt_xdu16 VFZHIGH 4 0 400 FORMAT "%8.4" DEPOSIT ABSOLUTE /end AXIS_DESCR
/end CHARACTERISTIC
/begin CHARACTERISTIC xActIn_InertiaFact_XAS16_04___A "Fahrzeuggeschwindigkeitsabhängiger Faktor Trägheit" CURVE 0x15C66C AblGLKLsw 20 RIGHTSH10NP -10 10 FORMAT "%8.5"
 /begin AXIS_DESCR STD_AXIS vApplI_AbsVehicleSpeedFilt_xdu16 VFZHIGH 4 0 400 FORMAT "%8.4" DEPOSIT ABSOLUTE /end AXIS_DESCR
/end CHARACTERISTIC
/begin CHARACTERISTIC xActIn_InertiaFact_XAS16_05___A "Fahrzeuggeschwindigkeitsabhängiger Faktor Trägheit" CURVE 0x15C680 AblGLKLsw 20 RIGHTSH10NP -10 10 FORMAT "%8.5"
 /begin AXIS_DESCR STD_AXIS vApplI_AbsVehicleSpeedFilt_xdu16 VFZHIGH 4 0 400 FORMAT "%8.4" DEPOSIT ABSOLUTE /end AXIS_DESCR
/end CHARACTERISTIC
/begin CHARACTERISTIC xActIn_InertiaFact_XAS16_06___A "Fahrzeuggeschwindigkeitsabhängiger Faktor Trägheit" CURVE 0x15C694 AblGLKLsw 20 RIGHTSH10NP -10 10 FORMAT "%8.5"
 /begin AXIS_DESCR STD_AXIS vApplI_AbsVehicleSpeedFilt_xdu16 VFZHIGH 4 0 400 FORMAT "%8.4" DEPOSIT ABSOLUTE /end AXIS_DESCR
/end CHARACTERISTIC
/begin CHARACTERISTIC xActIn_InertiaFact_XAS16_07___A "Fahrzeuggeschwindigkeitsabhängiger Faktor Trägheit" CURVE 0x15C6A8 AblGLKLsw 20 RIGHTSH10NP -10 10 FORMAT "%8.5"
 /begin AXIS_DESCR STD_AXIS vApplI_AbsVehicleSpeedFilt_xdu16 VFZHIGH 4 0 400 FORMAT "%8.4" DEPOSIT ABSOLUTE /end AXIS_DESCR
/end CHARACTERISTIC
/begin CHARACTERISTIC xActIn_InertiaFact_XAS16_08___A "Fahrzeuggeschwindigkeitsabhängiger Faktor Trägheit" CURVE 0x15C6BC AblGLKLsw 20 RIGHTSH10NP -10 10 FORMAT "%8.5"
 /begin AXIS_DESCR STD_AXIS vApplI_AbsVehicleSpeedFilt_xdu16 VFZHIGH 4 0 400 FORMAT "%8.4" DEPOSIT ABSOLUTE /end AXIS_DESCR
/end CHARACTERISTIC
/begin CHARACTERISTIC xActIn_InertiaFact_XAS16_09___A "Fahrzeuggeschwindigkeitsabhängiger Faktor Trägheit" CURVE 0x15C6D0 AblGLKLsw 20 RIGHTSH10NP -10 10 FORMAT "%8.5"
 /begin AXIS_DESCR STD_AXIS vApplI_AbsVehicleSpeedFilt_xdu16 VFZHIGH 4 0 400 FORMAT "%8.4" DEPOSIT ABSOLUTE /end AXIS_DESCR
/end CHARACTERISTIC
/begin CHARACTERISTIC xActIn_InertiaFact_XAS16_10___A "Fahrzeuggeschwindigkeitsabhängiger Faktor Trägheit" CURVE 0x15C6E4 AblGLKLsw 20 RIGHTSH10NP -10 10 FORMAT "%8.5"
 /begin AXIS_DESCR STD_AXIS vApplI_AbsVehicleSpeedFilt_xdu16 VFZHIGH 4 0 400 FORMAT "%8.4" DEPOSIT ABSOLUTE /end AXIS_DESCR
/end CHARACTERISTIC
/begin CHARACTERISTIC xActIn_InertiaFact_XAS16_11___A "Fahrzeuggeschwindigkeitsabhängiger Faktor Trägheit" CURVE 0x15C6F8 AblGLKLsw 20 RIGHTSH10NP -10 10 FORMAT "%8.5"
 /begin AXIS_DESCR STD_AXIS vApplI_AbsVehicleSpeedFilt_xdu16 VFZHIGH 4 0 400 FORMAT "%8.4" DEPOSIT ABSOLUTE /end AXIS_DESCR
/end CHARACTERISTIC
/begin CHARACTERISTIC xActIn_InertiaFact_XAS16_12___A "Fahrzeuggeschwindigkeitsabhängiger Faktor Trägheit" CURVE 0x15C70C AblGLKLsw 20 RIGHTSH10NP -10 10 FORMAT "%8.5"
 /begin AXIS_DESCR STD_AXIS vApplI_AbsVehicleSpeedFilt_xdu16 VFZHIGH 4 0 400 FORMAT "%8.4" DEPOSIT ABSOLUTE /end AXIS_DESCR
/end CHARACTERISTIC
/begin CHARACTERISTIC xActIn_InertiaFact_XAS16_13___A "Fahrzeuggeschwindigkeitsabhängiger Faktor Trägheit" CURVE 0x15C720 AblGLKLsw 20 RIGHTSH10NP -10 10 FORMAT "%8.5"
 /begin AXIS_DESCR STD_AXIS vApplI_AbsVehicleSpeedFilt_xdu16 VFZHIGH 4 0 400 FORMAT "%8.4" DEPOSIT ABSOLUTE /end AXIS_DESCR
/end CHARACTERISTIC
/begin CHARACTERISTIC xActIn_InertiaFact_XAS16_14___A "Fahrzeuggeschwindigkeitsabhängiger Faktor Trägheit" CURVE 0x15C734 AblGLKLsw 20 RIGHTSH10NP -10 10 FORMAT "%8.5"
 /begin AXIS_DESCR STD_AXIS vApplI_AbsVehicleSpeedFilt_xdu16 VFZHIGH 4 0 400 FORMAT "%8.4" DEPOSIT ABSOLUTE /end AXIS_DESCR
/end CHARACTERISTIC
/begin CHARACTERISTIC xActIn_InertiaFact_XAS16_15___A "Fahrzeuggeschwindigkeitsabhängiger Faktor Trägheit" CURVE 0x15C748 AblGLKLsw 20 RIGHTSH10NP -10 10 FORMAT "%8.5"
 /begin AXIS_DESCR STD_AXIS vApplI_AbsVehicleSpeedFilt_xdu16 VFZHIGH 4 0 400 FORMAT "%8.4" DEPOSIT ABSOLUTE /end AXIS_DESCR
/end CHARACTERISTIC
/begin CHARACTERISTIC xActIn_InertiaFact_XAS16_16___A "Fahrzeuggeschwindigkeitsabhängiger Faktor Trägheit" CURVE 0x15C75C AblGLKLsw 20 RIGHTSH10NP -10 10 FORMAT "%8.5"
 /begin AXIS_DESCR STD_AXIS vApplI_AbsVehicleSpeedFilt_xdu16 VFZHIGH 4 0 400 FORMAT "%8.4" DEPOSIT ABSOLUTE /end AXIS_DESCR
/end CHARACTERISTIC
/begin CHARACTERISTIC xActIn_InertiaFact_XAS16_17___A "Fahrzeuggeschwindigkeitsabhängiger Faktor Trägheit" CURVE 0x15C770 AblGLKLsw 20 RIGHTSH10NP -10 10 FORMAT "%8.5"
 /begin AXIS_DESCR STD_AXIS vApplI_AbsVehicleSpeedFilt_xdu16 VFZHIGH 4 0 400 FORMAT "%8.4" DEPOSIT ABSOLUTE /end AXIS_DESCR
/end CHARACTERISTIC
/begin CHARACTERISTIC xActIn_InertiaFact_XAS16_18___A "Fahrzeuggeschwindigkeitsabhängiger Faktor Trägheit" CURVE 0x15C784 AblGLKLsw 20 RIGHTSH10NP -10 10 FORMAT "%8.5"
 /begin AXIS_DESCR STD_AXIS vApplI_AbsVehicleSpeedFilt_xdu16 VFZHIGH 4 0 400 FORMAT "%8.4" DEPOSIT ABSOLUTE /end AXIS_DESCR
/end CHARACTERISTIC
/begin CHARACTERISTIC xActIn_InertiaFact_XAS16_19___A "Fahrzeuggeschwindigkeitsabhängiger Faktor Trägheit" CURVE 0x15C798 AblGLKLsw 20 RIGHTSH10NP -10 10 FORMAT "%8.5"
 /begin AXIS_DESCR STD_AXIS vApplI_AbsVehicleSpeedFilt_xdu16 VFZHIGH 4 0 400 FORMAT "%8.4" DEPOSIT ABSOLUTE /end AXIS_DESCR
/end CHARACTERISTIC
/begin CHARACTERISTIC xActIn_InertiaFact_XAS16_20___A "Fahrzeuggeschwindigkeitsabhängiger Faktor Trägheit" CURVE 0x15C7AC AblGLKLsw 20 RIGHTSH10NP -10 10 FORMAT "%8.5"
 /begin AXIS_DESCR STD_AXIS vApplI_AbsVehicleSpeedFilt_xdu16 VFZHIGH 4 0 400 FORMAT "%8.4" DEPOSIT ABSOLUTE /end AXIS_DESCR
/end CHARACTERISTIC
/begin CHARACTERISTIC xActIn_InertiaFact_XAS16_21___A "Fahrzeuggeschwindigkeitsabhängiger Faktor Trägheit" CURVE 0x15C7C0 AblGLKLsw 20 RIGHTSH10NP -10 10 FORMAT "%8.5"
 /begin AXIS_DESCR STD_AXIS vApplI_AbsVehicleSpeedFilt_xdu16 VFZHIGH 4 0 400 FORMAT "%8.4" DEPOSIT ABSOLUTE /end AXIS_DESCR
/end CHARACTERISTIC
/begin CHARACTERISTIC xActIn_InertiaFact_XAS16_22___A "Fahrzeuggeschwindigkeitsabhängiger Faktor Trägheit" CURVE 0x15C7D4 AblGLKLsw 20 RIGHTSH10NP -10 10 FORMAT "%8.5"
 /begin AXIS_DESCR STD_AXIS vApplI_AbsVehicleSpeedFilt_xdu16 VFZHIGH 4 0 400 FORMAT "%8.4" DEPOSIT ABSOLUTE /end AXIS_DESCR
/end CHARACTERISTIC
/begin CHARACTERISTIC xActIn_InertiaFact_XAS16_23___A "Fahrzeuggeschwindigkeitsabhängiger Faktor Trägheit" CURVE 0x15C7E8 AblGLKLsw 20 RIGHTSH10NP -10 10 FORMAT "%8.5"
 /begin AXIS_DESCR STD_AXIS vApplI_AbsVehicleSpeedFilt_xdu16 VFZHIGH 4 0 400 FORMAT "%8.4" DEPOSIT ABSOLUTE /end AXIS_DESCR
/end CHARACTERISTIC
/begin CHARACTERISTIC xActIn_InertiaFact_XAS16_24___A "Fahrzeuggeschwindigkeitsabhängiger Faktor Trägheit" CURVE 0x15C7FC AblGLKLsw 20 RIGHTSH10NP -10 10 FORMAT "%8.5"
 /begin AXIS_DESCR STD_AXIS vApplI_AbsVehicleSpeedFilt_xdu16 VFZHIGH 4 0 400 FORMAT "%8.4" DEPOSIT ABSOLUTE /end AXIS_DESCR
/end CHARACTERISTIC
/begin CHARACTERISTIC xActIn_InertiaFact_XAS16_25___A "Fahrzeuggeschwindigkeitsabhängiger Faktor Trägheit" CURVE 0x15C810 AblGLKLsw 20 RIGHTSH10NP -10 10 FORMAT "%8.5"
 /begin AXIS_DESCR STD_AXIS vApplI_AbsVehicleSpeedFilt_xdu16 VFZHIGH 4 0 400 FORMAT "%8.4" DEPOSIT ABSOLUTE /end AXIS_DESCR
/end CHARACTERISTIC
/begin CHARACTERISTIC xActIn_InertiaFact_XAS16_26___A "Fahrzeuggeschwindigkeitsabhängiger Faktor Trägheit" CURVE 0x15C824 AblGLKLsw 20 RIGHTSH10NP -10 10 FORMAT "%8.5"
 /begin AXIS_DESCR STD_AXIS vApplI_AbsVehicleSpeedFilt_xdu16 VFZHIGH 4 0 400 FORMAT "%8.4" DEPOSIT ABSOLUTE /end AXIS_DESCR
/end CHARACTERISTIC
/begin CHARACTERISTIC xActIn_InertiaFact_XAS16_27___A "Fahrzeuggeschwindigkeitsabhängiger Faktor Trägheit" CURVE 0x15C838 AblGLKLsw 20 RIGHTSH10NP -10 10 FORMAT "%8.5"
 /begin AXIS_DESCR STD_AXIS vApplI_AbsVehicleSpeedFilt_xdu16 VFZHIGH 4 0 400 FORMAT "%8.4" DEPOSIT ABSOLUTE /end AXIS_DESCR
/end CHARACTERISTIC
/begin CHARACTERISTIC xActIn_InertiaFact_XAS16_28___A "Fahrzeuggeschwindigkeitsabhängiger Faktor Trägheit" CURVE 0x15C84C AblGLKLsw 20 RIGHTSH10NP -10 10 FORMAT "%8.5"
 /begin AXIS_DESCR STD_AXIS vApplI_AbsVehicleSpeedFilt_xdu16 VFZHIGH 4 0 400 FORMAT "%8.4" DEPOSIT ABSOLUTE /end AXIS_DESCR
/end CHARACTERISTIC
/begin CHARACTERISTIC xActIn_InertiaFact_XAS16_29___A "Fahrzeuggeschwindigkeitsabhängiger Faktor Trägheit" CURVE 0x15C860 AblGLKLsw 20 RIGHTSH10NP -10 10 FORMAT "%8.5"
 /begin AXIS_DESCR STD_AXIS vApplI_AbsVehicleSpeedFilt_xdu16 VFZHIGH 4 0 400 FORMAT "%8.4" DEPOSIT ABSOLUTE /end AXIS_DESCR
/end CHARACTERISTIC
/begin CHARACTERISTIC xActIn_InertiaFact_XAS16_30___A "Fahrzeuggeschwindigkeitsabhängiger Faktor Trägheit" CURVE 0x15C874 AblGLKLsw 20 RIGHTSH10NP -10 10 FORMAT "%8.5"
 /begin AXIS_DESCR STD_AXIS vApplI_AbsVehicleSpeedFilt_xdu16 VFZHIGH 4 0 400 FORMAT "%8.4" DEPOSIT ABSOLUTE /end AXIS_DESCR
/end CHARACTERISTIC
/begin CHARACTERISTIC xActIn_InertiaFact_XAS16_31___A "Fahrzeuggeschwindigkeitsabhängiger Faktor Trägheit" CURVE 0x15C888 AblGLKLsw 20 RIGHTSH10NP -10 10 FORMAT "%8.5"
 /begin AXIS_DESCR STD_AXIS vApplI_AbsVehicleSpeedFilt_xdu16 VFZHIGH 4 0 400 FORMAT "%8.4" DEPOSIT ABSOLUTE /end AXIS_DESCR
/end CHARACTERISTIC
/begin CHARACTERISTIC xActIn_InertiaFact_XAS16_32___A "Fahrzeuggeschwindigkeitsabhängiger Faktor Trägheit" CURVE 0x15C89C AblGLKLsw 20 RIGHTSH10NP -10 10 FORMAT "%8.5"
 /begin AXIS_DESCR STD_AXIS vApplI_AbsVehicleSpeedFilt_xdu16 VFZHIGH 4 0 400 FORMAT "%8.4" DEPOSIT ABSOLUTE /end AXIS_DESCR
/end CHARACTERISTIC
/begin CHARACTERISTIC xActIn_InertiaFact_XAS16_33___A "Fahrzeuggeschwindigkeitsabhängiger Faktor Trägheit" CURVE 0x15C8B0 AblGLKLsw 20 RIGHTSH10NP -10 10 FORMAT "%8.5"
 /begin AXIS_DESCR STD_AXIS vApplI_AbsVehicleSpeedFilt_xdu16 VFZHIGH 4 0 400 FORMAT "%8.4" DEPOSIT ABSOLUTE /end AXIS_DESCR
/end CHARACTERISTIC
/begin CHARACTERISTIC xActIn_InertiaFact_XAS16_34___A "Fahrzeuggeschwindigkeitsabhängiger Faktor Trägheit" CURVE 0x15C8C4 AblGLKLsw 20 RIGHTSH10NP -10 10 FORMAT "%8.5"
 /begin AXIS_DESCR STD_AXIS vApplI_AbsVehicleSpeedFilt_xdu16 VFZHIGH 4 0 400 FORMAT "%8.4" DEPOSIT ABSOLUTE /end AXIS_DESCR
/end CHARACTERISTIC
/begin CHARACTERISTIC xActIn_InertiaFact_XAS16_35___A "Fahrzeuggeschwindigkeitsabhängiger Faktor Trägheit" CURVE 0x15C8D8 AblGLKLsw 20 RIGHTSH10NP -10 10 FORMAT "%8.5"
 /begin AXIS_DESCR STD_AXIS vApplI_AbsVehicleSpeedFilt_xdu16 VFZHIGH 4 0 400 FORMAT "%8.4" DEPOSIT ABSOLUTE /end AXIS_DESCR
/end CHARACTERISTIC
/begin CHARACTERISTIC xActIn_InertiaTBT_XAU16_00___A "Drehstabmomentanabhängiger Faktor trägheit" CURVE 0x15C8EC AblGLKLuw 1 RIGHTSH6NP 0 1 FORMAT "%8.6"
 /begin AXIS_DESCR STD_AXIS mApplI_AbsTorsionBarTorque_xdu16 TBTHIGH 4 0 8 FORMAT "%8.6" DEPOSIT ABSOLUTE /end AXIS_DESCR
/end CHARACTERISTIC
/begin CHARACTERISTIC xActIn_InertiaTBT_XAU16_01___A "Drehstabmomentanabhängiger Faktor trägheit" CURVE 0x15C900 AblGLKLuw 1 RIGHTSH6NP 0 1 FORMAT "%8.6"
 /begin AXIS_DESCR STD_AXIS mApplI_AbsTorsionBarTorque_xdu16 TBTHIGH 4 0 8 FORMAT "%8.6" DEPOSIT ABSOLUTE /end AXIS_DESCR
/end CHARACTERISTIC
/begin CHARACTERISTIC xActIn_InertiaTBT_XAU16_02___A "Drehstabmomentanabhängiger Faktor trägheit" CURVE 0x15C914 AblGLKLuw 1 RIGHTSH6NP 0 1 FORMAT "%8.6"
 /begin AXIS_DESCR STD_AXIS mApplI_AbsTorsionBarTorque_xdu16 TBTHIGH 4 0 8 FORMAT "%8.6" DEPOSIT ABSOLUTE /end AXIS_DESCR
/end CHARACTERISTIC
/begin CHARACTERISTIC xActIn_InertiaTBT_XAU16_03___A "Drehstabmomentanabhängiger Faktor trägheit" CURVE 0x15C928 AblGLKLuw 1 RIGHTSH6NP 0 1 FORMAT "%8.6"
 /begin AXIS_DESCR STD_AXIS mApplI_AbsTorsionBarTorque_xdu16 TBTHIGH 4 0 8 FORMAT "%8.6" DEPOSIT ABSOLUTE /end AXIS_DESCR
/end CHARACTERISTIC
/begin CHARACTERISTIC xActIn_InertiaTBT_XAU16_04___A "Drehstabmomentanabhängiger Faktor trägheit" CURVE 0x15C93C AblGLKLuw 1 RIGHTSH6NP 0 1 FORMAT "%8.6"
 /begin AXIS_DESCR STD_AXIS mApplI_AbsTorsionBarTorque_xdu16 TBTHIGH 4 0 8 FORMAT "%8.6" DEPOSIT ABSOLUTE /end AXIS_DESCR
/end CHARACTERISTIC
/begin CHARACTERISTIC xActIn_InertiaTBT_XAU16_05___A "Drehstabmomentanabhängiger Faktor trägheit" CURVE 0x15C950 AblGLKLuw 1 RIGHTSH6NP 0 1 FORMAT "%8.6"
 /begin AXIS_DESCR STD_AXIS mApplI_AbsTorsionBarTorque_xdu16 TBTHIGH 4 0 8 FORMAT "%8.6" DEPOSIT ABSOLUTE /end AXIS_DESCR
/end CHARACTERISTIC
/begin CHARACTERISTIC xActIn_InertiaTBT_XAU16_06___A "Drehstabmomentanabhängiger Faktor trägheit" CURVE 0x15C964 AblGLKLuw 1 RIGHTSH6NP 0 1 FORMAT "%8.6"
 /begin AXIS_DESCR STD_AXIS mApplI_AbsTorsionBarTorque_xdu16 TBTHIGH 4 0 8 FORMAT "%8.6" DEPOSIT ABSOLUTE /end AXIS_DESCR
/end CHARACTERISTIC
/begin CHARACTERISTIC xActIn_InertiaTBT_XAU16_07___A "Drehstabmomentanabhängiger Faktor trägheit" CURVE 0x15C978 AblGLKLuw 1 RIGHTSH6NP 0 1 FORMAT "%8.6"
 /begin AXIS_DESCR STD_AXIS mApplI_AbsTorsionBarTorque_xdu16 TBTHIGH 4 0 8 FORMAT "%8.6" DEPOSIT ABSOLUTE /end AXIS_DESCR
/end CHARACTERISTIC
/begin CHARACTERISTIC xActIn_InertiaTBT_XAU16_08___A "Drehstabmomentanabhängiger Faktor trägheit" CURVE 0x15C98C AblGLKLuw 1 RIGHTSH6NP 0 1 FORMAT "%8.6"
 /begin AXIS_DESCR STD_AXIS mApplI_AbsTorsionBarTorque_xdu16 TBTHIGH 4 0 8 FORMAT "%8.6" DEPOSIT ABSOLUTE /end AXIS_DESCR
/end CHARACTERISTIC
/begin CHARACTERISTIC xActIn_InertiaTBT_XAU16_09___A "Drehstabmomentanabhängiger Faktor trägheit" CURVE 0x15C9A0 AblGLKLuw 1 RIGHTSH6NP 0 1 FORMAT "%8.6"
 /begin AXIS_DESCR STD_AXIS mApplI_AbsTorsionBarTorque_xdu16 TBTHIGH 4 0 8 FORMAT "%8.6" DEPOSIT ABSOLUTE /end AXIS_DESCR
/end CHARACTERISTIC
/begin CHARACTERISTIC xActIn_InertiaTBT_XAU16_10___A "Drehstabmomentanabhängiger Faktor trägheit" CURVE 0x15C9B4 AblGLKLuw 1 RIGHTSH6NP 0 1 FORMAT "%8.6"
 /begin AXIS_DESCR STD_AXIS mApplI_AbsTorsionBarTorque_xdu16 TBTHIGH 4 0 8 FORMAT "%8.6" DEPOSIT ABSOLUTE /end AXIS_DESCR
/end CHARACTERISTIC
/begin CHARACTERISTIC xActIn_InertiaTBT_XAU16_11___A "Drehstabmomentanabhängiger Faktor trägheit" CURVE 0x15C9C8 AblGLKLuw 1 RIGHTSH6NP 0 1 FORMAT "%8.6"
 /begin AXIS_DESCR STD_AXIS mApplI_AbsTorsionBarTorque_xdu16 TBTHIGH 4 0 8 FORMAT "%8.6" DEPOSIT ABSOLUTE /end AXIS_DESCR
/end CHARACTERISTIC
/begin CHARACTERISTIC xActIn_InertiaTBT_XAU16_12___A "Drehstabmomentanabhängiger Faktor trägheit" CURVE 0x15C9DC AblGLKLuw 1 RIGHTSH6NP 0 1 FORMAT "%8.6"
 /begin AXIS_DESCR STD_AXIS mApplI_AbsTorsionBarTorque_xdu16 TBTHIGH 4 0 8 FORMAT "%8.6" DEPOSIT ABSOLUTE /end AXIS_DESCR
/end CHARACTERISTIC
/begin CHARACTERISTIC xActIn_InertiaTBT_XAU16_13___A "Drehstabmomentanabhängiger Faktor trägheit" CURVE 0x15C9F0 AblGLKLuw 1 RIGHTSH6NP 0 1 FORMAT "%8.6"
 /begin AXIS_DESCR STD_AXIS mApplI_AbsTorsionBarTorque_xdu16 TBTHIGH 4 0 8 FORMAT "%8.6" DEPOSIT ABSOLUTE /end AXIS_DESCR
/end CHARACTERISTIC
/begin CHARACTERISTIC xActIn_InertiaTBT_XAU16_14___A "Drehstabmomentanabhängiger Faktor trägheit" CURVE 0x15CA04 AblGLKLuw 1 RIGHTSH6NP 0 1 FORMAT "%8.6"
 /begin AXIS_DESCR STD_AXIS mApplI_AbsTorsionBarTorque_xdu16 TBTHIGH 4 0 8 FORMAT "%8.6" DEPOSIT ABSOLUTE /end AXIS_DESCR
/end CHARACTERISTIC
/begin CHARACTERISTIC xActIn_InertiaTBT_XAU16_15___A "Drehstabmomentanabhängiger Faktor trägheit" CURVE 0x15CA18 AblGLKLuw 1 RIGHTSH6NP 0 1 FORMAT "%8.6"
 /begin AXIS_DESCR STD_AXIS mApplI_AbsTorsionBarTorque_xdu16 TBTHIGH 4 0 8 FORMAT "%8.6" DEPOSIT ABSOLUTE /end AXIS_DESCR
/end CHARACTERISTIC
/begin CHARACTERISTIC xActIn_InertiaTBT_XAU16_16___A "Drehstabmomentanabhängiger Faktor trägheit" CURVE 0x15CA2C AblGLKLuw 1 RIGHTSH6NP 0 1 FORMAT "%8.6"
 /begin AXIS_DESCR STD_AXIS mApplI_AbsTorsionBarTorque_xdu16 TBTHIGH 4 0 8 FORMAT "%8.6" DEPOSIT ABSOLUTE /end AXIS_DESCR
/end CHARACTERISTIC
/begin CHARACTERISTIC xActIn_InertiaTBT_XAU16_17___A "Drehstabmomentanabhängiger Faktor trägheit" CURVE 0x15CA40 AblGLKLuw 1 RIGHTSH6NP 0 1 FORMAT "%8.6"
 /begin AXIS_DESCR STD_AXIS mApplI_AbsTorsionBarTorque_xdu16 TBTHIGH 4 0 8 FORMAT "%8.6" DEPOSIT ABSOLUTE /end AXIS_DESCR
/end CHARACTERISTIC
/begin CHARACTERISTIC xActIn_InertiaTBT_XAU16_18___A "Drehstabmomentanabhängiger Faktor trägheit" CURVE 0x15CA54 AblGLKLuw 1 RIGHTSH6NP 0 1 FORMAT "%8.6"
 /begin AXIS_DESCR STD_AXIS mApplI_AbsTorsionBarTorque_xdu16 TBTHIGH 4 0 8 FORMAT "%8.6" DEPOSIT ABSOLUTE /end AXIS_DESCR
/end CHARACTERISTIC
/begin CHARACTERISTIC xActIn_InertiaTBT_XAU16_19___A "Drehstabmomentanabhängiger Faktor trägheit" CURVE 0x15CA68 AblGLKLuw 1 RIGHTSH6NP 0 1 FORMAT "%8.6"
 /begin AXIS_DESCR STD_AXIS mApplI_AbsTorsionBarTorque_xdu16 TBTHIGH 4 0 8 FORMAT "%8.6" DEPOSIT ABSOLUTE /end AXIS_DESCR
/end CHARACTERISTIC
/begin CHARACTERISTIC xActIn_InertiaTBT_XAU16_20___A "Drehstabmomentanabhängiger Faktor trägheit" CURVE 0x15CA7C AblGLKLuw 1 RIGHTSH6NP 0 1 FORMAT "%8.6"
 /begin AXIS_DESCR STD_AXIS mApplI_AbsTorsionBarTorque_xdu16 TBTHIGH 4 0 8 FORMAT "%8.6" DEPOSIT ABSOLUTE /end AXIS_DESCR
/end CHARACTERISTIC
/begin CHARACTERISTIC xActIn_InertiaTBT_XAU16_21___A "Drehstabmomentanabhängiger Faktor trägheit" CURVE 0x15CA90 AblGLKLuw 1 RIGHTSH6NP 0 1 FORMAT "%8.6"
 /begin AXIS_DESCR STD_AXIS mApplI_AbsTorsionBarTorque_xdu16 TBTHIGH 4 0 8 FORMAT "%8.6" DEPOSIT ABSOLUTE /end AXIS_DESCR
/end CHARACTERISTIC
/begin CHARACTERISTIC xActIn_InertiaTBT_XAU16_22___A "Drehstabmomentanabhängiger Faktor trägheit" CURVE 0x15CAA4 AblGLKLuw 1 RIGHTSH6NP 0 1 FORMAT "%8.6"
 /begin AXIS_DESCR STD_AXIS mApplI_AbsTorsionBarTorque_xdu16 TBTHIGH 4 0 8 FORMAT "%8.6" DEPOSIT ABSOLUTE /end AXIS_DESCR
/end CHARACTERISTIC
/begin CHARACTERISTIC xActIn_InertiaTBT_XAU16_23___A "Drehstabmomentanabhängiger Faktor trägheit" CURVE 0x15CAB8 AblGLKLuw 1 RIGHTSH6NP 0 1 FORMAT "%8.6"
 /begin AXIS_DESCR STD_AXIS mApplI_AbsTorsionBarTorque_xdu16 TBTHIGH 4 0 8 FORMAT "%8.6" DEPOSIT ABSOLUTE /end AXIS_DESCR
/end CHARACTERISTIC
/begin CHARACTERISTIC xActIn_InertiaTBT_XAU16_24___A "Drehstabmomentanabhängiger Faktor trägheit" CURVE 0x15CACC AblGLKLuw 1 RIGHTSH6NP 0 1 FORMAT "%8.6"
 /begin AXIS_DESCR STD_AXIS mApplI_AbsTorsionBarTorque_xdu16 TBTHIGH 4 0 8 FORMAT "%8.6" DEPOSIT ABSOLUTE /end AXIS_DESCR
/end CHARACTERISTIC
/begin CHARACTERISTIC xActIn_InertiaTBT_XAU16_25___A "Drehstabmomentanabhängiger Faktor trägheit" CURVE 0x15CAE0 AblGLKLuw 1 RIGHTSH6NP 0 1 FORMAT "%8.6"
 /begin AXIS_DESCR STD_AXIS mApplI_AbsTorsionBarTorque_xdu16 TBTHIGH 4 0 8 FORMAT "%8.6" DEPOSIT ABSOLUTE /end AXIS_DESCR
/end CHARACTERISTIC
/begin CHARACTERISTIC xActIn_InertiaTBT_XAU16_26___A "Drehstabmomentanabhängiger Faktor trägheit" CURVE 0x15CAF4 AblGLKLuw 1 RIGHTSH6NP 0 1 FORMAT "%8.6"
 /begin AXIS_DESCR STD_AXIS mApplI_AbsTorsionBarTorque_xdu16 TBTHIGH 4 0 8 FORMAT "%8.6" DEPOSIT ABSOLUTE /end AXIS_DESCR
/end CHARACTERISTIC
/begin CHARACTERISTIC xActIn_InertiaTBT_XAU16_27___A "Drehstabmomentanabhängiger Faktor trägheit" CURVE 0x15CB08 AblGLKLuw 1 RIGHTSH6NP 0 1 FORMAT "%8.6"
 /begin AXIS_DESCR STD_AXIS mApplI_AbsTorsionBarTorque_xdu16 TBTHIGH 4 0 8 FORMAT "%8.6" DEPOSIT ABSOLUTE /end AXIS_DESCR
/end CHARACTERISTIC
/begin CHARACTERISTIC xActIn_InertiaTBT_XAU16_28___A "Drehstabmomentanabhängiger Faktor trägheit" CURVE 0x15CB1C AblGLKLuw 1 RIGHTSH6NP 0 1 FORMAT "%8.6"
 /begin AXIS_DESCR STD_AXIS mApplI_AbsTorsionBarTorque_xdu16 TBTHIGH 4 0 8 FORMAT "%8.6" DEPOSIT ABSOLUTE /end AXIS_DESCR
/end CHARACTERISTIC
/begin CHARACTERISTIC xActIn_InertiaTBT_XAU16_29___A "Drehstabmomentanabhängiger Faktor trägheit" CURVE 0x15CB30 AblGLKLuw 1 RIGHTSH6NP 0 1 FORMAT "%8.6"
 /begin AXIS_DESCR STD_AXIS mApplI_AbsTorsionBarTorque_xdu16 TBTHIGH 4 0 8 FORMAT "%8.6" DEPOSIT ABSOLUTE /end AXIS_DESCR
/end CHARACTERISTIC
/begin CHARACTERISTIC xActIn_InertiaTBT_XAU16_30___A "Drehstabmomentanabhängiger Faktor trägheit" CURVE 0x15CB44 AblGLKLuw 1 RIGHTSH6NP 0 1 FORMAT "%8.6"
 /begin AXIS_DESCR STD_AXIS mApplI_AbsTorsionBarTorque_xdu16 TBTHIGH 4 0 8 FORMAT "%8.6" DEPOSIT ABSOLUTE /end AXIS_DESCR
/end CHARACTERISTIC
/begin CHARACTERISTIC xActIn_InertiaTBT_XAU16_31___A "Drehstabmomentanabhängiger Faktor trägheit" CURVE 0x15CB58 AblGLKLuw 1 RIGHTSH6NP 0 1 FORMAT "%8.6"
 /begin AXIS_DESCR STD_AXIS mApplI_AbsTorsionBarTorque_xdu16 TBTHIGH 4 0 8 FORMAT "%8.6" DEPOSIT ABSOLUTE /end AXIS_DESCR
/end CHARACTERISTIC
/begin CHARACTERISTIC xActIn_InertiaTBT_XAU16_32___A "Drehstabmomentanabhängiger Faktor trägheit" CURVE 0x15CB6C AblGLKLuw 1 RIGHTSH6NP 0 1 FORMAT "%8.6"
 /begin AXIS_DESCR STD_AXIS mApplI_AbsTorsionBarTorque_xdu16 TBTHIGH 4 0 8 FORMAT "%8.6" DEPOSIT ABSOLUTE /end AXIS_DESCR
/end CHARACTERISTIC
/begin CHARACTERISTIC xActIn_InertiaTBT_XAU16_33___A "Drehstabmomentanabhängiger Faktor trägheit" CURVE 0x15CB80 AblGLKLuw 1 RIGHTSH6NP 0 1 FORMAT "%8.6"
 /begin AXIS_DESCR STD_AXIS mApplI_AbsTorsionBarTorque_xdu16 TBTHIGH 4 0 8 FORMAT "%8.6" DEPOSIT ABSOLUTE /end AXIS_DESCR
/end CHARACTERISTIC
/begin CHARACTERISTIC xActIn_InertiaTBT_XAU16_34___A "Drehstabmomentanabhängiger Faktor trägheit" CURVE 0x15CB94 AblGLKLuw 1 RIGHTSH6NP 0 1 FORMAT "%8.6"
 /begin AXIS_DESCR STD_AXIS mApplI_AbsTorsionBarTorque_xdu16 TBTHIGH 4 0 8 FORMAT "%8.6" DEPOSIT ABSOLUTE /end AXIS_DESCR
/end CHARACTERISTIC
/begin CHARACTERISTIC xActIn_InertiaTBT_XAU16_35___A "Drehstabmomentanabhängiger Faktor trägheit" CURVE 0x15CBA8 AblGLKLuw 1 RIGHTSH6NP 0 1 FORMAT "%8.6"
 /begin AXIS_DESCR STD_AXIS mApplI_AbsTorsionBarTorque_xdu16 TBTHIGH 4 0 8 FORMAT "%8.6" DEPOSIT ABSOLUTE /end AXIS_DESCR
/end CHARACTERISTIC
/begin CHARACTERISTIC xActRet_FilterFactor_XDU16_00___A "filter factor for filtrated nominal steering speed factor and motor torque factor" VALUE 0x1581B0 AblGLKWuw 0.990234 RIGHTSH10NP 0.009765625 1 FORMAT "%8.6" /end CHARACTERISTIC
/begin CHARACTERISTIC xActRet_FilterFactor_XDU16_01___A "filter factor for filtrated nominal steering speed factor and motor torque factor" VALUE 0x1581B2 AblGLKWuw 0.990234 RIGHTSH10NP 0.009765625 1 FORMAT "%8.6" /end CHARACTERISTIC
/begin CHARACTERISTIC xActRet_FilterFactor_XDU16_02___A "filter factor for filtrated nominal steering speed factor and motor torque factor" VALUE 0x1581B4 AblGLKWuw 0.990234 RIGHTSH10NP 0.009765625 1 FORMAT "%8.6" /end CHARACTERISTIC
/begin CHARACTERISTIC xActRet_FilterFactor_XDU16_03___A "filter factor for filtrated nominal steering speed factor and motor torque factor" VALUE 0x1581B6 AblGLKWuw 0.990234 RIGHTSH10NP 0.009765625 1 FORMAT "%8.6" /end CHARACTERISTIC
/begin CHARACTERISTIC xActRet_FilterFactor_XDU16_04___A "filter factor for filtrated nominal steering speed factor and motor torque factor" VALUE 0x1581B8 AblGLKWuw 0.990234 RIGHTSH10NP 0.009765625 1 FORMAT "%8.6" /end CHARACTERISTIC
/begin CHARACTERISTIC xActRet_FilterFactor_XDU16_05___A "filter factor for filtrated nominal steering speed factor and motor torque factor" VALUE 0x1581BA AblGLKWuw 0.990234 RIGHTSH10NP 0.009765625 1 FORMAT "%8.6" /end CHARACTERISTIC
/begin CHARACTERISTIC xActRet_FilterFactor_XDU16_06___A "filter factor for filtrated nominal steering speed factor and motor torque factor" VALUE 0x1581BC AblGLKWuw 0.990234 RIGHTSH10NP 0.009765625 1 FORMAT "%8.6" /end CHARACTERISTIC
/begin CHARACTERISTIC xActRet_FilterFactor_XDU16_07___A "filter factor for filtrated nominal steering speed factor and motor torque factor" VALUE 0x1581BE AblGLKWuw 0.990234 RIGHTSH10NP 0.009765625 1 FORMAT "%8.6" /end CHARACTERISTIC
/begin CHARACTERISTIC xActRet_FilterFactor_XDU16_08___A "filter factor for filtrated nominal steering speed factor and motor torque factor" VALUE 0x1581C0 AblGLKWuw 0.990234 RIGHTSH10NP 0.009765625 1 FORMAT "%8.6" /end CHARACTERISTIC
/begin CHARACTERISTIC xActRet_FilterFactor_XDU16_09___A "filter factor for filtrated nominal steering speed factor and motor torque factor" VALUE 0x1581C2 AblGLKWuw 0.990234 RIGHTSH10NP 0.009765625 1 FORMAT "%8.6" /end CHARACTERISTIC
/begin CHARACTERISTIC xActRet_FilterFactor_XDU16_10___A "filter factor for filtrated nominal steering speed factor and motor torque factor" VALUE 0x1581C4 AblGLKWuw 0.990234 RIGHTSH10NP 0.009765625 1 FORMAT "%8.6" /end CHARACTERISTIC
/begin CHARACTERISTIC xActRet_FilterFactor_XDU16_11___A "filter factor for filtrated nominal steering speed factor and motor torque factor" VALUE 0x1581C6 AblGLKWuw 0.990234 RIGHTSH10NP 0.009765625 1 FORMAT "%8.6" /end CHARACTERISTIC
/begin CHARACTERISTIC xActRet_FilterFactor_XDU16_12___A "filter factor for filtrated nominal steering speed factor and motor torque factor" VALUE 0x1581C8 AblGLKWuw 0.990234 RIGHTSH10NP 0.009765625 1 FORMAT "%8.6" /end CHARACTERISTIC
/begin CHARACTERISTIC xActRet_FilterFactor_XDU16_13___A "filter factor for filtrated nominal steering speed factor and motor torque factor" VALUE 0x1581CA AblGLKWuw 0.990234 RIGHTSH10NP 0.009765625 1 FORMAT "%8.6" /end CHARACTERISTIC
/begin CHARACTERISTIC xActRet_FilterFactor_XDU16_14___A "filter factor for filtrated nominal steering speed factor and motor torque factor" VALUE 0x1581CC AblGLKWuw 0.990234 RIGHTSH10NP 0.009765625 1 FORMAT "%8.6" /end CHARACTERISTIC
/begin CHARACTERISTIC xActRet_FilterFactor_XDU16_15___A "filter factor for filtrated nominal steering speed factor and motor torque factor" VALUE 0x1581CE AblGLKWuw 0.990234 RIGHTSH10NP 0.009765625 1 FORMAT "%8.6" /end CHARACTERISTIC
/begin CHARACTERISTIC xActRet_FilterFactor_XDU16_16___A "filter factor for filtrated nominal steering speed factor and motor torque factor" VALUE 0x1581D0 AblGLKWuw 0.990234 RIGHTSH10NP 0.009765625 1 FORMAT "%8.6" /end CHARACTERISTIC
/begin CHARACTERISTIC xActRet_FilterFactor_XDU16_17___A "filter factor for filtrated nominal steering speed factor and motor torque factor" VALUE 0x1581D2 AblGLKWuw 0.990234 RIGHTSH10NP 0.009765625 1 FORMAT "%8.6" /end CHARACTERISTIC
/begin CHARACTERISTIC xActRet_FilterFactor_XDU16_18___A "filter factor for filtrated nominal steering speed factor and motor torque factor" VALUE 0x1581D4 AblGLKWuw 0.990234 RIGHTSH10NP 0.009765625 1 FORMAT "%8.6" /end CHARACTERISTIC
/begin CHARACTERISTIC xActRet_FilterFactor_XDU16_19___A "filter factor for filtrated nominal steering speed factor and motor torque factor" VALUE 0x1581D6 AblGLKWuw 0.990234 RIGHTSH10NP 0.009765625 1 FORMAT "%8.6" /end CHARACTERISTIC
/begin CHARACTERISTIC xActRet_FilterFactor_XDU16_20___A "filter factor for filtrated nominal steering speed factor and motor torque factor" VALUE 0x1581D8 AblGLKWuw 0.990234 RIGHTSH10NP 0.009765625 1 FORMAT "%8.6" /end CHARACTERISTIC
/begin CHARACTERISTIC xActRet_FilterFactor_XDU16_21___A "filter factor for filtrated nominal steering speed factor and motor torque factor" VALUE 0x1581DA AblGLKWuw 0.990234 RIGHTSH10NP 0.009765625 1 FORMAT "%8.6" /end CHARACTERISTIC
/begin CHARACTERISTIC xActRet_FilterFactor_XDU16_22___A "filter factor for filtrated nominal steering speed factor and motor torque factor" VALUE 0x1581DC AblGLKWuw 0.990234 RIGHTSH10NP 0.009765625 1 FORMAT "%8.6" /end CHARACTERISTIC
/begin CHARACTERISTIC xActRet_FilterFactor_XDU16_23___A "filter factor for filtrated nominal steering speed factor and motor torque factor" VALUE 0x1581DE AblGLKWuw 0.990234 RIGHTSH10NP 0.009765625 1 FORMAT "%8.6" /end CHARACTERISTIC
/begin CHARACTERISTIC xActRet_FilterFactor_XDU16_24___A "filter factor for filtrated nominal steering speed factor and motor torque factor" VALUE 0x1581E0 AblGLKWuw 0.990234 RIGHTSH10NP 0.009765625 1 FORMAT "%8.6" /end CHARACTERISTIC
/begin CHARACTERISTIC xActRet_FilterFactor_XDU16_25___A "filter factor for filtrated nominal steering speed factor and motor torque factor" VALUE 0x1581E2 AblGLKWuw 0.990234 RIGHTSH10NP 0.009765625 1 FORMAT "%8.6" /end CHARACTERISTIC
/begin CHARACTERISTIC xActRet_FilterFactor_XDU16_26___A "filter factor for filtrated nominal steering speed factor and motor torque factor" VALUE 0x1581E4 AblGLKWuw 0.990234 RIGHTSH10NP 0.009765625 1 FORMAT "%8.6" /end CHARACTERISTIC
/begin CHARACTERISTIC xActRet_FilterFactor_XDU16_27___A "filter factor for filtrated nominal steering speed factor and motor torque factor" VALUE 0x1581E6 AblGLKWuw 0.990234 RIGHTSH10NP 0.009765625 1 FORMAT "%8.6" /end CHARACTERISTIC
/begin CHARACTERISTIC xActRet_FilterFactor_XDU16_28___A "filter factor for filtrated nominal steering speed factor and motor torque factor" VALUE 0x1581E8 AblGLKWuw 0.990234 RIGHTSH10NP 0.009765625 1 FORMAT "%8.6" /end CHARACTERISTIC
/begin CHARACTERISTIC xActRet_FilterFactor_XDU16_29___A "filter factor for filtrated nominal steering speed factor and motor torque factor" VALUE 0x1581EA AblGLKWuw 0.990234 RIGHTSH10NP 0.009765625 1 FORMAT "%8.6" /end CHARACTERISTIC
/begin CHARACTERISTIC xActRet_FilterFactor_XDU16_30___A "filter factor for filtrated nominal steering speed factor and motor torque factor" VALUE 0x1581EC AblGLKWuw 0.990234 RIGHTSH10NP 0.009765625 1 FORMAT "%8.6" /end CHARACTERISTIC
/begin CHARACTERISTIC xActRet_FilterFactor_XDU16_31___A "filter factor for filtrated nominal steering speed factor and motor torque factor" VALUE 0x1581EE AblGLKWuw 0.990234 RIGHTSH10NP 0.009765625 1 FORMAT "%8.6" /end CHARACTERISTIC
/begin CHARACTERISTIC xActRet_FilterFactor_XDU16_32___A "filter factor for filtrated nominal steering speed factor and motor torque factor" VALUE 0x1581F0 AblGLKWuw 0.990234 RIGHTSH10NP 0.009765625 1 FORMAT "%8.6" /end CHARACTERISTIC
/begin CHARACTERISTIC xActRet_FilterFactor_XDU16_33___A "filter factor for filtrated nominal steering speed factor and motor torque factor" VALUE 0x1581F2 AblGLKWuw 0.990234 RIGHTSH10NP 0.009765625 1 FORMAT "%8.6" /end CHARACTERISTIC
/begin CHARACTERISTIC xActRet_FilterFactor_XDU16_34___A "filter factor for filtrated nominal steering speed factor and motor torque factor" VALUE 0x1581F4 AblGLKWuw 0.990234 RIGHTSH10NP 0.009765625 1 FORMAT "%8.6" /end CHARACTERISTIC
/begin CHARACTERISTIC xActRet_FilterFactor_XDU16_35___A "filter factor for filtrated nominal steering speed factor and motor torque factor" VALUE 0x1581F6 AblGLKWuw 0.990234 RIGHTSH10NP 0.009765625 1 FORMAT "%8.6" /end CHARACTERISTIC
/begin CHARACTERISTIC xActRet_MotorTorqueGain_XAU16_00___A "motor torque factor" CURVE 0x15CBBC AblGLKLuw 3 RIGHTSH10NP 0 3 FORMAT "%8.6"
 /begin AXIS_DESCR STD_AXIS vVehSpI_AbsAvgVehSpd_xdu16 VFZHIGH 6 0 250 FORMAT "%8.4" DEPOSIT ABSOLUTE /end AXIS_DESCR
/end CHARACTERISTIC
/begin CHARACTERISTIC xActRet_MotorTorqueGain_XAU16_01___A "motor torque factor" CURVE 0x15CBD8 AblGLKLuw 3 RIGHTSH10NP 0 3 FORMAT "%8.6"
 /begin AXIS_DESCR STD_AXIS vVehSpI_AbsAvgVehSpd_xdu16 VFZHIGH 6 0 250 FORMAT "%8.4" DEPOSIT ABSOLUTE /end AXIS_DESCR
/end CHARACTERISTIC
/begin CHARACTERISTIC xActRet_MotorTorqueGain_XAU16_02___A "motor torque factor" CURVE 0x15CBF4 AblGLKLuw 3 RIGHTSH10NP 0 3 FORMAT "%8.6"
 /begin AXIS_DESCR STD_AXIS vVehSpI_AbsAvgVehSpd_xdu16 VFZHIGH 6 0 250 FORMAT "%8.4" DEPOSIT ABSOLUTE /end AXIS_DESCR
/end CHARACTERISTIC
/begin CHARACTERISTIC xActRet_MotorTorqueGain_XAU16_03___A "motor torque factor" CURVE 0x15CC10 AblGLKLuw 3 RIGHTSH10NP 0 3 FORMAT "%8.6"
 /begin AXIS_DESCR STD_AXIS vVehSpI_AbsAvgVehSpd_xdu16 VFZHIGH 6 0 250 FORMAT "%8.4" DEPOSIT ABSOLUTE /end AXIS_DESCR
/end CHARACTERISTIC
/begin CHARACTERISTIC xActRet_MotorTorqueGain_XAU16_04___A "motor torque factor" CURVE 0x15CC2C AblGLKLuw 3 RIGHTSH10NP 0 3 FORMAT "%8.6"
 /begin AXIS_DESCR STD_AXIS vVehSpI_AbsAvgVehSpd_xdu16 VFZHIGH 6 0 250 FORMAT "%8.4" DEPOSIT ABSOLUTE /end AXIS_DESCR
/end CHARACTERISTIC
/begin CHARACTERISTIC xActRet_MotorTorqueGain_XAU16_05___A "motor torque factor" CURVE 0x15CC48 AblGLKLuw 3 RIGHTSH10NP 0 3 FORMAT "%8.6"
 /begin AXIS_DESCR STD_AXIS vVehSpI_AbsAvgVehSpd_xdu16 VFZHIGH 6 0 250 FORMAT "%8.4" DEPOSIT ABSOLUTE /end AXIS_DESCR
/end CHARACTERISTIC
/begin CHARACTERISTIC xActRet_MotorTorqueGain_XAU16_06___A "motor torque factor" CURVE 0x15CC64 AblGLKLuw 3 RIGHTSH10NP 0 3 FORMAT "%8.6"
 /begin AXIS_DESCR STD_AXIS vVehSpI_AbsAvgVehSpd_xdu16 VFZHIGH 6 0 250 FORMAT "%8.4" DEPOSIT ABSOLUTE /end AXIS_DESCR
/end CHARACTERISTIC
/begin CHARACTERISTIC xActRet_MotorTorqueGain_XAU16_07___A "motor torque factor" CURVE 0x15CC80 AblGLKLuw 3 RIGHTSH10NP 0 3 FORMAT "%8.6"
 /begin AXIS_DESCR STD_AXIS vVehSpI_AbsAvgVehSpd_xdu16 VFZHIGH 6 0 250 FORMAT "%8.4" DEPOSIT ABSOLUTE /end AXIS_DESCR
/end CHARACTERISTIC
/begin CHARACTERISTIC xActRet_MotorTorqueGain_XAU16_08___A "motor torque factor" CURVE 0x15CC9C AblGLKLuw 3 RIGHTSH10NP 0 3 FORMAT "%8.6"
 /begin AXIS_DESCR STD_AXIS vVehSpI_AbsAvgVehSpd_xdu16 VFZHIGH 6 0 250 FORMAT "%8.4" DEPOSIT ABSOLUTE /end AXIS_DESCR
/end CHARACTERISTIC
/begin CHARACTERISTIC xActRet_MotorTorqueGain_XAU16_09___A "motor torque factor" CURVE 0x15CCB8 AblGLKLuw 3 RIGHTSH10NP 0 3 FORMAT "%8.6"
 /begin AXIS_DESCR STD_AXIS vVehSpI_AbsAvgVehSpd_xdu16 VFZHIGH 6 0 250 FORMAT "%8.4" DEPOSIT ABSOLUTE /end AXIS_DESCR
/end CHARACTERISTIC
/begin CHARACTERISTIC xActRet_MotorTorqueGain_XAU16_10___A "motor torque factor" CURVE 0x15CCD4 AblGLKLuw 3 RIGHTSH10NP 0 3 FORMAT "%8.6"
 /begin AXIS_DESCR STD_AXIS vVehSpI_AbsAvgVehSpd_xdu16 VFZHIGH 6 0 250 FORMAT "%8.4" DEPOSIT ABSOLUTE /end AXIS_DESCR
/end CHARACTERISTIC
/begin CHARACTERISTIC xActRet_MotorTorqueGain_XAU16_11___A "motor torque factor" CURVE 0x15CCF0 AblGLKLuw 3 RIGHTSH10NP 0 3 FORMAT "%8.6"
 /begin AXIS_DESCR STD_AXIS vVehSpI_AbsAvgVehSpd_xdu16 VFZHIGH 6 0 250 FORMAT "%8.4" DEPOSIT ABSOLUTE /end AXIS_DESCR
/end CHARACTERISTIC
/begin CHARACTERISTIC xActRet_MotorTorqueGain_XAU16_12___A "motor torque factor" CURVE 0x15CD0C AblGLKLuw 3 RIGHTSH10NP 0 3 FORMAT "%8.6"
 /begin AXIS_DESCR STD_AXIS vVehSpI_AbsAvgVehSpd_xdu16 VFZHIGH 6 0 250 FORMAT "%8.4" DEPOSIT ABSOLUTE /end AXIS_DESCR
/end CHARACTERISTIC
/begin CHARACTERISTIC xActRet_MotorTorqueGain_XAU16_13___A "motor torque factor" CURVE 0x15CD28 AblGLKLuw 3 RIGHTSH10NP 0 3 FORMAT "%8.6"
 /begin AXIS_DESCR STD_AXIS vVehSpI_AbsAvgVehSpd_xdu16 VFZHIGH 6 0 250 FORMAT "%8.4" DEPOSIT ABSOLUTE /end AXIS_DESCR
/end CHARACTERISTIC
/begin CHARACTERISTIC xActRet_MotorTorqueGain_XAU16_14___A "motor torque factor" CURVE 0x15CD44 AblGLKLuw 3 RIGHTSH10NP 0 3 FORMAT "%8.6"
 /begin AXIS_DESCR STD_AXIS vVehSpI_AbsAvgVehSpd_xdu16 VFZHIGH 6 0 250 FORMAT "%8.4" DEPOSIT ABSOLUTE /end AXIS_DESCR
/end CHARACTERISTIC
/begin CHARACTERISTIC xActRet_MotorTorqueGain_XAU16_15___A "motor torque factor" CURVE 0x15CD60 AblGLKLuw 3 RIGHTSH10NP 0 3 FORMAT "%8.6"
 /begin AXIS_DESCR STD_AXIS vVehSpI_AbsAvgVehSpd_xdu16 VFZHIGH 6 0 250 FORMAT "%8.4" DEPOSIT ABSOLUTE /end AXIS_DESCR
/end CHARACTERISTIC
/begin CHARACTERISTIC xActRet_MotorTorqueGain_XAU16_16___A "motor torque factor" CURVE 0x15CD7C AblGLKLuw 3 RIGHTSH10NP 0 3 FORMAT "%8.6"
 /begin AXIS_DESCR STD_AXIS vVehSpI_AbsAvgVehSpd_xdu16 VFZHIGH 6 0 250 FORMAT "%8.4" DEPOSIT ABSOLUTE /end AXIS_DESCR
/end CHARACTERISTIC
/begin CHARACTERISTIC xActRet_MotorTorqueGain_XAU16_17___A "motor torque factor" CURVE 0x15CD98 AblGLKLuw 3 RIGHTSH10NP 0 3 FORMAT "%8.6"
 /begin AXIS_DESCR STD_AXIS vVehSpI_AbsAvgVehSpd_xdu16 VFZHIGH 6 0 250 FORMAT "%8.4" DEPOSIT ABSOLUTE /end AXIS_DESCR
/end CHARACTERISTIC
/begin CHARACTERISTIC xActRet_MotorTorqueGain_XAU16_18___A "motor torque factor" CURVE 0x15CDB4 AblGLKLuw 3 RIGHTSH10NP 0 3 FORMAT "%8.6"
 /begin AXIS_DESCR STD_AXIS vVehSpI_AbsAvgVehSpd_xdu16 VFZHIGH 6 0 250 FORMAT "%8.4" DEPOSIT ABSOLUTE /end AXIS_DESCR
/end CHARACTERISTIC
/begin CHARACTERISTIC xActRet_MotorTorqueGain_XAU16_19___A "motor torque factor" CURVE 0x15CDD0 AblGLKLuw 3 RIGHTSH10NP 0 3 FORMAT "%8.6"
 /begin AXIS_DESCR STD_AXIS vVehSpI_AbsAvgVehSpd_xdu16 VFZHIGH 6 0 250 FORMAT "%8.4" DEPOSIT ABSOLUTE /end AXIS_DESCR
/end CHARACTERISTIC
/begin CHARACTERISTIC xActRet_MotorTorqueGain_XAU16_20___A "motor torque factor" CURVE 0x15CDEC AblGLKLuw 3 RIGHTSH10NP 0 3 FORMAT "%8.6"
 /begin AXIS_DESCR STD_AXIS vVehSpI_AbsAvgVehSpd_xdu16 VFZHIGH 6 0 250 FORMAT "%8.4" DEPOSIT ABSOLUTE /end AXIS_DESCR
/end CHARACTERISTIC
/begin CHARACTERISTIC xActRet_MotorTorqueGain_XAU16_21___A "motor torque factor" CURVE 0x15CE08 AblGLKLuw 3 RIGHTSH10NP 0 3 FORMAT "%8.6"
 /begin AXIS_DESCR STD_AXIS vVehSpI_AbsAvgVehSpd_xdu16 VFZHIGH 6 0 250 FORMAT "%8.4" DEPOSIT ABSOLUTE /end AXIS_DESCR
/end CHARACTERISTIC
/begin CHARACTERISTIC xActRet_MotorTorqueGain_XAU16_22___A "motor torque factor" CURVE 0x15CE24 AblGLKLuw 3 RIGHTSH10NP 0 3 FORMAT "%8.6"
 /begin AXIS_DESCR STD_AXIS vVehSpI_AbsAvgVehSpd_xdu16 VFZHIGH 6 0 250 FORMAT "%8.4" DEPOSIT ABSOLUTE /end AXIS_DESCR
/end CHARACTERISTIC
/begin CHARACTERISTIC xActRet_MotorTorqueGain_XAU16_23___A "motor torque factor" CURVE 0x15CE40 AblGLKLuw 3 RIGHTSH10NP 0 3 FORMAT "%8.6"
 /begin AXIS_DESCR STD_AXIS vVehSpI_AbsAvgVehSpd_xdu16 VFZHIGH 6 0 250 FORMAT "%8.4" DEPOSIT ABSOLUTE /end AXIS_DESCR
/end CHARACTERISTIC
/begin CHARACTERISTIC xActRet_MotorTorqueGain_XAU16_24___A "motor torque factor" CURVE 0x15CE5C AblGLKLuw 3 RIGHTSH10NP 0 3 FORMAT "%8.6"
 /begin AXIS_DESCR STD_AXIS vVehSpI_AbsAvgVehSpd_xdu16 VFZHIGH 6 0 250 FORMAT "%8.4" DEPOSIT ABSOLUTE /end AXIS_DESCR
/end CHARACTERISTIC
/begin CHARACTERISTIC xActRet_MotorTorqueGain_XAU16_25___A "motor torque factor" CURVE 0x15CE78 AblGLKLuw 3 RIGHTSH10NP 0 3 FORMAT "%8.6"
 /begin AXIS_DESCR STD_AXIS vVehSpI_AbsAvgVehSpd_xdu16 VFZHIGH 6 0 250 FORMAT "%8.4" DEPOSIT ABSOLUTE /end AXIS_DESCR
/end CHARACTERISTIC
/begin CHARACTERISTIC xActRet_MotorTorqueGain_XAU16_26___A "motor torque factor" CURVE 0x15CE94 AblGLKLuw 3 RIGHTSH10NP 0 3 FORMAT "%8.6"
 /begin AXIS_DESCR STD_AXIS vVehSpI_AbsAvgVehSpd_xdu16 VFZHIGH 6 0 250 FORMAT "%8.4" DEPOSIT ABSOLUTE /end AXIS_DESCR
/end CHARACTERISTIC
/begin CHARACTERISTIC xActRet_MotorTorqueGain_XAU16_27___A "motor torque factor" CURVE 0x15CEB0 AblGLKLuw 3 RIGHTSH10NP 0 3 FORMAT "%8.6"
 /begin AXIS_DESCR STD_AXIS vVehSpI_AbsAvgVehSpd_xdu16 VFZHIGH 6 0 250 FORMAT "%8.4" DEPOSIT ABSOLUTE /end AXIS_DESCR
/end CHARACTERISTIC
/begin CHARACTERISTIC xActRet_MotorTorqueGain_XAU16_28___A "motor torque factor" CURVE 0x15CECC AblGLKLuw 3 RIGHTSH10NP 0 3 FORMAT "%8.6"
 /begin AXIS_DESCR STD_AXIS vVehSpI_AbsAvgVehSpd_xdu16 VFZHIGH 6 0 250 FORMAT "%8.4" DEPOSIT ABSOLUTE /end AXIS_DESCR
/end CHARACTERISTIC
/begin CHARACTERISTIC xActRet_MotorTorqueGain_XAU16_29___A "motor torque factor" CURVE 0x15CEE8 AblGLKLuw 3 RIGHTSH10NP 0 3 FORMAT "%8.6"
 /begin AXIS_DESCR STD_AXIS vVehSpI_AbsAvgVehSpd_xdu16 VFZHIGH 6 0 250 FORMAT "%8.4" DEPOSIT ABSOLUTE /end AXIS_DESCR
/end CHARACTERISTIC
/begin CHARACTERISTIC xActRet_MotorTorqueGain_XAU16_30___A "motor torque factor" CURVE 0x15CF04 AblGLKLuw 3 RIGHTSH10NP 0 3 FORMAT "%8.6"
 /begin AXIS_DESCR STD_AXIS vVehSpI_AbsAvgVehSpd_xdu16 VFZHIGH 6 0 250 FORMAT "%8.4" DEPOSIT ABSOLUTE /end AXIS_DESCR
/end CHARACTERISTIC
/begin CHARACTERISTIC xActRet_MotorTorqueGain_XAU16_31___A "motor torque factor" CURVE 0x15CF20 AblGLKLuw 3 RIGHTSH10NP 0 3 FORMAT "%8.6"
 /begin AXIS_DESCR STD_AXIS vVehSpI_AbsAvgVehSpd_xdu16 VFZHIGH 6 0 250 FORMAT "%8.4" DEPOSIT ABSOLUTE /end AXIS_DESCR
/end CHARACTERISTIC
/begin CHARACTERISTIC xActRet_MotorTorqueGain_XAU16_32___A "motor torque factor" CURVE 0x15CF3C AblGLKLuw 3 RIGHTSH10NP 0 3 FORMAT "%8.6"
 /begin AXIS_DESCR STD_AXIS vVehSpI_AbsAvgVehSpd_xdu16 VFZHIGH 6 0 250 FORMAT "%8.4" DEPOSIT ABSOLUTE /end AXIS_DESCR
/end CHARACTERISTIC
/begin CHARACTERISTIC xActRet_MotorTorqueGain_XAU16_33___A "motor torque factor" CURVE 0x15CF58 AblGLKLuw 3 RIGHTSH10NP 0 3 FORMAT "%8.6"
 /begin AXIS_DESCR STD_AXIS vVehSpI_AbsAvgVehSpd_xdu16 VFZHIGH 6 0 250 FORMAT "%8.4" DEPOSIT ABSOLUTE /end AXIS_DESCR
/end CHARACTERISTIC
/begin CHARACTERISTIC xActRet_MotorTorqueGain_XAU16_34___A "motor torque factor" CURVE 0x15CF74 AblGLKLuw 3 RIGHTSH10NP 0 3 FORMAT "%8.6"
 /begin AXIS_DESCR STD_AXIS vVehSpI_AbsAvgVehSpd_xdu16 VFZHIGH 6 0 250 FORMAT "%8.4" DEPOSIT ABSOLUTE /end AXIS_DESCR
/end CHARACTERISTIC
/begin CHARACTERISTIC xActRet_MotorTorqueGain_XAU16_35___A "motor torque factor" CURVE 0x15CF90 AblGLKLuw 3 RIGHTSH10NP 0 3 FORMAT "%8.6"
 /begin AXIS_DESCR STD_AXIS vVehSpI_AbsAvgVehSpd_xdu16 VFZHIGH 6 0 250 FORMAT "%8.4" DEPOSIT ABSOLUTE /end AXIS_DESCR
/end CHARACTERISTIC
/begin CHARACTERISTIC xActRet_RetTorqueFactDepOnDriver_XAU16_00___A "factor of active return motor torque (after limitation) depending on driver torque" CURVE 0x15CFAC AblGLKLuw 1 RIGHTSH10NP 0 1 FORMAT "%8.6"
 /begin AXIS_DESCR STD_AXIS mApplI_AbsDriverTorque_xdu16 TBTHIGH 6 0 25 FORMAT "%8.5" DEPOSIT ABSOLUTE /end AXIS_DESCR
/end CHARACTERISTIC
/begin CHARACTERISTIC xActRet_RetTorqueFactDepOnDriver_XAU16_01___A "factor of active return motor torque (after limitation) depending on driver torque" CURVE 0x15CFC8 AblGLKLuw 1 RIGHTSH10NP 0 1 FORMAT "%8.6"
 /begin AXIS_DESCR STD_AXIS mApplI_AbsDriverTorque_xdu16 TBTHIGH 6 0 25 FORMAT "%8.5" DEPOSIT ABSOLUTE /end AXIS_DESCR
/end CHARACTERISTIC
/begin CHARACTERISTIC xActRet_RetTorqueFactDepOnDriver_XAU16_02___A "factor of active return motor torque (after limitation) depending on driver torque" CURVE 0x15CFE4 AblGLKLuw 1 RIGHTSH10NP 0 1 FORMAT "%8.6"
 /begin AXIS_DESCR STD_AXIS mApplI_AbsDriverTorque_xdu16 TBTHIGH 6 0 25 FORMAT "%8.5" DEPOSIT ABSOLUTE /end AXIS_DESCR
/end CHARACTERISTIC
/begin CHARACTERISTIC xActRet_RetTorqueFactDepOnDriver_XAU16_03___A "factor of active return motor torque (after limitation) depending on driver torque" CURVE 0x15D000 AblGLKLuw 1 RIGHTSH10NP 0 1 FORMAT "%8.6"
 /begin AXIS_DESCR STD_AXIS mApplI_AbsDriverTorque_xdu16 TBTHIGH 6 0 25 FORMAT "%8.5" DEPOSIT ABSOLUTE /end AXIS_DESCR
/end CHARACTERISTIC
/begin CHARACTERISTIC xActRet_RetTorqueFactDepOnDriver_XAU16_04___A "factor of active return motor torque (after limitation) depending on driver torque" CURVE 0x15D01C AblGLKLuw 1 RIGHTSH10NP 0 1 FORMAT "%8.6"
 /begin AXIS_DESCR STD_AXIS mApplI_AbsDriverTorque_xdu16 TBTHIGH 6 0 25 FORMAT "%8.5" DEPOSIT ABSOLUTE /end AXIS_DESCR
/end CHARACTERISTIC
/begin CHARACTERISTIC xActRet_RetTorqueFactDepOnDriver_XAU16_05___A "factor of active return motor torque (after limitation) depending on driver torque" CURVE 0x15D038 AblGLKLuw 1 RIGHTSH10NP 0 1 FORMAT "%8.6"
 /begin AXIS_DESCR STD_AXIS mApplI_AbsDriverTorque_xdu16 TBTHIGH 6 0 25 FORMAT "%8.5" DEPOSIT ABSOLUTE /end AXIS_DESCR
/end CHARACTERISTIC
/begin CHARACTERISTIC xActRet_RetTorqueFactDepOnDriver_XAU16_06___A "factor of active return motor torque (after limitation) depending on driver torque" CURVE 0x15D054 AblGLKLuw 1 RIGHTSH10NP 0 1 FORMAT "%8.6"
 /begin AXIS_DESCR STD_AXIS mApplI_AbsDriverTorque_xdu16 TBTHIGH 6 0 25 FORMAT "%8.5" DEPOSIT ABSOLUTE /end AXIS_DESCR
/end CHARACTERISTIC
/begin CHARACTERISTIC xActRet_RetTorqueFactDepOnDriver_XAU16_07___A "factor of active return motor torque (after limitation) depending on driver torque" CURVE 0x15D070 AblGLKLuw 1 RIGHTSH10NP 0 1 FORMAT "%8.6"
 /begin AXIS_DESCR STD_AXIS mApplI_AbsDriverTorque_xdu16 TBTHIGH 6 0 25 FORMAT "%8.5" DEPOSIT ABSOLUTE /end AXIS_DESCR
/end CHARACTERISTIC
/begin CHARACTERISTIC xActRet_RetTorqueFactDepOnDriver_XAU16_08___A "factor of active return motor torque (after limitation) depending on driver torque" CURVE 0x15D08C AblGLKLuw 1 RIGHTSH10NP 0 1 FORMAT "%8.6"
 /begin AXIS_DESCR STD_AXIS mApplI_AbsDriverTorque_xdu16 TBTHIGH 6 0 25 FORMAT "%8.5" DEPOSIT ABSOLUTE /end AXIS_DESCR
/end CHARACTERISTIC
/begin CHARACTERISTIC xActRet_RetTorqueFactDepOnDriver_XAU16_09___A "factor of active return motor torque (after limitation) depending on driver torque" CURVE 0x15D0A8 AblGLKLuw 1 RIGHTSH10NP 0 1 FORMAT "%8.6"
 /begin AXIS_DESCR STD_AXIS mApplI_AbsDriverTorque_xdu16 TBTHIGH 6 0 25 FORMAT "%8.5" DEPOSIT ABSOLUTE /end AXIS_DESCR
/end CHARACTERISTIC
/begin CHARACTERISTIC xActRet_RetTorqueFactDepOnDriver_XAU16_10___A "factor of active return motor torque (after limitation) depending on driver torque" CURVE 0x15D0C4 AblGLKLuw 1 RIGHTSH10NP 0 1 FORMAT "%8.6"
 /begin AXIS_DESCR STD_AXIS mApplI_AbsDriverTorque_xdu16 TBTHIGH 6 0 25 FORMAT "%8.5" DEPOSIT ABSOLUTE /end AXIS_DESCR
/end CHARACTERISTIC
/begin CHARACTERISTIC xActRet_RetTorqueFactDepOnDriver_XAU16_11___A "factor of active return motor torque (after limitation) depending on driver torque" CURVE 0x15D0E0 AblGLKLuw 1 RIGHTSH10NP 0 1 FORMAT "%8.6"
 /begin AXIS_DESCR STD_AXIS mApplI_AbsDriverTorque_xdu16 TBTHIGH 6 0 25 FORMAT "%8.5" DEPOSIT ABSOLUTE /end AXIS_DESCR
/end CHARACTERISTIC
/begin CHARACTERISTIC xActRet_RetTorqueFactDepOnDriver_XAU16_12___A "factor of active return motor torque (after limitation) depending on driver torque" CURVE 0x15D0FC AblGLKLuw 1 RIGHTSH10NP 0 1 FORMAT "%8.6"
 /begin AXIS_DESCR STD_AXIS mApplI_AbsDriverTorque_xdu16 TBTHIGH 6 0 25 FORMAT "%8.5" DEPOSIT ABSOLUTE /end AXIS_DESCR
/end CHARACTERISTIC
/begin CHARACTERISTIC xActRet_RetTorqueFactDepOnDriver_XAU16_13___A "factor of active return motor torque (after limitation) depending on driver torque" CURVE 0x15D118 AblGLKLuw 1 RIGHTSH10NP 0 1 FORMAT "%8.6"
 /begin AXIS_DESCR STD_AXIS mApplI_AbsDriverTorque_xdu16 TBTHIGH 6 0 25 FORMAT "%8.5" DEPOSIT ABSOLUTE /end AXIS_DESCR
/end CHARACTERISTIC
/begin CHARACTERISTIC xActRet_RetTorqueFactDepOnDriver_XAU16_14___A "factor of active return motor torque (after limitation) depending on driver torque" CURVE 0x15D134 AblGLKLuw 1 RIGHTSH10NP 0 1 FORMAT "%8.6"
 /begin AXIS_DESCR STD_AXIS mApplI_AbsDriverTorque_xdu16 TBTHIGH 6 0 25 FORMAT "%8.5" DEPOSIT ABSOLUTE /end AXIS_DESCR
/end CHARACTERISTIC
/begin CHARACTERISTIC xActRet_RetTorqueFactDepOnDriver_XAU16_15___A "factor of active return motor torque (after limitation) depending on driver torque" CURVE 0x15D150 AblGLKLuw 1 RIGHTSH10NP 0 1 FORMAT "%8.6"
 /begin AXIS_DESCR STD_AXIS mApplI_AbsDriverTorque_xdu16 TBTHIGH 6 0 25 FORMAT "%8.5" DEPOSIT ABSOLUTE /end AXIS_DESCR
/end CHARACTERISTIC
/begin CHARACTERISTIC xActRet_RetTorqueFactDepOnDriver_XAU16_16___A "factor of active return motor torque (after limitation) depending on driver torque" CURVE 0x15D16C AblGLKLuw 1 RIGHTSH10NP 0 1 FORMAT "%8.6"
 /begin AXIS_DESCR STD_AXIS mApplI_AbsDriverTorque_xdu16 TBTHIGH 6 0 25 FORMAT "%8.5" DEPOSIT ABSOLUTE /end AXIS_DESCR
/end CHARACTERISTIC
/begin CHARACTERISTIC xActRet_RetTorqueFactDepOnDriver_XAU16_17___A "factor of active return motor torque (after limitation) depending on driver torque" CURVE 0x15D188 AblGLKLuw 1 RIGHTSH10NP 0 1 FORMAT "%8.6"
 /begin AXIS_DESCR STD_AXIS mApplI_AbsDriverTorque_xdu16 TBTHIGH 6 0 25 FORMAT "%8.5" DEPOSIT ABSOLUTE /end AXIS_DESCR
/end CHARACTERISTIC
/begin CHARACTERISTIC xActRet_RetTorqueFactDepOnDriver_XAU16_18___A "factor of active return motor torque (after limitation) depending on driver torque" CURVE 0x15D1A4 AblGLKLuw 1 RIGHTSH10NP 0 1 FORMAT "%8.6"
 /begin AXIS_DESCR STD_AXIS mApplI_AbsDriverTorque_xdu16 TBTHIGH 6 0 25 FORMAT "%8.5" DEPOSIT ABSOLUTE /end AXIS_DESCR
/end CHARACTERISTIC
/begin CHARACTERISTIC xActRet_RetTorqueFactDepOnDriver_XAU16_19___A "factor of active return motor torque (after limitation) depending on driver torque" CURVE 0x15D1C0 AblGLKLuw 1 RIGHTSH10NP 0 1 FORMAT "%8.6"
 /begin AXIS_DESCR STD_AXIS mApplI_AbsDriverTorque_xdu16 TBTHIGH 6 0 25 FORMAT "%8.5" DEPOSIT ABSOLUTE /end AXIS_DESCR
/end CHARACTERISTIC
/begin CHARACTERISTIC xActRet_RetTorqueFactDepOnDriver_XAU16_20___A "factor of active return motor torque (after limitation) depending on driver torque" CURVE 0x15D1DC AblGLKLuw 1 RIGHTSH10NP 0 1 FORMAT "%8.6"
 /begin AXIS_DESCR STD_AXIS mApplI_AbsDriverTorque_xdu16 TBTHIGH 6 0 25 FORMAT "%8.5" DEPOSIT ABSOLUTE /end AXIS_DESCR
/end CHARACTERISTIC
/begin CHARACTERISTIC xActRet_RetTorqueFactDepOnDriver_XAU16_21___A "factor of active return motor torque (after limitation) depending on driver torque" CURVE 0x15D1F8 AblGLKLuw 1 RIGHTSH10NP 0 1 FORMAT "%8.6"
 /begin AXIS_DESCR STD_AXIS mApplI_AbsDriverTorque_xdu16 TBTHIGH 6 0 25 FORMAT "%8.5" DEPOSIT ABSOLUTE /end AXIS_DESCR
/end CHARACTERISTIC
/begin CHARACTERISTIC xActRet_RetTorqueFactDepOnDriver_XAU16_22___A "factor of active return motor torque (after limitation) depending on driver torque" CURVE 0x15D214 AblGLKLuw 1 RIGHTSH10NP 0 1 FORMAT "%8.6"
 /begin AXIS_DESCR STD_AXIS mApplI_AbsDriverTorque_xdu16 TBTHIGH 6 0 25 FORMAT "%8.5" DEPOSIT ABSOLUTE /end AXIS_DESCR
/end CHARACTERISTIC
/begin CHARACTERISTIC xActRet_RetTorqueFactDepOnDriver_XAU16_23___A "factor of active return motor torque (after limitation) depending on driver torque" CURVE 0x15D230 AblGLKLuw 1 RIGHTSH10NP 0 1 FORMAT "%8.6"
 /begin AXIS_DESCR STD_AXIS mApplI_AbsDriverTorque_xdu16 TBTHIGH 6 0 25 FORMAT "%8.5" DEPOSIT ABSOLUTE /end AXIS_DESCR
/end CHARACTERISTIC
/begin CHARACTERISTIC xActRet_RetTorqueFactDepOnDriver_XAU16_24___A "factor of active return motor torque (after limitation) depending on driver torque" CURVE 0x15D24C AblGLKLuw 1 RIGHTSH10NP 0 1 FORMAT "%8.6"
 /begin AXIS_DESCR STD_AXIS mApplI_AbsDriverTorque_xdu16 TBTHIGH 6 0 25 FORMAT "%8.5" DEPOSIT ABSOLUTE /end AXIS_DESCR
/end CHARACTERISTIC
/begin CHARACTERISTIC xActRet_RetTorqueFactDepOnDriver_XAU16_25___A "factor of active return motor torque (after limitation) depending on driver torque" CURVE 0x15D268 AblGLKLuw 1 RIGHTSH10NP 0 1 FORMAT "%8.6"
 /begin AXIS_DESCR STD_AXIS mApplI_AbsDriverTorque_xdu16 TBTHIGH 6 0 25 FORMAT "%8.5" DEPOSIT ABSOLUTE /end AXIS_DESCR
/end CHARACTERISTIC
/begin CHARACTERISTIC xActRet_RetTorqueFactDepOnDriver_XAU16_26___A "factor of active return motor torque (after limitation) depending on driver torque" CURVE 0x15D284 AblGLKLuw 1 RIGHTSH10NP 0 1 FORMAT "%8.6"
 /begin AXIS_DESCR STD_AXIS mApplI_AbsDriverTorque_xdu16 TBTHIGH 6 0 25 FORMAT "%8.5" DEPOSIT ABSOLUTE /end AXIS_DESCR
/end CHARACTERISTIC
/begin CHARACTERISTIC xActRet_RetTorqueFactDepOnDriver_XAU16_27___A "factor of active return motor torque (after limitation) depending on driver torque" CURVE 0x15D2A0 AblGLKLuw 1 RIGHTSH10NP 0 1 FORMAT "%8.6"
 /begin AXIS_DESCR STD_AXIS mApplI_AbsDriverTorque_xdu16 TBTHIGH 6 0 25 FORMAT "%8.5" DEPOSIT ABSOLUTE /end AXIS_DESCR
/end CHARACTERISTIC
/begin CHARACTERISTIC xActRet_RetTorqueFactDepOnDriver_XAU16_28___A "factor of active return motor torque (after limitation) depending on driver torque" CURVE 0x15D2BC AblGLKLuw 1 RIGHTSH10NP 0 1 FORMAT "%8.6"
 /begin AXIS_DESCR STD_AXIS mApplI_AbsDriverTorque_xdu16 TBTHIGH 6 0 25 FORMAT "%8.5" DEPOSIT ABSOLUTE /end AXIS_DESCR
/end CHARACTERISTIC
/begin CHARACTERISTIC xActRet_RetTorqueFactDepOnDriver_XAU16_29___A "factor of active return motor torque (after limitation) depending on driver torque" CURVE 0x15D2D8 AblGLKLuw 1 RIGHTSH10NP 0 1 FORMAT "%8.6"
 /begin AXIS_DESCR STD_AXIS mApplI_AbsDriverTorque_xdu16 TBTHIGH 6 0 25 FORMAT "%8.5" DEPOSIT ABSOLUTE /end AXIS_DESCR
/end CHARACTERISTIC
/begin CHARACTERISTIC xActRet_RetTorqueFactDepOnDriver_XAU16_30___A "factor of active return motor torque (after limitation) depending on driver torque" CURVE 0x15D2F4 AblGLKLuw 1 RIGHTSH10NP 0 1 FORMAT "%8.6"
 /begin AXIS_DESCR STD_AXIS mApplI_AbsDriverTorque_xdu16 TBTHIGH 6 0 25 FORMAT "%8.5" DEPOSIT ABSOLUTE /end AXIS_DESCR
/end CHARACTERISTIC
/begin CHARACTERISTIC xActRet_RetTorqueFactDepOnDriver_XAU16_31___A "factor of active return motor torque (after limitation) depending on driver torque" CURVE 0x15D310 AblGLKLuw 1 RIGHTSH10NP 0 1 FORMAT "%8.6"
 /begin AXIS_DESCR STD_AXIS mApplI_AbsDriverTorque_xdu16 TBTHIGH 6 0 25 FORMAT "%8.5" DEPOSIT ABSOLUTE /end AXIS_DESCR
/end CHARACTERISTIC
/begin CHARACTERISTIC xActRet_RetTorqueFactDepOnDriver_XAU16_32___A "factor of active return motor torque (after limitation) depending on driver torque" CURVE 0x15D32C AblGLKLuw 1 RIGHTSH10NP 0 1 FORMAT "%8.6"
 /begin AXIS_DESCR STD_AXIS mApplI_AbsDriverTorque_xdu16 TBTHIGH 6 0 25 FORMAT "%8.5" DEPOSIT ABSOLUTE /end AXIS_DESCR
/end CHARACTERISTIC
/begin CHARACTERISTIC xActRet_RetTorqueFactDepOnDriver_XAU16_33___A "factor of active return motor torque (after limitation) depending on driver torque" CURVE 0x15D348 AblGLKLuw 1 RIGHTSH10NP 0 1 FORMAT "%8.6"
 /begin AXIS_DESCR STD_AXIS mApplI_AbsDriverTorque_xdu16 TBTHIGH 6 0 25 FORMAT "%8.5" DEPOSIT ABSOLUTE /end AXIS_DESCR
/end CHARACTERISTIC
/begin CHARACTERISTIC xActRet_RetTorqueFactDepOnDriver_XAU16_34___A "factor of active return motor torque (after limitation) depending on driver torque" CURVE 0x15D364 AblGLKLuw 1 RIGHTSH10NP 0 1 FORMAT "%8.6"
 /begin AXIS_DESCR STD_AXIS mApplI_AbsDriverTorque_xdu16 TBTHIGH 6 0 25 FORMAT "%8.5" DEPOSIT ABSOLUTE /end AXIS_DESCR
/end CHARACTERISTIC
/begin CHARACTERISTIC xActRet_RetTorqueFactDepOnDriver_XAU16_35___A "factor of active return motor torque (after limitation) depending on driver torque" CURVE 0x15D380 AblGLKLuw 1 RIGHTSH10NP 0 1 FORMAT "%8.6"
 /begin AXIS_DESCR STD_AXIS mApplI_AbsDriverTorque_xdu16 TBTHIGH 6 0 25 FORMAT "%8.5" DEPOSIT ABSOLUTE /end AXIS_DESCR
/end CHARACTERISTIC
/begin CHARACTERISTIC xActRet_SteeringSpeedAmp_XDU16_00___A "active return control amplification [Nm * s / °]" VALUE 0x1581F8 AblGLKWuw 0.0200195 ARFACT 0 0.02001953 FORMAT "%10.8" /end CHARACTERISTIC
/begin CHARACTERISTIC xActRet_SteeringSpeedAmp_XDU16_01___A "active return control amplification [Nm * s / °]" VALUE 0x1581FA AblGLKWuw 0.0200195 ARFACT 0 0.02001953 FORMAT "%10.8" /end CHARACTERISTIC
/begin CHARACTERISTIC xActRet_SteeringSpeedAmp_XDU16_02___A "active return control amplification [Nm * s / °]" VALUE 0x1581FC AblGLKWuw 0.0200195 ARFACT 0 0.02001953 FORMAT "%10.8" /end CHARACTERISTIC
/begin CHARACTERISTIC xActRet_SteeringSpeedAmp_XDU16_03___A "active return control amplification [Nm * s / °]" VALUE 0x1581FE AblGLKWuw 0.0200195 ARFACT 0 0.02001953 FORMAT "%10.8" /end CHARACTERISTIC
/begin CHARACTERISTIC xActRet_SteeringSpeedAmp_XDU16_04___A "active return control amplification [Nm * s / °]" VALUE 0x158200 AblGLKWuw 0.0200195 ARFACT 0 0.02001953 FORMAT "%10.8" /end CHARACTERISTIC
/begin CHARACTERISTIC xActRet_SteeringSpeedAmp_XDU16_05___A "active return control amplification [Nm * s / °]" VALUE 0x158202 AblGLKWuw 0.0200195 ARFACT 0 0.02001953 FORMAT "%10.8" /end CHARACTERISTIC
/begin CHARACTERISTIC xActRet_SteeringSpeedAmp_XDU16_06___A "active return control amplification [Nm * s / °]" VALUE 0x158204 AblGLKWuw 0.0200195 ARFACT 0 0.02001953 FORMAT "%10.8" /end CHARACTERISTIC
/begin CHARACTERISTIC xActRet_SteeringSpeedAmp_XDU16_07___A "active return control amplification [Nm * s / °]" VALUE 0x158206 AblGLKWuw 0.0200195 ARFACT 0 0.02001953 FORMAT "%10.8" /end CHARACTERISTIC
/begin CHARACTERISTIC xActRet_SteeringSpeedAmp_XDU16_08___A "active return control amplification [Nm * s / °]" VALUE 0x158208 AblGLKWuw 0.0200195 ARFACT 0 0.02001953 FORMAT "%10.8" /end CHARACTERISTIC
/begin CHARACTERISTIC xActRet_SteeringSpeedAmp_XDU16_09___A "active return control amplification [Nm * s / °]" VALUE 0x15820A AblGLKWuw 0.0200195 ARFACT 0 0.02001953 FORMAT "%10.8" /end CHARACTERISTIC
/begin CHARACTERISTIC xActRet_SteeringSpeedAmp_XDU16_10___A "active return control amplification [Nm * s / °]" VALUE 0x15820C AblGLKWuw 0.0200195 ARFACT 0 0.02001953 FORMAT "%10.8" /end CHARACTERISTIC
/begin CHARACTERISTIC xActRet_SteeringSpeedAmp_XDU16_11___A "active return control amplification [Nm * s / °]" VALUE 0x15820E AblGLKWuw 0.0200195 ARFACT 0 0.02001953 FORMAT "%10.8" /end CHARACTERISTIC
/begin CHARACTERISTIC xActRet_SteeringSpeedAmp_XDU16_12___A "active return control amplification [Nm * s / °]" VALUE 0x158210 AblGLKWuw 0.0200195 ARFACT 0 0.02001953 FORMAT "%10.8" /end CHARACTERISTIC
/begin CHARACTERISTIC xActRet_SteeringSpeedAmp_XDU16_13___A "active return control amplification [Nm * s / °]" VALUE 0x158212 AblGLKWuw 0.0200195 ARFACT 0 0.02001953 FORMAT "%10.8" /end CHARACTERISTIC
/begin CHARACTERISTIC xActRet_SteeringSpeedAmp_XDU16_14___A "active return control amplification [Nm * s / °]" VALUE 0x158214 AblGLKWuw 0.0200195 ARFACT 0 0.02001953 FORMAT "%10.8" /end CHARACTERISTIC
/begin CHARACTERISTIC xActRet_SteeringSpeedAmp_XDU16_15___A "active return control amplification [Nm * s / °]" VALUE 0x158216 AblGLKWuw 0.0200195 ARFACT 0 0.02001953 FORMAT "%10.8" /end CHARACTERISTIC
/begin CHARACTERISTIC xActRet_SteeringSpeedAmp_XDU16_16___A "active return control amplification [Nm * s / °]" VALUE 0x158218 AblGLKWuw 0.0200195 ARFACT 0 0.02001953 FORMAT "%10.8" /end CHARACTERISTIC
/begin CHARACTERISTIC xActRet_SteeringSpeedAmp_XDU16_17___A "active return control amplification [Nm * s / °]" VALUE 0x15821A AblGLKWuw 0.0200195 ARFACT 0 0.02001953 FORMAT "%10.8" /end CHARACTERISTIC
/begin CHARACTERISTIC xActRet_SteeringSpeedAmp_XDU16_18___A "active return control amplification [Nm * s / °]" VALUE 0x15821C AblGLKWuw 0.0200195 ARFACT 0 0.02001953 FORMAT "%10.8" /end CHARACTERISTIC
/begin CHARACTERISTIC xActRet_SteeringSpeedAmp_XDU16_19___A "active return control amplification [Nm * s / °]" VALUE 0x15821E AblGLKWuw 0.0200195 ARFACT 0 0.02001953 FORMAT "%10.8" /end CHARACTERISTIC
/begin CHARACTERISTIC xActRet_SteeringSpeedAmp_XDU16_20___A "active return control amplification [Nm * s / °]" VALUE 0x158220 AblGLKWuw 0.0200195 ARFACT 0 0.02001953 FORMAT "%10.8" /end CHARACTERISTIC
/begin CHARACTERISTIC xActRet_SteeringSpeedAmp_XDU16_21___A "active return control amplification [Nm * s / °]" VALUE 0x158222 AblGLKWuw 0.0200195 ARFACT 0 0.02001953 FORMAT "%10.8" /end CHARACTERISTIC
/begin CHARACTERISTIC xActRet_SteeringSpeedAmp_XDU16_22___A "active return control amplification [Nm * s / °]" VALUE 0x158224 AblGLKWuw 0.0200195 ARFACT 0 0.02001953 FORMAT "%10.8" /end CHARACTERISTIC
/begin CHARACTERISTIC xActRet_SteeringSpeedAmp_XDU16_23___A "active return control amplification [Nm * s / °]" VALUE 0x158226 AblGLKWuw 0.0200195 ARFACT 0 0.02001953 FORMAT "%10.8" /end CHARACTERISTIC
/begin CHARACTERISTIC xActRet_SteeringSpeedAmp_XDU16_24___A "active return control amplification [Nm * s / °]" VALUE 0x158228 AblGLKWuw 0.0200195 ARFACT 0 0.02001953 FORMAT "%10.8" /end CHARACTERISTIC
/begin CHARACTERISTIC xActRet_SteeringSpeedAmp_XDU16_25___A "active return control amplification [Nm * s / °]" VALUE 0x15822A AblGLKWuw 0.0200195 ARFACT 0 0.02001953 FORMAT "%10.8" /end CHARACTERISTIC
/begin CHARACTERISTIC xActRet_SteeringSpeedAmp_XDU16_26___A "active return control amplification [Nm * s / °]" VALUE 0x15822C AblGLKWuw 0.0200195 ARFACT 0 0.02001953 FORMAT "%10.8" /end CHARACTERISTIC
/begin CHARACTERISTIC xActRet_SteeringSpeedAmp_XDU16_27___A "active return control amplification [Nm * s / °]" VALUE 0x15822E AblGLKWuw 0.0200195 ARFACT 0 0.02001953 FORMAT "%10.8" /end CHARACTERISTIC
/begin CHARACTERISTIC xActRet_SteeringSpeedAmp_XDU16_28___A "active return control amplification [Nm * s / °]" VALUE 0x158230 AblGLKWuw 0.0200195 ARFACT 0 0.02001953 FORMAT "%10.8" /end CHARACTERISTIC
/begin CHARACTERISTIC xActRet_SteeringSpeedAmp_XDU16_29___A "active return control amplification [Nm * s / °]" VALUE 0x158232 AblGLKWuw 0.0200195 ARFACT 0 0.02001953 FORMAT "%10.8" /end CHARACTERISTIC
/begin CHARACTERISTIC xActRet_SteeringSpeedAmp_XDU16_30___A "active return control amplification [Nm * s / °]" VALUE 0x158234 AblGLKWuw 0.0200195 ARFACT 0 0.02001953 FORMAT "%10.8" /end CHARACTERISTIC
/begin CHARACTERISTIC xActRet_SteeringSpeedAmp_XDU16_31___A "active return control amplification [Nm * s / °]" VALUE 0x158236 AblGLKWuw 0.0200195 ARFACT 0 0.02001953 FORMAT "%10.8" /end CHARACTERISTIC
/begin CHARACTERISTIC xActRet_SteeringSpeedAmp_XDU16_32___A "active return control amplification [Nm * s / °]" VALUE 0x158238 AblGLKWuw 0.0200195 ARFACT 0 0.02001953 FORMAT "%10.8" /end CHARACTERISTIC
/begin CHARACTERISTIC xActRet_SteeringSpeedAmp_XDU16_33___A "active return control amplification [Nm * s / °]" VALUE 0x15823A AblGLKWuw 0.0200195 ARFACT 0 0.02001953 FORMAT "%10.8" /end CHARACTERISTIC
/begin CHARACTERISTIC xActRet_SteeringSpeedAmp_XDU16_34___A "active return control amplification [Nm * s / °]" VALUE 0x15823C AblGLKWuw 0.0200195 ARFACT 0 0.02001953 FORMAT "%10.8" /end CHARACTERISTIC
/begin CHARACTERISTIC xActRet_SteeringSpeedAmp_XDU16_35___A "active return control amplification [Nm * s / °]" VALUE 0x15823E AblGLKWuw 0.0200195 ARFACT 0 0.02001953 FORMAT "%10.8" /end CHARACTERISTIC
/begin CHARACTERISTIC xActRet_SteeringSpeedFact_XDU8_00___A "factor of nominal steering speed" VALUE 0x158562 AblGLKWub 1.5 RIGHTSH7NP 0 1.5 FORMAT "%5.3" /end CHARACTERISTIC
/begin CHARACTERISTIC xActRet_SteeringSpeedFact_XDU8_01___A "factor of nominal steering speed" VALUE 0x158563 AblGLKWub 1.5 RIGHTSH7NP 0 1.5 FORMAT "%5.3" /end CHARACTERISTIC
/begin CHARACTERISTIC xActRet_SteeringSpeedFact_XDU8_02___A "factor of nominal steering speed" VALUE 0x158564 AblGLKWub 1.5 RIGHTSH7NP 0 1.5 FORMAT "%5.3" /end CHARACTERISTIC
/begin CHARACTERISTIC xActRet_SteeringSpeedFact_XDU8_03___A "factor of nominal steering speed" VALUE 0x158565 AblGLKWub 1.5 RIGHTSH7NP 0 1.5 FORMAT "%5.3" /end CHARACTERISTIC
/begin CHARACTERISTIC xActRet_SteeringSpeedFact_XDU8_04___A "factor of nominal steering speed" VALUE 0x158566 AblGLKWub 1.5 RIGHTSH7NP 0 1.5 FORMAT "%5.3" /end CHARACTERISTIC
/begin CHARACTERISTIC xActRet_SteeringSpeedFact_XDU8_05___A "factor of nominal steering speed" VALUE 0x158567 AblGLKWub 1.5 RIGHTSH7NP 0 1.5 FORMAT "%5.3" /end CHARACTERISTIC
/begin CHARACTERISTIC xActRet_SteeringSpeedFact_XDU8_06___A "factor of nominal steering speed" VALUE 0x158568 AblGLKWub 1.5 RIGHTSH7NP 0 1.5 FORMAT "%5.3" /end CHARACTERISTIC
/begin CHARACTERISTIC xActRet_SteeringSpeedFact_XDU8_07___A "factor of nominal steering speed" VALUE 0x158569 AblGLKWub 1.5 RIGHTSH7NP 0 1.5 FORMAT "%5.3" /end CHARACTERISTIC
/begin CHARACTERISTIC xActRet_SteeringSpeedFact_XDU8_08___A "factor of nominal steering speed" VALUE 0x15856A AblGLKWub 1.5 RIGHTSH7NP 0 1.5 FORMAT "%5.3" /end CHARACTERISTIC
/begin CHARACTERISTIC xActRet_SteeringSpeedFact_XDU8_09___A "factor of nominal steering speed" VALUE 0x15856B AblGLKWub 1.5 RIGHTSH7NP 0 1.5 FORMAT "%5.3" /end CHARACTERISTIC
/begin CHARACTERISTIC xActRet_SteeringSpeedFact_XDU8_10___A "factor of nominal steering speed" VALUE 0x15856C AblGLKWub 1.5 RIGHTSH7NP 0 1.5 FORMAT "%5.3" /end CHARACTERISTIC
/begin CHARACTERISTIC xActRet_SteeringSpeedFact_XDU8_11___A "factor of nominal steering speed" VALUE 0x15856D AblGLKWub 1.5 RIGHTSH7NP 0 1.5 FORMAT "%5.3" /end CHARACTERISTIC
/begin CHARACTERISTIC xActRet_SteeringSpeedFact_XDU8_12___A "factor of nominal steering speed" VALUE 0x15856E AblGLKWub 1.5 RIGHTSH7NP 0 1.5 FORMAT "%5.3" /end CHARACTERISTIC
/begin CHARACTERISTIC xActRet_SteeringSpeedFact_XDU8_13___A "factor of nominal steering speed" VALUE 0x15856F AblGLKWub 1.5 RIGHTSH7NP 0 1.5 FORMAT "%5.3" /end CHARACTERISTIC
/begin CHARACTERISTIC xActRet_SteeringSpeedFact_XDU8_14___A "factor of nominal steering speed" VALUE 0x158570 AblGLKWub 1.5 RIGHTSH7NP 0 1.5 FORMAT "%5.3" /end CHARACTERISTIC
/begin CHARACTERISTIC xActRet_SteeringSpeedFact_XDU8_15___A "factor of nominal steering speed" VALUE 0x158571 AblGLKWub 1.5 RIGHTSH7NP 0 1.5 FORMAT "%5.3" /end CHARACTERISTIC
/begin CHARACTERISTIC xActRet_SteeringSpeedFact_XDU8_16___A "factor of nominal steering speed" VALUE 0x158572 AblGLKWub 1.5 RIGHTSH7NP 0 1.5 FORMAT "%5.3" /end CHARACTERISTIC
/begin CHARACTERISTIC xActRet_SteeringSpeedFact_XDU8_17___A "factor of nominal steering speed" VALUE 0x158573 AblGLKWub 1.5 RIGHTSH7NP 0 1.5 FORMAT "%5.3" /end CHARACTERISTIC
/begin CHARACTERISTIC xActRet_SteeringSpeedFact_XDU8_18___A "factor of nominal steering speed" VALUE 0x158574 AblGLKWub 1.5 RIGHTSH7NP 0 1.5 FORMAT "%5.3" /end CHARACTERISTIC
/begin CHARACTERISTIC xActRet_SteeringSpeedFact_XDU8_19___A "factor of nominal steering speed" VALUE 0x158575 AblGLKWub 1.5 RIGHTSH7NP 0 1.5 FORMAT "%5.3" /end CHARACTERISTIC
/begin CHARACTERISTIC xActRet_SteeringSpeedFact_XDU8_20___A "factor of nominal steering speed" VALUE 0x158576 AblGLKWub 1.5 RIGHTSH7NP 0 1.5 FORMAT "%5.3" /end CHARACTERISTIC
/begin CHARACTERISTIC xActRet_SteeringSpeedFact_XDU8_21___A "factor of nominal steering speed" VALUE 0x158577 AblGLKWub 1.5 RIGHTSH7NP 0 1.5 FORMAT "%5.3" /end CHARACTERISTIC
/begin CHARACTERISTIC xActRet_SteeringSpeedFact_XDU8_22___A "factor of nominal steering speed" VALUE 0x158578 AblGLKWub 1.5 RIGHTSH7NP 0 1.5 FORMAT "%5.3" /end CHARACTERISTIC
/begin CHARACTERISTIC xActRet_SteeringSpeedFact_XDU8_23___A "factor of nominal steering speed" VALUE 0x158579 AblGLKWub 1.5 RIGHTSH7NP 0 1.5 FORMAT "%5.3" /end CHARACTERISTIC
/begin CHARACTERISTIC xActRet_SteeringSpeedFact_XDU8_24___A "factor of nominal steering speed" VALUE 0x15857A AblGLKWub 1.5 RIGHTSH7NP 0 1.5 FORMAT "%5.3" /end CHARACTERISTIC
/begin CHARACTERISTIC xActRet_SteeringSpeedFact_XDU8_25___A "factor of nominal steering speed" VALUE 0x15857B AblGLKWub 1.5 RIGHTSH7NP 0 1.5 FORMAT "%5.3" /end CHARACTERISTIC
/begin CHARACTERISTIC xActRet_SteeringSpeedFact_XDU8_26___A "factor of nominal steering speed" VALUE 0x15857C AblGLKWub 1.5 RIGHTSH7NP 0 1.5 FORMAT "%5.3" /end CHARACTERISTIC
/begin CHARACTERISTIC xActRet_SteeringSpeedFact_XDU8_27___A "factor of nominal steering speed" VALUE 0x15857D AblGLKWub 1.5 RIGHTSH7NP 0 1.5 FORMAT "%5.3" /end CHARACTERISTIC
/begin CHARACTERISTIC xActRet_SteeringSpeedFact_XDU8_28___A "factor of nominal steering speed" VALUE 0x15857E AblGLKWub 1.5 RIGHTSH7NP 0 1.5 FORMAT "%5.3" /end CHARACTERISTIC
/begin CHARACTERISTIC xActRet_SteeringSpeedFact_XDU8_29___A "factor of nominal steering speed" VALUE 0x15857F AblGLKWub 1.5 RIGHTSH7NP 0 1.5 FORMAT "%5.3" /end CHARACTERISTIC
/begin CHARACTERISTIC xActRet_SteeringSpeedFact_XDU8_30___A "factor of nominal steering speed" VALUE 0x158580 AblGLKWub 1.5 RIGHTSH7NP 0 1.5 FORMAT "%5.3" /end CHARACTERISTIC
/begin CHARACTERISTIC xActRet_SteeringSpeedFact_XDU8_31___A "factor of nominal steering speed" VALUE 0x158581 AblGLKWub 1.5 RIGHTSH7NP 0 1.5 FORMAT "%5.3" /end CHARACTERISTIC
/begin CHARACTERISTIC xActRet_SteeringSpeedFact_XDU8_32___A "factor of nominal steering speed" VALUE 0x158582 AblGLKWub 1.5 RIGHTSH7NP 0 1.5 FORMAT "%5.3" /end CHARACTERISTIC
/begin CHARACTERISTIC xActRet_SteeringSpeedFact_XDU8_33___A "factor of nominal steering speed" VALUE 0x158583 AblGLKWub 1.5 RIGHTSH7NP 0 1.5 FORMAT "%5.3" /end CHARACTERISTIC
/begin CHARACTERISTIC xActRet_SteeringSpeedFact_XDU8_34___A "factor of nominal steering speed" VALUE 0x158584 AblGLKWub 1.5 RIGHTSH7NP 0 1.5 FORMAT "%5.3" /end CHARACTERISTIC
/begin CHARACTERISTIC xActRet_SteeringSpeedFact_XDU8_35___A "factor of nominal steering speed" VALUE 0x158585 AblGLKWub 1.5 RIGHTSH7NP 0 1.5 FORMAT "%5.3" /end CHARACTERISTIC
/begin CHARACTERISTIC xActRet_SteerSpeedFactDepOnDriver_XAU16_00___A "factor of nominal steering speed depending on driver torque" CURVE 0x15D39C AblGLKLuw 1 RIGHTSH10NP 0 1 FORMAT "%8.6"
 /begin AXIS_DESCR STD_AXIS mApplI_AbsDriverTorque_xdu16 TBTHIGH 6 0 25 FORMAT "%8.5" DEPOSIT ABSOLUTE /end AXIS_DESCR
/end CHARACTERISTIC
/begin CHARACTERISTIC xActRet_SteerSpeedFactDepOnDriver_XAU16_01___A "factor of nominal steering speed depending on driver torque" CURVE 0x15D3B8 AblGLKLuw 1 RIGHTSH10NP 0 1 FORMAT "%8.6"
 /begin AXIS_DESCR STD_AXIS mApplI_AbsDriverTorque_xdu16 TBTHIGH 6 0 25 FORMAT "%8.5" DEPOSIT ABSOLUTE /end AXIS_DESCR
/end CHARACTERISTIC
/begin CHARACTERISTIC xActRet_SteerSpeedFactDepOnDriver_XAU16_02___A "factor of nominal steering speed depending on driver torque" CURVE 0x15D3D4 AblGLKLuw 1 RIGHTSH10NP 0 1 FORMAT "%8.6"
 /begin AXIS_DESCR STD_AXIS mApplI_AbsDriverTorque_xdu16 TBTHIGH 6 0 25 FORMAT "%8.5" DEPOSIT ABSOLUTE /end AXIS_DESCR
/end CHARACTERISTIC
/begin CHARACTERISTIC xActRet_SteerSpeedFactDepOnDriver_XAU16_03___A "factor of nominal steering speed depending on driver torque" CURVE 0x15D3F0 AblGLKLuw 1 RIGHTSH10NP 0 1 FORMAT "%8.6"
 /begin AXIS_DESCR STD_AXIS mApplI_AbsDriverTorque_xdu16 TBTHIGH 6 0 25 FORMAT "%8.5" DEPOSIT ABSOLUTE /end AXIS_DESCR
/end CHARACTERISTIC
/begin CHARACTERISTIC xActRet_SteerSpeedFactDepOnDriver_XAU16_04___A "factor of nominal steering speed depending on driver torque" CURVE 0x15D40C AblGLKLuw 1 RIGHTSH10NP 0 1 FORMAT "%8.6"
 /begin AXIS_DESCR STD_AXIS mApplI_AbsDriverTorque_xdu16 TBTHIGH 6 0 25 FORMAT "%8.5" DEPOSIT ABSOLUTE /end AXIS_DESCR
/end CHARACTERISTIC
/begin CHARACTERISTIC xActRet_SteerSpeedFactDepOnDriver_XAU16_05___A "factor of nominal steering speed depending on driver torque" CURVE 0x15D428 AblGLKLuw 1 RIGHTSH10NP 0 1 FORMAT "%8.6"
 /begin AXIS_DESCR STD_AXIS mApplI_AbsDriverTorque_xdu16 TBTHIGH 6 0 25 FORMAT "%8.5" DEPOSIT ABSOLUTE /end AXIS_DESCR
/end CHARACTERISTIC
/begin CHARACTERISTIC xActRet_SteerSpeedFactDepOnDriver_XAU16_06___A "factor of nominal steering speed depending on driver torque" CURVE 0x15D444 AblGLKLuw 1 RIGHTSH10NP 0 1 FORMAT "%8.6"
 /begin AXIS_DESCR STD_AXIS mApplI_AbsDriverTorque_xdu16 TBTHIGH 6 0 25 FORMAT "%8.5" DEPOSIT ABSOLUTE /end AXIS_DESCR
/end CHARACTERISTIC
/begin CHARACTERISTIC xActRet_SteerSpeedFactDepOnDriver_XAU16_07___A "factor of nominal steering speed depending on driver torque" CURVE 0x15D460 AblGLKLuw 1 RIGHTSH10NP 0 1 FORMAT "%8.6"
 /begin AXIS_DESCR STD_AXIS mApplI_AbsDriverTorque_xdu16 TBTHIGH 6 0 25 FORMAT "%8.5" DEPOSIT ABSOLUTE /end AXIS_DESCR
/end CHARACTERISTIC
/begin CHARACTERISTIC xActRet_SteerSpeedFactDepOnDriver_XAU16_08___A "factor of nominal steering speed depending on driver torque" CURVE 0x15D47C AblGLKLuw 1 RIGHTSH10NP 0 1 FORMAT "%8.6"
 /begin AXIS_DESCR STD_AXIS mApplI_AbsDriverTorque_xdu16 TBTHIGH 6 0 25 FORMAT "%8.5" DEPOSIT ABSOLUTE /end AXIS_DESCR
/end CHARACTERISTIC
/begin CHARACTERISTIC xActRet_SteerSpeedFactDepOnDriver_XAU16_09___A "factor of nominal steering speed depending on driver torque" CURVE 0x15D498 AblGLKLuw 1 RIGHTSH10NP 0 1 FORMAT "%8.6"
 /begin AXIS_DESCR STD_AXIS mApplI_AbsDriverTorque_xdu16 TBTHIGH 6 0 25 FORMAT "%8.5" DEPOSIT ABSOLUTE /end AXIS_DESCR
/end CHARACTERISTIC
/begin CHARACTERISTIC xActRet_SteerSpeedFactDepOnDriver_XAU16_10___A "factor of nominal steering speed depending on driver torque" CURVE 0x15D4B4 AblGLKLuw 1 RIGHTSH10NP 0 1 FORMAT "%8.6"
 /begin AXIS_DESCR STD_AXIS mApplI_AbsDriverTorque_xdu16 TBTHIGH 6 0 25 FORMAT "%8.5" DEPOSIT ABSOLUTE /end AXIS_DESCR
/end CHARACTERISTIC
/begin CHARACTERISTIC xActRet_SteerSpeedFactDepOnDriver_XAU16_11___A "factor of nominal steering speed depending on driver torque" CURVE 0x15D4D0 AblGLKLuw 1 RIGHTSH10NP 0 1 FORMAT "%8.6"
 /begin AXIS_DESCR STD_AXIS mApplI_AbsDriverTorque_xdu16 TBTHIGH 6 0 25 FORMAT "%8.5" DEPOSIT ABSOLUTE /end AXIS_DESCR
/end CHARACTERISTIC
/begin CHARACTERISTIC xActRet_SteerSpeedFactDepOnDriver_XAU16_12___A "factor of nominal steering speed depending on driver torque" CURVE 0x15D4EC AblGLKLuw 1 RIGHTSH10NP 0 1 FORMAT "%8.6"
 /begin AXIS_DESCR STD_AXIS mApplI_AbsDriverTorque_xdu16 TBTHIGH 6 0 25 FORMAT "%8.5" DEPOSIT ABSOLUTE /end AXIS_DESCR
/end CHARACTERISTIC
/begin CHARACTERISTIC xActRet_SteerSpeedFactDepOnDriver_XAU16_13___A "factor of nominal steering speed depending on driver torque" CURVE 0x15D508 AblGLKLuw 1 RIGHTSH10NP 0 1 FORMAT "%8.6"
 /begin AXIS_DESCR STD_AXIS mApplI_AbsDriverTorque_xdu16 TBTHIGH 6 0 25 FORMAT "%8.5" DEPOSIT ABSOLUTE /end AXIS_DESCR
/end CHARACTERISTIC
/begin CHARACTERISTIC xActRet_SteerSpeedFactDepOnDriver_XAU16_14___A "factor of nominal steering speed depending on driver torque" CURVE 0x15D524 AblGLKLuw 1 RIGHTSH10NP 0 1 FORMAT "%8.6"
 /begin AXIS_DESCR STD_AXIS mApplI_AbsDriverTorque_xdu16 TBTHIGH 6 0 25 FORMAT "%8.5" DEPOSIT ABSOLUTE /end AXIS_DESCR
/end CHARACTERISTIC
/begin CHARACTERISTIC xActRet_SteerSpeedFactDepOnDriver_XAU16_15___A "factor of nominal steering speed depending on driver torque" CURVE 0x15D540 AblGLKLuw 1 RIGHTSH10NP 0 1 FORMAT "%8.6"
 /begin AXIS_DESCR STD_AXIS mApplI_AbsDriverTorque_xdu16 TBTHIGH 6 0 25 FORMAT "%8.5" DEPOSIT ABSOLUTE /end AXIS_DESCR
/end CHARACTERISTIC
/begin CHARACTERISTIC xActRet_SteerSpeedFactDepOnDriver_XAU16_16___A "factor of nominal steering speed depending on driver torque" CURVE 0x15D55C AblGLKLuw 1 RIGHTSH10NP 0 1 FORMAT "%8.6"
 /begin AXIS_DESCR STD_AXIS mApplI_AbsDriverTorque_xdu16 TBTHIGH 6 0 25 FORMAT "%8.5" DEPOSIT ABSOLUTE /end AXIS_DESCR
/end CHARACTERISTIC
/begin CHARACTERISTIC xActRet_SteerSpeedFactDepOnDriver_XAU16_17___A "factor of nominal steering speed depending on driver torque" CURVE 0x15D578 AblGLKLuw 1 RIGHTSH10NP 0 1 FORMAT "%8.6"
 /begin AXIS_DESCR STD_AXIS mApplI_AbsDriverTorque_xdu16 TBTHIGH 6 0 25 FORMAT "%8.5" DEPOSIT ABSOLUTE /end AXIS_DESCR
/end CHARACTERISTIC
/begin CHARACTERISTIC xActRet_SteerSpeedFactDepOnDriver_XAU16_18___A "factor of nominal steering speed depending on driver torque" CURVE 0x15D594 AblGLKLuw 1 RIGHTSH10NP 0 1 FORMAT "%8.6"
 /begin AXIS_DESCR STD_AXIS mApplI_AbsDriverTorque_xdu16 TBTHIGH 6 0 25 FORMAT "%8.5" DEPOSIT ABSOLUTE /end AXIS_DESCR
/end CHARACTERISTIC
/begin CHARACTERISTIC xActRet_SteerSpeedFactDepOnDriver_XAU16_19___A "factor of nominal steering speed depending on driver torque" CURVE 0x15D5B0 AblGLKLuw 1 RIGHTSH10NP 0 1 FORMAT "%8.6"
 /begin AXIS_DESCR STD_AXIS mApplI_AbsDriverTorque_xdu16 TBTHIGH 6 0 25 FORMAT "%8.5" DEPOSIT ABSOLUTE /end AXIS_DESCR
/end CHARACTERISTIC
/begin CHARACTERISTIC xActRet_SteerSpeedFactDepOnDriver_XAU16_20___A "factor of nominal steering speed depending on driver torque" CURVE 0x15D5CC AblGLKLuw 1 RIGHTSH10NP 0 1 FORMAT "%8.6"
 /begin AXIS_DESCR STD_AXIS mApplI_AbsDriverTorque_xdu16 TBTHIGH 6 0 25 FORMAT "%8.5" DEPOSIT ABSOLUTE /end AXIS_DESCR
/end CHARACTERISTIC
/begin CHARACTERISTIC xActRet_SteerSpeedFactDepOnDriver_XAU16_21___A "factor of nominal steering speed depending on driver torque" CURVE 0x15D5E8 AblGLKLuw 1 RIGHTSH10NP 0 1 FORMAT "%8.6"
 /begin AXIS_DESCR STD_AXIS mApplI_AbsDriverTorque_xdu16 TBTHIGH 6 0 25 FORMAT "%8.5" DEPOSIT ABSOLUTE /end AXIS_DESCR
/end CHARACTERISTIC
/begin CHARACTERISTIC xActRet_SteerSpeedFactDepOnDriver_XAU16_22___A "factor of nominal steering speed depending on driver torque" CURVE 0x15D604 AblGLKLuw 1 RIGHTSH10NP 0 1 FORMAT "%8.6"
 /begin AXIS_DESCR STD_AXIS mApplI_AbsDriverTorque_xdu16 TBTHIGH 6 0 25 FORMAT "%8.5" DEPOSIT ABSOLUTE /end AXIS_DESCR
/end CHARACTERISTIC
/begin CHARACTERISTIC xActRet_SteerSpeedFactDepOnDriver_XAU16_23___A "factor of nominal steering speed depending on driver torque" CURVE 0x15D620 AblGLKLuw 1 RIGHTSH10NP 0 1 FORMAT "%8.6"
 /begin AXIS_DESCR STD_AXIS mApplI_AbsDriverTorque_xdu16 TBTHIGH 6 0 25 FORMAT "%8.5" DEPOSIT ABSOLUTE /end AXIS_DESCR
/end CHARACTERISTIC
/begin CHARACTERISTIC xActRet_SteerSpeedFactDepOnDriver_XAU16_24___A "factor of nominal steering speed depending on driver torque" CURVE 0x15D63C AblGLKLuw 1 RIGHTSH10NP 0 1 FORMAT "%8.6"
 /begin AXIS_DESCR STD_AXIS mApplI_AbsDriverTorque_xdu16 TBTHIGH 6 0 25 FORMAT "%8.5" DEPOSIT ABSOLUTE /end AXIS_DESCR
/end CHARACTERISTIC
/begin CHARACTERISTIC xActRet_SteerSpeedFactDepOnDriver_XAU16_25___A "factor of nominal steering speed depending on driver torque" CURVE 0x15D658 AblGLKLuw 1 RIGHTSH10NP 0 1 FORMAT "%8.6"
 /begin AXIS_DESCR STD_AXIS mApplI_AbsDriverTorque_xdu16 TBTHIGH 6 0 25 FORMAT "%8.5" DEPOSIT ABSOLUTE /end AXIS_DESCR
/end CHARACTERISTIC
/begin CHARACTERISTIC xActRet_SteerSpeedFactDepOnDriver_XAU16_26___A "factor of nominal steering speed depending on driver torque" CURVE 0x15D674 AblGLKLuw 1 RIGHTSH10NP 0 1 FORMAT "%8.6"
 /begin AXIS_DESCR STD_AXIS mApplI_AbsDriverTorque_xdu16 TBTHIGH 6 0 25 FORMAT "%8.5" DEPOSIT ABSOLUTE /end AXIS_DESCR
/end CHARACTERISTIC
/begin CHARACTERISTIC xActRet_SteerSpeedFactDepOnDriver_XAU16_27___A "factor of nominal steering speed depending on driver torque" CURVE 0x15D690 AblGLKLuw 1 RIGHTSH10NP 0 1 FORMAT "%8.6"
 /begin AXIS_DESCR STD_AXIS mApplI_AbsDriverTorque_xdu16 TBTHIGH 6 0 25 FORMAT "%8.5" DEPOSIT ABSOLUTE /end AXIS_DESCR
/end CHARACTERISTIC
/begin CHARACTERISTIC xActRet_SteerSpeedFactDepOnDriver_XAU16_28___A "factor of nominal steering speed depending on driver torque" CURVE 0x15D6AC AblGLKLuw 1 RIGHTSH10NP 0 1 FORMAT "%8.6"
 /begin AXIS_DESCR STD_AXIS mApplI_AbsDriverTorque_xdu16 TBTHIGH 6 0 25 FORMAT "%8.5" DEPOSIT ABSOLUTE /end AXIS_DESCR
/end CHARACTERISTIC
/begin CHARACTERISTIC xActRet_SteerSpeedFactDepOnDriver_XAU16_29___A "factor of nominal steering speed depending on driver torque" CURVE 0x15D6C8 AblGLKLuw 1 RIGHTSH10NP 0 1 FORMAT "%8.6"
 /begin AXIS_DESCR STD_AXIS mApplI_AbsDriverTorque_xdu16 TBTHIGH 6 0 25 FORMAT "%8.5" DEPOSIT ABSOLUTE /end AXIS_DESCR
/end CHARACTERISTIC
/begin CHARACTERISTIC xActRet_SteerSpeedFactDepOnDriver_XAU16_30___A "factor of nominal steering speed depending on driver torque" CURVE 0x15D6E4 AblGLKLuw 1 RIGHTSH10NP 0 1 FORMAT "%8.6"
 /begin AXIS_DESCR STD_AXIS mApplI_AbsDriverTorque_xdu16 TBTHIGH 6 0 25 FORMAT "%8.5" DEPOSIT ABSOLUTE /end AXIS_DESCR
/end CHARACTERISTIC
/begin CHARACTERISTIC xActRet_SteerSpeedFactDepOnDriver_XAU16_31___A "factor of nominal steering speed depending on driver torque" CURVE 0x15D700 AblGLKLuw 1 RIGHTSH10NP 0 1 FORMAT "%8.6"
 /begin AXIS_DESCR STD_AXIS mApplI_AbsDriverTorque_xdu16 TBTHIGH 6 0 25 FORMAT "%8.5" DEPOSIT ABSOLUTE /end AXIS_DESCR
/end CHARACTERISTIC
/begin CHARACTERISTIC xActRet_SteerSpeedFactDepOnDriver_XAU16_32___A "factor of nominal steering speed depending on driver torque" CURVE 0x15D71C AblGLKLuw 1 RIGHTSH10NP 0 1 FORMAT "%8.6"
 /begin AXIS_DESCR STD_AXIS mApplI_AbsDriverTorque_xdu16 TBTHIGH 6 0 25 FORMAT "%8.5" DEPOSIT ABSOLUTE /end AXIS_DESCR
/end CHARACTERISTIC
/begin CHARACTERISTIC xActRet_SteerSpeedFactDepOnDriver_XAU16_33___A "factor of nominal steering speed depending on driver torque" CURVE 0x15D738 AblGLKLuw 1 RIGHTSH10NP 0 1 FORMAT "%8.6"
 /begin AXIS_DESCR STD_AXIS mApplI_AbsDriverTorque_xdu16 TBTHIGH 6 0 25 FORMAT "%8.5" DEPOSIT ABSOLUTE /end AXIS_DESCR
/end CHARACTERISTIC
/begin CHARACTERISTIC xActRet_SteerSpeedFactDepOnDriver_XAU16_34___A "factor of nominal steering speed depending on driver torque" CURVE 0x15D754 AblGLKLuw 1 RIGHTSH10NP 0 1 FORMAT "%8.6"
 /begin AXIS_DESCR STD_AXIS mApplI_AbsDriverTorque_xdu16 TBTHIGH 6 0 25 FORMAT "%8.5" DEPOSIT ABSOLUTE /end AXIS_DESCR
/end CHARACTERISTIC
/begin CHARACTERISTIC xActRet_SteerSpeedFactDepOnDriver_XAU16_35___A "factor of nominal steering speed depending on driver torque" CURVE 0x15D770 AblGLKLuw 1 RIGHTSH10NP 0 1 FORMAT "%8.6"
 /begin AXIS_DESCR STD_AXIS mApplI_AbsDriverTorque_xdu16 TBTHIGH 6 0 25 FORMAT "%8.5" DEPOSIT ABSOLUTE /end AXIS_DESCR
/end CHARACTERISTIC
/begin CHARACTERISTIC xActRet_SteerSpeedGradAfterInvalid_XDU16 "Gradient für einrampen nachdem Eingänge wieder gültig sind" VALUE 0x150948 AblGLKWuw 1 RIGHTSH15NP 0 1 FORMAT "%8.6" /end CHARACTERISTIC
/begin CHARACTERISTIC xAhaDet_FiltFactPT1YR_XDU16 "Filter Faktor des PT1-Filters der Gierrate; 1-kein Filtern, 0 - max.Filtern" VALUE 0x15094A AblGLKWuw 1 RIGHTSH10NP 0 1 FORMAT "%8.6" /end CHARACTERISTIC
/begin CHARACTERISTIC xAhaDet_LowerRatioLimitAhead_XDU16 "unterer Grenzwert des Raddrehzahlverhältnisses für Geradeausfahrt" VALUE 0x15094C AblGLKWuw 2 RIGHTSH10NP 0 2 FORMAT "%8.6" /end CHARACTERISTIC
/begin CHARACTERISTIC xAhaDet_MaxRatioGradient_XDU16 "max. Änderung des Radgeschwindigkeitsquotienten für Ahead-Erkennung" VALUE 0x15094E AblGLKWuw 16 RIGHTSH10NP 0 16 FORMAT "%8.5" /end CHARACTERISTIC
/begin CHARACTERISTIC xAhaDet_PedalMax_XDU16 "Maximale Gaspedalstellung" VALUE 0x150950 AblGLKWuw 1 RIGHTSH10NP 0 1 FORMAT "%8.6" /end CHARACTERISTIC
/begin CHARACTERISTIC xAhaDet_RatioLimitAhead_XDU16 "Grenzwert des Raddrehzahlverhältnisses für Geradeausfahrt" VALUE 0x150952 AblGLKWuw 2 RIGHTSH10NP 0 2 FORMAT "%8.6" /end CHARACTERISTIC
/begin CHARACTERISTIC xAhaDet_SlipLimit_XDU16 "Limit für den max. Schlupf zur Plausibilisierung" VALUE 0x150954 AblGLKWuw 2 RIGHTSH10NP 0 2 FORMAT "%8.6" /end CHARACTERISTIC
/begin MEASUREMENT fActRet_Disable_xdb "disable flag: in case of a detected error during the monitoring the disable flag is set" UWORD ZU0 1 100 0 1 BIT_MASK 0x1 FORMAT "%5.3" ECU_ADDRESS 0xFEBE983F /end MEASUREMENT
/begin MEASUREMENT mActDampI_MotorTorque_xds16 "motor torque of active damping component" SWORD MMOT 1 100 -2 2 FORMAT "%8.6" ECU_ADDRESS 0xFEBE9412 /end MEASUREMENT
/begin MEASUREMENT mActInI_NominalSteerTorque_xds16 "Sollhandlenkmoment aktive Trägheit" SWORD TBTHIGH 1 100 -10 10 FORMAT "%8.5" ECU_ADDRESS 0xFEBE9414 /end MEASUREMENT
/begin MEASUREMENT mActIn_MaxNominalSteerTorque_xdu16 "Maximal erlaubtes Handmoment aktive Trägheit" UWORD TBTHIGH 1 100 0 10 FORMAT "%8.5" ECU_ADDRESS 0xFEBE9416 /end MEASUREMENT
/begin MEASUREMENT mActRetI_MotorTorque_xds16 "motor torque of active return functionality" SWORD MMOT 1 100 -3 3 FORMAT "%8.6" ECU_ADDRESS 0xFEBE9418 /end MEASUREMENT
/begin MEASUREMENT mActRetI_MotTrq4Check_xds16 "motor torque of active return component for check" SWORD MMOT 1 100 -3 3 FORMAT "%8.6" ECU_ADDRESS 0xFEBE941A /end MEASUREMENT
/begin MEASUREMENT mActRet_MotTrqSaturated_xds16 "saturated motor torque" SWORD MMOT 1 100 -3 3 FORMAT "%8.6" ECU_ADDRESS 0xFEBE941C /end MEASUREMENT
/begin MEASUREMENT nActDamp_AbsRotorSpeedFilt_xdu16 "Absolutwert von RotorspeedFilt" UWORD VROT 1 100 0 13000 FORMAT "%3.0" ECU_ADDRESS 0xFEBE95BA /end MEASUREMENT
/begin MEASUREMENT sAhaDetI_AheadFromWheels_xdu8 "Flag: Geradeauslauf erkannt aus Raddrehzahlen" UBYTE ZU0 1 100 0 255 FORMAT "%5.1" ECU_ADDRESS 0xFEBE98FD /end MEASUREMENT
/begin MEASUREMENT sAhaDetI_AheadFromYaw_xdu8 "Flag: Geradeauslauf erkannt aus Drehstabmoment und Fahrzeuggeschwindigkeit (Gierrate etc)" UBYTE ZU0 1 100 0 255 FORMAT "%5.1" ECU_ADDRESS 0xFEBE98FE /end MEASUREMENT
/begin MEASUREMENT sAhaDetI_DetDemandWhlsSupp_xdu8 "Steuerflag aus Supp fuer ahead detection main: 0-Main decides, 1-force ahead, 2-inhibit ahead" UBYTE ZU0 1 100 0 2 FORMAT "%5.3" ECU_ADDRESS 0xFEBE98FF /end MEASUREMENT
/begin MEASUREMENT sAhaDetI_DetDemandYawSupp_xdu8 "Steuerflag aus Supp fuer ahead detection main: 0-Main decides, 1-force ahead, 2-inhibit ahead" UBYTE ZU0 1 100 0 2 FORMAT "%5.3" ECU_ADDRESS 0xFEBE9900 /end MEASUREMENT
/begin MEASUREMENT sAhaDet_AheadDetectionwhlStatus_xdu8 "Ahead detection debug status bits" UBYTE ZU0 1 100 0 255 FORMAT "%5.1" ECU_ADDRESS 0xFEBE9901 /end MEASUREMENT
/begin MEASUREMENT sApplI_EscBrakeState_xdu8 "Esc Brake State" UBYTE ZU0 1 100 0 255 FORMAT "%5.1" ECU_ADDRESS 0xFEBE9916 /end MEASUREMENT
/begin MEASUREMENT sApplI_ParkingBrakeState_xdu8 "Parkbremse betÃ¤tigt" UBYTE ZU0 1 100 0 255 FORMAT "%5.1" ECU_ADDRESS 0xFEBE9923 /end MEASUREMENT
/begin MEASUREMENT vActRet_ReturnSpeedDiff_xds16 "difference of steering speed controller" SWORD SAS_8 1 100 -1500 1500 FORMAT "%8.3" ECU_ADDRESS 0xFEBE9642 /end MEASUREMENT
/begin MEASUREMENT xActDamp_RateLimitedFactors_xdu16 "rate limited factor dependent on vehicle speed and steering angle" UWORD RIGHTSH10NP 1 100 0 3 FORMAT "%8.6" ECU_ADDRESS 0xFEBE9718 /end MEASUREMENT
/begin MEASUREMENT xActDamp_TotalDampingFactor_xdu16 "Total Damping factor dependent on vehicle speed, steering angle, driver Torque, ActiveDampingFactor" UWORD RIGHTSH10NP 1 100 0 6 FORMAT "%8.6" ECU_ADDRESS 0xFEBE971A /end MEASUREMENT
/begin MEASUREMENT xActIn_TorqueFact_xds16 "Faktor des nominellen Lenkmoments der aktiven Trägheit" SWORD RIGHTSH10NP 1 100 -10 10 FORMAT "%8.5" ECU_ADDRESS 0xFEBE971C /end MEASUREMENT
/begin MEASUREMENT xActRet_MotorTorqueGain_xdu16 "value of xActRet_MotorTorqueGain_XAU16" UWORD RIGHTSH10NP 1 100 0 3 FORMAT "%8.6" ECU_ADDRESS 0xFEBE971E /end MEASUREMENT
/begin MEASUREMENT xActRet_NomSteerSpdFrac_xdu16 "pre-looked up fraction used for the interpolation of axis1 (vehicle speed) of vActRet_NominalSteeringSpeed_XAU16" UWORD RIGHTSH16NP 1 100 0 0.9999847 FORMAT "%9.7" ECU_ADDRESS 0xFEBE9720 /end MEASUREMENT
/begin MEASUREMENT xActRet_SpeedFactorFilt_xds32 "filtrated active return steering speed factor" SLONG RIGHTSH20NP 1 100 0 1 FORMAT "%13.11" ECU_ADDRESS 0xFEBE9254 /end MEASUREMENT
/begin MEASUREMENT xActRet_TorqueFactorFilt_xds32 "filtrated active return motor torque factor due to driver torque" SLONG RIGHTSH20NP 1 100 0 1 FORMAT "%13.11" ECU_ADDRESS 0xFEBE9258 /end MEASUREMENT
/begin MEASUREMENT xApplI_AccelPedalPosition_xdu16 "Position des Gaspedals" UWORD RIGHTSH10NP 1 100 0 1 FORMAT "%8.6" ECU_ADDRESS 0xFEBE9722 /end MEASUREMENT
/begin MEASUREMENT yActRet_NomSteerSpdIdx_xdu8 "pre-looked up index used for the interpolation of axis1 (vehicle speed) of vActRet_NominalSteeringSpeed_XAU16" UBYTE ZU0 1 100 0 254 FORMAT "%5.1" ECU_ADDRESS 0xFEBE9A5E /end MEASUREMENT
/begin COMPU_METHOD AFZ "" RAT_FUNC "%6.5" "m/s^2" COEFFS 0 1024 0 0 0 1 /end COMPU_METHOD
/begin COMPU_METHOD ARFACT "" RAT_FUNC "%7.6" "Nm s / Â°" COEFFS 0 16384 0 0 0 1 /end COMPU_METHOD
/begin COMPU_METHOD MMOT "" RAT_FUNC "%6.5" "Nm" COEFFS 0 1024 0 0 0 1 /end COMPU_METHOD
/begin COMPU_METHOD MMOT_RSH6 "" RAT_FUNC "%6.4" "Nm" COEFFS 0 64 0 0 0 1 /end COMPU_METHOD
/begin COMPU_METHOD RIGHTSH10NP "" RAT_FUNC "%6.5" "" COEFFS 0 1024 0 0 0 1 /end COMPU_METHOD
/begin COMPU_METHOD RIGHTSH15NP "" RAT_FUNC "%7.6" "" COEFFS 0 32768 0 0 0 1 /end COMPU_METHOD
/begin COMPU_METHOD RIGHTSH16NP "" RAT_FUNC "%7.6" "" COEFFS 0 65536 0 0 0 1 /end COMPU_METHOD
/begin COMPU_METHOD RIGHTSH20NP "" RAT_FUNC "%9.8" "" COEFFS 0 1048576 0 0 0 1 /end COMPU_METHOD
/begin COMPU_METHOD RIGHTSH6NP "" RAT_FUNC "%6.4" "" COEFFS 0 64 0 0 0 1 /end COMPU_METHOD
/begin COMPU_METHOD RIGHTSH7NP "" RAT_FUNC "%6.4" "" COEFFS 0 128 0 0 0 1 /end COMPU_METHOD
/begin COMPU_METHOD SAS_8 "" RAT_FUNC "%6.3" "Â°/s" COEFFS 0 8 0 0 0 1 /end COMPU_METHOD
/begin COMPU_METHOD SA_10 "" RAT_FUNC "%6.3" "Â°" COEFFS 0 10 0 0 0 1 /end COMPU_METHOD
/begin COMPU_METHOD TBTHIGH "" RAT_FUNC "%6.5" "Nm" COEFFS 0 1024 0 0 0 1 /end COMPU_METHOD
/begin COMPU_METHOD TBT_RSH4 "" RAT_FUNC "%6.4" "Nm" COEFFS 0 16 0 0 0 1 /end COMPU_METHOD
/begin COMPU_METHOD TIMSEC "" RAT_FUNC "%6.4" "SEC" COEFFS 0 100 0 0 0 1 /end COMPU_METHOD
/begin COMPU_METHOD VFZHIGH "" RAT_FUNC "%6.4" "km/h" COEFFS 0 64 0 0 0 1 /end COMPU_METHOD
/begin COMPU_METHOD VGIER "" RAT_FUNC "%6.4" "Â°/s" COEFFS 0 200 0 0 0 1 /end COMPU_METHOD
/begin COMPU_METHOD VROT "" RAT_FUNC "%3.1" "1/min" COEFFS 0 1 0 0 0 1 /end COMPU_METHOD
/begin COMPU_METHOD ZU0 "" RAT_FUNC "%6.2" "" COEFFS 0 1 0 0 0 1 /end COMPU_METHOD
/begin FUNCTION ActiveDamping "Active Damping"
 /begin DEF_CHARACTERISTIC mActDamp_MaxMotorTorqueDepOnRotorSpeed_XAU16 xActDamp_FactorDepOnDriverTorque_XAU16_00___A xActDamp_FactorDepOnDriverTorque_XAU16_01___A xActDamp_FactorDepOnDriverTorque_XAU16_02___A xActDamp_FactorDepOnDriverTorque_XAU16_03___A xActDamp_FactorDepOnDriverTorque_XAU16_04___A xActDamp_FactorDepOnDriverTorque_XAU16_05___A xActDamp_FactorDepOnDriverTorque_XAU16_06___A xActDamp_FactorDepOnDriverTorque_XAU16_07___A xActDamp_FactorDepOnDriverTorque_XAU16_08___A xActDamp_FactorDepOnDriverTorque_XAU16_09___A xActDamp_FactorDepOnDriverTorque_XAU16_10___A xActDamp_FactorDepOnDriverTorque_XAU16_11___A xActDamp_FactorDepOnDriverTorque_XAU16_12___A xActDamp_FactorDepOnDriverTorque_XAU16_13___A xActDamp_FactorDepOnDriverTorque_XAU16_14___A xActDamp_FactorDepOnDriverTorque_XAU16_15___A xActDamp_FactorDepOnDriverTorque_XAU16_16___A xActDamp_FactorDepOnDriverTorque_XAU16_17___A xActDamp_FactorDepOnDriverTorque_XAU16_18___A xActDamp_FactorDepOnDriverTorque_XAU16_19___A xActDamp_FactorDepOnDriverTorque_XAU16_20___A xActDamp_FactorDepOnDriverTorque_XAU16_21___A xActDamp_FactorDepOnDriverTorque_XAU16_22___A xActDamp_FactorDepOnDriverTorque_XAU16_23___A xActDamp_FactorDepOnDriverTorque_XAU16_24___A xActDamp_FactorDepOnDriverTorque_XAU16_25___A xActDamp_FactorDepOnDriverTorque_XAU16_26___A xActDamp_FactorDepOnDriverTorque_XAU16_27___A xActDamp_FactorDepOnDriverTorque_XAU16_28___A xActDamp_FactorDepOnDriverTorque_XAU16_29___A xActDamp_FactorDepOnDriverTorque_XAU16_30___A xActDamp_FactorDepOnDriverTorque_XAU16_31___A xActDamp_FactorDepOnDriverTorque_XAU16_32___A xActDamp_FactorDepOnDriverTorque_XAU16_33___A xActDamp_FactorDepOnDriverTorque_XAU16_34___A xActDamp_FactorDepOnDriverTorque_XAU16_35___A xActDamp_FactorDepOnSteerAngle_XAU16_00___A xActDamp_FactorDepOnSteerAngle_XAU16_01___A xActDamp_FactorDepOnSteerAngle_XAU16_02___A xActDamp_FactorDepOnSteerAngle_XAU16_03___A xActDamp_FactorDepOnSteerAngle_XAU16_04___A xActDamp_FactorDepOnSteerAngle_XAU16_05___A xActDamp_FactorDepOnSteerAngle_XAU16_06___A xActDamp_FactorDepOnSteerAngle_XAU16_07___A xActDamp_FactorDepOnSteerAngle_XAU16_08___A xActDamp_FactorDepOnSteerAngle_XAU16_09___A xActDamp_FactorDepOnSteerAngle_XAU16_10___A xActDamp_FactorDepOnSteerAngle_XAU16_11___A xActDamp_FactorDepOnSteerAngle_XAU16_12___A xActDamp_FactorDepOnSteerAngle_XAU16_13___A xActDamp_FactorDepOnSteerAngle_XAU16_14___A xActDamp_FactorDepOnSteerAngle_XAU16_15___A xActDamp_FactorDepOnSteerAngle_XAU16_16___A xActDamp_FactorDepOnSteerAngle_XAU16_17___A xActDamp_FactorDepOnSteerAngle_XAU16_18___A xActDamp_FactorDepOnSteerAngle_XAU16_19___A xActDamp_FactorDepOnSteerAngle_XAU16_20___A xActDamp_FactorDepOnSteerAngle_XAU16_21___A xActDamp_FactorDepOnSteerAngle_XAU16_22___A xActDamp_FactorDepOnSteerAngle_XAU16_23___A xActDamp_FactorDepOnSteerAngle_XAU16_24___A xActDamp_FactorDepOnSteerAngle_XAU16_25___A xActDamp_FactorDepOnSteerAngle_XAU16_26___A xActDamp_FactorDepOnSteerAngle_XAU16_27___A xActDamp_FactorDepOnSteerAngle_XAU16_28___A xActDamp_FactorDepOnSteerAngle_XAU16_29___A xActDamp_FactorDepOnSteerAngle_XAU16_30___A xActDamp_FactorDepOnSteerAngle_XAU16_31___A xActDamp_FactorDepOnSteerAngle_XAU16_32___A xActDamp_FactorDepOnSteerAngle_XAU16_33___A xActDamp_FactorDepOnSteerAngle_XAU16_34___A xActDamp_FactorDepOnSteerAngle_XAU16_35___A xActDamp_FactorDepOnVehSpeed_XAU16_00___A xActDamp_FactorDepOnVehSpeed_XAU16_01___A xActDamp_FactorDepOnVehSpeed_XAU16_02___A xActDamp_FactorDepOnVehSpeed_XAU16_03___A xActDamp_FactorDepOnVehSpeed_XAU16_04___A xActDamp_FactorDepOnVehSpeed_XAU16_05___A xActDamp_FactorDepOnVehSpeed_XAU16_06___A xActDamp_FactorDepOnVehSpeed_XAU16_07___A xActDamp_FactorDepOnVehSpeed_XAU16_08___A xActDamp_FactorDepOnVehSpeed_XAU16_09___A xActDamp_FactorDepOnVehSpeed_XAU16_10___A xActDamp_FactorDepOnVehSpeed_XAU16_11___A xActDamp_FactorDepOnVehSpeed_XAU16_12___A xActDamp_FactorDepOnVehSpeed_XAU16_13___A xActDamp_FactorDepOnVehSpeed_XAU16_14___A xActDamp_FactorDepOnVehSpeed_XAU16_15___A xActDamp_FactorDepOnVehSpeed_XAU16_16___A xActDamp_FactorDepOnVehSpeed_XAU16_17___A xActDamp_FactorDepOnVehSpeed_XAU16_18___A xActDamp_FactorDepOnVehSpeed_XAU16_19___A xActDamp_FactorDepOnVehSpeed_XAU16_20___A xActDamp_FactorDepOnVehSpeed_XAU16_21___A xActDamp_FactorDepOnVehSpeed_XAU16_22___A xActDamp_FactorDepOnVehSpeed_XAU16_23___A xActDamp_FactorDepOnVehSpeed_XAU16_24___A xActDamp_FactorDepOnVehSpeed_XAU16_25___A xActDamp_FactorDepOnVehSpeed_XAU16_26___A xActDamp_FactorDepOnVehSpeed_XAU16_27___A xActDamp_FactorDepOnVehSpeed_XAU16_28___A xActDamp_FactorDepOnVehSpeed_XAU16_29___A xActDamp_FactorDepOnVehSpeed_XAU16_30___A xActDamp_FactorDepOnVehSpeed_XAU16_31___A xActDamp_FactorDepOnVehSpeed_XAU16_32___A xActDamp_FactorDepOnVehSpeed_XAU16_33___A xActDamp_FactorDepOnVehSpeed_XAU16_34___A xActDamp_FactorDepOnVehSpeed_XAU16_35___A xActDamp_FactorGrad_XDU16 xActDamp_TorqueDepOnRotorSpeed_XAU16_00___A xActDamp_TorqueDepOnRotorSpeed_XAU16_01___A xActDamp_TorqueDepOnRotorSpeed_XAU16_02___A xActDamp_TorqueDepOnRotorSpeed_XAU16_03___A xActDamp_TorqueDepOnRotorSpeed_XAU16_04___A xActDamp_TorqueDepOnRotorSpeed_XAU16_05___A xActDamp_TorqueDepOnRotorSpeed_XAU16_06___A xActDamp_TorqueDepOnRotorSpeed_XAU16_07___A xActDamp_TorqueDepOnRotorSpeed_XAU16_08___A xActDamp_TorqueDepOnRotorSpeed_XAU16_09___A xActDamp_TorqueDepOnRotorSpeed_XAU16_10___A xActDamp_TorqueDepOnRotorSpeed_XAU16_11___A xActDamp_TorqueDepOnRotorSpeed_XAU16_12___A xActDamp_TorqueDepOnRotorSpeed_XAU16_13___A xActDamp_TorqueDepOnRotorSpeed_XAU16_14___A xActDamp_TorqueDepOnRotorSpeed_XAU16_15___A xActDamp_TorqueDepOnRotorSpeed_XAU16_16___A xActDamp_TorqueDepOnRotorSpeed_XAU16_17___A xActDamp_TorqueDepOnRotorSpeed_XAU16_18___A xActDamp_TorqueDepOnRotorSpeed_XAU16_19___A xActDamp_TorqueDepOnRotorSpeed_XAU16_20___A xActDamp_TorqueDepOnRotorSpeed_XAU16_21___A xActDamp_TorqueDepOnRotorSpeed_XAU16_22___A xActDamp_TorqueDepOnRotorSpeed_XAU16_23___A xActDamp_TorqueDepOnRotorSpeed_XAU16_24___A xActDamp_TorqueDepOnRotorSpeed_XAU16_25___A xActDamp_TorqueDepOnRotorSpeed_XAU16_26___A xActDamp_TorqueDepOnRotorSpeed_XAU16_27___A xActDamp_TorqueDepOnRotorSpeed_XAU16_28___A xActDamp_TorqueDepOnRotorSpeed_XAU16_29___A xActDamp_TorqueDepOnRotorSpeed_XAU16_30___A xActDamp_TorqueDepOnRotorSpeed_XAU16_31___A xActDamp_TorqueDepOnRotorSpeed_XAU16_32___A xActDamp_TorqueDepOnRotorSpeed_XAU16_33___A xActDamp_TorqueDepOnRotorSpeed_XAU16_34___A xActDamp_TorqueDepOnRotorSpeed_XAU16_35___A /end DEF_CHARACTERISTIC
 /begin IN_MEASUREMENT mApplI_AbsDriverTorque_xdu16 vVehSpI_AbsAvgVehSpd_xdu16 wApplI_AbsSteeringAngle_xdu16 /end IN_MEASUREMENT
 /begin OUT_MEASUREMENT nActDamp_AbsRotorSpeedFilt_xdu16 xActDamp_RateLimitedFactors_xdu16 xActDamp_TotalDampingFactor_xdu16 /end OUT_MEASUREMENT
/end FUNCTION
/begin FUNCTION ActiveDampingInterface "Active Damping Interface" /begin OUT_MEASUREMENT mActDampI_MotorTorque_xds16 /end OUT_MEASUREMENT /end FUNCTION
/begin FUNCTION ActiveInertia_Nst "Active Inertia nominal steer torque"
 /begin DEF_CHARACTERISTIC mActIn_InertiaMax_XAU16 xActIn_InertiaFact_XAS16_00___A xActIn_InertiaFact_XAS16_01___A xActIn_InertiaFact_XAS16_02___A xActIn_InertiaFact_XAS16_03___A xActIn_InertiaFact_XAS16_04___A xActIn_InertiaFact_XAS16_05___A xActIn_InertiaFact_XAS16_06___A xActIn_InertiaFact_XAS16_07___A xActIn_InertiaFact_XAS16_08___A xActIn_InertiaFact_XAS16_09___A xActIn_InertiaFact_XAS16_10___A xActIn_InertiaFact_XAS16_11___A xActIn_InertiaFact_XAS16_12___A xActIn_InertiaFact_XAS16_13___A xActIn_InertiaFact_XAS16_14___A xActIn_InertiaFact_XAS16_15___A xActIn_InertiaFact_XAS16_16___A xActIn_InertiaFact_XAS16_17___A xActIn_InertiaFact_XAS16_18___A xActIn_InertiaFact_XAS16_19___A xActIn_InertiaFact_XAS16_20___A xActIn_InertiaFact_XAS16_21___A xActIn_InertiaFact_XAS16_22___A xActIn_InertiaFact_XAS16_23___A xActIn_InertiaFact_XAS16_24___A xActIn_InertiaFact_XAS16_25___A xActIn_InertiaFact_XAS16_26___A xActIn_InertiaFact_XAS16_27___A xActIn_InertiaFact_XAS16_28___A xActIn_InertiaFact_XAS16_29___A xActIn_InertiaFact_XAS16_30___A xActIn_InertiaFact_XAS16_31___A xActIn_InertiaFact_XAS16_32___A xActIn_InertiaFact_XAS16_33___A xActIn_InertiaFact_XAS16_34___A xActIn_InertiaFact_XAS16_35___A xActIn_InertiaTBT_XAU16_00___A xActIn_InertiaTBT_XAU16_01___A xActIn_InertiaTBT_XAU16_02___A xActIn_InertiaTBT_XAU16_03___A xActIn_InertiaTBT_XAU16_04___A xActIn_InertiaTBT_XAU16_05___A xActIn_InertiaTBT_XAU16_06___A xActIn_InertiaTBT_XAU16_07___A xActIn_InertiaTBT_XAU16_08___A xActIn_InertiaTBT_XAU16_09___A xActIn_InertiaTBT_XAU16_10___A xActIn_InertiaTBT_XAU16_11___A xActIn_InertiaTBT_XAU16_12___A xActIn_InertiaTBT_XAU16_13___A xActIn_InertiaTBT_XAU16_14___A xActIn_InertiaTBT_XAU16_15___A xActIn_InertiaTBT_XAU16_16___A xActIn_InertiaTBT_XAU16_17___A xActIn_InertiaTBT_XAU16_18___A xActIn_InertiaTBT_XAU16_19___A xActIn_InertiaTBT_XAU16_20___A xActIn_InertiaTBT_XAU16_21___A xActIn_InertiaTBT_XAU16_22___A xActIn_InertiaTBT_XAU16_23___A xActIn_InertiaTBT_XAU16_24___A xActIn_InertiaTBT_XAU16_25___A xActIn_InertiaTBT_XAU16_26___A xActIn_InertiaTBT_XAU16_27___A xActIn_InertiaTBT_XAU16_28___A xActIn_InertiaTBT_XAU16_29___A xActIn_InertiaTBT_XAU16_30___A xActIn_InertiaTBT_XAU16_31___A xActIn_InertiaTBT_XAU16_32___A xActIn_InertiaTBT_XAU16_33___A xActIn_InertiaTBT_XAU16_34___A xActIn_InertiaTBT_XAU16_35___A /end DEF_CHARACTERISTIC
 /begin IN_MEASUREMENT mApplI_AbsTorsionBarTorque_xdu16 vApplI_AbsVehicleSpeedFilt_xdu16 /end IN_MEASUREMENT
 /begin OUT_MEASUREMENT mActIn_MaxNominalSteerTorque_xdu16 xActIn_TorqueFact_xds16 /end OUT_MEASUREMENT
/end FUNCTION
/begin FUNCTION ActiveInertia_NstI "Aktiver Trägheit (nominelles Lenkmoment) - Interface" /begin OUT_MEASUREMENT mActInI_NominalSteerTorque_xds16 /end OUT_MEASUREMENT /end FUNCTION
/begin FUNCTION ActiveReturn "Active Return"
 /begin DEF_CHARACTERISTIC mActRet_MaxMotorTorque_XDU8 vActRet_NominalSteeringSpeed_XAU16_00___A vActRet_NominalSteeringSpeed_XAU16_01___A vActRet_NominalSteeringSpeed_XAU16_02___A vActRet_NominalSteeringSpeed_XAU16_03___A vActRet_NominalSteeringSpeed_XAU16_04___A vActRet_NominalSteeringSpeed_XAU16_05___A vActRet_NominalSteeringSpeed_XAU16_06___A vActRet_NominalSteeringSpeed_XAU16_07___A vActRet_NominalSteeringSpeed_XAU16_08___A vActRet_NominalSteeringSpeed_XAU16_09___A vActRet_NominalSteeringSpeed_XAU16_10___A vActRet_NominalSteeringSpeed_XAU16_11___A vActRet_NominalSteeringSpeed_XAU16_12___A vActRet_NominalSteeringSpeed_XAU16_13___A vActRet_NominalSteeringSpeed_XAU16_14___A vActRet_NominalSteeringSpeed_XAU16_15___A vActRet_NominalSteeringSpeed_XAU16_16___A vActRet_NominalSteeringSpeed_XAU16_17___A vActRet_NominalSteeringSpeed_XAU16_18___A vActRet_NominalSteeringSpeed_XAU16_19___A vActRet_NominalSteeringSpeed_XAU16_20___A vActRet_NominalSteeringSpeed_XAU16_21___A vActRet_NominalSteeringSpeed_XAU16_22___A vActRet_NominalSteeringSpeed_XAU16_23___A vActRet_NominalSteeringSpeed_XAU16_24___A vActRet_NominalSteeringSpeed_XAU16_25___A vActRet_NominalSteeringSpeed_XAU16_26___A vActRet_NominalSteeringSpeed_XAU16_27___A vActRet_NominalSteeringSpeed_XAU16_28___A vActRet_NominalSteeringSpeed_XAU16_29___A vActRet_NominalSteeringSpeed_XAU16_30___A vActRet_NominalSteeringSpeed_XAU16_31___A vActRet_NominalSteeringSpeed_XAU16_32___A vActRet_NominalSteeringSpeed_XAU16_33___A vActRet_NominalSteeringSpeed_XAU16_34___A vActRet_NominalSteeringSpeed_XAU16_35___A xActRet_FilterFactor_XDU16_00___A xActRet_FilterFactor_XDU16_01___A xActRet_FilterFactor_XDU16_02___A xActRet_FilterFactor_XDU16_03___A xActRet_FilterFactor_XDU16_04___A xActRet_FilterFactor_XDU16_05___A xActRet_FilterFactor_XDU16_06___A xActRet_FilterFactor_XDU16_07___A xActRet_FilterFactor_XDU16_08___A xActRet_FilterFactor_XDU16_09___A xActRet_FilterFactor_XDU16_10___A xActRet_FilterFactor_XDU16_11___A xActRet_FilterFactor_XDU16_12___A xActRet_FilterFactor_XDU16_13___A xActRet_FilterFactor_XDU16_14___A xActRet_FilterFactor_XDU16_15___A xActRet_FilterFactor_XDU16_16___A xActRet_FilterFactor_XDU16_17___A xActRet_FilterFactor_XDU16_18___A xActRet_FilterFactor_XDU16_19___A xActRet_FilterFactor_XDU16_20___A xActRet_FilterFactor_XDU16_21___A xActRet_FilterFactor_XDU16_22___A xActRet_FilterFactor_XDU16_23___A xActRet_FilterFactor_XDU16_24___A xActRet_FilterFactor_XDU16_25___A xActRet_FilterFactor_XDU16_26___A xActRet_FilterFactor_XDU16_27___A xActRet_FilterFactor_XDU16_28___A xActRet_FilterFactor_XDU16_29___A xActRet_FilterFactor_XDU16_30___A xActRet_FilterFactor_XDU16_31___A xActRet_FilterFactor_XDU16_32___A xActRet_FilterFactor_XDU16_33___A xActRet_FilterFactor_XDU16_34___A xActRet_FilterFactor_XDU16_35___A xActRet_MotorTorqueGain_XAU16_00___A xActRet_MotorTorqueGain_XAU16_01___A xActRet_MotorTorqueGain_XAU16_02___A xActRet_MotorTorqueGain_XAU16_03___A xActRet_MotorTorqueGain_XAU16_04___A xActRet_MotorTorqueGain_XAU16_05___A xActRet_MotorTorqueGain_XAU16_06___A xActRet_MotorTorqueGain_XAU16_07___A xActRet_MotorTorqueGain_XAU16_08___A xActRet_MotorTorqueGain_XAU16_09___A xActRet_MotorTorqueGain_XAU16_10___A xActRet_MotorTorqueGain_XAU16_11___A xActRet_MotorTorqueGain_XAU16_12___A xActRet_MotorTorqueGain_XAU16_13___A xActRet_MotorTorqueGain_XAU16_14___A xActRet_MotorTorqueGain_XAU16_15___A xActRet_MotorTorqueGain_XAU16_16___A xActRet_MotorTorqueGain_XAU16_17___A xActRet_MotorTorqueGain_XAU16_18___A xActRet_MotorTorqueGain_XAU16_19___A xActRet_MotorTorqueGain_XAU16_20___A xActRet_MotorTorqueGain_XAU16_21___A xActRet_MotorTorqueGain_XAU16_22___A xActRet_MotorTorqueGain_XAU16_23___A xActRet_MotorTorqueGain_XAU16_24___A xActRet_MotorTorqueGain_XAU16_25___A xActRet_MotorTorqueGain_XAU16_26___A xActRet_MotorTorqueGain_XAU16_27___A xActRet_MotorTorqueGain_XAU16_28___A xActRet_MotorTorqueGain_XAU16_29___A xActRet_MotorTorqueGain_XAU16_30___A xActRet_MotorTorqueGain_XAU16_31___A xActRet_MotorTorqueGain_XAU16_32___A xActRet_MotorTorqueGain_XAU16_33___A xActRet_MotorTorqueGain_XAU16_34___A xActRet_MotorTorqueGain_XAU16_35___A xActRet_RetTorqueFactDepOnDriver_XAU16_00___A xActRet_RetTorqueFactDepOnDriver_XAU16_01___A xActRet_RetTorqueFactDepOnDriver_XAU16_02___A xActRet_RetTorqueFactDepOnDriver_XAU16_03___A xActRet_RetTorqueFactDepOnDriver_XAU16_04___A xActRet_RetTorqueFactDepOnDriver_XAU16_05___A xActRet_RetTorqueFactDepOnDriver_XAU16_06___A xActRet_RetTorqueFactDepOnDriver_XAU16_07___A xActRet_RetTorqueFactDepOnDriver_XAU16_08___A xActRet_RetTorqueFactDepOnDriver_XAU16_09___A xActRet_RetTorqueFactDepOnDriver_XAU16_10___A xActRet_RetTorqueFactDepOnDriver_XAU16_11___A xActRet_RetTorqueFactDepOnDriver_XAU16_12___A xActRet_RetTorqueFactDepOnDriver_XAU16_13___A xActRet_RetTorqueFactDepOnDriver_XAU16_14___A xActRet_RetTorqueFactDepOnDriver_XAU16_15___A xActRet_RetTorqueFactDepOnDriver_XAU16_16___A xActRet_RetTorqueFactDepOnDriver_XAU16_17___A xActRet_RetTorqueFactDepOnDriver_XAU16_18___A xActRet_RetTorqueFactDepOnDriver_XAU16_19___A xActRet_RetTorqueFactDepOnDriver_XAU16_20___A xActRet_RetTorqueFactDepOnDriver_XAU16_21___A xActRet_RetTorqueFactDepOnDriver_XAU16_22___A xActRet_RetTorqueFactDepOnDriver_XAU16_23___A xActRet_RetTorqueFactDepOnDriver_XAU16_24___A xActRet_RetTorqueFactDepOnDriver_XAU16_25___A xActRet_RetTorqueFactDepOnDriver_XAU16_26___A xActRet_RetTorqueFactDepOnDriver_XAU16_27___A xActRet_RetTorqueFactDepOnDriver_XAU16_28___A xActRet_RetTorqueFactDepOnDriver_XAU16_29___A xActRet_RetTorqueFactDepOnDriver_XAU16_30___A xActRet_RetTorqueFactDepOnDriver_XAU16_31___A xActRet_RetTorqueFactDepOnDriver_XAU16_32___A xActRet_RetTorqueFactDepOnDriver_XAU16_33___A xActRet_RetTorqueFactDepOnDriver_XAU16_34___A xActRet_RetTorqueFactDepOnDriver_XAU16_35___A xActRet_SteeringSpeedAmp_XDU16_00___A xActRet_SteeringSpeedAmp_XDU16_01___A xActRet_SteeringSpeedAmp_XDU16_02___A xActRet_SteeringSpeedAmp_XDU16_03___A xActRet_SteeringSpeedAmp_XDU16_04___A xActRet_SteeringSpeedAmp_XDU16_05___A xActRet_SteeringSpeedAmp_XDU16_06___A xActRet_SteeringSpeedAmp_XDU16_07___A xActRet_SteeringSpeedAmp_XDU16_08___A xActRet_SteeringSpeedAmp_XDU16_09___A xActRet_SteeringSpeedAmp_XDU16_10___A xActRet_SteeringSpeedAmp_XDU16_11___A xActRet_SteeringSpeedAmp_XDU16_12___A xActRet_SteeringSpeedAmp_XDU16_13___A xActRet_SteeringSpeedAmp_XDU16_14___A xActRet_SteeringSpeedAmp_XDU16_15___A xActRet_SteeringSpeedAmp_XDU16_16___A xActRet_SteeringSpeedAmp_XDU16_17___A xActRet_SteeringSpeedAmp_XDU16_18___A xActRet_SteeringSpeedAmp_XDU16_19___A xActRet_SteeringSpeedAmp_XDU16_20___A xActRet_SteeringSpeedAmp_XDU16_21___A xActRet_SteeringSpeedAmp_XDU16_22___A xActRet_SteeringSpeedAmp_XDU16_23___A xActRet_SteeringSpeedAmp_XDU16_24___A xActRet_SteeringSpeedAmp_XDU16_25___A xActRet_SteeringSpeedAmp_XDU16_26___A xActRet_SteeringSpeedAmp_XDU16_27___A xActRet_SteeringSpeedAmp_XDU16_28___A xActRet_SteeringSpeedAmp_XDU16_29___A xActRet_SteeringSpeedAmp_XDU16_30___A xActRet_SteeringSpeedAmp_XDU16_31___A xActRet_SteeringSpeedAmp_XDU16_32___A xActRet_SteeringSpeedAmp_XDU16_33___A xActRet_SteeringSpeedAmp_XDU16_34___A xActRet_SteeringSpeedAmp_XDU16_35___A xActRet_SteeringSpeedFact_XDU8_00___A xActRet_SteeringSpeedFact_XDU8_01___A xActRet_SteeringSpeedFact_XDU8_02___A xActRet_SteeringSpeedFact_XDU8_03___A xActRet_SteeringSpeedFact_XDU8_04___A xActRet_SteeringSpeedFact_XDU8_05___A xActRet_SteeringSpeedFact_XDU8_06___A xActRet_SteeringSpeedFact_XDU8_07___A xActRet_SteeringSpeedFact_XDU8_08___A xActRet_SteeringSpeedFact_XDU8_09___A xActRet_SteeringSpeedFact_XDU8_10___A xActRet_SteeringSpeedFact_XDU8_11___A xActRet_SteeringSpeedFact_XDU8_12___A xActRet_SteeringSpeedFact_XDU8_13___A xActRet_SteeringSpeedFact_XDU8_14___A xActRet_SteeringSpeedFact_XDU8_15___A xActRet_SteeringSpeedFact_XDU8_16___A xActRet_SteeringSpeedFact_XDU8_17___A xActRet_SteeringSpeedFact_XDU8_18___A xActRet_SteeringSpeedFact_XDU8_19___A xActRet_SteeringSpeedFact_XDU8_20___A xActRet_SteeringSpeedFact_XDU8_21___A xActRet_SteeringSpeedFact_XDU8_22___A xActRet_SteeringSpeedFact_XDU8_23___A xActRet_SteeringSpeedFact_XDU8_24___A xActRet_SteeringSpeedFact_XDU8_25___A xActRet_SteeringSpeedFact_XDU8_26___A xActRet_SteeringSpeedFact_XDU8_27___A xActRet_SteeringSpeedFact_XDU8_28___A xActRet_SteeringSpeedFact_XDU8_29___A xActRet_SteeringSpeedFact_XDU8_30___A xActRet_SteeringSpeedFact_XDU8_31___A xActRet_SteeringSpeedFact_XDU8_32___A xActRet_SteeringSpeedFact_XDU8_33___A xActRet_SteeringSpeedFact_XDU8_34___A xActRet_SteeringSpeedFact_XDU8_35___A xActRet_SteerSpeedFactDepOnDriver_XAU16_00___A xActRet_SteerSpeedFactDepOnDriver_XAU16_01___A xActRet_SteerSpeedFactDepOnDriver_XAU16_02___A xActRet_SteerSpeedFactDepOnDriver_XAU16_03___A xActRet_SteerSpeedFactDepOnDriver_XAU16_04___A xActRet_SteerSpeedFactDepOnDriver_XAU16_05___A xActRet_SteerSpeedFactDepOnDriver_XAU16_06___A xActRet_SteerSpeedFactDepOnDriver_XAU16_07___A xActRet_SteerSpeedFactDepOnDriver_XAU16_08___A xActRet_SteerSpeedFactDepOnDriver_XAU16_09___A xActRet_SteerSpeedFactDepOnDriver_XAU16_10___A xActRet_SteerSpeedFactDepOnDriver_XAU16_11___A xActRet_SteerSpeedFactDepOnDriver_XAU16_12___A xActRet_SteerSpeedFactDepOnDriver_XAU16_13___A xActRet_SteerSpeedFactDepOnDriver_XAU16_14___A xActRet_SteerSpeedFactDepOnDriver_XAU16_15___A xActRet_SteerSpeedFactDepOnDriver_XAU16_16___A xActRet_SteerSpeedFactDepOnDriver_XAU16_17___A xActRet_SteerSpeedFactDepOnDriver_XAU16_18___A xActRet_SteerSpeedFactDepOnDriver_XAU16_19___A xActRet_SteerSpeedFactDepOnDriver_XAU16_20___A xActRet_SteerSpeedFactDepOnDriver_XAU16_21___A xActRet_SteerSpeedFactDepOnDriver_XAU16_22___A xActRet_SteerSpeedFactDepOnDriver_XAU16_23___A xActRet_SteerSpeedFactDepOnDriver_XAU16_24___A xActRet_SteerSpeedFactDepOnDriver_XAU16_25___A xActRet_SteerSpeedFactDepOnDriver_XAU16_26___A xActRet_SteerSpeedFactDepOnDriver_XAU16_27___A xActRet_SteerSpeedFactDepOnDriver_XAU16_28___A xActRet_SteerSpeedFactDepOnDriver_XAU16_29___A xActRet_SteerSpeedFactDepOnDriver_XAU16_30___A xActRet_SteerSpeedFactDepOnDriver_XAU16_31___A xActRet_SteerSpeedFactDepOnDriver_XAU16_32___A xActRet_SteerSpeedFactDepOnDriver_XAU16_33___A xActRet_SteerSpeedFactDepOnDriver_XAU16_34___A xActRet_SteerSpeedFactDepOnDriver_XAU16_35___A xActRet_SteerSpeedGradAfterInvalid_XDU16 /end DEF_CHARACTERISTIC
 /begin IN_MEASUREMENT mApplI_AbsDriverTorque_xdu16 vVehSpI_AbsAvgVehSpd_xdu16 wApplI_AbsSteeringAngle_xdu16 /end IN_MEASUREMENT
 /begin OUT_MEASUREMENT vActRet_ReturnSpeedDiff_xds16 xActRet_MotorTorqueGain_xdu16 xActRet_NomSteerSpdFrac_xdu16 xActRet_SpeedFactorFilt_xds32 xActRet_TorqueFactorFilt_xds32 yActRet_NomSteerSpdIdx_xdu8 /end OUT_MEASUREMENT
/end FUNCTION
/begin FUNCTION ActiveReturnCheck "ActiveReturnCheck"
 /begin DEF_CHARACTERISTIC mActRet_MaxMotorTorqueDepOnSteeringAngle_XAU16 mActRet_MaxMotorTorqueDepOnVehSpeed_XAU16 mActRet_MaxTBT4ShutDown_XDU8 /end DEF_CHARACTERISTIC
 /begin IN_MEASUREMENT vVehSpI_AbsMaxSafeVehSpd_xdu16 wApplI_AbsSteeringAngle_xdu16 /end IN_MEASUREMENT
 /begin OUT_MEASUREMENT fActRet_Disable_xdb mActRet_MotTrqSaturated_xds16 /end OUT_MEASUREMENT
/end FUNCTION
/begin FUNCTION ActiveReturnCheckI "ActiveReturnCheckI" /begin OUT_MEASUREMENT mActRetI_MotorTorque_xds16 /end OUT_MEASUREMENT /end FUNCTION
/begin FUNCTION ActiveReturnInterface "Active Return Interface" /begin OUT_MEASUREMENT mActRetI_MotTrq4Check_xds16 /end OUT_MEASUREMENT /end FUNCTION
/begin FUNCTION AheadDetection "AheadDetection kgt"
 /begin DEF_CHARACTERISTIC aAhaDet_AccLimit_XDU16 aAhaDet_MaxAbsLateralAccel_XDU16 mAhaDet_TorqueLimit_XDU16 tAhaDet_AheadDetectionTimer_XDU8 vAhaDet_FrontESPvLimit_XDU16 vAhaDet_FrontRearRotationLimit_XDU16 vAhaDet_LeftRightRotationLimit_XDU16 vAhaDet_MaxAbsYawVelocity_XDU16 vAhaDet_MinRotationLimit_XDU16 vAhaDet_MinVehicleSpeed_XDU16 vAhaDet_StAnSpeedLimit_XDU16 xAhaDet_FiltFactPT1YR_XDU16 xAhaDet_LowerRatioLimitAhead_XDU16 xAhaDet_MaxRatioGradient_XDU16 xAhaDet_RatioLimitAhead_XDU16 xAhaDet_SlipLimit_XDU16 /end DEF_CHARACTERISTIC
 /begin OUT_MEASUREMENT sAhaDet_AheadDetectionwhlStatus_xdu8 /end OUT_MEASUREMENT
/end FUNCTION
/begin FUNCTION AheadDetectionSupp "AheadDetectionSupp kgt" /begin DEF_CHARACTERISTIC xAhaDet_PedalMax_XDU16 /end DEF_CHARACTERISTIC /end FUNCTION
/begin FUNCTION AheadDetectionSupp_Interface "Ahead Detection Supp Interface kgt"
 /begin OUT_MEASUREMENT sAhaDetI_DetDemandWhlsSupp_xdu8 sAhaDetI_DetDemandYawSupp_xdu8 /end OUT_MEASUREMENT
/end FUNCTION
/begin FUNCTION AheadDetectionSupp_Stubs "Ahead Detection supp stubs"
 /begin OUT_MEASUREMENT sApplI_EscBrakeState_xdu8 sApplI_ParkingBrakeState_xdu8 xApplI_AccelPedalPosition_xdu16 /end OUT_MEASUREMENT
/end FUNCTION
/begin FUNCTION AheadDetection_Main_Interface "AheadDetection Main Interface kgt" /begin OUT_MEASUREMENT sAhaDetI_AheadFromWheels_xdu8 sAhaDetI_AheadFromYaw_xdu8 /end OUT_MEASUREMENT /end FUNCTION
/begin RECORD_LAYOUT AblGLKFuw FNC_VALUES 3 UWORD COLUMN_DIR DIRECT AXIS_PTS_X 1 UWORD INDEX_INCR DIRECT AXIS_PTS_Y 2 UWORD INDEX_INCR DIRECT /end RECORD_LAYOUT
/begin RECORD_LAYOUT AblGLKLsw FNC_VALUES 3 SWORD COLUMN_DIR DIRECT AXIS_PTS_X 2 SWORD INDEX_INCR DIRECT NO_AXIS_PTS_X 1 UWORD /end RECORD_LAYOUT
/begin RECORD_LAYOUT AblGLKLuw FNC_VALUES 3 UWORD COLUMN_DIR DIRECT AXIS_PTS_X 2 UWORD INDEX_INCR DIRECT NO_AXIS_PTS_X 1 UWORD /end RECORD_LAYOUT
/begin RECORD_LAYOUT AblGLKWub FNC_VALUES 1 UBYTE COLUMN_DIR DIRECT /end RECORD_LAYOUT
/begin RECORD_LAYOUT AblGLKWuw FNC_VALUES 1 UWORD COLUMN_DIR DIRECT /end RECORD_LAYOUT
/begin VARIANT_CODING /end VARIANT_CODING
/end MODULE
/end PROJECT
