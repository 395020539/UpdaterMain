ASAP2_VERSION 1 70
/begin PROJECT _GA1_103 "SCU3_B3_VAR_04"
/begin HEADER "" VERSION "GA1_103_C_03_00" PROJECT_NO _GA1_103 /end HEADER
/begin MODULE XCP_EPS_ECU "G08"
/begin MOD_COMMON "" BYTE_ORDER MSB_LAST ALIGNMENT_BYTE 1 ALIGNMENT_WORD 2 ALIGNMENT_LONG 4 ALIGNMENT_FLOAT32_IEEE 4 ALIGNMENT_FLOAT64_IEEE 8 /end MOD_COMMON
/begin CHARACTERISTIC aDsd_MaxDeltaLatAccSpeed_SK_XDF32 "Gradientenbegrenzung Querbeschleunigung (steigend) [m/s^2/10ms]" VALUE 0x150400 AblGLKWfl4 0.45 ZU0 0 0.45 FORMAT "%11.9" /end CHARACTERISTIC
/begin CHARACTERISTIC aDsd_Th_DeltaLatAcc_SK_XDF32 "Schwellwert Querbeschleunigungsdifferenz für Aktivierung Steilkurvenerkennung [m/s^2]" VALUE 0x150404 AblGLKWfl4 45 ZU0 0 45 FORMAT "%10.7" /end CHARACTERISTIC
/begin CHARACTERISTIC aDthrCtrl_ESLRackAccelBrake_XDU16 "Zahnstangenbeschleunigung beim Abbremsen für ES" VALUE 0x150534 AblGLKWuw 470 RACKACC128 30 500 FORMAT "%8.4" /end CHARACTERISTIC
/begin CHARACTERISTIC aDthrCtrl_ESLRackAccel_XDU16 "Zahnstangenbeschleunigung bei Endstopsuche" VALUE 0x150536 AblGLKWuw 235 RACKACC128 15 250 FORMAT "%8.4" /end CHARACTERISTIC
/begin CHARACTERISTIC aDthrCtrl_IDAngleAcc_XDU16 "Lenkwinkelbeschleunigung bei Index anlernen" VALUE 0x150538 AblGLKWuw 9900 SAA 100 10000 FORMAT "%8.2" /end CHARACTERISTIC
/begin CHARACTERISTIC aDthrCtrl_MidhAngleacc_XDU16 "Lenkwinkelbeschleunigung bei Mittenhalt" VALUE 0x15053A AblGLKWuw 65499 SAA 1 65500 FORMAT "%8.2" /end CHARACTERISTIC
/begin CHARACTERISTIC aDTSC_MaxLatAcceleration_XDU16 "Maximale Querbeschleunigung für die Berechnung/Validierung des Kalibrierwerts" VALUE 0x15053C AblGLKWuw 20 AFZ 0 20 FORMAT "%8.5" /end CHARACTERISTIC
/begin CHARACTERISTIC fBci_Level1CheckActivated_XDU8 "Schalter um die Pruefung der rueckgerechneten BasisSteerTorque-Kennlinie auf Level1 (integer) zu deaktivieren: 0=deakiviert 1=aktiviert" VALUE 0x150AB1 AblGLKWub 1 ZU0 0 1 FORMAT "%5.3" /end CHARACTERISTIC
/begin CHARACTERISTIC fBci_Level2CheckActivated_XDU8 "Schalter um die Pruefung der rueckgerechneten BasisSteerTorque-Kennlinie auf Level2 (float) zu deaktivieren: 0=deakiviert 1=aktiviert" VALUE 0x150AB2 AblGLKWub 1 ZU0 0 1 FORMAT "%5.3" /end CHARACTERISTIC
/begin CHARACTERISTIC fDthrCtrl_BypassEnable_XDU8 "Aktivierung der Ableitung der Soll-Zahnstangenposition" VALUE 0x150AB4 AblGLKWub 1 ZU0 0 1 FORMAT "%5.3" /end CHARACTERISTIC
/begin CHARACTERISTIC fDTSC_Enable_XDU8 "Aktivierung von DriveTorqueSteerCompensation" VALUE 0x150AB5 AblGLKWub 1 ZU0 0 1 FORMAT "%5.3" /end CHARACTERISTIC
/begin CHARACTERISTIC fDTSC_UseDTSCEstimator_XDU8 "Verwendung des DTSC Estimator-Kanals zur Kalibrierung" VALUE 0x150AB6 AblGLKWub 1 ZU0 0 1 FORMAT "%5.3" /end CHARACTERISTIC
/begin CHARACTERISTIC fDTSC_UseLongAcceleration_XDU8 "Benutzen der Längsbeschleunigung anstatt des Antriebswellenmoments" VALUE 0x150AB7 AblGLKWub 1 ZU0 0 1 FORMAT "%5.3" /end CHARACTERISTIC
/begin CHARACTERISTIC fEndStopHsd_EnableUndervoltOffset_XDU8 "Enable undervolt offset in EndStopHsd if set to true" VALUE 0x150AB8 AblGLKWub 1 BIT 0 1 FORMAT "%5.3" /end CHARACTERISTIC
/begin CHARACTERISTIC fEndStopHsd_EnableUnFiltRotSpeed_XDU8 "0 = gefilterte Rotordrehzahl; 1 = verwende die UNgefilterte Rotordrehzahl in HighSpeedDamping" VALUE 0x150AB9 AblGLKWub 1 ZU0 0 1 FORMAT "%5.3" /end CHARACTERISTIC
/begin CHARACTERISTIC fEndStop_DisableReactivation_XDU8 "Monitoring: Reaktivierung nach Verschwinden eines erkannten Fehlers deaktivieren" VALUE 0x150ABA AblGLKWub 1 ZU0 0 1 FORMAT "%5.3" /end CHARACTERISTIC
/begin CHARACTERISTIC fEndStop_EnableDyn_XDU8 "Flag Einschalten dynamischer Endanschlag. Achtung: EndstopSupp-Komponente kann fEndStop_LimitEnable ueberstimmen!!!" VALUE 0x150ABB AblGLKWub 1 ZU0 0 1 FORMAT "%5.3" /end CHARACTERISTIC
/begin CHARACTERISTIC fEndStop_LimitEnable_XDU8 "Flag Einschalten Limitierung Endanschlagsmomente. Achtung: EndstopSupp-Komponente kann diese Limitierung aufheben wenn fEndStop_EnableDyn_XDU8 aktiv!!!" VALUE 0x150ABC AblGLKWub 1 ZU0 0 1 FORMAT "%5.3" /end CHARACTERISTIC
/begin CHARACTERISTIC fEndStop_ResetLearnedEndstopPosition_XDU8 "Gelernte Endstop-Positionen verwerfen - nach erfolgtem Reset wieder auf 0 setzen" VALUE 0x150ABD AblGLKWub 1 ZU0 0 1 FORMAT "%5.3" /end CHARACTERISTIC
/begin CHARACTERISTIC kBci_MaxRackForceOnVehicleSpeed_XAF32 "fahrzeuggeschwindigkeitsabhängige maximale Zahnstangenkraft für Berechnung der BasicSteerTorque Kennlinie" CURVE 0x150BCC AblGLKLfl4 29500 ZU0 500 30000 FORMAT "%10.4"
 /begin AXIS_DESCR STD_AXIS vBci_AbsSafeNssVehicleSpeedCalcCurvesL2_xdf32 ZU0 7 0 300 FORMAT "%10.6" DEPOSIT ABSOLUTE /end AXIS_DESCR
/end CHARACTERISTIC
/begin CHARACTERISTIC kBci_MaxRackForceOnVehicleSpeed_XAU16 "fahrzeuggeschwindigkeitsabhängige maximale Zahnstangenkraft für Berechnung der BasicSteerTorque Kennlinie" CURVE 0x150F08 AblGLKLuw 29500 FRACK 500 30000 FORMAT "%8.2"
 /begin AXIS_DESCR STD_AXIS vApplI_AbsSafeNssVehicleSpeed_xdu16 VFZHIGH 7 0 300 FORMAT "%8.4" DEPOSIT ABSOLUTE /end AXIS_DESCR
/end CHARACTERISTIC
/begin CHARACTERISTIC kBci_MaxRackForce_XDU16 "maximale Zahnstangenkraft für Berechnung der BasicSteerTorque-Kennlinie" VALUE 0x15054E AblGLKWuw 30000 FRACK 0 30000 FORMAT "%8.2" /end CHARACTERISTIC
/begin CHARACTERISTIC kBci_SafetyLimiterMinRackForce1_XDU16 "Zahnstangenkraft ab der auf mBci_SafetyLimiterMinTorsionBarTorque1_XDU16 limitiert wird" VALUE 0x150550 AblGLKWuw 30000 FRACK 0 30000 FORMAT "%8.2" /end CHARACTERISTIC
/begin CHARACTERISTIC kBci_SafetyLimiterMinRackForce2_XDU16 "Zahnstangenkraft ab der auf mBci_SafetyLimiterMinTorsionBarTorque2_XDU16 limitiert wird" VALUE 0x150552 AblGLKWuw 30000 FRACK 0 30000 FORMAT "%8.2" /end CHARACTERISTIC
/begin CHARACTERISTIC kDthrCtrl_MidhRackforceMax_XDU16 "Grenzewert für Zahnstangenkraft bei Mittenhalt" VALUE 0x150554 AblGLKWuw 20000 PDC_FRACK 0 20000 FORMAT "%8.2" /end CHARACTERISTIC
/begin CHARACTERISTIC lDthrCtrl_CenterPositionTolerance_XDU16 "Center position tolerance after Endstop Learning [mm]" VALUE 0x150558 AblGLKWuw 109.992 RACKPOS128 0.0078125 110 FORMAT "%8.4" /end CHARACTERISTIC
/begin CHARACTERISTIC lDthrCtrl_ESLIndexWidthHalf_XDU16 "mittlere halbe Indexbreite " VALUE 0x15055A AblGLKWuw 3 RACKPOS128 0 3 FORMAT "%8.6" /end CHARACTERISTIC
/begin CHARACTERISTIC lDthrCtrl_ESLLock2Lock_XDU16 "Zahnstangenposition: Mindestabstand Endstop zu Endstop" VALUE 0x15055C AblGLKWuw 100 RACKPOS128 100 200 FORMAT "%8.4" /end CHARACTERISTIC
/begin CHARACTERISTIC lDthrCtrl_ESLLockMin_XDU16 "Zahnstangenposition: Mindestabstand Endstop zu Mittenindex" VALUE 0x15055E AblGLKWuw 50 RACKPOS128 50 100 FORMAT "%8.4" /end CHARACTERISTIC
/begin CHARACTERISTIC lDthrCtrl_ESLRackRangeFine_XDU16 "Zahnstangenposition: Amplitude bei exakter Indexsuche für ES" VALUE 0x150560 AblGLKWuw 20 RACKPOS128 0 20 FORMAT "%8.5" /end CHARACTERISTIC
/begin CHARACTERISTIC lDthrCtrl_ESLRackRange_XDU16 "Zahnstangenposition: Amplitude bei Indexsuche für ES" VALUE 0x150562 AblGLKWuw 27 RACKPOS128 0 27 FORMAT "%8.5" /end CHARACTERISTIC
/begin CHARACTERISTIC lDthrCtrl_ESLRangeCorrection_XDS16 "Correction term for steering range due to mechanical tension from low motor torque" VALUE 0x150564 AblGLKWsw 10 RACKPOS128 -5 5 FORMAT "%8.6" /end CHARACTERISTIC
/begin CHARACTERISTIC lDthrCtrl_IDFFinishTolerance_XDU16 "Toleranz für Endposition" VALUE 0x150566 AblGLKWuw 90 RACKPOS128 0 90 FORMAT "%8.5" /end CHARACTERISTIC
/begin CHARACTERISTIC lDthrCtrl_RackPosDiffMax_XDU16 "Max allowed position following error (target-actual)" VALUE 0x150568 AblGLKWuw 100 RACKPOS128 0 100 FORMAT "%8.4" /end CHARACTERISTIC
/begin CHARACTERISTIC lEndStopHsdCheck_SubstDistToES_XDU16 "Ersatzwert - Distance to endstop wenn Lenkwinkel ungueltig" VALUE 0x15056A AblGLKWuw 125 RACKPOS128 0 125 FORMAT "%8.4" /end CHARACTERISTIC
/begin CHARACTERISTIC lEndStopHsd_DistanceToEndStop_LastP_XDU16 "Monitoring: DistanceToEndStop letzte Stuetzstelle von mEndStopHsd_MaxMotorTorque_XAS16" VALUE 0x15056C AblGLKWuw 125 RACKPOS128 0 125 FORMAT "%8.4" /end CHARACTERISTIC
/begin CHARACTERISTIC lEndStopHsd_SubstDistToES_XDU16 "Ersatzwert - Distance to endstop wenn Lenkwinkel ungueltig" VALUE 0x15056E AblGLKWuw 125 RACKPOS128 0 125 FORMAT "%8.4" /end CHARACTERISTIC
/begin CHARACTERISTIC lEndStop_AllowedPosBorderHigh_XDU16 " obere Grenze abs. Zahnstangenposition ohne Endstopmoment --> Level2" VALUE 0x150570 AblGLKWuw 90 RACKPOS128 35 125 FORMAT "%8.4" /end CHARACTERISTIC
/begin CHARACTERISTIC lEndStop_AllowedPosBorder_XDU16 "max. Absoluter Zahnstangenbereich ohne Endanschlag Level2" VALUE 0x150572 AblGLKWuw 125 RACKPOS128 0 125 FORMAT "%8.4" /end CHARACTERISTIC
/begin CHARACTERISTIC lEndStop_EsMechIndentLeft_XDU16 "Einruecken/Abstand in [mm] vom eingelernten Endanschlag" VALUE 0x150574 AblGLKWuw 40 RACKPOS128 0 40 FORMAT "%8.5" /end CHARACTERISTIC
/begin CHARACTERISTIC lEndStop_EsMechIndentRight_XDU16 "Einruecken/Abstand in [mm] vom eingelernten Endanschlag" VALUE 0x150576 AblGLKWuw 40 RACKPOS128 0 40 FORMAT "%8.5" /end CHARACTERISTIC
/begin CHARACTERISTIC lEndStop_MinSteerRangeLearned_XDU16 "Mindestens gelernter Lenkhub wenn fertig gelernt wurde" VALUE 0x150578 AblGLKWuw 200 RACKPOS128 0 200 FORMAT "%8.4" /end CHARACTERISTIC
/begin CHARACTERISTIC lEndStop_oAbsSteerLearn_XDU16 "Einlernbedingung: max. Lenkhub zum Einlernen bezogen auf Indexmitte bzw. ext. LWS" VALUE 0x15057A AblGLKWuw 75 RACKPOS128 50 125 FORMAT "%8.4" /end CHARACTERISTIC
/begin CHARACTERISTIC lEndStop_OffsetNotExactlyInit_XDU16 "Differenz in [mm] bei Abstand vom Endanschlag beruecksichtigt, wenn der Lenkwinkel nicht exakt initialisiert ist" VALUE 0x15057C AblGLKWuw 3 RACKPOS128 0 3 FORMAT "%8.6" /end CHARACTERISTIC
/begin CHARACTERISTIC lEndStop_RelearnOffset_XDU16 "Zusaetzliche Distanz, um die die neu RackPosMax/Min größer sein muss als der alte Wert, damit nachgelernt wird [mm]" VALUE 0x15057E AblGLKWuw 10 RACKPOS128 0 10 FORMAT "%8.5" /end CHARACTERISTIC
/begin CHARACTERISTIC lEndStop_StatusChangeAllowedOffset_XDU16 "Zusaetzliches Offset zu Springstartposition (um sicher zu gehen, dass wirklich ausserhalb EndstopArea)[mm]" VALUE 0x150580 AblGLKWuw 5 RACKPOS128 0 5 FORMAT "%8.6" /end CHARACTERISTIC
/begin CHARACTERISTIC lEndStop_SteerRangeLimit_XDU16 "Limitierung auf Mindest-Lenkhub bezogen auf kalibrierten LWS [mm]" VALUE 0x150582 AblGLKWuw 75 RACKPOS128 50 125 FORMAT "%8.4" /end CHARACTERISTIC
/begin CHARACTERISTIC lEndStop_SteerRange_XDU16 "Lenkhub von rechts nach links in [mm]" VALUE 0x150584 AblGLKWuw 250 RACKPOS128 0 250 FORMAT "%8.4" /end CHARACTERISTIC
/begin CHARACTERISTIC lEndStop_uAbsSteerLearn_XDU16 "Einlernbedingung: Zahnstangenposition, die mindestens ueberlenkt werden muss" VALUE 0x150586 AblGLKWuw 75 RACKPOS128 50 125 FORMAT "%8.4" /end CHARACTERISTIC
/begin CHARACTERISTIC lEndStop_uDistanceLearnCondition_XDU16 "Abstand zum Endanschlag, ab welchem die Fertiglernbedingungen geprueft werden" VALUE 0x150588 AblGLKWuw 8 RACKPOS128 0 8 FORMAT "%8.6" /end CHARACTERISTIC
/begin CHARACTERISTIC mBci_ErrorInjectionMotorTorqueOnAssistChar_XAS16 "Motormomentenoffset auf Assist-Kennlinie zum Test der Level2-Prüfung (Testschalter)" VAL_BLK 0x150C1C AblGLKWBsw 2 MMOT -1 1 NUMBER 10 FORMAT "%8.6" /end CHARACTERISTIC
/begin CHARACTERISTIC mBci_ErrorInjectionTorsionBarTorqueOnAssistChar_XAS16 "Handmomentenoffset auf Assist-Kennlinie zum Test der Level2-Prüfung (Testschalter)" VAL_BLK 0x150C30 AblGLKWBsw 2 TBTHIGH -1 1 NUMBER 10 FORMAT "%8.6" /end CHARACTERISTIC
/begin CHARACTERISTIC mBci_MaxAssistanceTorque_XDU16 "maximales Unterstützungsmoment für Berechnung der Assistance-Kennlinie" VALUE 0x1505A6 AblGLKWuw 12 MMOT 0 12 FORMAT "%8.5" /end CHARACTERISTIC
/begin CHARACTERISTIC mBci_SafetyLimiterMinTorsionBarTorque1_XDU16 "minimales Handmoment auf das ab kBci_SafetyLimiterMinForce1_XAU16 limitiert wird" VALUE 0x1505A8 AblGLKWuw 15 TBTHIGH 0 15 FORMAT "%8.5" /end CHARACTERISTIC
/begin CHARACTERISTIC mBci_SafetyLimiterMinTorsionBarTorque2_XDU16 "minimales Handmoment auf das ab kBci_SafetyLimiterMinForce2_XAU16 limitiert wird" VALUE 0x1505AA AblGLKWuw 15 TBTHIGH 0 15 FORMAT "%8.5" /end CHARACTERISTIC
/begin CHARACTERISTIC mCentFeel_MaxCenterFeelTorque_XDU16 "maximales Mittengefühlmoment" VALUE 0x1505B2 AblGLKWuw 1 TBTHIGH 0 1 FORMAT "%8.6" /end CHARACTERISTIC
/begin CHARACTERISTIC mCentFeel_NormCenterFeelTorque_XAU16_00___A "dynamic steering angle dependent factor of center feel torque" CURVE 0x15B074 AblGLKLuw 1 TBTHIGH 0 1 FORMAT "%8.6"
 /begin AXIS_DESCR STD_AXIS wApplI_AbsDynSteerAngle_xdu16 SA_10 6 0 15 FORMAT "%8.5" DEPOSIT ABSOLUTE /end AXIS_DESCR
/end CHARACTERISTIC
/begin CHARACTERISTIC mCentFeel_NormCenterFeelTorque_XAU16_01___A "dynamic steering angle dependent factor of center feel torque" CURVE 0x15B090 AblGLKLuw 1 TBTHIGH 0 1 FORMAT "%8.6"
 /begin AXIS_DESCR STD_AXIS wApplI_AbsDynSteerAngle_xdu16 SA_10 6 0 15 FORMAT "%8.5" DEPOSIT ABSOLUTE /end AXIS_DESCR
/end CHARACTERISTIC
/begin CHARACTERISTIC mCentFeel_NormCenterFeelTorque_XAU16_02___A "dynamic steering angle dependent factor of center feel torque" CURVE 0x15B0AC AblGLKLuw 1 TBTHIGH 0 1 FORMAT "%8.6"
 /begin AXIS_DESCR STD_AXIS wApplI_AbsDynSteerAngle_xdu16 SA_10 6 0 15 FORMAT "%8.5" DEPOSIT ABSOLUTE /end AXIS_DESCR
/end CHARACTERISTIC
/begin CHARACTERISTIC mCentFeel_NormCenterFeelTorque_XAU16_03___A "dynamic steering angle dependent factor of center feel torque" CURVE 0x15B0C8 AblGLKLuw 1 TBTHIGH 0 1 FORMAT "%8.6"
 /begin AXIS_DESCR STD_AXIS wApplI_AbsDynSteerAngle_xdu16 SA_10 6 0 15 FORMAT "%8.5" DEPOSIT ABSOLUTE /end AXIS_DESCR
/end CHARACTERISTIC
/begin CHARACTERISTIC mCentFeel_NormCenterFeelTorque_XAU16_04___A "dynamic steering angle dependent factor of center feel torque" CURVE 0x15B0E4 AblGLKLuw 1 TBTHIGH 0 1 FORMAT "%8.6"
 /begin AXIS_DESCR STD_AXIS wApplI_AbsDynSteerAngle_xdu16 SA_10 6 0 15 FORMAT "%8.5" DEPOSIT ABSOLUTE /end AXIS_DESCR
/end CHARACTERISTIC
/begin CHARACTERISTIC mCentFeel_NormCenterFeelTorque_XAU16_05___A "dynamic steering angle dependent factor of center feel torque" CURVE 0x15B100 AblGLKLuw 1 TBTHIGH 0 1 FORMAT "%8.6"
 /begin AXIS_DESCR STD_AXIS wApplI_AbsDynSteerAngle_xdu16 SA_10 6 0 15 FORMAT "%8.5" DEPOSIT ABSOLUTE /end AXIS_DESCR
/end CHARACTERISTIC
/begin CHARACTERISTIC mCentFeel_NormCenterFeelTorque_XAU16_06___A "dynamic steering angle dependent factor of center feel torque" CURVE 0x15B11C AblGLKLuw 1 TBTHIGH 0 1 FORMAT "%8.6"
 /begin AXIS_DESCR STD_AXIS wApplI_AbsDynSteerAngle_xdu16 SA_10 6 0 15 FORMAT "%8.5" DEPOSIT ABSOLUTE /end AXIS_DESCR
/end CHARACTERISTIC
/begin CHARACTERISTIC mCentFeel_NormCenterFeelTorque_XAU16_07___A "dynamic steering angle dependent factor of center feel torque" CURVE 0x15B138 AblGLKLuw 1 TBTHIGH 0 1 FORMAT "%8.6"
 /begin AXIS_DESCR STD_AXIS wApplI_AbsDynSteerAngle_xdu16 SA_10 6 0 15 FORMAT "%8.5" DEPOSIT ABSOLUTE /end AXIS_DESCR
/end CHARACTERISTIC
/begin CHARACTERISTIC mCentFeel_NormCenterFeelTorque_XAU16_08___A "dynamic steering angle dependent factor of center feel torque" CURVE 0x15B154 AblGLKLuw 1 TBTHIGH 0 1 FORMAT "%8.6"
 /begin AXIS_DESCR STD_AXIS wApplI_AbsDynSteerAngle_xdu16 SA_10 6 0 15 FORMAT "%8.5" DEPOSIT ABSOLUTE /end AXIS_DESCR
/end CHARACTERISTIC
/begin CHARACTERISTIC mCentFeel_NormCenterFeelTorque_XAU16_09___A "dynamic steering angle dependent factor of center feel torque" CURVE 0x15B170 AblGLKLuw 1 TBTHIGH 0 1 FORMAT "%8.6"
 /begin AXIS_DESCR STD_AXIS wApplI_AbsDynSteerAngle_xdu16 SA_10 6 0 15 FORMAT "%8.5" DEPOSIT ABSOLUTE /end AXIS_DESCR
/end CHARACTERISTIC
/begin CHARACTERISTIC mCentFeel_NormCenterFeelTorque_XAU16_10___A "dynamic steering angle dependent factor of center feel torque" CURVE 0x15B18C AblGLKLuw 1 TBTHIGH 0 1 FORMAT "%8.6"
 /begin AXIS_DESCR STD_AXIS wApplI_AbsDynSteerAngle_xdu16 SA_10 6 0 15 FORMAT "%8.5" DEPOSIT ABSOLUTE /end AXIS_DESCR
/end CHARACTERISTIC
/begin CHARACTERISTIC mCentFeel_NormCenterFeelTorque_XAU16_11___A "dynamic steering angle dependent factor of center feel torque" CURVE 0x15B1A8 AblGLKLuw 1 TBTHIGH 0 1 FORMAT "%8.6"
 /begin AXIS_DESCR STD_AXIS wApplI_AbsDynSteerAngle_xdu16 SA_10 6 0 15 FORMAT "%8.5" DEPOSIT ABSOLUTE /end AXIS_DESCR
/end CHARACTERISTIC
/begin CHARACTERISTIC mCentFeel_NormCenterFeelTorque_XAU16_12___A "dynamic steering angle dependent factor of center feel torque" CURVE 0x15B1C4 AblGLKLuw 1 TBTHIGH 0 1 FORMAT "%8.6"
 /begin AXIS_DESCR STD_AXIS wApplI_AbsDynSteerAngle_xdu16 SA_10 6 0 15 FORMAT "%8.5" DEPOSIT ABSOLUTE /end AXIS_DESCR
/end CHARACTERISTIC
/begin CHARACTERISTIC mCentFeel_NormCenterFeelTorque_XAU16_13___A "dynamic steering angle dependent factor of center feel torque" CURVE 0x15B1E0 AblGLKLuw 1 TBTHIGH 0 1 FORMAT "%8.6"
 /begin AXIS_DESCR STD_AXIS wApplI_AbsDynSteerAngle_xdu16 SA_10 6 0 15 FORMAT "%8.5" DEPOSIT ABSOLUTE /end AXIS_DESCR
/end CHARACTERISTIC
/begin CHARACTERISTIC mCentFeel_NormCenterFeelTorque_XAU16_14___A "dynamic steering angle dependent factor of center feel torque" CURVE 0x15B1FC AblGLKLuw 1 TBTHIGH 0 1 FORMAT "%8.6"
 /begin AXIS_DESCR STD_AXIS wApplI_AbsDynSteerAngle_xdu16 SA_10 6 0 15 FORMAT "%8.5" DEPOSIT ABSOLUTE /end AXIS_DESCR
/end CHARACTERISTIC
/begin CHARACTERISTIC mCentFeel_NormCenterFeelTorque_XAU16_15___A "dynamic steering angle dependent factor of center feel torque" CURVE 0x15B218 AblGLKLuw 1 TBTHIGH 0 1 FORMAT "%8.6"
 /begin AXIS_DESCR STD_AXIS wApplI_AbsDynSteerAngle_xdu16 SA_10 6 0 15 FORMAT "%8.5" DEPOSIT ABSOLUTE /end AXIS_DESCR
/end CHARACTERISTIC
/begin CHARACTERISTIC mCentFeel_NormCenterFeelTorque_XAU16_16___A "dynamic steering angle dependent factor of center feel torque" CURVE 0x15B234 AblGLKLuw 1 TBTHIGH 0 1 FORMAT "%8.6"
 /begin AXIS_DESCR STD_AXIS wApplI_AbsDynSteerAngle_xdu16 SA_10 6 0 15 FORMAT "%8.5" DEPOSIT ABSOLUTE /end AXIS_DESCR
/end CHARACTERISTIC
/begin CHARACTERISTIC mCentFeel_NormCenterFeelTorque_XAU16_17___A "dynamic steering angle dependent factor of center feel torque" CURVE 0x15B250 AblGLKLuw 1 TBTHIGH 0 1 FORMAT "%8.6"
 /begin AXIS_DESCR STD_AXIS wApplI_AbsDynSteerAngle_xdu16 SA_10 6 0 15 FORMAT "%8.5" DEPOSIT ABSOLUTE /end AXIS_DESCR
/end CHARACTERISTIC
/begin CHARACTERISTIC mCentFeel_NormCenterFeelTorque_XAU16_18___A "dynamic steering angle dependent factor of center feel torque" CURVE 0x15B26C AblGLKLuw 1 TBTHIGH 0 1 FORMAT "%8.6"
 /begin AXIS_DESCR STD_AXIS wApplI_AbsDynSteerAngle_xdu16 SA_10 6 0 15 FORMAT "%8.5" DEPOSIT ABSOLUTE /end AXIS_DESCR
/end CHARACTERISTIC
/begin CHARACTERISTIC mCentFeel_NormCenterFeelTorque_XAU16_19___A "dynamic steering angle dependent factor of center feel torque" CURVE 0x15B288 AblGLKLuw 1 TBTHIGH 0 1 FORMAT "%8.6"
 /begin AXIS_DESCR STD_AXIS wApplI_AbsDynSteerAngle_xdu16 SA_10 6 0 15 FORMAT "%8.5" DEPOSIT ABSOLUTE /end AXIS_DESCR
/end CHARACTERISTIC
/begin CHARACTERISTIC mCentFeel_NormCenterFeelTorque_XAU16_20___A "dynamic steering angle dependent factor of center feel torque" CURVE 0x15B2A4 AblGLKLuw 1 TBTHIGH 0 1 FORMAT "%8.6"
 /begin AXIS_DESCR STD_AXIS wApplI_AbsDynSteerAngle_xdu16 SA_10 6 0 15 FORMAT "%8.5" DEPOSIT ABSOLUTE /end AXIS_DESCR
/end CHARACTERISTIC
/begin CHARACTERISTIC mCentFeel_NormCenterFeelTorque_XAU16_21___A "dynamic steering angle dependent factor of center feel torque" CURVE 0x15B2C0 AblGLKLuw 1 TBTHIGH 0 1 FORMAT "%8.6"
 /begin AXIS_DESCR STD_AXIS wApplI_AbsDynSteerAngle_xdu16 SA_10 6 0 15 FORMAT "%8.5" DEPOSIT ABSOLUTE /end AXIS_DESCR
/end CHARACTERISTIC
/begin CHARACTERISTIC mCentFeel_NormCenterFeelTorque_XAU16_22___A "dynamic steering angle dependent factor of center feel torque" CURVE 0x15B2DC AblGLKLuw 1 TBTHIGH 0 1 FORMAT "%8.6"
 /begin AXIS_DESCR STD_AXIS wApplI_AbsDynSteerAngle_xdu16 SA_10 6 0 15 FORMAT "%8.5" DEPOSIT ABSOLUTE /end AXIS_DESCR
/end CHARACTERISTIC
/begin CHARACTERISTIC mCentFeel_NormCenterFeelTorque_XAU16_23___A "dynamic steering angle dependent factor of center feel torque" CURVE 0x15B2F8 AblGLKLuw 1 TBTHIGH 0 1 FORMAT "%8.6"
 /begin AXIS_DESCR STD_AXIS wApplI_AbsDynSteerAngle_xdu16 SA_10 6 0 15 FORMAT "%8.5" DEPOSIT ABSOLUTE /end AXIS_DESCR
/end CHARACTERISTIC
/begin CHARACTERISTIC mCentFeel_NormCenterFeelTorque_XAU16_24___A "dynamic steering angle dependent factor of center feel torque" CURVE 0x15B314 AblGLKLuw 1 TBTHIGH 0 1 FORMAT "%8.6"
 /begin AXIS_DESCR STD_AXIS wApplI_AbsDynSteerAngle_xdu16 SA_10 6 0 15 FORMAT "%8.5" DEPOSIT ABSOLUTE /end AXIS_DESCR
/end CHARACTERISTIC
/begin CHARACTERISTIC mCentFeel_NormCenterFeelTorque_XAU16_25___A "dynamic steering angle dependent factor of center feel torque" CURVE 0x15B330 AblGLKLuw 1 TBTHIGH 0 1 FORMAT "%8.6"
 /begin AXIS_DESCR STD_AXIS wApplI_AbsDynSteerAngle_xdu16 SA_10 6 0 15 FORMAT "%8.5" DEPOSIT ABSOLUTE /end AXIS_DESCR
/end CHARACTERISTIC
/begin CHARACTERISTIC mCentFeel_NormCenterFeelTorque_XAU16_26___A "dynamic steering angle dependent factor of center feel torque" CURVE 0x15B34C AblGLKLuw 1 TBTHIGH 0 1 FORMAT "%8.6"
 /begin AXIS_DESCR STD_AXIS wApplI_AbsDynSteerAngle_xdu16 SA_10 6 0 15 FORMAT "%8.5" DEPOSIT ABSOLUTE /end AXIS_DESCR
/end CHARACTERISTIC
/begin CHARACTERISTIC mCentFeel_NormCenterFeelTorque_XAU16_27___A "dynamic steering angle dependent factor of center feel torque" CURVE 0x15B368 AblGLKLuw 1 TBTHIGH 0 1 FORMAT "%8.6"
 /begin AXIS_DESCR STD_AXIS wApplI_AbsDynSteerAngle_xdu16 SA_10 6 0 15 FORMAT "%8.5" DEPOSIT ABSOLUTE /end AXIS_DESCR
/end CHARACTERISTIC
/begin CHARACTERISTIC mCentFeel_NormCenterFeelTorque_XAU16_28___A "dynamic steering angle dependent factor of center feel torque" CURVE 0x15B384 AblGLKLuw 1 TBTHIGH 0 1 FORMAT "%8.6"
 /begin AXIS_DESCR STD_AXIS wApplI_AbsDynSteerAngle_xdu16 SA_10 6 0 15 FORMAT "%8.5" DEPOSIT ABSOLUTE /end AXIS_DESCR
/end CHARACTERISTIC
/begin CHARACTERISTIC mCentFeel_NormCenterFeelTorque_XAU16_29___A "dynamic steering angle dependent factor of center feel torque" CURVE 0x15B3A0 AblGLKLuw 1 TBTHIGH 0 1 FORMAT "%8.6"
 /begin AXIS_DESCR STD_AXIS wApplI_AbsDynSteerAngle_xdu16 SA_10 6 0 15 FORMAT "%8.5" DEPOSIT ABSOLUTE /end AXIS_DESCR
/end CHARACTERISTIC
/begin CHARACTERISTIC mCentFeel_NormCenterFeelTorque_XAU16_30___A "dynamic steering angle dependent factor of center feel torque" CURVE 0x15B3BC AblGLKLuw 1 TBTHIGH 0 1 FORMAT "%8.6"
 /begin AXIS_DESCR STD_AXIS wApplI_AbsDynSteerAngle_xdu16 SA_10 6 0 15 FORMAT "%8.5" DEPOSIT ABSOLUTE /end AXIS_DESCR
/end CHARACTERISTIC
/begin CHARACTERISTIC mCentFeel_NormCenterFeelTorque_XAU16_31___A "dynamic steering angle dependent factor of center feel torque" CURVE 0x15B3D8 AblGLKLuw 1 TBTHIGH 0 1 FORMAT "%8.6"
 /begin AXIS_DESCR STD_AXIS wApplI_AbsDynSteerAngle_xdu16 SA_10 6 0 15 FORMAT "%8.5" DEPOSIT ABSOLUTE /end AXIS_DESCR
/end CHARACTERISTIC
/begin CHARACTERISTIC mCentFeel_NormCenterFeelTorque_XAU16_32___A "dynamic steering angle dependent factor of center feel torque" CURVE 0x15B3F4 AblGLKLuw 1 TBTHIGH 0 1 FORMAT "%8.6"
 /begin AXIS_DESCR STD_AXIS wApplI_AbsDynSteerAngle_xdu16 SA_10 6 0 15 FORMAT "%8.5" DEPOSIT ABSOLUTE /end AXIS_DESCR
/end CHARACTERISTIC
/begin CHARACTERISTIC mCentFeel_NormCenterFeelTorque_XAU16_33___A "dynamic steering angle dependent factor of center feel torque" CURVE 0x15B410 AblGLKLuw 1 TBTHIGH 0 1 FORMAT "%8.6"
 /begin AXIS_DESCR STD_AXIS wApplI_AbsDynSteerAngle_xdu16 SA_10 6 0 15 FORMAT "%8.5" DEPOSIT ABSOLUTE /end AXIS_DESCR
/end CHARACTERISTIC
/begin CHARACTERISTIC mCentFeel_NormCenterFeelTorque_XAU16_34___A "dynamic steering angle dependent factor of center feel torque" CURVE 0x15B42C AblGLKLuw 1 TBTHIGH 0 1 FORMAT "%8.6"
 /begin AXIS_DESCR STD_AXIS wApplI_AbsDynSteerAngle_xdu16 SA_10 6 0 15 FORMAT "%8.5" DEPOSIT ABSOLUTE /end AXIS_DESCR
/end CHARACTERISTIC
/begin CHARACTERISTIC mCentFeel_NormCenterFeelTorque_XAU16_35___A "dynamic steering angle dependent factor of center feel torque" CURVE 0x15B448 AblGLKLuw 1 TBTHIGH 0 1 FORMAT "%8.6"
 /begin AXIS_DESCR STD_AXIS wApplI_AbsDynSteerAngle_xdu16 SA_10 6 0 15 FORMAT "%8.5" DEPOSIT ABSOLUTE /end AXIS_DESCR
/end CHARACTERISTIC
/begin CHARACTERISTIC mCJC_LimitSteerTorqueOffset_XDU16 "limit of steering torque offset" VALUE 0x1505B4 AblGLKWuw 3 TBTHIGH 0 3 FORMAT "%8.6" /end CHARACTERISTIC
/begin CHARACTERISTIC mCJC_SafetyLimitSteerTorque_XDU16 "Safety limit of steer torque offset" VALUE 0x1505B6 AblGLKWuw 3 TBTHIGH 0 3 FORMAT "%8.6" /end CHARACTERISTIC
/begin CHARACTERISTIC mCrpI_MaxThresholdMotTor_XDU16 "Maximales Schwellenmotordrehmoment" VALUE 0x1505B8 AblGLKWuw 0.0996094 MMOT 0 0.09960938 FORMAT "%9.7" /end CHARACTERISTIC
/begin CHARACTERISTIC mCrpI_MaxThresholdTBT_XDU16 "maximale erlaubte Schwelle für das Verdrehungsbar-Drehmoment" VALUE 0x1505BA AblGLKWuw 0.200195 TBTHIGH 0 0.2001953 FORMAT "%9.7" /end CHARACTERISTIC
/begin CHARACTERISTIC mDMS_CharShiftBorder_XDU16 "Unterhalb dieser Schwelle dï¿½rfen Kennlinien umgeschaltet werden" VALUE 0x1505BC AblGLKWuw 8 TBTHIGH 0 8 FORMAT "%8.6" /end CHARACTERISTIC
/begin CHARACTERISTIC mDSR_EMA_MaxMotorTrq_XDU16 "Maximales EMA Motor Offstemoment" VALUE 0x1505BE AblGLKWuw 0.5 MMOT 0 0.5 FORMAT "%9.7" /end CHARACTERISTIC
/begin CHARACTERISTIC mDSR_EMA_MaxTBTOffset_XDU16 "Maximales EMA Drehstab Offstemoment" VALUE 0x1505C0 AblGLKWuw 5 TBTHIGH 0 5 FORMAT "%8.6" /end CHARACTERISTIC
/begin CHARACTERISTIC mDSR_EMA_MinTBT_XDU16 "Grenzwert des Drehstabmomentes für ein aktives Lenken" VALUE 0x1505C2 AblGLKWuw 12 TBTHIGH 0 12 FORMAT "%8.5" /end CHARACTERISTIC
/begin CHARACTERISTIC mDSR_MaxMotorTrq_XDU16 "Maximales Offstemoment" VALUE 0x1505C4 AblGLKWuw 0.5 MMOT 0 0.5 FORMAT "%9.7" /end CHARACTERISTIC
/begin CHARACTERISTIC mDSR_MaxTBTOffset_XDU16 "Maximales Offstemoment" VALUE 0x1505C6 AblGLKWuw 3 TBTHIGH 0 3 FORMAT "%8.6" /end CHARACTERISTIC
/begin CHARACTERISTIC mDsr_SafetyLimitDSRMotorTorque_XDU16 "Max. Handmomentenoffset DSR Monsafe" VALUE 0x1505C8 AblGLKWuw 0.5 MMOT 0 0.5 FORMAT "%9.7" /end CHARACTERISTIC
/begin CHARACTERISTIC mDsr_SafetyLimitDSRSteerTorque_XDU16 "Max. Handmomentenoffset DSR Monsafe" VALUE 0x1505CA AblGLKWuw 3 TBTHIGH 0 3 FORMAT "%8.6" /end CHARACTERISTIC
/begin CHARACTERISTIC mDsr_SafetyLimitEMAMotorTorque_XDU16 "Max. Handmomentenoffset EMA Monsafe" VALUE 0x1505CC AblGLKWuw 0.5 MMOT 0 0.5 FORMAT "%9.7" /end CHARACTERISTIC
/begin CHARACTERISTIC mDsr_SafetyLimitEMASteerTorque_XDU16 "Max. Handmomentenoffset EMA Monsafe" VALUE 0x1505CE AblGLKWuw 3 TBTHIGH 0 3 FORMAT "%8.6" /end CHARACTERISTIC
/begin CHARACTERISTIC mDsr_SafetyLimitSteerTorque_XDU16 "Max. Handmomentenoffset DSR " VALUE 0x1505D0 AblGLKWuw 5 TBTHIGH 0 5 FORMAT "%8.6" /end CHARACTERISTIC
/begin CHARACTERISTIC mDthrCtrl_CheckHandsOnTorqLim_XDU16 "threshold of driver's steering torque to detect HandsOn" VALUE 0x1505D2 AblGLKWuw 11.5 TBTHIGH 0.5 12 FORMAT "%8.5" /end CHARACTERISTIC
/begin CHARACTERISTIC mDthrCtrl_DeadbandTobato_XDU16 "Totband Torsionbartorque bei d- und d-offset Faktor Korrektur" VALUE 0x1505D4 AblGLKWuw 10 TBTHIGH 0 10 FORMAT "%8.5" /end CHARACTERISTIC
/begin CHARACTERISTIC mDthrCtrl_EslTensionReleaseThres_XDU16 "Reduzierung der mech. Verspannung nach erkanntem Endanschlag" VALUE 0x1505D6 AblGLKWuw 8 MMOT 0 8 FORMAT "%8.6" /end CHARACTERISTIC
/begin CHARACTERISTIC mDthrCtrl_HandTorqueMax_XDU16 "Grenzewert für Handlenkmoment" VALUE 0x1505D8 AblGLKWuw 60 TBTHIGH 0 60 FORMAT "%8.5" /end CHARACTERISTIC
/begin CHARACTERISTIC mDthrCtrl_MaxMotTorqEsSearch_XDU16 "Maximal verwendetes Motormoment bei Endstop einlernen ueber AZG" VALUE 0x1505DA AblGLKWuw 0.700195 MMOT 0 0.7001953 FORMAT "%9.7" /end CHARACTERISTIC
/begin CHARACTERISTIC mDthrCtrl_MotTorqThresholdEsUds_XDU16 "Motormomentschwelle für Endstop Erkennung ueber UDS" VALUE 0x1505DC AblGLKWuw 6 MMOT 0 6 FORMAT "%8.6" /end CHARACTERISTIC
/begin CHARACTERISTIC mDthrCtrl_MotTorqThresholdES_XDU16 "Motormomentschwelle für Endstop Erkennung ueber AZG" VALUE 0x1505DE AblGLKWuw 5 MMOT 0 5 FORMAT "%8.6" /end CHARACTERISTIC
/begin CHARACTERISTIC mDthrCtrl_RotDampMaxMotTorque_XDU16 "Maximaler Motormomentenanteil aus Rotorlagedämpfung" VALUE 0x1505E0 AblGLKWuw 1 MMOT 0 1 FORMAT "%8.6" /end CHARACTERISTIC
/begin CHARACTERISTIC mDTSC_DefaultAdaptiveValueCorner_XDS16 "Defaultwert für den Kalibrierwert. Ist dieser Wert ungleich 0, so wird er anstatt des ermittelten Kalibrierwerts verwendet" VALUE 0x1505E2 AblGLKWsw 2 MMOT -1 1 FORMAT "%8.6" /end CHARACTERISTIC
/begin CHARACTERISTIC mDTSC_DefaultAdaptiveValueStraight_XDS16 "Defaultwert für den Kalibrierwert. Ist dieser Wert ungleich 0, so wird er anstatt des ermittelten Kalibrierwerts verwendet" VALUE 0x1505E4 AblGLKWsw 2 MMOT -1 1 FORMAT "%8.6" /end CHARACTERISTIC
/begin CHARACTERISTIC mDTSC_FadeOutRate_XDU16 "Rate mit der der Motormomentenoffset im Fehlerfall ausgeblendet wird" VALUE 0x1505E6 AblGLKWuw 1 MMOT 0 1 FORMAT "%8.6" /end CHARACTERISTIC
/begin CHARACTERISTIC mDTSC_MaxMonSafeNegGradient_XAU16 "Maximaler negativer Gradient für das Kompensationsmoment" CURVE 0x151040 AblGLKLuw 1 MMOT 0 1 FORMAT "%8.6"
 /begin AXIS_DESCR STD_AXIS vVehSpI_AbsMaxSafeVehSpd_xdu16 VFZHIGH 5 0 410 FORMAT "%8.4" DEPOSIT ABSOLUTE /end AXIS_DESCR
/end CHARACTERISTIC
/begin CHARACTERISTIC mDTSC_MaxMonSafePosGradient_XAU16 "Maximaler positiver Gradient für das Kompensationsmoment" CURVE 0x151058 AblGLKLuw 1 MMOT 0 1 FORMAT "%8.6"
 /begin AXIS_DESCR STD_AXIS vVehSpI_AbsMaxSafeVehSpd_xdu16 VFZHIGH 5 0 410 FORMAT "%8.4" DEPOSIT ABSOLUTE /end AXIS_DESCR
/end CHARACTERISTIC
/begin CHARACTERISTIC mDTSC_MaxNegGradient_XAU16 "Maximaler negativer Gradient für das Kompensationsmoment" CURVE 0x151070 AblGLKLuw 1 MMOT 0 1 FORMAT "%8.6"
 /begin AXIS_DESCR STD_AXIS vVehSpI_AbsMaxSafeVehSpd_xdu16 VFZHIGH 5 0 500 FORMAT "%8.4" DEPOSIT ABSOLUTE /end AXIS_DESCR
/end CHARACTERISTIC
/begin CHARACTERISTIC mDTSC_MaxNegGradient_XDU16 "Maximaler negativer Gradient für das Kompensationsmoment" VALUE 0x1505E8 AblGLKWuw 1 MMOT 0 1 FORMAT "%8.6" /end CHARACTERISTIC
/begin CHARACTERISTIC mDTSC_MaxNegMotorTorqueOffset_XDS16 "Maximaler Motormomentenoffset in negative Richtung" VALUE 0x1505EA AblGLKWsw 2.5 MMOT -2 0.5 FORMAT "%8.6" /end CHARACTERISTIC
/begin CHARACTERISTIC mDTSC_MaxPosGradient_XAU16 "Maximaler positiver Gradient für das Kompensationsmoment" CURVE 0x151088 AblGLKLuw 1 RIGHTSH10NP 0 1 FORMAT "%8.6"
 /begin AXIS_DESCR STD_AXIS vVehSpI_AbsMaxSafeVehSpd_xdu16 VFZHIGH 5 0 500 FORMAT "%8.4" DEPOSIT ABSOLUTE /end AXIS_DESCR
/end CHARACTERISTIC
/begin CHARACTERISTIC mDTSC_MaxPosGradient_XDU16 "Maximaler positiver Gradient für das Kompensationsmoment" VALUE 0x1505EC AblGLKWuw 1 MMOT 0 1 FORMAT "%8.6" /end CHARACTERISTIC
/begin CHARACTERISTIC mDTSC_MaxPosMotorTorqueOffset_XDS16 "Maximaler Motormomentenoffset in positive Richtung" VALUE 0x1505EE AblGLKWsw 2 MMOT 0 2 FORMAT "%8.6" /end CHARACTERISTIC
/begin CHARACTERISTIC mDTSC_MaxSafetyMotorTorq_XDU16 "Max. Motormoment von Seiten Sicherheit" VALUE 0x14A04C AblGLKWuw 1 MMOT 0 1 FORMAT "%8.6" /end CHARACTERISTIC
/begin CHARACTERISTIC mDTSC_MaxTorsionBarTorqueDiff_XDU16 "Maximale Differenz des Drehstabmoments bei der Validierung" VALUE 0x1505F0 AblGLKWuw 10 TBTHIGH 0 10 FORMAT "%8.5" /end CHARACTERISTIC
/begin CHARACTERISTIC mDTSC_MinEffectiveTorque_XDU16 "Minmimal wirkendes Moment für die Berechnung/Validierung des Kalibrierwerts " VALUE 0x1505F2 AblGLKWuw 2 MMOT 0 2 FORMAT "%8.6" /end CHARACTERISTIC
/begin CHARACTERISTIC mDTSC_SafeFadeOutRate_XDU16 "Rate mit der der Motormomentenoffset im Fehlerfall ausgeblendet wird" VALUE 0x1505F4 AblGLKWuw 1 MMOT 0 1 FORMAT "%8.6" /end CHARACTERISTIC
/begin CHARACTERISTIC mEndStopHsd_DontCareMMotTh_XDU16 "MMot that is generally allowed if the sign is correct (opposite to rotorspeed)" VALUE 0x1505F6 AblGLKWuw 0.5 MMOT 0 0.5 FORMAT "%9.7" /end CHARACTERISTIC
/begin CHARACTERISTIC mEndStopHsd_MaxAllwdMMotVHigh_XDU16 "Max allowed damping torque at high speeds" VALUE 0x1505F8 AblGLKWuw 12 MMOT 0 12 FORMAT "%8.5" /end CHARACTERISTIC
/begin CHARACTERISTIC mEndStopHsd_MaxAllwdMMotVLow_XDU16 "Max allowed damping torque at low speeds" VALUE 0x1505FA AblGLKWuw 12 MMOT 0 12 FORMAT "%8.5" /end CHARACTERISTIC
/begin CHARACTERISTIC mEndStopHsd_MaxMotorTorque_FirstP_XDU16 "Monitoring: Maximales Motormoment wenn DistanceToEndStop <= erste Stuetzstelle von mEndStopHsd_MaxMotorTorque_XAS16" VALUE 0x1505FC AblGLKWuw 6 MMOT 0 6 FORMAT "%8.6" /end CHARACTERISTIC
/begin CHARACTERISTIC mEndStopHsd_MaxMotorTorque_LastP_XDU16 "Monitoring: Maximales Motormoment wenn DistanceToEndStop >= letzte Stuetzstelle von mEndStopHsd_MaxMotorTorque_XAS16" VALUE 0x1505FE AblGLKWuw 6 MMOT 0 6 FORMAT "%8.6" /end CHARACTERISTIC
/begin CHARACTERISTIC mEndStopHsd_MaxMotorTorque_XAS16 "Saturation: Maximales Daempfungsmoment bei hoher Drehzahl abhaengig von DistanceToEndstop" CURVE 0x1510A0 AblGLKLsw 6 MMOT 0 6 FORMAT "%8.6"
 /begin AXIS_DESCR STD_AXIS lEndStopHsd_InternDistToESCheck_xds16 RACKPOS128 3 0 125 FORMAT "%8.4" DEPOSIT ABSOLUTE /end AXIS_DESCR
/end CHARACTERISTIC
/begin CHARACTERISTIC mEndStop_LimitDamping_XDU16 "max. Dämpfungsmoment beim Rauslenken vom Endanschlag" VALUE 0x150600 AblGLKWuw 8 MMOT 0 8 FORMAT "%8.6" /end CHARACTERISTIC
/begin CHARACTERISTIC mEndStop_MaxTorquePointingOutwards_XDU16 "max. EndStop-Moment in Richtung Endanschlag (Dämpfung ermöglichen)" VALUE 0x150602 AblGLKWuw 2 MMOT 0 2 FORMAT "%8.6" /end CHARACTERISTIC
/begin CHARACTERISTIC mEndStop_oMaxDamping_XDU16_0___A "max. Daempfungsmoment" VALUE 0x1580AC AblGLKWuw 10 MMOT 0 10 FORMAT "%8.5" /end CHARACTERISTIC
/begin CHARACTERISTIC mEndStop_oMaxDamping_XDU16_1___A "max. Daempfungsmoment" VALUE 0x1580AE AblGLKWuw 10 MMOT 0 10 FORMAT "%8.5" /end CHARACTERISTIC
/begin CHARACTERISTIC mEndStop_oMaxDamping_XDU16_2___A "max. Daempfungsmoment" VALUE 0x1580B0 AblGLKWuw 10 MMOT 0 10 FORMAT "%8.5" /end CHARACTERISTIC
/begin CHARACTERISTIC mEndStop_oMaxDamping_XDU16_3___A "max. Daempfungsmoment" VALUE 0x1580B2 AblGLKWuw 10 MMOT 0 10 FORMAT "%8.5" /end CHARACTERISTIC
/begin CHARACTERISTIC mEndStop_oMaxDamping_XDU16_4___A "max. Daempfungsmoment" VALUE 0x1580B4 AblGLKWuw 10 MMOT 0 10 FORMAT "%8.5" /end CHARACTERISTIC
/begin CHARACTERISTIC mEndStop_oMaxDamping_XDU16_5___A "max. Daempfungsmoment" VALUE 0x1580B6 AblGLKWuw 10 MMOT 0 10 FORMAT "%8.5" /end CHARACTERISTIC
/begin CHARACTERISTIC mEndStop_SpringTorque_XAS16_0___A "Feder Moment Endanschlag" CURVE 0x15B464 AblGLKLsw 23.999 MMOT 0 23.99902 FORMAT "%8.5"
 /begin AXIS_DESCR STD_AXIS lEndStopI_DistanceToEndstop_xds16 RACKPOS128 5 -8 12 FORMAT "%8.5" DEPOSIT ABSOLUTE /end AXIS_DESCR
/end CHARACTERISTIC
/begin CHARACTERISTIC mEndStop_SpringTorque_XAS16_1___A "Feder Moment Endanschlag" CURVE 0x15B47C AblGLKLsw 23.999 MMOT 0 23.99902 FORMAT "%8.5"
 /begin AXIS_DESCR STD_AXIS lEndStopI_DistanceToEndstop_xds16 RACKPOS128 5 -8 12 FORMAT "%8.5" DEPOSIT ABSOLUTE /end AXIS_DESCR
/end CHARACTERISTIC
/begin CHARACTERISTIC mEndStop_SpringTorque_XAS16_2___A "Feder Moment Endanschlag" CURVE 0x15B494 AblGLKLsw 23.999 MMOT 0 23.99902 FORMAT "%8.5"
 /begin AXIS_DESCR STD_AXIS lEndStopI_DistanceToEndstop_xds16 RACKPOS128 5 -8 12 FORMAT "%8.5" DEPOSIT ABSOLUTE /end AXIS_DESCR
/end CHARACTERISTIC
/begin CHARACTERISTIC mEndStop_SpringTorque_XAS16_3___A "Feder Moment Endanschlag" CURVE 0x15B4AC AblGLKLsw 23.999 MMOT 0 23.99902 FORMAT "%8.5"
 /begin AXIS_DESCR STD_AXIS lEndStopI_DistanceToEndstop_xds16 RACKPOS128 5 -8 12 FORMAT "%8.5" DEPOSIT ABSOLUTE /end AXIS_DESCR
/end CHARACTERISTIC
/begin CHARACTERISTIC mEndStop_SpringTorque_XAS16_4___A "Feder Moment Endanschlag" CURVE 0x15B4C4 AblGLKLsw 23.999 MMOT 0 23.99902 FORMAT "%8.5"
 /begin AXIS_DESCR STD_AXIS lEndStopI_DistanceToEndstop_xds16 RACKPOS128 5 -8 12 FORMAT "%8.5" DEPOSIT ABSOLUTE /end AXIS_DESCR
/end CHARACTERISTIC
/begin CHARACTERISTIC mEndStop_SpringTorque_XAS16_5___A "Feder Moment Endanschlag" CURVE 0x15B4DC AblGLKLsw 23.999 MMOT 0 23.99902 FORMAT "%8.5"
 /begin AXIS_DESCR STD_AXIS lEndStopI_DistanceToEndstop_xds16 RACKPOS128 5 -8 12 FORMAT "%8.5" DEPOSIT ABSOLUTE /end AXIS_DESCR
/end CHARACTERISTIC
/begin CHARACTERISTIC mEndStop_uMotorTorque_XDU16 "Einlernbedingung: Minimales Motormoment fuer fertig gelernt" VALUE 0x150604 AblGLKWuw 10 MMOT 0 10 FORMAT "%8.5" /end CHARACTERISTIC
/begin CHARACTERISTIC mEndStop_uSpringTorque_XDU16 "Maximale Federkraft für Einlernen der Endstops" VALUE 0x150606 AblGLKWuw 15 MMOT 0 15 FORMAT "%8.5" /end CHARACTERISTIC
/begin CHARACTERISTIC mEndStop_uTBTLearn_XDU16 "Einlernbedingung: Minimales Handmoment" VALUE 0x150608 AblGLKWuw 15 TBTHIGH 0 15 FORMAT "%8.5" /end CHARACTERISTIC
/begin CHARACTERISTIC nCrpI_MaxThresholdRotorSpeed_XDU16 "Rotor-Geschwindigkeitsschwelle für die Wiederkalibrierungsstrategie" VALUE 0x1506CC AblGLKWuw 5 VROT 0 5 /end CHARACTERISTIC
/begin CHARACTERISTIC ncruAbsChatterGrad_XDU16 "minimum rotor acceleration to activation the Chatter detection" VALUE 0x1506CE AblGLKWuw 299 ROTACC 1 300 FORMAT "%8.4" /end CHARACTERISTIC
/begin CHARACTERISTIC nEndStopHsdCheck_HighSpeedDampingStart_XAS16 "Drehzahl ab welcher die 'HighSpeed' Daempfung beginnt" CURVE 0x151458 AblGLKLsw 5000 VROT 0 5000 FORMAT "%3.0"
 /begin AXIS_DESCR STD_AXIS lEndStopHsd_InternDistToESCheck_xds16 RACKPOS128 3 0 125 FORMAT "%8.4" DEPOSIT ABSOLUTE /end AXIS_DESCR
/end CHARACTERISTIC
/begin CHARACTERISTIC nEndStopHsd_HighSpeedDampingStartReverse_XAS16 "Drehzahl ab welcher die 'HighSpeed' Daempfung beginnt beim Rueckwaertsfahren" CURVE 0x151468 AblGLKLsw 5000 VROT 0 5000 FORMAT "%3.0"
 /begin AXIS_DESCR STD_AXIS lEndStopHsd_InternDistToES_xds16 RACKPOS128 3 0 125 FORMAT "%8.4" DEPOSIT ABSOLUTE /end AXIS_DESCR
/end CHARACTERISTIC
/begin CHARACTERISTIC nEndStopHsd_HighSpeedDampingStart_XAS16 "Drehzahl ab welcher die 'HighSpeed' Daempfung beginnt" CURVE 0x151478 AblGLKLsw 5000 VROT 0 5000 FORMAT "%3.0"
 /begin AXIS_DESCR STD_AXIS lEndStopHsd_InternDistToES_xds16 RACKPOS128 3 0 125 FORMAT "%8.4" DEPOSIT ABSOLUTE /end AXIS_DESCR
/end CHARACTERISTIC
/begin CHARACTERISTIC nEndStopHsd_MinNeededRotSpdVHigh_XDU16 "At high speeds damping torque is only allowed above this value" VALUE 0x1506D0 AblGLKWuw 5000 VROT 0 5000 FORMAT "%3.0" /end CHARACTERISTIC
/begin CHARACTERISTIC nEndStopHsd_MinNeededRotSpdVLow_XDU16 "At low speeds damping torque is only allowed above this value" VALUE 0x1506D2 AblGLKWuw 5000 VROT 0 5000 FORMAT "%3.0" /end CHARACTERISTIC
/begin CHARACTERISTIC nEndStopHsd_MinRotSpd_XDU16 "Monitoring: Kleinste Drehzahl ab welcher die 'HighSpeed' Daempfung aktiv sein darf" VALUE 0x1506D4 AblGLKWuw 5000 VROT 0 5000 FORMAT "%3.0" /end CHARACTERISTIC
/begin CHARACTERISTIC nEndStopHsd_RotSpeedFallingHysteresisReverse_XAU16 "Hysterese auf Eingangsdrehzahl beim Rueckwaertsfahren" CURVE 0x151488 AblGLKLuw 5000 VROT 0 5000 FORMAT "%3.0"
 /begin AXIS_DESCR STD_AXIS vApplI_AbsVehicleSpeedFilt_xdu16 VFZHIGH 3 0 500 FORMAT "%8.4" DEPOSIT ABSOLUTE /end AXIS_DESCR
/end CHARACTERISTIC
/begin CHARACTERISTIC nEndStopHsd_RotSpeedFallingHysteresis_XAU16 "Hysterese auf Eingangsdrehzahl" CURVE 0x151498 AblGLKLuw 5000 VROT 0 5000 FORMAT "%3.0"
 /begin AXIS_DESCR STD_AXIS vApplI_AbsVehicleSpeedFilt_xdu16 VFZHIGH 3 0 500 FORMAT "%8.4" DEPOSIT ABSOLUTE /end AXIS_DESCR
/end CHARACTERISTIC
/begin CHARACTERISTIC nEndStopHsd_UnderVoltageStartOffset_XAU16 "Drehzahl um die die Startdrehzahl bei Unterspannung reduziert wird" CURVE 0x1514A8 AblGLKLuw 5000 VROT 0 5000 FORMAT "%3.0"
 /begin AXIS_DESCR STD_AXIS uApplI_SupplyVoltage_xdu16 U64V 3 0 20 FORMAT "%8.5" DEPOSIT ABSOLUTE /end AXIS_DESCR
/end CHARACTERISTIC
/begin CHARACTERISTIC nEndStopHsd_UndervoltOffset_XDU16 "Offset to allow high speed damping at lower rotorspeeds in undervoltage situations" VALUE 0x1506D6 AblGLKWuw 5000 VROT 0 5000 FORMAT "%3.0" /end CHARACTERISTIC
/begin CHARACTERISTIC nEndStop_oRotSpeedLearnFinished_XDU16 "Einlernbedingung: Maximale Rotordrehzahl fuer fertig gelernt" VALUE 0x1506D8 AblGLKWuw 2000 VROT 0 2000 FORMAT "%3.0" /end CHARACTERISTIC
/begin CHARACTERISTIC nEndStop_oRotSpeedLearn_XDU16 "Einlernbedingung: Maximale Rotordrehzahl" VALUE 0x1506DA AblGLKWuw 2000 VROT 0 2000 FORMAT "%3.0" /end CHARACTERISTIC
/begin CHARACTERISTIC nEndStop_oRotSpeedRedSpringTorque_XDU16 "Maximale Rotordrehzahl für Reduzierung Federmoment wenn Lernstatus =2" VALUE 0x1506DC AblGLKWuw 500 VROT 0 500 FORMAT "%3.0" /end CHARACTERISTIC
/begin CHARACTERISTIC nEngRn_EngineNotRunning_XDU16 "Motordrehzahl für den Wechsel aus dem Status EngineRunning oder EngineRunningStable in den Status EngineNotRunning" VALUE 0x1506DE AblGLKWuw 16000 VENG 0 16000 FORMAT "%8.2" /end CHARACTERISTIC
/begin CHARACTERISTIC nEngRn_EngineRunning_XDU16 "Motordrehzahl für den Wechsel aus dem Status EngineNotRunning in den Status EngineRunning oder EngineRunningStable" VALUE 0x1506E0 AblGLKWuw 16000 VENG 0 16000 FORMAT "%8.2" /end CHARACTERISTIC
/begin CHARACTERISTIC NvData_DMSActCharacteresiticValue "NvData_DMSActCharacteresiticValue" VALUE 0x150AFD AblGLKWub 1 ZU0 0 1 FORMAT "%5.3" /end CHARACTERISTIC
/begin CHARACTERISTIC qDsd_FreqFilt_anvYaw_XDF32 "Filterkonstante [Hz]" VALUE 0x150418 AblGLKWfl4 100 ZU0 0 100 FORMAT "%10.6" /end CHARACTERISTIC
/begin CHARACTERISTIC qDsd_YawRef_a_freq_XDF32 "Eigenfrequenz Funktionsparameter A für ausgewogenes Modell" VALUE 0x15041C AblGLKWfl4 100 ZU0 0 100 FORMAT "%10.6" /end CHARACTERISTIC
/begin CHARACTERISTIC qDsd_YawRef_b_freq_XDF32 "Eigenfrequenz Funktionsparameter B für ausgewogenes Modell" VALUE 0x150420 AblGLKWfl4 100 ZU0 0 100 FORMAT "%10.6" /end CHARACTERISTIC
/begin CHARACTERISTIC qDsd_YawRef_c_freq_XDF32 "Eigenfrequenz Funktionsparameter C für ausgewogenes Modell" VALUE 0x150424 AblGLKWfl4 100 ZU0 0 100 FORMAT "%10.6" /end CHARACTERISTIC
/begin CHARACTERISTIC qDsd_YawRef_freqFilt_XDF32 "PT1 auf psip_ay [Hz]" VALUE 0x150428 AblGLKWfl4 100 ZU0 0 100 FORMAT "%10.6" /end CHARACTERISTIC
/begin CHARACTERISTIC qDSR_LowPassCutOffFrequency_XDU8 "Grenzfrequenz des Tiefpass PT1 Filters von TBT und SASpeed in ActiveSteeringDetection" VALUE 0x150AFF AblGLKWub 25 RIGHTSH2NP 3 28 FORMAT "%5.2" /end CHARACTERISTIC
/begin CHARACTERISTIC sChatterSnsr_ConfigFlag_XDU8 "To activate /deactivate chattersensor mode and chatter sensor Disabled = 0,APC check enabled = 1,LKA check enabled = 2,LDW check enabled = 4" VALUE 0x150B01 AblGLKWub 15 ZU0 0 15 FORMAT "%5.2" /end CHARACTERISTIC
/begin CHARACTERISTIC sDMS_ConfigMain_XDU8 "Configuration variable to configure: Bit 0 - SteeringAngleSpeed - ; Bit 1 - UDS request; Bit 2 - BatteryOffOn Check; Bit 3 - Retain Chracteristic; Bit 4 - Mode transisition Failed MONID; Bit 5 - Special Mode based on LKA Torque Overlay; Bit 6 - No Special" VALUE 0x150B02 AblGLKWub 255 ZU0 0 255 FORMAT "%5.1" /end CHARACTERISTIC
/begin CHARACTERISTIC sDMS_DefaultVehicleModeTable_XAU8 "Array of vehicle drive mode" VAL_BLK 0x151AF8 AblGLKWBub 255 ZU0 0 255 NUMBER 15 FORMAT "%5.1" /end CHARACTERISTIC
/begin CHARACTERISTIC sDMS_MaxUserSelectedMode_XDU8 "The max valid value of UserSelectedMode" VALUE 0x150B03 AblGLKWub 255 ZU0 0 255 FORMAT "%5.1" /end CHARACTERISTIC
/begin CHARACTERISTIC sDrvTorque_UseDynSteerAngle_XDU8 "(0): use wApplI_DynSteerAngle_xds16; (1): use internal calculated DynSteerAngle (out of RotorPosition)" VALUE 0x150B04 AblGLKWub 1 ZU0 0 1 FORMAT "%5.3" /end CHARACTERISTIC
/begin CHARACTERISTIC sDSR_RecErrortoInactive_XDU8 "Maximales Gradient bei Fehler" VALUE 0x150B05 AblGLKWub 1 ZU0 0 1 FORMAT "%5.3" /end CHARACTERISTIC
/begin CHARACTERISTIC sDthrCtrl_Request_XDU8 "DitherControl Xcp Request (0=Set Off, 1=Set On, 255=No impact/UDS is used)" VALUE 0x150B06 AblGLKWub 255 ZU0 0 255 FORMAT "%5.1" /end CHARACTERISTIC
/begin CHARACTERISTIC sDthrCtrl_StateRequest_XDU8 "DitherControl Xcp State Request (0=IdxLearn, 1=MidHold, 2=EsLearn AZG, 3=EsLearn UDS)" VALUE 0x150B07 AblGLKWub 3 ZU0 0 3 FORMAT "%5.3" /end CHARACTERISTIC
/begin CHARACTERISTIC sDTSC_ConfigFlagsMainActivErr_XDU16 " Belegung siehe TL oder ...; einzelne Fehler aktiv / aus setzen " VALUE 0x1506FE AblGLKWuw 32768 ZU0 0 32768 FORMAT "%8.2" /end CHARACTERISTIC
/begin CHARACTERISTIC tcnCycleTime_EPS_HSC_FrP00_XDU16 "Zykluszeit der EPS_HSC_FrP00 Botschaft (in ms)" VALUE 0x14A078 AblGLKWuw 14990 ZU0 10 15000 FORMAT "%8.2" /end CHARACTERISTIC
/begin CHARACTERISTIC tcrChatterCycleResetDelay_XDU16 "hold chatter cycle counter for this time to the value of MinChatterPeriodsCountDelayed" VALUE 0x150744 AblGLKWuw 59.999 TIMSEC_1000 0.001 60 FORMAT "%8.5" /end CHARACTERISTIC
/begin CHARACTERISTIC tcroChatterTime_XDU8 "maximum time until next half period of rotor acceleration must be detected" VALUE 0x150B25 AblGLKWub 0.253 TIMSEC_1000 0.001 0.254 FORMAT "%6.4" /end CHARACTERISTIC
/begin CHARACTERISTIC tCrpI_MinConditionTime_XDU8 "Liegezeit für die Bedingung" VALUE 0x150B26 AblGLKWub 2 TIMMS 3 5 FORMAT "%5.3" /end CHARACTERISTIC
/begin CHARACTERISTIC tDMS_CycleTime_XDU8 "DMS Zykluszeit [ms]" VALUE 0x150B27 AblGLKWub 99 TIMMS 1 100 FORMAT "%5.1" /end CHARACTERISTIC
/begin CHARACTERISTIC tDMS_HandsOffTime_XDU16 "" VALUE 0x150746 AblGLKWuw 5000 TIMMS 0 5000 FORMAT "%8.3" /end CHARACTERISTIC
/begin CHARACTERISTIC tDMS_HandsOnTime_XDU16 "" VALUE 0x150748 AblGLKWuw 2000 TIMMS 0 2000 FORMAT "%8.3" /end CHARACTERISTIC
/begin CHARACTERISTIC tDMS_SpecialModeQuitTime_XDU16 "" VALUE 0x15074A AblGLKWuw 10000 TIMMS 0 10000 FORMAT "%8.2" /end CHARACTERISTIC
/begin CHARACTERISTIC tDMS_SteeringAngleSpeedInRange_XDU16 "" VALUE 0x15074C AblGLKWuw 10000 TIMMS 0 10000 FORMAT "%8.2" /end CHARACTERISTIC
/begin CHARACTERISTIC tDMS_UserSelectedModeVerifyTime_XDU16 "" VALUE 0x15074E AblGLKWuw 10000 TIMMS 0 10000 FORMAT "%8.2" /end CHARACTERISTIC
/begin CHARACTERISTIC tDMS_VehicleSpeedInRange_XDU16 "" VALUE 0x150750 AblGLKWuw 10000 TIMMS 0 10000 FORMAT "%8.2" /end CHARACTERISTIC
/begin CHARACTERISTIC tDrvExit_CycleCounter_XDU16 "" VALUE 0x150752 AblGLKWuw 5000 TIMMS 0 5000 FORMAT "%8.3" /end CHARACTERISTIC
/begin CHARACTERISTIC tDrvExit_MaxTimeRetryShutdown_XDU16 "" VALUE 0x150754 AblGLKWuw 5000 TIMMS 0 5000 FORMAT "%8.3" /end CHARACTERISTIC
/begin CHARACTERISTIC tDsd_YawRef_Ts_XDF32 "Abtastzeit [s]" VALUE 0x15042C AblGLKWfl4 1 ZU0 0 1 FORMAT "%10.8" /end CHARACTERISTIC
/begin CHARACTERISTIC tDthrCtrl_CenterPositionHoldTime_XDU8 "Center position tolerance after Endstop Learning [s]" VALUE 0x150756 AblGLKWuw 0.9 TIMSEC 0.1 1 FORMAT "%8.6" /end CHARACTERISTIC
/begin CHARACTERISTIC tDthrCtrl_CheckHandsOnSwOffTime_XDU16 "detection time for HandsOn" VALUE 0x150758 AblGLKWuw 990 TIMMS 10 1000 FORMAT "%8.3" /end CHARACTERISTIC
/begin CHARACTERISTIC tDthrCtrl_HandsOnTime_XDU16 "Erkennungzeit für Hands-On-Überwachung" VALUE 0x15075A AblGLKWuw 990 TIMMS 10 1000 FORMAT "%8.3" /end CHARACTERISTIC
/begin CHARACTERISTIC tDthrCtrl_MidhMaxRackforceTime_XDU16 "Wert für das Abbruchkriterium Zeitspanne Zahnstangekraft" VALUE 0x15075C AblGLKWuw 29990 TIMMS 10 30000 FORMAT "%8.2" /end CHARACTERISTIC
/begin CHARACTERISTIC tDthrCtrl_NvMStatusCheckTime_XDU16 "NvM Status check time" VALUE 0x15075E AblGLKWuw 2.9 TIMSEC 0.1 3 FORMAT "%8.6" /end CHARACTERISTIC
/begin CHARACTERISTIC tDthrCtrl_Steptime_XDU8 "Zeitschrittweite" VALUE 0x150B28 AblGLKWub 0.249 TIMSEC_1000 0.001 0.25 FORMAT "%6.4" /end CHARACTERISTIC
/begin CHARACTERISTIC tDthrCtrl_TargetCorridorReachedDelay_XDU16 "Zeit im Zielkorridor bis 'Ziel-erreicht-Flag' gesetzt wird" VALUE 0x150760 AblGLKWuw 60 TIMSEC_1000 0 60 FORMAT "%8.5" /end CHARACTERISTIC
/begin CHARACTERISTIC tEndStopHsd_SpeedTooHighTol_XDU16 "Zeit in der ein Ueberschreiten des Geschwindigkeitsgrenzwerts toleriert wird, bevor Rueckwaertsfahrt abgebrochen wird" VALUE 0x150762 AblGLKWuw 4.999 TIMSEC_1000 0.001 5 FORMAT "%8.6" /end CHARACTERISTIC
/begin CHARACTERISTIC tEndStopHsd_VehDirDebounceTime_XDU16 "Zeitliche Entprellung des Rueckfahrflags von Rueckwaerts- auf Vorwaertsfahrt" VALUE 0x150764 AblGLKWuw 9.999 TIMSEC_1000 0.001 10 FORMAT "%8.5" /end CHARACTERISTIC
/begin CHARACTERISTIC tEndStop_DebounceTimeLearnFin_XDU8 "Entprellzeit, fuer die die Bedienungen beim Fertig-Lernen gehalten werden müssen." VALUE 0x150B29 AblGLKWub 249 TIMMS 1 250 FORMAT "%5.1" /end CHARACTERISTIC
/begin CHARACTERISTIC tEndStop_MaxTimeIncrDamping_XDU8 "Max. Zeit fuer erhöhte Daempfung (nicht-überlenkbarer ES); [value = durationtime / task cycle time]" VALUE 0x150B2A AblGLKWub 100 TIMMS 0 100 FORMAT "%5.1" /end CHARACTERISTIC
/begin CHARACTERISTIC tEngRn_Running2Stable_XDU16 "Zeit für den Wechsel aus dem Status EngineRunning in den Status EngineRunningStable" VALUE 0x150766 AblGLKWuw 10000 TIMMS_10 0 10000 FORMAT "%8.2" /end CHARACTERISTIC
/begin CHARACTERISTIC tEngRn_Stable2NotRunning_XDU16 "Zeit für den Wechsel aus dem Status EngineRunningStable in den Status EngineNotRunning" VALUE 0x150768 AblGLKWuw 10000 TIMMS_10 0 10000 FORMAT "%8.2" /end CHARACTERISTIC
/begin CHARACTERISTIC uds_HighVoltForCalib_XDU16 "Grenzwert Unterspannungsschwelle verlassen" VALUE 0x15080A AblGLKWuw 30 U64V 0 30 FORMAT "%8.5" /end CHARACTERISTIC
/begin CHARACTERISTIC uds_HighVoltForDither_XDU16 "Grenzwert Unterspannungsschwelle verlassen" VALUE 0x15080C AblGLKWuw 30 U64V 0 30 FORMAT "%8.5" /end CHARACTERISTIC
/begin CHARACTERISTIC uds_LowVoltForCalib_XDU16 "Grenzwert Unterspannungsschwelle verlassen" VALUE 0x15080E AblGLKWuw 15 U64V 0 15 FORMAT "%8.5" /end CHARACTERISTIC
/begin CHARACTERISTIC uds_LowVoltForDither_XDU16 "Grenzwert Unterspannungsschwelle verlassen" VALUE 0x150810 AblGLKWuw 30 U64V 0 30 FORMAT "%8.5" /end CHARACTERISTIC
/begin CHARACTERISTIC uds_MaxWaitTimeForNvmWrite_XDU8 "maximale Fahrzeuggeschwindigkeit fÃ¼r UDS" VALUE 0x150B43 AblGLKWub 100 ZU0 0 100 FORMAT "%5.1" /end CHARACTERISTIC
/begin CHARACTERISTIC uds_TBTTuning_XDU16 "max TBT fÃ¼r UDS" VALUE 0x150812 AblGLKWuw 7 TBTHIGH 0 7 FORMAT "%8.6" /end CHARACTERISTIC
/begin CHARACTERISTIC uds_VehSpeedTuning_XDU8 "maximale Fahrzeuggeschwindigkeit fÃ¼r UDS" VALUE 0x150B44 AblGLKWub 100 ZU0 0 100 FORMAT "%5.1" /end CHARACTERISTIC
/begin CHARACTERISTIC uEndStopHsd_ApplyUOffsetTh_XDU16 "Voltage threshold under which to apply the additional rotorspeed offset" VALUE 0x150814 AblGLKWuw 33 U64V 0 33 FORMAT "%8.5" /end CHARACTERISTIC
/begin CHARACTERISTIC vBci_SafetyLimiterMinSpeed_XDU16 "Geschwindigkeitsschwelle, ab der die Limitierung gegen zu leichtgängiges Lenken wirkt" VALUE 0x150834 AblGLKWuw 500 VFZHIGH 0 500 FORMAT "%8.4" /end CHARACTERISTIC
/begin CHARACTERISTIC vcrChatterSensr_MaxRackSpeed4RecoverDController_XDU16 "Abs. Max Rack Speed for Recover D Controller [mm/s]" VALUE 0x15083A AblGLKWuw 20 RACKSPEED128 0 20 FORMAT "%8.5" /end CHARACTERISTIC
/begin CHARACTERISTIC vcrChatterSensr_MaxVehicleSpeed4RecoverDController_XDU16 "maximum allowed vehicle speed for Recover D Controller [km/h]" VALUE 0x15083C AblGLKWuw 180 VFZHIGH 0 180 FORMAT "%8.4" /end CHARACTERISTIC
/begin CHARACTERISTIC vcrChatterSensr_VehicleSpeedLA_XDU16 "ChatterSensr vehicle speed LA" VALUE 0x15083E AblGLKWuw 150 VFZHIGH 0 150 FORMAT "%8.4" /end CHARACTERISTIC
/begin CHARACTERISTIC vcrVehSpeedLimit_XDU16_0__A "minimum vahicle speed to start the holding timer" VALUE 0x158190 AblGLKWuw 255 VFZHIGH 0 255 FORMAT "%8.4" /end CHARACTERISTIC
/begin CHARACTERISTIC vcrVehSpeedLimit_XDU16_1__A "minimum vahicle speed to start the holding timer" VALUE 0x158192 AblGLKWuw 255 VFZHIGH 0 255 FORMAT "%8.4" /end CHARACTERISTIC
/begin CHARACTERISTIC vcrVehSpeedLimit_XDU16_2__A "minimum vahicle speed to start the holding timer" VALUE 0x158194 AblGLKWuw 255 VFZHIGH 0 255 FORMAT "%8.4" /end CHARACTERISTIC
/begin CHARACTERISTIC vcrVehSpeedLimit_XDU16_3__A "minimum vahicle speed to start the holding timer" VALUE 0x158196 AblGLKWuw 255 VFZHIGH 0 255 FORMAT "%8.4" /end CHARACTERISTIC
/begin CHARACTERISTIC vDMS_SteeringAngleSpeedBorder_XDU16 "" VALUE 0x150840 AblGLKWuw 1500 SAS_8 0 1500 FORMAT "%8.3" /end CHARACTERISTIC
/begin CHARACTERISTIC vDMS_VehSpeedBorder_XDU16 "Fahrzeuggeschw.-Schwelle unterhalb der eine Fahrprogrammumschaltung unabh. vom Lenkwinkel ausgefÃ¼hrt wird" VALUE 0x150842 AblGLKWuw 500 VFZHIGH 0 500 FORMAT "%8.4" /end CHARACTERISTIC
/begin CHARACTERISTIC vDsd_MaxDeltaYawSpeed_SK_XDF32 "Gradientenbegrenzung Gierrate (steigend) [°/s/10ms]" VALUE 0x150434 AblGLKWfl4 0.45 ZU0 0 0.45 FORMAT "%11.9" /end CHARACTERISTIC
/begin CHARACTERISTIC vDsd_MaxRollAngleSpeed_SK_XDF32 "Gradientenbegrenzung Wankwinkel/Querneigung (steigend) [°/10ms]" VALUE 0x150438 AblGLKWfl4 0.45 ZU0 0 0.45 FORMAT "%11.9" /end CHARACTERISTIC
/begin CHARACTERISTIC vDsd_Threshold_anvYaw_XAF32 "Parameter Threshold Calculation für Gierraten" CURVE 0x150C50 AblGLKLfl4 1 ZU0 0 1 FORMAT "%10.8"
 /begin AXIS_DESCR STD_AXIS vDsd_velVehPT1_xdf32 ZU0 7 0 255 FORMAT "%10.6" DEPOSIT ABSOLUTE /end AXIS_DESCR
/end CHARACTERISTIC
/begin CHARACTERISTIC vDsd_Th_DeltaYaw_SK_XDF32 "Schwellwert Gierratendifferenz für Aktivierung Steilkurvenerkennung [°/s]" VALUE 0x15043C AblGLKWfl4 45 ZU0 0 45 FORMAT "%10.7" /end CHARACTERISTIC
/begin CHARACTERISTIC vDsd_Th_RollAngleSpeed_SK_XDF32 "Schwellwert Wankwinkelgeschwindigkeit (steigend) für Aktivierung Steilkurvenerkennung [°/s]" VALUE 0x150440 AblGLKWfl4 45 ZU0 0 45 FORMAT "%10.7" /end CHARACTERISTIC
/begin CHARACTERISTIC vDsd_Th_YawHyst_XDF32 "Differenz auf Einstiegsschwelle als Hysterese" VALUE 0x150444 AblGLKWfl4 1 ZU0 0 1 FORMAT "%10.8" /end CHARACTERISTIC
/begin CHARACTERISTIC vDsd_Th_Yaw_OS_XDF32 "Schwelle Gierrate Übersteuern [rad/s]" VALUE 0x150448 AblGLKWfl4 1 ZU0 0 1 FORMAT "%10.8" /end CHARACTERISTIC
/begin CHARACTERISTIC vDsd_Th_Yaw_US_XDF32 "Schwelle Gierrate Untersteuern [rad/s]" VALUE 0x15044C AblGLKWfl4 1 ZU0 0 1 FORMAT "%10.8" /end CHARACTERISTIC
/begin CHARACTERISTIC vDsd_VelVeh_Init_XDF32 "Init Fahrzeuggeschwindigkeit [m/s]" VALUE 0x150450 AblGLKWfl4 15 ZU0 0 15 FORMAT "%10.7" /end CHARACTERISTIC
/begin CHARACTERISTIC vDsd_VelVeh_max_XDF32 "max. Fahrzeuggeschwindigkeit [m/s]" VALUE 0x150454 AblGLKWfl4 70 ZU0 0 70 FORMAT "%10.7" /end CHARACTERISTIC
/begin CHARACTERISTIC vDSR_EMA_MinSteeringAngleSpeed_XDU16 "Grenzwert der Lenkwinkelgeschwindigkeit für ein aktives Lenken" VALUE 0x150844 AblGLKWuw 360 SAS_8 0 360 FORMAT "%8.4" /end CHARACTERISTIC
/begin CHARACTERISTIC vDthrCtrl_DeadBandRackSpeed_XDU16 "Totband Zahnstangengeschwindigkeit  [mm/s]" VALUE 0x150846 AblGLKWuw 100 RACKSPEED128 0 100 FORMAT "%8.4" /end CHARACTERISTIC
/begin CHARACTERISTIC vDthrCtrl_EslLockSpeedTresh_XDU8 "ES Lernbedingung Zahnstangengeschwindigkeit unter Schwelle" VALUE 0x150B45 AblGLKWub 1.5 RACKSPEED128 0 1.5 FORMAT "%5.3" /end CHARACTERISTIC
/begin CHARACTERISTIC vDthrCtrl_ESLLockSpeed_XDU16 "Zahnstangengeschwindigkeit bei langsamer Annäherung an Endstop" VALUE 0x150848 AblGLKWuw 30 RACKSPEED128 0 30 FORMAT "%8.5" /end CHARACTERISTIC
/begin CHARACTERISTIC vDthrCtrl_ESLRackSpeedFine_XDU16 "Zahnstangengeschwindigkeit bei exakter Indexsuche für ES" VALUE 0x15084A AblGLKWuw 100 RACKSPEED128 0 100 FORMAT "%8.4" /end CHARACTERISTIC
/begin CHARACTERISTIC vDthrCtrl_ESLRackSpeed_XDU16 "Zahnstangengeschwindigkeit bei Indexsuche für ES" VALUE 0x15084C AblGLKWuw 150 RACKSPEED128 0 150 FORMAT "%8.4" /end CHARACTERISTIC
/begin CHARACTERISTIC vDthrCtrl_IDFAngleSpeed_XDU16 "Lenkwinkelgeschwindigkeit bei Index anlernen (10ms Abtastung)" VALUE 0x15084E AblGLKWuw 500 SAS 0 500 FORMAT "%8.4" /end CHARACTERISTIC
/begin CHARACTERISTIC vDthrCtrl_IDSAngleSpeed_XDU16 "Lenkwinkelgeschwindigkeit beim Index anlernen" VALUE 0x150850 AblGLKWuw 500 SAS 0 500 FORMAT "%8.4" /end CHARACTERISTIC
/begin CHARACTERISTIC vDthrCtrl_MaxGradRackSpeed_XDU16 "Gradientenbegrenzung Zahnstangengeschwindigkeit  [mm/s / 10ms]" VALUE 0x150852 AblGLKWuw 10 RACKSPEED128 0 10 FORMAT "%8.5" /end CHARACTERISTIC
/begin CHARACTERISTIC vDthrCtrl_MaxRackSpeed_XDU16 "maximale Zahnstangengeschwindigkeit  [mm/s]" VALUE 0x150856 AblGLKWuw 200 RACKSPEED128 0 200 FORMAT "%8.4" /end CHARACTERISTIC
/begin CHARACTERISTIC vDthrCtrl_MidhAngleSpeed_XDU16 "Lenkwinkelgeschwindigkeit bei Mittenhalt" VALUE 0x150858 AblGLKWuw 30000 SAS 0 30000 FORMAT "%8.2" /end CHARACTERISTIC
/begin CHARACTERISTIC vDthrCtrl_SafetyLimitMaxVehicleSpeed_XDU16 "safety limit of maximum allowed vehicle speed" VALUE 0x15085A AblGLKWuw 12 VFZHIGH 0 12 FORMAT "%8.5" /end CHARACTERISTIC
/begin CHARACTERISTIC vDthrCtrl_VehicleSpeedMax_XDU16 "Grenzwert Fahrzeuggeschwindigkeit" VALUE 0x15085C AblGLKWuw 20 VFZHIGH 0 20 FORMAT "%8.5" /end CHARACTERISTIC
/begin CHARACTERISTIC vDTSC_MaxYawVelocity_XAU16 "Maximale Gierrate für die Berechnung/Validierung des Kalibrierwerts" CURVE 0x151510 AblGLKLuw 20 RIGHTSH10NP 0 20 FORMAT "%8.5"
 /begin AXIS_DESCR STD_AXIS vVehSpI_AbsMaxSafeVehSpd_xdu16 VFZHIGH 3 0 500 FORMAT "%8.4" DEPOSIT ABSOLUTE /end AXIS_DESCR
/end CHARACTERISTIC
/begin CHARACTERISTIC vDTSC_MinVehicleSpeed_XDU16 "Minimale Fahrzeuggeschwindigkeit für die Berechnung/Validierung des Kalibrierwerts" VALUE 0x15085E AblGLKWuw 500 VFZHIGH 0 500 FORMAT "%8.4" /end CHARACTERISTIC
/begin CHARACTERISTIC vEndStopHsd_BackwardDisableTh_XDU8 "Ruecksetzen der Rueckfahrerkennung unterhalb dieser Geschwindigkeitsschwelle" VALUE 0x150B46 AblGLKWub 50 VFZ 0 50 FORMAT "%5.2" /end CHARACTERISTIC
/begin CHARACTERISTIC vEndStopHsd_BackwardEnableTh_XDU8 "Rueckwaertsfahrt wird erst oberhalb dieser Geschwindigkeitsschwelle erkannt" VALUE 0x150B47 AblGLKWub 50 VFZ 0 50 FORMAT "%5.2" /end CHARACTERISTIC
/begin CHARACTERISTIC vEndStopHsd_MaxAllowedBackward_XDU8 "Abbruch Rueckwaertsfahrterkennung oberhalb dieser Geschwindigkeit" VALUE 0x150B48 AblGLKWub 90 VFZ 10 100 FORMAT "%5.1" /end CHARACTERISTIC
/begin CHARACTERISTIC vEndStop_uVehSpeedLearnFinished_XDU16 "Fertiglernbedingung, untere Fahrzeuggeschwindigkeitsgrenze" VALUE 0x150860 AblGLKWuw 20 VFZHIGH 0 20 FORMAT "%8.5" /end CHARACTERISTIC
/begin CHARACTERISTIC wCJC_AngleOffset_XDS16 "phase shift" VALUE 0x1508DC AblGLKWsw 360 SA_10 -180 180 FORMAT "%8.4" /end CHARACTERISTIC
/begin CHARACTERISTIC wDsd_Th_RollAngle_SK_off_XDF32 "Schwellwert Wankwinkel/Querneigung für Deaktivierung Steilkurvenerkennung [°]" VALUE 0x150458 AblGLKWfl4 45 ZU0 0 45 FORMAT "%10.7" /end CHARACTERISTIC
/begin CHARACTERISTIC wDsd_Th_RollAngle_SK_on_XDF32 "Schwellwert Wankwinkel/Querneigung für Aktivierung Steilkurvenerkennung [°]" VALUE 0x15045C AblGLKWfl4 45 ZU0 0 45 FORMAT "%10.7" /end CHARACTERISTIC
/begin CHARACTERISTIC wDthrCtrl_IDFAngle_XDU16 "Lenkwinkelamplitude beim Index anlernen" VALUE 0x1508DE AblGLKWuw 179.989 SA 0 179.9886 FORMAT "%8.4" /end CHARACTERISTIC
/begin CHARACTERISTIC wDthrCtrl_IDFIndexWidthMax_XDU16 "Schwellwert maximale Indexbreite " VALUE 0x1508E0 AblGLKWuw 89.9943 SA 0 89.99431 FORMAT "%8.5" /end CHARACTERISTIC
/begin CHARACTERISTIC wDthrCtrl_IDFIndexWidthMin_XDU16 "Schwellwert minimale Indexbreite " VALUE 0x1508E2 AblGLKWuw 89.9943 SA 0 89.99431 FORMAT "%8.5" /end CHARACTERISTIC
/begin CHARACTERISTIC wDthrCtrl_IDSAngle_XDU16 "Lenkwinkelamplitude beim Index anlernen" VALUE 0x1508E4 AblGLKWuw 179.989 SA 0 179.9886 FORMAT "%8.4" /end CHARACTERISTIC
/begin CHARACTERISTIC wDthrCtrl_TargetAngleCorridor_XDU16 "Zielkorridor beim Sollwert, in dem 'Ziel-erreicht-Flag' gesetzt wird" VALUE 0x1508E6 AblGLKWuw 600 SA_10 0 600 FORMAT "%8.4" /end CHARACTERISTIC
/begin CHARACTERISTIC wDTSC_MaxSteeringAngle_XDU16 "Maximaler Lenkwinkel für die Berechnung/Validierung des Kalibrierwerts" VALUE 0x1508E8 AblGLKWuw 20 SA_10 0 20 FORMAT "%8.5" /end CHARACTERISTIC
/begin CHARACTERISTIC xBci_InvSteeringRatioVarFact_XAF32 "Anpassfaktor Übersetzung für i variabel - level2 (muss identisch zu den Werten von xsyInvSteeringRatioVarFact_XAU16 sein)" CURVE 0x151B08 AblGLKLfl4 1.99902 ZU0 0.0009765625 2 FORMAT "%10.8"
 /begin AXIS_DESCR STD_AXIS wBci_AbsSteeringAngleL2_xdf32 ZU0 13 0 700 FORMAT "%10.6" DEPOSIT ABSOLUTE /end AXIS_DESCR
/end CHARACTERISTIC
/begin CHARACTERISTIC xBci_MaxAssistPostscaler_XDU16 "maximaler Wert für den postscaler" VALUE 0x150968 AblGLKWuw 1 RIGHTSH10NP 1 2 FORMAT "%8.6" /end CHARACTERISTIC
/begin CHARACTERISTIC xBci_MaxAssistPrescaler_XDU16 "maximaler Wert für den prescaler" VALUE 0x15096A AblGLKWuw 1 RIGHTSH10NP 1 2 FORMAT "%8.6" /end CHARACTERISTIC
/begin CHARACTERISTIC xBci_MaxAssistXxxscalerNoGradient_XDU16 "obere Grenze des Bereichs von prescaler und postscaler, in dem keine Gradientenbegrenzung erfolgt" VALUE 0x15096C AblGLKWuw 1 RIGHTSH10NP 1 2 FORMAT "%8.6" /end CHARACTERISTIC
/begin CHARACTERISTIC xBci_MaxGradAssistXxxscalerOnEntering_XDU16 "zulässiger Gradient, falls sich prescaler oder postscaler zu dem Bereich ohne Gradientenbegrenzung hinbewegen" VALUE 0x15096E AblGLKWuw 1.99902 RIGHTSH10NP_10MS 0.0009765625 2 FORMAT "%8.6" /end CHARACTERISTIC
/begin CHARACTERISTIC xBci_MaxGradAssistXxxscalerOnExceeding_XDU16 "zulässiger Gradient, falls sich prescaler oder postscaler von dem Bereich ohne Gradientenbegrenzung wegbewegen" VALUE 0x150970 AblGLKWuw 1.99902 RIGHTSH10NP_10MS 0.0009765625 2 FORMAT "%8.6" /end CHARACTERISTIC
/begin CHARACTERISTIC xBci_MinAssistPostscaler_XDU16 "minimaler Wert für den postscaler" VALUE 0x150972 AblGLKWuw 0.800781 RIGHTSH10NP 0.1992188 1 FORMAT "%8.6" /end CHARACTERISTIC
/begin CHARACTERISTIC xBci_MinAssistPrescaler_XDU16 "minimaler Wert für den prescaler" VALUE 0x150974 AblGLKWuw 0.800781 RIGHTSH10NP 0.1992188 1 FORMAT "%8.6" /end CHARACTERISTIC
/begin CHARACTERISTIC xBci_MinAssistXxxscalerNoGradient_XDU16 "untere Grenze des Bereichs von prescaler und postscaler, in dem keine Gradientenbegrenzung erfolgt" VALUE 0x150976 AblGLKWuw 0.800781 RIGHTSH10NP 0.1992188 1 FORMAT "%8.6" /end CHARACTERISTIC
/begin CHARACTERISTIC xCalDatHdl_StartXcpFlash_XDU8 "Ausloeser für XCP Flash" VALUE 0x150B54 AblGLKWub 1 ZU0 0 1 FORMAT "%5.3" /end CHARACTERISTIC
/begin CHARACTERISTIC xCentFeel_CenterFeelTorqueFact_XAU16_00___A "vehicle speed dependent factor of center feel torque" CURVE 0x15DA5C AblGLKLuw 1 RIGHTSH10NP 0 1 FORMAT "%8.6"
 /begin AXIS_DESCR STD_AXIS vApplI_AbsVehicleSpeedFilt_xdu16 VFZHIGH 6 0 500 FORMAT "%8.4" DEPOSIT ABSOLUTE /end AXIS_DESCR
/end CHARACTERISTIC
/begin CHARACTERISTIC xCentFeel_CenterFeelTorqueFact_XAU16_01___A "vehicle speed dependent factor of center feel torque" CURVE 0x15DA78 AblGLKLuw 1 RIGHTSH10NP 0 1 FORMAT "%8.6"
 /begin AXIS_DESCR STD_AXIS vApplI_AbsVehicleSpeedFilt_xdu16 VFZHIGH 6 0 500 FORMAT "%8.4" DEPOSIT ABSOLUTE /end AXIS_DESCR
/end CHARACTERISTIC
/begin CHARACTERISTIC xCentFeel_CenterFeelTorqueFact_XAU16_02___A "vehicle speed dependent factor of center feel torque" CURVE 0x15DA94 AblGLKLuw 1 RIGHTSH10NP 0 1 FORMAT "%8.6"
 /begin AXIS_DESCR STD_AXIS vApplI_AbsVehicleSpeedFilt_xdu16 VFZHIGH 6 0 500 FORMAT "%8.4" DEPOSIT ABSOLUTE /end AXIS_DESCR
/end CHARACTERISTIC
/begin CHARACTERISTIC xCentFeel_CenterFeelTorqueFact_XAU16_03___A "vehicle speed dependent factor of center feel torque" CURVE 0x15DAB0 AblGLKLuw 1 RIGHTSH10NP 0 1 FORMAT "%8.6"
 /begin AXIS_DESCR STD_AXIS vApplI_AbsVehicleSpeedFilt_xdu16 VFZHIGH 6 0 500 FORMAT "%8.4" DEPOSIT ABSOLUTE /end AXIS_DESCR
/end CHARACTERISTIC
/begin CHARACTERISTIC xCentFeel_CenterFeelTorqueFact_XAU16_04___A "vehicle speed dependent factor of center feel torque" CURVE 0x15DACC AblGLKLuw 1 RIGHTSH10NP 0 1 FORMAT "%8.6"
 /begin AXIS_DESCR STD_AXIS vApplI_AbsVehicleSpeedFilt_xdu16 VFZHIGH 6 0 500 FORMAT "%8.4" DEPOSIT ABSOLUTE /end AXIS_DESCR
/end CHARACTERISTIC
/begin CHARACTERISTIC xCentFeel_CenterFeelTorqueFact_XAU16_05___A "vehicle speed dependent factor of center feel torque" CURVE 0x15DAE8 AblGLKLuw 1 RIGHTSH10NP 0 1 FORMAT "%8.6"
 /begin AXIS_DESCR STD_AXIS vApplI_AbsVehicleSpeedFilt_xdu16 VFZHIGH 6 0 500 FORMAT "%8.4" DEPOSIT ABSOLUTE /end AXIS_DESCR
/end CHARACTERISTIC
/begin CHARACTERISTIC xCentFeel_CenterFeelTorqueFact_XAU16_06___A "vehicle speed dependent factor of center feel torque" CURVE 0x15DB04 AblGLKLuw 1 RIGHTSH10NP 0 1 FORMAT "%8.6"
 /begin AXIS_DESCR STD_AXIS vApplI_AbsVehicleSpeedFilt_xdu16 VFZHIGH 6 0 500 FORMAT "%8.4" DEPOSIT ABSOLUTE /end AXIS_DESCR
/end CHARACTERISTIC
/begin CHARACTERISTIC xCentFeel_CenterFeelTorqueFact_XAU16_07___A "vehicle speed dependent factor of center feel torque" CURVE 0x15DB20 AblGLKLuw 1 RIGHTSH10NP 0 1 FORMAT "%8.6"
 /begin AXIS_DESCR STD_AXIS vApplI_AbsVehicleSpeedFilt_xdu16 VFZHIGH 6 0 500 FORMAT "%8.4" DEPOSIT ABSOLUTE /end AXIS_DESCR
/end CHARACTERISTIC
/begin CHARACTERISTIC xCentFeel_CenterFeelTorqueFact_XAU16_08___A "vehicle speed dependent factor of center feel torque" CURVE 0x15DB3C AblGLKLuw 1 RIGHTSH10NP 0 1 FORMAT "%8.6"
 /begin AXIS_DESCR STD_AXIS vApplI_AbsVehicleSpeedFilt_xdu16 VFZHIGH 6 0 500 FORMAT "%8.4" DEPOSIT ABSOLUTE /end AXIS_DESCR
/end CHARACTERISTIC
/begin CHARACTERISTIC xCentFeel_CenterFeelTorqueFact_XAU16_09___A "vehicle speed dependent factor of center feel torque" CURVE 0x15DB58 AblGLKLuw 1 RIGHTSH10NP 0 1 FORMAT "%8.6"
 /begin AXIS_DESCR STD_AXIS vApplI_AbsVehicleSpeedFilt_xdu16 VFZHIGH 6 0 500 FORMAT "%8.4" DEPOSIT ABSOLUTE /end AXIS_DESCR
/end CHARACTERISTIC
/begin CHARACTERISTIC xCentFeel_CenterFeelTorqueFact_XAU16_10___A "vehicle speed dependent factor of center feel torque" CURVE 0x15DB74 AblGLKLuw 1 RIGHTSH10NP 0 1 FORMAT "%8.6"
 /begin AXIS_DESCR STD_AXIS vApplI_AbsVehicleSpeedFilt_xdu16 VFZHIGH 6 0 500 FORMAT "%8.4" DEPOSIT ABSOLUTE /end AXIS_DESCR
/end CHARACTERISTIC
/begin CHARACTERISTIC xCentFeel_CenterFeelTorqueFact_XAU16_11___A "vehicle speed dependent factor of center feel torque" CURVE 0x15DB90 AblGLKLuw 1 RIGHTSH10NP 0 1 FORMAT "%8.6"
 /begin AXIS_DESCR STD_AXIS vApplI_AbsVehicleSpeedFilt_xdu16 VFZHIGH 6 0 500 FORMAT "%8.4" DEPOSIT ABSOLUTE /end AXIS_DESCR
/end CHARACTERISTIC
/begin CHARACTERISTIC xCentFeel_CenterFeelTorqueFact_XAU16_12___A "vehicle speed dependent factor of center feel torque" CURVE 0x15DBAC AblGLKLuw 1 RIGHTSH10NP 0 1 FORMAT "%8.6"
 /begin AXIS_DESCR STD_AXIS vApplI_AbsVehicleSpeedFilt_xdu16 VFZHIGH 6 0 500 FORMAT "%8.4" DEPOSIT ABSOLUTE /end AXIS_DESCR
/end CHARACTERISTIC
/begin CHARACTERISTIC xCentFeel_CenterFeelTorqueFact_XAU16_13___A "vehicle speed dependent factor of center feel torque" CURVE 0x15DBC8 AblGLKLuw 1 RIGHTSH10NP 0 1 FORMAT "%8.6"
 /begin AXIS_DESCR STD_AXIS vApplI_AbsVehicleSpeedFilt_xdu16 VFZHIGH 6 0 500 FORMAT "%8.4" DEPOSIT ABSOLUTE /end AXIS_DESCR
/end CHARACTERISTIC
/begin CHARACTERISTIC xCentFeel_CenterFeelTorqueFact_XAU16_14___A "vehicle speed dependent factor of center feel torque" CURVE 0x15DBE4 AblGLKLuw 1 RIGHTSH10NP 0 1 FORMAT "%8.6"
 /begin AXIS_DESCR STD_AXIS vApplI_AbsVehicleSpeedFilt_xdu16 VFZHIGH 6 0 500 FORMAT "%8.4" DEPOSIT ABSOLUTE /end AXIS_DESCR
/end CHARACTERISTIC
/begin CHARACTERISTIC xCentFeel_CenterFeelTorqueFact_XAU16_15___A "vehicle speed dependent factor of center feel torque" CURVE 0x15DC00 AblGLKLuw 1 RIGHTSH10NP 0 1 FORMAT "%8.6"
 /begin AXIS_DESCR STD_AXIS vApplI_AbsVehicleSpeedFilt_xdu16 VFZHIGH 6 0 500 FORMAT "%8.4" DEPOSIT ABSOLUTE /end AXIS_DESCR
/end CHARACTERISTIC
/begin CHARACTERISTIC xCentFeel_CenterFeelTorqueFact_XAU16_16___A "vehicle speed dependent factor of center feel torque" CURVE 0x15DC1C AblGLKLuw 1 RIGHTSH10NP 0 1 FORMAT "%8.6"
 /begin AXIS_DESCR STD_AXIS vApplI_AbsVehicleSpeedFilt_xdu16 VFZHIGH 6 0 500 FORMAT "%8.4" DEPOSIT ABSOLUTE /end AXIS_DESCR
/end CHARACTERISTIC
/begin CHARACTERISTIC xCentFeel_CenterFeelTorqueFact_XAU16_17___A "vehicle speed dependent factor of center feel torque" CURVE 0x15DC38 AblGLKLuw 1 RIGHTSH10NP 0 1 FORMAT "%8.6"
 /begin AXIS_DESCR STD_AXIS vApplI_AbsVehicleSpeedFilt_xdu16 VFZHIGH 6 0 500 FORMAT "%8.4" DEPOSIT ABSOLUTE /end AXIS_DESCR
/end CHARACTERISTIC
/begin CHARACTERISTIC xCentFeel_CenterFeelTorqueFact_XAU16_18___A "vehicle speed dependent factor of center feel torque" CURVE 0x15DC54 AblGLKLuw 1 RIGHTSH10NP 0 1 FORMAT "%8.6"
 /begin AXIS_DESCR STD_AXIS vApplI_AbsVehicleSpeedFilt_xdu16 VFZHIGH 6 0 500 FORMAT "%8.4" DEPOSIT ABSOLUTE /end AXIS_DESCR
/end CHARACTERISTIC
/begin CHARACTERISTIC xCentFeel_CenterFeelTorqueFact_XAU16_19___A "vehicle speed dependent factor of center feel torque" CURVE 0x15DC70 AblGLKLuw 1 RIGHTSH10NP 0 1 FORMAT "%8.6"
 /begin AXIS_DESCR STD_AXIS vApplI_AbsVehicleSpeedFilt_xdu16 VFZHIGH 6 0 500 FORMAT "%8.4" DEPOSIT ABSOLUTE /end AXIS_DESCR
/end CHARACTERISTIC
/begin CHARACTERISTIC xCentFeel_CenterFeelTorqueFact_XAU16_20___A "vehicle speed dependent factor of center feel torque" CURVE 0x15DC8C AblGLKLuw 1 RIGHTSH10NP 0 1 FORMAT "%8.6"
 /begin AXIS_DESCR STD_AXIS vApplI_AbsVehicleSpeedFilt_xdu16 VFZHIGH 6 0 500 FORMAT "%8.4" DEPOSIT ABSOLUTE /end AXIS_DESCR
/end CHARACTERISTIC
/begin CHARACTERISTIC xCentFeel_CenterFeelTorqueFact_XAU16_21___A "vehicle speed dependent factor of center feel torque" CURVE 0x15DCA8 AblGLKLuw 1 RIGHTSH10NP 0 1 FORMAT "%8.6"
 /begin AXIS_DESCR STD_AXIS vApplI_AbsVehicleSpeedFilt_xdu16 VFZHIGH 6 0 500 FORMAT "%8.4" DEPOSIT ABSOLUTE /end AXIS_DESCR
/end CHARACTERISTIC
/begin CHARACTERISTIC xCentFeel_CenterFeelTorqueFact_XAU16_22___A "vehicle speed dependent factor of center feel torque" CURVE 0x15DCC4 AblGLKLuw 1 RIGHTSH10NP 0 1 FORMAT "%8.6"
 /begin AXIS_DESCR STD_AXIS vApplI_AbsVehicleSpeedFilt_xdu16 VFZHIGH 6 0 500 FORMAT "%8.4" DEPOSIT ABSOLUTE /end AXIS_DESCR
/end CHARACTERISTIC
/begin CHARACTERISTIC xCentFeel_CenterFeelTorqueFact_XAU16_23___A "vehicle speed dependent factor of center feel torque" CURVE 0x15DCE0 AblGLKLuw 1 RIGHTSH10NP 0 1 FORMAT "%8.6"
 /begin AXIS_DESCR STD_AXIS vApplI_AbsVehicleSpeedFilt_xdu16 VFZHIGH 6 0 500 FORMAT "%8.4" DEPOSIT ABSOLUTE /end AXIS_DESCR
/end CHARACTERISTIC
/begin CHARACTERISTIC xCentFeel_CenterFeelTorqueFact_XAU16_24___A "vehicle speed dependent factor of center feel torque" CURVE 0x15DCFC AblGLKLuw 1 RIGHTSH10NP 0 1 FORMAT "%8.6"
 /begin AXIS_DESCR STD_AXIS vApplI_AbsVehicleSpeedFilt_xdu16 VFZHIGH 6 0 500 FORMAT "%8.4" DEPOSIT ABSOLUTE /end AXIS_DESCR
/end CHARACTERISTIC
/begin CHARACTERISTIC xCentFeel_CenterFeelTorqueFact_XAU16_25___A "vehicle speed dependent factor of center feel torque" CURVE 0x15DD18 AblGLKLuw 1 RIGHTSH10NP 0 1 FORMAT "%8.6"
 /begin AXIS_DESCR STD_AXIS vApplI_AbsVehicleSpeedFilt_xdu16 VFZHIGH 6 0 500 FORMAT "%8.4" DEPOSIT ABSOLUTE /end AXIS_DESCR
/end CHARACTERISTIC
/begin CHARACTERISTIC xCentFeel_CenterFeelTorqueFact_XAU16_26___A "vehicle speed dependent factor of center feel torque" CURVE 0x15DD34 AblGLKLuw 1 RIGHTSH10NP 0 1 FORMAT "%8.6"
 /begin AXIS_DESCR STD_AXIS vApplI_AbsVehicleSpeedFilt_xdu16 VFZHIGH 6 0 500 FORMAT "%8.4" DEPOSIT ABSOLUTE /end AXIS_DESCR
/end CHARACTERISTIC
/begin CHARACTERISTIC xCentFeel_CenterFeelTorqueFact_XAU16_27___A "vehicle speed dependent factor of center feel torque" CURVE 0x15DD50 AblGLKLuw 1 RIGHTSH10NP 0 1 FORMAT "%8.6"
 /begin AXIS_DESCR STD_AXIS vApplI_AbsVehicleSpeedFilt_xdu16 VFZHIGH 6 0 500 FORMAT "%8.4" DEPOSIT ABSOLUTE /end AXIS_DESCR
/end CHARACTERISTIC
/begin CHARACTERISTIC xCentFeel_CenterFeelTorqueFact_XAU16_28___A "vehicle speed dependent factor of center feel torque" CURVE 0x15DD6C AblGLKLuw 1 RIGHTSH10NP 0 1 FORMAT "%8.6"
 /begin AXIS_DESCR STD_AXIS vApplI_AbsVehicleSpeedFilt_xdu16 VFZHIGH 6 0 500 FORMAT "%8.4" DEPOSIT ABSOLUTE /end AXIS_DESCR
/end CHARACTERISTIC
/begin CHARACTERISTIC xCentFeel_CenterFeelTorqueFact_XAU16_29___A "vehicle speed dependent factor of center feel torque" CURVE 0x15DD88 AblGLKLuw 1 RIGHTSH10NP 0 1 FORMAT "%8.6"
 /begin AXIS_DESCR STD_AXIS vApplI_AbsVehicleSpeedFilt_xdu16 VFZHIGH 6 0 500 FORMAT "%8.4" DEPOSIT ABSOLUTE /end AXIS_DESCR
/end CHARACTERISTIC
/begin CHARACTERISTIC xCentFeel_CenterFeelTorqueFact_XAU16_30___A "vehicle speed dependent factor of center feel torque" CURVE 0x15DDA4 AblGLKLuw 1 RIGHTSH10NP 0 1 FORMAT "%8.6"
 /begin AXIS_DESCR STD_AXIS vApplI_AbsVehicleSpeedFilt_xdu16 VFZHIGH 6 0 500 FORMAT "%8.4" DEPOSIT ABSOLUTE /end AXIS_DESCR
/end CHARACTERISTIC
/begin CHARACTERISTIC xCentFeel_CenterFeelTorqueFact_XAU16_31___A "vehicle speed dependent factor of center feel torque" CURVE 0x15DDC0 AblGLKLuw 1 RIGHTSH10NP 0 1 FORMAT "%8.6"
 /begin AXIS_DESCR STD_AXIS vApplI_AbsVehicleSpeedFilt_xdu16 VFZHIGH 6 0 500 FORMAT "%8.4" DEPOSIT ABSOLUTE /end AXIS_DESCR
/end CHARACTERISTIC
/begin CHARACTERISTIC xCentFeel_CenterFeelTorqueFact_XAU16_32___A "vehicle speed dependent factor of center feel torque" CURVE 0x15DDDC AblGLKLuw 1 RIGHTSH10NP 0 1 FORMAT "%8.6"
 /begin AXIS_DESCR STD_AXIS vApplI_AbsVehicleSpeedFilt_xdu16 VFZHIGH 6 0 500 FORMAT "%8.4" DEPOSIT ABSOLUTE /end AXIS_DESCR
/end CHARACTERISTIC
/begin CHARACTERISTIC xCentFeel_CenterFeelTorqueFact_XAU16_33___A "vehicle speed dependent factor of center feel torque" CURVE 0x15DDF8 AblGLKLuw 1 RIGHTSH10NP 0 1 FORMAT "%8.6"
 /begin AXIS_DESCR STD_AXIS vApplI_AbsVehicleSpeedFilt_xdu16 VFZHIGH 6 0 500 FORMAT "%8.4" DEPOSIT ABSOLUTE /end AXIS_DESCR
/end CHARACTERISTIC
/begin CHARACTERISTIC xCentFeel_CenterFeelTorqueFact_XAU16_34___A "vehicle speed dependent factor of center feel torque" CURVE 0x15DE14 AblGLKLuw 1 RIGHTSH10NP 0 1 FORMAT "%8.6"
 /begin AXIS_DESCR STD_AXIS vApplI_AbsVehicleSpeedFilt_xdu16 VFZHIGH 6 0 500 FORMAT "%8.4" DEPOSIT ABSOLUTE /end AXIS_DESCR
/end CHARACTERISTIC
/begin CHARACTERISTIC xCentFeel_CenterFeelTorqueFact_XAU16_35___A "vehicle speed dependent factor of center feel torque" CURVE 0x15DE30 AblGLKLuw 1 RIGHTSH10NP 0 1 FORMAT "%8.6"
 /begin AXIS_DESCR STD_AXIS vApplI_AbsVehicleSpeedFilt_xdu16 VFZHIGH 6 0 500 FORMAT "%8.4" DEPOSIT ABSOLUTE /end AXIS_DESCR
/end CHARACTERISTIC
/begin CHARACTERISTIC xCJC_AmplitudeFactor_XAS16 "pinion angle dependent amplitude factor" CURVE 0x1516E0 AblGLKLsw 1 RIGHTSH10NP 0 1 FORMAT "%8.6"
 /begin AXIS_DESCR STD_AXIS wApplI_PinionAngle_xds16 SA_10 7 -1000 1000 FORMAT "%8.3" DEPOSIT ABSOLUTE /end AXIS_DESCR
/end CHARACTERISTIC
/begin CHARACTERISTIC xCJC_ControlRatio_XDU16 "factor to calculate motor torque offset out of steering torque offset" VALUE 0x15097C AblGLKWuw 0.150391 RIGHTSH10NP 0 0.1503906 FORMAT "%9.7" /end CHARACTERISTIC
/begin CHARACTERISTIC xCJC_SubVehSpeedFactor_XDU16 "substitute factor in case of invalid vehicle speed" VALUE 0x15097E AblGLKWuw 1 RIGHTSH10NP 0 1 FORMAT "%8.6" /end CHARACTERISTIC
/begin CHARACTERISTIC xCJC_VehicleSpeedFactor_XAU16 "vehicle speed dependent factor" CURVE 0x151700 AblGLKLuw 1 RIGHTSH10NP 0 1 FORMAT "%8.6"
 /begin AXIS_DESCR STD_AXIS vVehSpI_AbsAvgVehSpd_xdu16 VFZHIGH 4 0 250 FORMAT "%8.4" DEPOSIT ABSOLUTE /end AXIS_DESCR
/end CHARACTERISTIC
/begin CHARACTERISTIC xDrvTorque_G_N1_XDF32 "FIR-Filter Koeffizient N1" VALUE 0x14A004 AblGLKWfl4 10000 FLOAT -5000 5000 FORMAT "%16.11" /end CHARACTERISTIC
/begin CHARACTERISTIC xDrvTorque_G_N2_XDF32 "FIR-Filter Koeffizient N2" VALUE 0x14A008 AblGLKWfl4 10000 FLOAT -5000 5000 FORMAT "%16.11" /end CHARACTERISTIC
/begin CHARACTERISTIC xDrvTorque_G_N3_XDF32 "FIR-Filter Koeffizient N3" VALUE 0x14A00C AblGLKWfl4 10000 FLOAT -5000 5000 FORMAT "%16.11" /end CHARACTERISTIC
/begin CHARACTERISTIC xDrvTorque_RotAccFilterFact_XDU16 "Filterfaktor 1 und 2 der Lenkradwinkelbeschleunigung" VALUE 0x150980 AblGLKWuw 0.999023 RIGHTSH10NP 0.0009765625 1 FORMAT "%8.6" /end CHARACTERISTIC
/begin CHARACTERISTIC xDrvTorque_Sign_XDS16 "Vorzeichen DriverTorque" VALUE 0x150982 AblGLKWsw 2 ZU0 -1 1 FORMAT "%8.6" /end CHARACTERISTIC
/begin CHARACTERISTIC xDrvTorque_SWRotorInertia_XDU16 "Relevante Massenträgheit des Lenkrads [kgm^2]" VALUE 0x150984 AblGLKWuw 1 RIGHTSH10NP 0 1 FORMAT "%8.6" /end CHARACTERISTIC
/begin CHARACTERISTIC xDrvTorque_TBTFilterFact_XDU16 "Filterfaktor 1 und 2 des Drehstabmoments" VALUE 0x150986 AblGLKWuw 0.999023 TBTHIGH 0.0009765625 1 FORMAT "%8.6" /end CHARACTERISTIC
/begin CHARACTERISTIC xDrvTorque_TorsionBarStiffnessMod_XDS16 "Modifikation Drehstabsteifgkeit" VALUE 0x150988 AblGLKWsw 3 TBTSTIFFHIGH 0 3 FORMAT "%8.6" /end CHARACTERISTIC
/begin CHARACTERISTIC xDsd_Kd_Yaw_OS_XDF32 "Faktor Berechnung prozentuales Übersteuern -> Annahme dpsip im Fahrzustand mit 40° Schwimmwinkel entspricht 100% Instabilität" VALUE 0x150488 AblGLKWfl4 1000 ZU0 0 1000 FORMAT "%10.5" /end CHARACTERISTIC
/begin CHARACTERISTIC xDsd_Kd_Yaw_US_XDF32 "Faktor Berechnung prozentuales Untersteuern" VALUE 0x15048C AblGLKWfl4 1000 ZU0 0 1000 FORMAT "%10.5" /end CHARACTERISTIC
/begin CHARACTERISTIC xDsd_Th_GradOS_SK_off_XDF32 "Schwellwert Grad Übersteuern Austrittsbedingung Steilkurvenerkennung [%]" VALUE 0x150490 AblGLKWfl4 100 ZU0 0 100 FORMAT "%10.6" /end CHARACTERISTIC
/begin CHARACTERISTIC xDsd_Th_GradOS_SK_on_XDF32 "Maximalwert Grad Übersteuern für Aktivierung Steilkurvenerkennung [%]" VALUE 0x150494 AblGLKWfl4 100 ZU0 0 100 FORMAT "%10.6" /end CHARACTERISTIC
/begin CHARACTERISTIC xDsd_YawRef_a_damp_XDF32 "Dämpfungsmaß Funktionsparameter A für ausgewogenes Modell" VALUE 0x150498 AblGLKWfl4 2 ZU0 0 2 FORMAT "%10.8" /end CHARACTERISTIC
/begin CHARACTERISTIC xDsd_YawRef_a_stat_XDF32 "Faktor für Quadrat der Fahrzeuggeschwindigkeit" VALUE 0x15049C AblGLKWfl4 1 ZU0 0 1 FORMAT "%10.8" /end CHARACTERISTIC
/begin CHARACTERISTIC xDsd_YawRef_a_t_XDF32 "Zählerzeitkonstante Funktionsparameter A für ausgewogenes Modell" VALUE 0x1504A0 AblGLKWfl4 1 ZU0 0 1 FORMAT "%10.8" /end CHARACTERISTIC
/begin CHARACTERISTIC xDsd_YawRef_b_stat_neg_XDF32 "Faktor für negativen Zweig" VALUE 0x1504A4 AblGLKWfl4 1 ZU0 0 1 FORMAT "%10.8" /end CHARACTERISTIC
/begin CHARACTERISTIC xDsd_YawRef_b_stat_pos_XDF32 "Faktor für positiven Zweig" VALUE 0x1504A8 AblGLKWfl4 1 ZU0 0 1 FORMAT "%10.8" /end CHARACTERISTIC
/begin CHARACTERISTIC xDsd_YawRef_k_wu_ayshape_XAF32 "Verstärkung Wind-Up für anvYawAy, geschwindigkeitsabhängig" CURVE 0x150CDC AblGLKLfl4 100 ZU0 0 100 FORMAT "%10.6"
 /begin AXIS_DESCR STD_AXIS vDsd_Vehicle_xdf32 ZU0 6 0 255 FORMAT "%10.6" DEPOSIT ABSOLUTE /end AXIS_DESCR
/end CHARACTERISTIC
/begin CHARACTERISTIC xDSR_DefaultBypassFactor_XDU16 "Prozentualer Motormomenten Bypass Disableswitch" VALUE 0x15098A AblGLKWuw 1 RIGHTSH10NP 0 1 FORMAT "%8.6" /end CHARACTERISTIC
/begin CHARACTERISTIC xDsr_DefaultGradient_XDU16 "DSR Gradientenlimitierungsoffset(Handmoment)Disable switch" VALUE 0x15098C AblGLKWuw 4 TORGRAD_10MS 0 4 FORMAT "%8.6" /end CHARACTERISTIC
/begin CHARACTERISTIC xDSR_DSRBypassFactor_XDU16 "Prozentualer Motormomenten Bypass" VALUE 0x15098E AblGLKWuw 1 RIGHTSH10NP 0 1 FORMAT "%8.6" /end CHARACTERISTIC
/begin CHARACTERISTIC xDSR_DSRSafetyBypassFactor_XDU16 "Prozentualer Motormomenten Bypass Monsafe" VALUE 0x150990 AblGLKWuw 1 RIGHTSH10NP 0 1 FORMAT "%8.6" /end CHARACTERISTIC
/begin CHARACTERISTIC xDSR_EMABypassFactor_XDU16 "Prozentualer Motormomenten Bypass" VALUE 0x150992 AblGLKWuw 1 RIGHTSH10NP 0 1 FORMAT "%8.6" /end CHARACTERISTIC
/begin CHARACTERISTIC xDSR_EMASafetyBypassFactor_XDU16 "Prozentualer Motormomenten Bypass Monsafe" VALUE 0x150994 AblGLKWuw 1 RIGHTSH10NP 0 1 FORMAT "%8.6" /end CHARACTERISTIC
/begin CHARACTERISTIC xDSR_ErrorModeRampRate_XDU16 "Maximales Gradient bei Fehler" VALUE 0x150996 AblGLKWuw 4 TORGRAD_10MS 0 4 FORMAT "%8.6" /end CHARACTERISTIC
/begin CHARACTERISTIC xDSR_SafetyErrorRampRate_XDU16 "Maximales Gradient bei Fehler Monsafe" VALUE 0x150998 AblGLKWuw 4 TORGRAD_10MS 0 4 FORMAT "%8.6" /end CHARACTERISTIC
/begin CHARACTERISTIC xDthrCtrl_BypassFiltFac_XDF32 "Filterfaktor für Rackspeed Bypass" VALUE 0x1504AC AblGLKWfl4 10 ZU0 0 10 FORMAT "%10.7" /end CHARACTERISTIC
/begin CHARACTERISTIC xDthrCtrl_DeadbandTobatoFact_XDS16 "Factor auf Moment aus Totband Torsionbartorque bei d- und d-offset Faktor Korrektur" VALUE 0x15099A AblGLKWsw 20 TBTHIGH -10 10 FORMAT "%8.5" /end CHARACTERISTIC
/begin CHARACTERISTIC xDthrCtrl_DPartFactor_XDU16 "berechneter Faktor auf D-Anteil" VALUE 0x15099C AblGLKWuw 1 RIGHTSH10NP 0 1 FORMAT "%8.6" /end CHARACTERISTIC
/begin CHARACTERISTIC xDthrCtrl_InertiaRotAccFactor_XDS16 "Trägheitsmomentfaktor" VALUE 0x15099E AblGLKWsw 2 INERTOR_HIGH -1 1 FORMAT "%8.6" /end CHARACTERISTIC
/begin CHARACTERISTIC xDthrCtrl_PositionDPart_XDF32 "D-Anteil Positionsregler " VALUE 0x1504B0 AblGLKWfl4 100 ZU0 0 100 FORMAT "%10.6" /end CHARACTERISTIC
/begin CHARACTERISTIC xDthrCtrl_PositionIMax_XDF32 "Begrenzung I-Anteil Positionsregler " VALUE 0x1504B4 AblGLKWfl4 2000 ZU0 0 2000 FORMAT "%10.5" /end CHARACTERISTIC
/begin CHARACTERISTIC xDthrCtrl_PositionIPart_XDF32 "I-Anteil Positionsregler " VALUE 0x1504B8 AblGLKWfl4 100 ZU0 0 100 FORMAT "%10.6" /end CHARACTERISTIC
/begin CHARACTERISTIC xDthrCtrl_PositionPPart_XDF32 "P-Anteil Positionsregler " VALUE 0x1504BC AblGLKWfl4 60 ZU0 0 60 FORMAT "%10.7" /end CHARACTERISTIC
/begin CHARACTERISTIC xDthrCtrl_RackSpeedDPart_XDF32 "D-Anteil Geschwindigkeitssregler " VALUE 0x1504C0 AblGLKWfl4 2 ZU0 0 2 FORMAT "%10.8" /end CHARACTERISTIC
/begin CHARACTERISTIC xDthrCtrl_RackSpeedIMax_XDF32 "Begrenzung I-Anteil Geschwindigkeitssregler " VALUE 0x1504C4 AblGLKWfl4 8 ZU0 0 8 FORMAT "%10.8" /end CHARACTERISTIC
/begin CHARACTERISTIC xDthrCtrl_RackSpeedIPart_XDF32 "I-Anteil Geschwindigkeitssregler " VALUE 0x1504C8 AblGLKWfl4 1 ZU0 0 1 FORMAT "%10.8" /end CHARACTERISTIC
/begin CHARACTERISTIC xDthrCtrl_RackSpeedPPart_XDF32 "P-Anteil Geschwindigkeitssregler " VALUE 0x1504CC AblGLKWfl4 2 ZU0 0 2 FORMAT "%10.8" /end CHARACTERISTIC
/begin CHARACTERISTIC xDTSC_EffectiveTorqueFactor_XDS16_0___A "Faktor für das Wirkmoment" VALUE 0x158240 AblGLKWsw 4 RIGHTSH10NP -2 2 FORMAT "%8.6" /end CHARACTERISTIC
/begin CHARACTERISTIC xDTSC_EffectiveTorqueFactor_XDS16_1___A "Faktor für das Wirkmoment" VALUE 0x158242 AblGLKWsw 4 RIGHTSH10NP -2 2 FORMAT "%8.6" /end CHARACTERISTIC
/begin CHARACTERISTIC xDTSC_EffectiveTorqueFactor_XDS16_2___A "Faktor für das Wirkmoment" VALUE 0x158244 AblGLKWsw 4 RIGHTSH10NP -2 2 FORMAT "%8.6" /end CHARACTERISTIC
/begin CHARACTERISTIC xDTSC_EffectiveTorqueFactor_XDS16_3___A "Faktor für das Wirkmoment" VALUE 0x158246 AblGLKWsw 4 RIGHTSH10NP -2 2 FORMAT "%8.6" /end CHARACTERISTIC
/begin CHARACTERISTIC xDTSC_EffectiveTorqueFactor_XDS16_4___A "Faktor für das Wirkmoment" VALUE 0x158248 AblGLKWsw 4 RIGHTSH10NP -2 2 FORMAT "%8.6" /end CHARACTERISTIC
/begin CHARACTERISTIC xDTSC_EffectiveTorqueFactor_XDS16_5___A "Faktor für das Wirkmoment" VALUE 0x15824A AblGLKWsw 4 RIGHTSH10NP -2 2 FORMAT "%8.6" /end CHARACTERISTIC
/begin CHARACTERISTIC xDTSC_MaxInputValueNorm4Switch_XDU16 "Maximaler Eingangswert für das Ändern des Kalibrierwerts (Aktivierung/Deaktivierung des Kalibrierwerts)" VALUE 0x1509A0 AblGLKWuw 9.8999 RIGHTSH12NP 0.1000977 10 FORMAT "%8.5" /end CHARACTERISTIC
/begin CHARACTERISTIC xDTSC_MinInputValueNormCorner_XDU16 "Normierte Eingansgröße ab der TorqueSteer aktiv ist" VALUE 0x1509A2 AblGLKWuw 10 RIGHTSH12NP 0 10 FORMAT "%8.5" /end CHARACTERISTIC
/begin CHARACTERISTIC xDTSC_MinInputValueNormStraight_XDU16 "Normierte Eingansgröße ab der TorqueSteer aktiv ist" VALUE 0x1509A4 AblGLKWuw 10 RIGHTSH12NP 0 10 FORMAT "%8.5" /end CHARACTERISTIC
/begin CHARACTERISTIC xDTSC_MinInputValueNorm_XDU16 "Minimaler normierter Eingangswert für die Berechnung/Validierung des Kalibrierwerts" VALUE 0x1509A6 AblGLKWuw 9.8999 RIGHTSH12NP 0.1000977 10 FORMAT "%8.5" /end CHARACTERISTIC
/begin CHARACTERISTIC xDTSC_NormInputValue_XDU16 "Normierungsfaktor Eingangsgrösse" VALUE 0x1509A8 AblGLKWuw 10 RIGHTSH10NP 0 10 FORMAT "%8.5" /end CHARACTERISTIC
/begin CHARACTERISTIC xDTSC_SteeringAngleCorrCorner_XAU16 "Korrekturfaktor für das Kompensationsmoment (Eingangsgröße: Lenkwinkel)" CURVE 0x151714 AblGLKLuw 1 RIGHTSH10NP 0 1 FORMAT "%8.6"
 /begin AXIS_DESCR STD_AXIS wApplI_AbsSteeringAngle_xdu16 SA_10 6 0 800 FORMAT "%8.4" DEPOSIT ABSOLUTE /end AXIS_DESCR
/end CHARACTERISTIC
/begin CHARACTERISTIC xDTSC_SteeringAngleCorrStraight_XAU16_0___A "Korrekturfaktor für das Kompensationsmoment (Eingangsgröße: Lenkwinkel)" CURVE 0x15DE4C AblGLKLuw 1 RIGHTSH10NP 0 1 FORMAT "%8.6"
 /begin AXIS_DESCR STD_AXIS wApplI_AbsSteeringAngle_xdu16 SA_10 6 0 800 FORMAT "%8.4" DEPOSIT ABSOLUTE /end AXIS_DESCR
/end CHARACTERISTIC
/begin CHARACTERISTIC xDTSC_SteeringAngleCorrStraight_XAU16_1___A "Korrekturfaktor für das Kompensationsmoment (Eingangsgröße: Lenkwinkel)" CURVE 0x15DE68 AblGLKLuw 1 RIGHTSH10NP 0 1 FORMAT "%8.6"
 /begin AXIS_DESCR STD_AXIS wApplI_AbsSteeringAngle_xdu16 SA_10 6 0 800 FORMAT "%8.4" DEPOSIT ABSOLUTE /end AXIS_DESCR
/end CHARACTERISTIC
/begin CHARACTERISTIC xDTSC_SteeringAngleCorrStraight_XAU16_2___A "Korrekturfaktor für das Kompensationsmoment (Eingangsgröße: Lenkwinkel)" CURVE 0x15DE84 AblGLKLuw 1 RIGHTSH10NP 0 1 FORMAT "%8.6"
 /begin AXIS_DESCR STD_AXIS wApplI_AbsSteeringAngle_xdu16 SA_10 6 0 800 FORMAT "%8.4" DEPOSIT ABSOLUTE /end AXIS_DESCR
/end CHARACTERISTIC
/begin CHARACTERISTIC xDTSC_SteeringAngleCorrStraight_XAU16_3___A "Korrekturfaktor für das Kompensationsmoment (Eingangsgröße: Lenkwinkel)" CURVE 0x15DEA0 AblGLKLuw 1 RIGHTSH10NP 0 1 FORMAT "%8.6"
 /begin AXIS_DESCR STD_AXIS wApplI_AbsSteeringAngle_xdu16 SA_10 6 0 800 FORMAT "%8.4" DEPOSIT ABSOLUTE /end AXIS_DESCR
/end CHARACTERISTIC
/begin CHARACTERISTIC xDTSC_SteeringAngleCorrStraight_XAU16_4___A "Korrekturfaktor für das Kompensationsmoment (Eingangsgröße: Lenkwinkel)" CURVE 0x15DEBC AblGLKLuw 1 RIGHTSH10NP 0 1 FORMAT "%8.6"
 /begin AXIS_DESCR STD_AXIS wApplI_AbsSteeringAngle_xdu16 SA_10 6 0 800 FORMAT "%8.4" DEPOSIT ABSOLUTE /end AXIS_DESCR
/end CHARACTERISTIC
/begin CHARACTERISTIC xDTSC_SteeringAngleCorrStraight_XAU16_5___A "Korrekturfaktor für das Kompensationsmoment (Eingangsgröße: Lenkwinkel)" CURVE 0x15DED8 AblGLKLuw 1 RIGHTSH10NP 0 1 FORMAT "%8.6"
 /begin AXIS_DESCR STD_AXIS wApplI_AbsSteeringAngle_xdu16 SA_10 6 0 800 FORMAT "%8.4" DEPOSIT ABSOLUTE /end AXIS_DESCR
/end CHARACTERISTIC
/begin CHARACTERISTIC xDTSC_VehicleSpeedCorrCorner_XAU16 "Korrekturfaktor für das Kompensationsmoment (Eingangsgröße: Fahrzeuggeschwindigkeit)" CURVE 0x151730 AblGLKLuw 1 RIGHTSH10NP 0 1 FORMAT "%8.6"
 /begin AXIS_DESCR STD_AXIS vVehSpI_AbsMaxSafeVehSpd_xdu16 VFZHIGH 5 0 410 FORMAT "%8.4" DEPOSIT ABSOLUTE /end AXIS_DESCR
/end CHARACTERISTIC
/begin CHARACTERISTIC xDTSC_VehicleSpeedCorrStraight_XAU16_0___A "Korrekturfaktor für das Kompensationsmoment (Eingangsgröße: Fahrzeuggeschwindigkeit)" CURVE 0x15DEF4 AblGLKLuw 1 RIGHTSH10NP 0 1 FORMAT "%8.6"
 /begin AXIS_DESCR STD_AXIS vVehSpI_AbsMaxSafeVehSpd_xdu16 VFZHIGH 5 0 410 FORMAT "%8.4" DEPOSIT ABSOLUTE /end AXIS_DESCR
/end CHARACTERISTIC
/begin CHARACTERISTIC xDTSC_VehicleSpeedCorrStraight_XAU16_1___A "Korrekturfaktor für das Kompensationsmoment (Eingangsgröße: Fahrzeuggeschwindigkeit)" CURVE 0x15DF0C AblGLKLuw 1 RIGHTSH10NP 0 1 FORMAT "%8.6"
 /begin AXIS_DESCR STD_AXIS vVehSpI_AbsMaxSafeVehSpd_xdu16 VFZHIGH 5 0 410 FORMAT "%8.4" DEPOSIT ABSOLUTE /end AXIS_DESCR
/end CHARACTERISTIC
/begin CHARACTERISTIC xDTSC_VehicleSpeedCorrStraight_XAU16_2___A "Korrekturfaktor für das Kompensationsmoment (Eingangsgröße: Fahrzeuggeschwindigkeit)" CURVE 0x15DF24 AblGLKLuw 1 RIGHTSH10NP 0 1 FORMAT "%8.6"
 /begin AXIS_DESCR STD_AXIS vVehSpI_AbsMaxSafeVehSpd_xdu16 VFZHIGH 5 0 410 FORMAT "%8.4" DEPOSIT ABSOLUTE /end AXIS_DESCR
/end CHARACTERISTIC
/begin CHARACTERISTIC xDTSC_VehicleSpeedCorrStraight_XAU16_3___A "Korrekturfaktor für das Kompensationsmoment (Eingangsgröße: Fahrzeuggeschwindigkeit)" CURVE 0x15DF3C AblGLKLuw 1 RIGHTSH10NP 0 1 FORMAT "%8.6"
 /begin AXIS_DESCR STD_AXIS vVehSpI_AbsMaxSafeVehSpd_xdu16 VFZHIGH 5 0 410 FORMAT "%8.4" DEPOSIT ABSOLUTE /end AXIS_DESCR
/end CHARACTERISTIC
/begin CHARACTERISTIC xDTSC_VehicleSpeedCorrStraight_XAU16_4___A "Korrekturfaktor für das Kompensationsmoment (Eingangsgröße: Fahrzeuggeschwindigkeit)" CURVE 0x15DF54 AblGLKLuw 1 RIGHTSH10NP 0 1 FORMAT "%8.6"
 /begin AXIS_DESCR STD_AXIS vVehSpI_AbsMaxSafeVehSpd_xdu16 VFZHIGH 5 0 410 FORMAT "%8.4" DEPOSIT ABSOLUTE /end AXIS_DESCR
/end CHARACTERISTIC
/begin CHARACTERISTIC xDTSC_VehicleSpeedCorrStraight_XAU16_5___A "Korrekturfaktor für das Kompensationsmoment (Eingangsgröße: Fahrzeuggeschwindigkeit)" CURVE 0x15DF6C AblGLKLuw 1 RIGHTSH10NP 0 1 FORMAT "%8.6"
 /begin AXIS_DESCR STD_AXIS vVehSpI_AbsMaxSafeVehSpd_xdu16 VFZHIGH 5 0 410 FORMAT "%8.4" DEPOSIT ABSOLUTE /end AXIS_DESCR
/end CHARACTERISTIC
/begin CHARACTERISTIC xEndStopHsd_HighSpeedDampingFactorReverse_XAU16 "'High Speed Daempfungsfaktor Nm*min abhaengig von vFahrzeug beim Rueckwaertsfahren" CURVE 0x151748 AblGLKLuw 0.00488281 RIGHTSH15NP 0 0.004882813 FORMAT "%11.9"
 /begin AXIS_DESCR STD_AXIS vApplI_AbsVehicleSpeedFilt_xdu16 VFZHIGH 4 0 255 FORMAT "%8.4" DEPOSIT ABSOLUTE /end AXIS_DESCR
/end CHARACTERISTIC
/begin CHARACTERISTIC xEndStopHsd_HighSpeedDampingFactor_XAU16 "'High Speed Daempfungsfaktor Nm*min abhaengig von vFahrzeug" CURVE 0x15175C AblGLKLuw 0.00488281 RIGHTSH15NP 0 0.004882813 FORMAT "%11.9"
 /begin AXIS_DESCR STD_AXIS vApplI_AbsVehicleSpeedFilt_xdu16 VFZHIGH 4 0 255 FORMAT "%8.4" DEPOSIT ABSOLUTE /end AXIS_DESCR
/end CHARACTERISTIC
/begin CHARACTERISTIC xEndStopHsd_SubstHighSpeedDampingFactorReverse_XDU16 "Ersatzwert - High Speed Daempfungsfaktor Nm*min beim Rueckwaertsfahren" VALUE 0x1509AA AblGLKWuw 0.00488281 RIGHTSH15NP 0 0.004882813 FORMAT "%11.9" /end CHARACTERISTIC
/begin CHARACTERISTIC xEndStopHsd_SubstHighSpeedDampingFactor_XDU16 "Ersatzwert - High Speed Daempfungsfaktor Nm*min" VALUE 0x1509AC AblGLKWuw 0.00488281 RIGHTSH15NP 0 0.004882813 FORMAT "%11.9" /end CHARACTERISTIC
/begin CHARACTERISTIC xEndStop_Damping_XAS16_0___A "Daempfungskennlinie in Nm/(1024/min) abhaengig vom Abstand zum Endanschlag" CURVE 0x15DF84 AblGLKLsw 10 NM_MIN_1024 0 10 FORMAT "%8.5"
 /begin AXIS_DESCR STD_AXIS lEndStopI_DistanceToEndstop_xds16 RACKPOS128 5 -5 5 FORMAT "%8.6" DEPOSIT ABSOLUTE /end AXIS_DESCR
/end CHARACTERISTIC
/begin CHARACTERISTIC xEndStop_Damping_XAS16_1___A "Daempfungskennlinie in Nm/(1024/min) abhaengig vom Abstand zum Endanschlag" CURVE 0x15DF9C AblGLKLsw 10 NM_MIN_1024 0 10 FORMAT "%8.5"
 /begin AXIS_DESCR STD_AXIS lEndStopI_DistanceToEndstop_xds16 RACKPOS128 5 -5 5 FORMAT "%8.6" DEPOSIT ABSOLUTE /end AXIS_DESCR
/end CHARACTERISTIC
/begin CHARACTERISTIC xEndStop_Damping_XAS16_2___A "Daempfungskennlinie in Nm/(1024/min) abhaengig vom Abstand zum Endanschlag" CURVE 0x15DFB4 AblGLKLsw 10 NM_MIN_1024 0 10 FORMAT "%8.5"
 /begin AXIS_DESCR STD_AXIS lEndStopI_DistanceToEndstop_xds16 RACKPOS128 5 -5 5 FORMAT "%8.6" DEPOSIT ABSOLUTE /end AXIS_DESCR
/end CHARACTERISTIC
/begin CHARACTERISTIC xEndStop_Damping_XAS16_3___A "Daempfungskennlinie in Nm/(1024/min) abhaengig vom Abstand zum Endanschlag" CURVE 0x15DFCC AblGLKLsw 10 NM_MIN_1024 0 10 FORMAT "%8.5"
 /begin AXIS_DESCR STD_AXIS lEndStopI_DistanceToEndstop_xds16 RACKPOS128 5 -5 5 FORMAT "%8.6" DEPOSIT ABSOLUTE /end AXIS_DESCR
/end CHARACTERISTIC
/begin CHARACTERISTIC xEndStop_Damping_XAS16_4___A "Daempfungskennlinie in Nm/(1024/min) abhaengig vom Abstand zum Endanschlag" CURVE 0x15DFE4 AblGLKLsw 10 NM_MIN_1024 0 10 FORMAT "%8.5"
 /begin AXIS_DESCR STD_AXIS lEndStopI_DistanceToEndstop_xds16 RACKPOS128 5 -5 5 FORMAT "%8.6" DEPOSIT ABSOLUTE /end AXIS_DESCR
/end CHARACTERISTIC
/begin CHARACTERISTIC xEndStop_Damping_XAS16_5___A "Daempfungskennlinie in Nm/(1024/min) abhaengig vom Abstand zum Endanschlag" CURVE 0x15DFFC AblGLKLsw 10 NM_MIN_1024 0 10 FORMAT "%8.5"
 /begin AXIS_DESCR STD_AXIS lEndStopI_DistanceToEndstop_xds16 RACKPOS128 5 -5 5 FORMAT "%8.6" DEPOSIT ABSOLUTE /end AXIS_DESCR
/end CHARACTERISTIC
/begin CHARACTERISTIC xEndStop_FadeFactorLimitation_XAU16 "Fading-Faktor bei überlenkbarem Endanschlag (0: Limitierung auf 100% min(MotTrqSum2,MaxRequiredMotorTorque), 1: Limitierung auf 100% MaxRequiredMotorTorque)" CURVE 0x151770 AblGLKLuw 1 RIGHTSH15NP 0 1 FORMAT "%8.6"
 /begin AXIS_DESCR STD_AXIS nApplI_AbsRotorSpeedFilt_xdu16 VROT 2 0 5000 FORMAT "%3.0" DEPOSIT ABSOLUTE /end AXIS_DESCR
/end CHARACTERISTIC
/begin CHARACTERISTIC xEndStop_FadeFactorMotTrq_XAU16 "Fading-Faktor Motortorque LimitLowSpeed (0: Limitierung auf 100% MotTrqSum2, 1: Limitierung auf 100% MaxRequiredMotorTorque)" CURVE 0x15177C AblGLKLuw 1 MMOT 0 1 FORMAT "%8.6"
 /begin AXIS_DESCR STD_AXIS mApplI_AbsTorsionBarTorque_xdu16 TBTHIGH 2 0 8 FORMAT "%8.6" DEPOSIT ABSOLUTE /end AXIS_DESCR
/end CHARACTERISTIC
/begin CHARACTERISTIC xEndStop_FadeRateTorqueLim_XDU16 "Fade Rate für Federmoment von nicht ueberlenkbar auf ueberlenkbar; [value = rate * task cycle time]" VALUE 0x1509AE AblGLKWuw 1 RIGHTSH10NP_1MS 0 1 FORMAT "%8.6" /end CHARACTERISTIC
/begin CHARACTERISTIC xEndStop_RateLimiterToZeroRate_XDU32 "Gradient Nm/ms fuer RateToZeroLimiter bei überlenktem EndStop oder Deaktivierung des EndStops; [value = rate * task cycle time]" VALUE 0x1504D0 AblGLKWul 24 RIGHTSH15NP 0 24 FORMAT "%13.10" /end CHARACTERISTIC
/begin CHARACTERISTIC xEndStop_ResidualAssistance_XDU16_0___A "Faktor Mindest-Restunterstützung bei Überlenkbarem Endstop [%/100]" VALUE 0x15824C AblGLKWuw 1 RIGHTSH15NP 0 1 FORMAT "%8.6" /end CHARACTERISTIC
/begin CHARACTERISTIC xEndStop_ResidualAssistance_XDU16_1___A "Faktor Mindest-Restunterstützung bei Überlenkbarem Endstop [%/100]" VALUE 0x15824E AblGLKWuw 1 RIGHTSH15NP 0 1 FORMAT "%8.6" /end CHARACTERISTIC
/begin CHARACTERISTIC xEndStop_ResidualAssistance_XDU16_2___A "Faktor Mindest-Restunterstützung bei Überlenkbarem Endstop [%/100]" VALUE 0x158250 AblGLKWuw 1 RIGHTSH15NP 0 1 FORMAT "%8.6" /end CHARACTERISTIC
/begin CHARACTERISTIC xEndStop_ResidualAssistance_XDU16_3___A "Faktor Mindest-Restunterstützung bei Überlenkbarem Endstop [%/100]" VALUE 0x158252 AblGLKWuw 1 RIGHTSH15NP 0 1 FORMAT "%8.6" /end CHARACTERISTIC
/begin CHARACTERISTIC xEndStop_ResidualAssistance_XDU16_4___A "Faktor Mindest-Restunterstützung bei Überlenkbarem Endstop [%/100]" VALUE 0x158254 AblGLKWuw 1 RIGHTSH15NP 0 1 FORMAT "%8.6" /end CHARACTERISTIC
/begin CHARACTERISTIC xEndStop_ResidualAssistance_XDU16_5___A "Faktor Mindest-Restunterstützung bei Überlenkbarem Endstop [%/100]" VALUE 0x158256 AblGLKWuw 1 RIGHTSH15NP 0 1 FORMAT "%8.6" /end CHARACTERISTIC
/begin CHARACTERISTIC xEndStop_RotSpeedFact_XAU16 "Faktor auf Rotordrehzahl" CURVE 0x151788 AblGLKLuw 5 RIGHTSH10NP 0 5 FORMAT "%8.6"
 /begin AXIS_DESCR STD_AXIS nApplI_AbsRotorSpeedFilt_xdu16 VROT 3 0 3000 FORMAT "%3.0" DEPOSIT ABSOLUTE /end AXIS_DESCR
/end CHARACTERISTIC
/begin CHARACTERISTIC xEndStop_RotSpeedFiltFact_XDU16 "Filterfaktor fuer Rotordrehzahl; [value = filterfact * task cycle time]" VALUE 0x1509B0 AblGLKWuw 0.988281 RIGHTSH8NP 0.01171875 1 FORMAT "%8.6" /end CHARACTERISTIC
/begin CHARACTERISTIC xEndStop_SpringFactorGrad_XDU16 "Gradient Faktor/ms fuer Reduzierung des Federmoments, wenn Lernstatus =1; [value = gradient * task cycle time]" VALUE 0x1509B2 AblGLKWuw 0.100006 RIGHTSH15NP 0 0.1000061 FORMAT "%9.7" /end CHARACTERISTIC
/begin CHARACTERISTIC xEndStop_uTotalMotTorLimLearnFinished_XDU16 "Fertiglernbedingung: min. LimMotTorFactor" VALUE 0x1509B4 AblGLKWuw 100 RSH15 0 100 FORMAT "%8.4" /end CHARACTERISTIC
/begin CHARACTERISTIC yDMS_DefaultActCharacteristic_XDU8 "Default Actual characteristic, 0-Normal Mode, 1-Comfort Mode, 2-Sport Mode, 3-Reserved1, 4-Reserved2" VALUE 0x150B59 AblGLKWub 5 ZU0 0 5 FORMAT "%5.3" /end CHARACTERISTIC
/begin CHARACTERISTIC zcnBusOffSilentTime_XDU8 "Zeit bis zur Wiederaufnahme des CAN-Sendebetriebs nach BusOff" VALUE 0x150B62 AblGLKWub 248 ZU0 7 255 FORMAT "%5.1" /end CHARACTERISTIC
/begin CHARACTERISTIC zcnTxRecoveryMax_XDU8 "" VALUE 0x150B63 AblGLKWub 15 ZU0 5 20 FORMAT "%5.2" /end CHARACTERISTIC
/begin CHARACTERISTIC zcnTxTimeoutMax_XDU8 "" VALUE 0x150B64 AblGLKWub 18 ZU0 2 20 FORMAT "%5.2" /end CHARACTERISTIC
/begin CHARACTERISTIC zcrMinChatterPeriodsCountDelayed_XDU8 "minimum chatter cycle counter during holing time (after chatter detection finished)" VALUE 0x150B65 AblGLKWub 30 ZU0 0 30 FORMAT "%5.2" /end CHARACTERISTIC
/begin CHARACTERISTIC zDMS_MaxVehicleModeIndex_XDU8 "Max Index for vehicle mode table" VALUE 0x150B66 AblGLKWub 255 ZU0 0 255 FORMAT "%5.1" /end CHARACTERISTIC
/begin CHARACTERISTIC zDthrCtrl_IDFcnt_XDU8 "Anzahl von schnellen Ueberlenkungen" VALUE 0x150B67 AblGLKWub 250 ZU0 0 250 FORMAT "%5.1" /end CHARACTERISTIC
/begin CHARACTERISTIC zDthrCtrl_IDScnt_XDU8 "Anzahl der Indexmarkenüberlenkungen" VALUE 0x150B68 AblGLKWub 250 ZU0 0 250 FORMAT "%5.1" /end CHARACTERISTIC
/begin CHARACTERISTIC zDTSC_MinActivationCycles4Calibration_XDU8 "Minimale Anzahl von Aktivierungszyklen, damit mit der Berechnung des Kalibrierwerts begonnen wird" VALUE 0x150B69 AblGLKWub 255 ZU0 0 255 FORMAT "%5.1" /end CHARACTERISTIC
/begin CHARACTERISTIC zDTSC_MinActivationCycles4Validation_XDU8 "Minimale Anzahl von Aktivierungszyklen, damit mit der Validierung des Kalibrierwerts begonnen wird" VALUE 0x150B6A AblGLKWub 255 ZU0 0 255 FORMAT "%5.1" /end CHARACTERISTIC
/begin CHARACTERISTIC zDTSC_MinActiveCycles4Calibration_XDU16 "Minimale Anzahl von Kalibrierzyklen für die Berechnung des Kalibrierwerts" VALUE 0x150A9C AblGLKWuw 59999 ZU0 1 60000 FORMAT "%8.2" /end CHARACTERISTIC
/begin CHARACTERISTIC zDTSC_MinActiveCycles4Validation_XDU16 "Minimale Anzahl von Validierungszyklen für die Validierung des Kalibrierwerts" VALUE 0x150A9E AblGLKWuw 59999 ZU0 1 60000 FORMAT "%8.2" /end CHARACTERISTIC
/begin CHARACTERISTIC zEndStop_MaxChancesWriteTrigger_XDU8 "Maximum chances given for write request before triggering error" VALUE 0x150B6B AblGLKWub 10 ZU0 0 10 FORMAT "%5.2" /end CHARACTERISTIC
/begin MEASUREMENT aDsdI_LateralAcceleration_xdf32 "Querbeschleunigung [m/s^2]" FLOAT32_IEEE ZU0 1 100 -30 30 FORMAT "%10.7" ECU_ADDRESS 0xFEBE9048 /end MEASUREMENT
/begin MEASUREMENT aDsd_AccLatByYawSetUndersteer_xdf32 "Referenzquerbeschleunigung Steilkurvenerkennung [m/s^2]" FLOAT32_IEEE ZU0 1 100 0 100 FORMAT "%10.6" ECU_ADDRESS 0xFEBE904C /end MEASUREMENT
/begin MEASUREMENT fApplI_DsrErrorModeMonSafe_xdb "Flag ob diverse CAN Eingangsignale gueltig sind" UWORD ZU0 1 100 0 1 BIT_MASK 0x1 FORMAT "%5.3" ECU_ADDRESS 0xFEBE9840 /end MEASUREMENT
/begin MEASUREMENT fApplI_DSRTorqueLimited_xdb "Flag, ob Moment begrenzt wurde(0=nicht limitiert, 1=limitiert)" UWORD ZU0 1 100 0 1 BIT_MASK 0x1 FORMAT "%5.3" ECU_ADDRESS 0xFEBE9842 /end MEASUREMENT
/begin MEASUREMENT fCJCI_MonSafeOk_xdb "Indicates whether the MonitorSafe checks report OK (true) or if they have detected a problem (false)" UWORD ZU0 1 100 0 1 BIT_MASK 0x1 FORMAT "%5.3" ECU_ADDRESS 0xFEBE9853 /end MEASUREMENT
/begin MEASUREMENT fCJC_Activate_xdb "Indicates whether CJC shall actively calculate and request a torque." UWORD ZU0 1 100 0 1 BIT_MASK 0x1 FORMAT "%5.3" ECU_ADDRESS 0xFEBE9854 /end MEASUREMENT
/begin MEASUREMENT fCJC_LastCJCArbPas_xdb "Indicates whether the sFctCoI_ArbitrationResult is Passive and the mCJC_DesSteerTrqOffsetChecked is 0 in previous cycle or not " UWORD ZU0 1 100 0 1 BIT_MASK 0x1 FORMAT "%5.3" ECU_ADDRESS 0xFEBE9855 /end MEASUREMENT
/begin MEASUREMENT fcnBusOffFlag_xdb "CAN BusOff flag" UBYTE BIT 1 100 0 1 BIT_MASK 0x1 FORMAT "%5.3" ECU_ADDRESS 0xFEBE9856 /end MEASUREMENT
/begin MEASUREMENT fcnCanBusOffTransmissionStopped_xdb "CAN BusOff Übertragung CAN gestoppt" UBYTE BIT 1 100 0 1 BIT_MASK 0x1 FORMAT "%5.3" ECU_ADDRESS 0xFEBE9857 /end MEASUREMENT
/begin MEASUREMENT fcnTxEnable_xdb "Senden von CAN-Nachrichten aktivieren" UWORD BIT 1 100 0 1 BIT_MASK 0x1 FORMAT "%5.3" ECU_ADDRESS 0xFEBE9858 /end MEASUREMENT
/begin MEASUREMENT fDMSI_LkaActiveRequest_xdb "DMS-Anforderung zur Aktivierung von LKA" UWORD ZU0 1 100 0 1 BIT_MASK 0x1 FORMAT "%5.3" ECU_ADDRESS 0xFEBE9859 /end MEASUREMENT
/begin MEASUREMENT fDsdI_BankedCurveDetected_xdb "Flag Steilkurvenerkennung 1=Steilkurve erkannt 0=Steilkurve nicht erkannt" UWORD ZU0 1 100 0 1 BIT_MASK 0x1 FORMAT "%5.3" ECU_ADDRESS 0xFEBE985A /end MEASUREMENT
/begin MEASUREMENT fDsd_ValidVehSpeed_xdb "Status v_vehicle nach Geschw.Auswertung: 0=ungueltig; 1=gueltig" UWORD ZU0 1 100 0 1 BIT_MASK 0x1 FORMAT "%5.3" ECU_ADDRESS 0xFEBE985B /end MEASUREMENT
/begin MEASUREMENT fDsd_YawLearnedFine_xdb "Langzeit Nullpunktabgleich Gierrate erfolgt" UWORD ZU0 1 100 0 1 BIT_MASK 0x1 FORMAT "%5.3" ECU_ADDRESS 0xFEBE985C /end MEASUREMENT
/begin MEASUREMENT fDsd_YawLearnedInit_xdb "Kurzzeit Nullpunktabgleich Gierrate erfolgt" UWORD ZU0 1 100 0 1 BIT_MASK 0x1 FORMAT "%5.3" ECU_ADDRESS 0xFEBE985D /end MEASUREMENT
/begin MEASUREMENT fDsd_ZeroPntYawRateLearned_xdb "Nullpunktabgleich Gierrate erfolgt" UWORD ZU0 1 100 0 1 BIT_MASK 0x1 FORMAT "%5.3" ECU_ADDRESS 0xFEBE985E /end MEASUREMENT
/begin MEASUREMENT fDsrI_MonSafeOk_xdb "Interner Dsr Kontroll Status " UWORD ZU0 1 100 0 1 BIT_MASK 0x1 FORMAT "%5.3" ECU_ADDRESS 0xFEBE985F /end MEASUREMENT
/begin MEASUREMENT fDsr_EmaActivatedMonSafe_xdb "Flag ob diverse CAN Eingangsignale gueltig sind" UWORD ZU0 1 100 0 1 BIT_MASK 0x1 FORMAT "%5.3" ECU_ADDRESS 0xFEBE9861 /end MEASUREMENT
/begin MEASUREMENT fDsr_LastLdwArbitrationResultPassive_xdb "Indicates whether the DSRArbitrationResult is Passive and the TbtOffset is 0 in previous cycle or not for DSR arbitration valid" UWORD ZU0 1 100 0 1 BIT_MASK 0x1 FORMAT "%5.3" ECU_ADDRESS 0xFEBE9864 /end MEASUREMENT
/begin MEASUREMENT fDTCReport_Allow_xdu8 "" UBYTE ZU0 1 100 0 4 FORMAT "%5.3" ECU_ADDRESS 0xFEBE9865 /end MEASUREMENT
/begin MEASUREMENT fDthrCtrl_MonSafeOk_xdb "Indicates whether the MonitorSafe checks report OK (1) or if they have detected a problem (0)" UWORD ZU0 1 100 0 1 BIT_MASK 0x1 FORMAT "%5.3" ECU_ADDRESS 0xFEBE9866 /end MEASUREMENT
/begin MEASUREMENT fDthrCtrl_NvMWriteError_xdb "Shows write error has detected" UBYTE BIT 1 100 0 1 BIT_MASK 0x1 FORMAT "%5.3" ECU_ADDRESS 0xFEBE9867 /end MEASUREMENT
/begin MEASUREMENT fDthrCtrl_RackCtrlEnable_xdb "Dither Regler Aktivierung" UBYTE STATUS 1 100 0 1 BIT_MASK 0x1 FORMAT "%5.3" ECU_ADDRESS 0xFEBE9868 /end MEASUREMENT
/begin MEASUREMENT fDthrCtrl_ResetRequest_xdb "Reset Request for Dither Control Nv Block: 0 - No Reset, 1 - Reset" UWORD ZU0 1 100 0 1 BIT_MASK 0x1 FORMAT "%5.3" ECU_ADDRESS 0xFEBE9869 /end MEASUREMENT
/begin MEASUREMENT fDTSCI_MonSafeOk_xdb "Indicates whether MonitorSafe checks report OK (1) or if they have detected a problem (0)" UWORD ZU0 1 100 0 1 BIT_MASK 0x1 FORMAT "%5.3" ECU_ADDRESS 0xFEBE986A /end MEASUREMENT
/begin MEASUREMENT fDTSC_ActivateFctCo_xdb "Flag für den ActivationRequest des FunctionCoordinators" UWORD ZU0 1 100 0 1 BIT_MASK 0x1 FORMAT "%5.3" ECU_ADDRESS 0xFEBE986B /end MEASUREMENT
/begin MEASUREMENT fDTSC_ActivateRequestSupp_xdb "DTSC Activation Request flag" UWORD ZU0 1 100 0 1 BIT_MASK 0x1 FORMAT "%5.3" ECU_ADDRESS 0xFEBE986C /end MEASUREMENT
/begin MEASUREMENT fDTSC_NvMReadError_xdb "Flag für NvM-Lesefehler" UWORD ZU0 1 100 0 1 BIT_MASK 0x1 FORMAT "%5.3" ECU_ADDRESS 0xFEBE986D /end MEASUREMENT
/begin MEASUREMENT fDTSC_PrevArbitrationResultPassive_xdb "1 - Previous Arbitration Result Passive" UWORD ZU0 1 100 0 1 BIT_MASK 0x1 FORMAT "%5.3" ECU_ADDRESS 0xFEBE986E /end MEASUREMENT
/begin MEASUREMENT fDTSC_StateIsActive_xdb "zeigt an, ob DTSC aktiv ein Moment berechnet und anfordert." UWORD ZU0 1 100 0 1 BIT_MASK 0x1 FORMAT "%5.3" ECU_ADDRESS 0xFEBE986F /end MEASUREMENT
/begin MEASUREMENT fEndStopHsdI_EnableUndervoltOffset_xdb "Enable undervolt offset in EndStopHsd if set to true" UWORD ZU0 1 100 0 1 BIT_MASK 0x1 FORMAT "%5.3" ECU_ADDRESS 0xFEBE9870 /end MEASUREMENT
/begin MEASUREMENT fEndStopHsd_Disable_xdb "Disable flag: Wird beim Monitoring ein Fehler erkannt, wird das Disable-Flag gesetzt" UWORD ZU0 1 100 0 1 BIT_MASK 0x1 FORMAT "%5.3" ECU_ADDRESS 0xFEBE9871 /end MEASUREMENT
/begin MEASUREMENT fEndStopHsd_ForwardDrv_xdb "Internal fwd driving flag (0=bwd; 1=fwd)" UWORD ZU0 1 100 0 1 BIT_MASK 0x1 FORMAT "%5.3" ECU_ADDRESS 0xFEBE9872 /end MEASUREMENT
/begin MEASUREMENT fEndStopI_EndStopActive_xdu8 "Flag fuer EndStop aktiv" UBYTE ZU0 1 100 0 1 FORMAT "%5.3" ECU_ADDRESS 0xFEBE9873 /end MEASUREMENT
/begin MEASUREMENT fEndStopI_LimitEnable_xdu8 "Anzeige Flag Einschalten Limitierung Endanschlagsmomente" UBYTE ZU0 1 100 0 1 FORMAT "%5.3" ECU_ADDRESS 0xFEBE9874 /end MEASUREMENT
/begin MEASUREMENT fEndStopI_ReduceSpring_xdu8 "Flag fuer SpringTorque Reduktion beim nicht-überlenkbaren EndStop" UBYTE ZU0 1 100 0 1 FORMAT "%5.3" ECU_ADDRESS 0xFEBE9875 /end MEASUREMENT
/begin MEASUREMENT fEndStopI_SpringActive_xdu8 "Flag fuer Federmoment aktiv" UBYTE ZU0 1 100 0 1 FORMAT "%5.3" ECU_ADDRESS 0xFEBE9876 /end MEASUREMENT
/begin MEASUREMENT fEndStop_AllowSpringReduction_xdu8 "Freigabeflag fuer Zuruecknahme des Federmoments wenn fertif gelernt" UBYTE ZU0 1 100 0 1 FORMAT "%5.3" ECU_ADDRESS 0xFEBE9877 /end MEASUREMENT
/begin MEASUREMENT fEndStop_Disable_xdb "Disable flag: Wird beim Monitoring ein Fehler erkannt, wird das Disable-Flag gesetzt" UBYTE BIT 1 100 0 1 BIT_MASK 0x1 FORMAT "%5.3" ECU_ADDRESS 0xFEBE9878 /end MEASUREMENT
/begin MEASUREMENT fEndStop_JobCallCounter_xdu16 "Jobcallback-Zähler" UWORD ZU0 1 100 0 65535 FORMAT "%8.2" ECU_ADDRESS 0xFEBE93A6 /end MEASUREMENT
/begin MEASUREMENT fEndStop_JobResultOK_xdu8 "Flag, um zu wissen, dass Lesen oder Schreiben aufgerufen wird " UBYTE ZU0 1 100 0 255 FORMAT "%5.1" ECU_ADDRESS 0xFEBE9879 /end MEASUREMENT
/begin MEASUREMENT fEndStop_NoLearnFlag_xdu8 "Ist dieses Flag gesetzt wird nicht nachgelernt" UBYTE ZU0 1 100 0 1 FORMAT "%5.3" ECU_ADDRESS 0xFEBE987A /end MEASUREMENT
/begin MEASUREMENT fEndStop_RateDownLimiterActive_xdu8 "Statische Größe: Ist dieses Flag gesetzt ist der RateDownLimiter aktiv" UBYTE ZU0 1 100 0 1 FORMAT "%5.3" ECU_ADDRESS 0xFEBE987B /end MEASUREMENT
/begin MEASUREMENT fEndStop_RequestPendingRangeOffset_xdb "Schreibanforderung vom CalcRangeAndOffset-Subsystem" UBYTE BIT 1 100 0 1 BIT_MASK 0x1 FORMAT "%5.3" ECU_ADDRESS 0xFEBE987C /end MEASUREMENT
/begin MEASUREMENT fEndStop_RequestPushed_xdb "Flag to Check NvM Write Request State" UBYTE BIT 1 100 0 1 BIT_MASK 0x1 FORMAT "%5.3" ECU_ADDRESS 0xFEBE987D /end MEASUREMENT
/begin MEASUREMENT fEndStop_ResetFlag_xdb "Flag fuer Endanschlagwerte ruecksetzen" UBYTE BIT 1 100 0 1 BIT_MASK 0x1 FORMAT "%5.3" ECU_ADDRESS 0xFEBE987E /end MEASUREMENT
/begin MEASUREMENT fEndStop_SpringActiveCheck_xdu8 "Flag fuer Federmoment aktiv für Überprüfung" UBYTE ZU0 1 100 0 1 FORMAT "%5.3" ECU_ADDRESS 0xFEBE987F /end MEASUREMENT
/begin MEASUREMENT fRequestPendingLearnState_xdb "Schreibanforderung vom CalcNewLearnStates-Subsystem" UBYTE BIT 1 100 0 1 BIT_MASK 0x1 FORMAT "%5.3" ECU_ADDRESS 0xFEBE98C5 /end MEASUREMENT
/begin MEASUREMENT fVolDTCReport_Notallow_xdu8 "" UBYTE ZU0 1 100 0 4 FORMAT "%5.3" ECU_ADDRESS 0xFEBE98F6 /end MEASUREMENT
/begin MEASUREMENT hDsd_NumOversteer_xdf32 "Grad Übersteuern [%]" FLOAT32_IEEE ZU0 1 100 0 100 FORMAT "%10.6" ECU_ADDRESS 0xFEBE9064 /end MEASUREMENT
/begin MEASUREMENT hDsd_NumUndersteer_xdf32 "Grad Untersteuern [%]" FLOAT32_IEEE ZU0 1 100 0 100 FORMAT "%10.6" ECU_ADDRESS 0xFEBE9068 /end MEASUREMENT
/begin MEASUREMENT kBci_BSTCurveXAxisBackwardL2_xaf32 "level2 rückgerechnete x-Achsenwerte der BasicSteerTorque-Kennlinie (Zahnstangenkraft)" FLOAT32_IEEE ZU0 1 100 -30000 30000 FORMAT "%10.4" ECU_ADDRESS 0xFEBE9AC8 MATRIX_DIM 10 1 1 /end MEASUREMENT
/begin MEASUREMENT kBci_BSTCurveXAxisBackwardRescaledL2_xaf32 "level2 rückgerechnete und rückskalierte x-Achsenwerte der BasicSteerTorque-Kennlinie (Zahnstangenkraft)" FLOAT32_IEEE ZU0 1 100 -30000 30000 FORMAT "%10.4" ECU_ADDRESS 0xFEBE9AF0 MATRIX_DIM 10 1 1 /end MEASUREMENT
/begin MEASUREMENT lDthrCtrlI_AddSteerRange_xdu16 "zusätzlicher Lenkbereich / Endstop" UWORD RACKPOS128 1 100 0 511.9922 FORMAT "%8.4" ECU_ADDRESS 0xFEBE93CC /end MEASUREMENT
/begin MEASUREMENT lDthrCtrlI_CenterOffset_xds16 "Mittelversatz [mm] / Endstop" SWORD RACKPOS128 1 100 -256 255.9922 FORMAT "%8.4" ECU_ADDRESS 0xFEBE93CE /end MEASUREMENT
/begin MEASUREMENT lDthrCtrlI_DesiredRackPosition_xds16 "Soll-Zanhstangenposition" SWORD RACKPOS128 1 100 -200 200 FORMAT "%8.4" ECU_ADDRESS 0xFEBE93D0 /end MEASUREMENT
/begin MEASUREMENT lDthrCtrlI_RelRackPosition_xds16 "relative Ist-Zahnstangenposition" SWORD RACKPOS128 1 100 -200 200 FORMAT "%8.4" ECU_ADDRESS 0xFEBE93D2 /end MEASUREMENT
/begin MEASUREMENT lDthrCtrlI_SteerRngProd_xdu16 "steering range right to left measured at production" UWORD RACKPOS128 1 100 0 511.9922 FORMAT "%8.4" ECU_ADDRESS 0xFEBE93D4 /end MEASUREMENT
/begin MEASUREMENT lDthrCtrl_RackPositionDiff_xds16 "Difference between target and actual rack position" SWORD RACKPOS128 1 100 -200 200 FORMAT "%8.4" ECU_ADDRESS 0xFEBE93D6 /end MEASUREMENT
/begin MEASUREMENT lEndStopHsd_InternDistToESCheck_xds16 "Interne Groesse - Abstand vom Endanschlag in mm" SWORD RACKPOS128 1 100 -125 125 FORMAT "%8.4" ECU_ADDRESS 0xFEBE93D8 /end MEASUREMENT
/begin MEASUREMENT lEndStopHsd_InternDistToES_xds16 "Interne Groesse - Abstand vom Endanschlag in mm" SWORD RACKPOS128 1 100 -125 125 FORMAT "%8.4" ECU_ADDRESS 0xFEBE93DA /end MEASUREMENT
/begin MEASUREMENT lEndStopI_AbsPosOffset_xdu16 "Zusaetzlicher Offset des Endanschlags (VSE). Wenn EndStopSupp nicht benutzt, wird dieser Wert nur initial geschrieben" UWORD RACKPOS128 1 100 0 30 FORMAT "%8.5" ECU_ADDRESS 0xFEBE93DC /end MEASUREMENT
/begin MEASUREMENT lEndStopI_AddSteerRange_xdu16 "zusätzlicher Lenkbereich / Endstop" UWORD RACKPOS128 1 100 0 511.9922 FORMAT "%8.4" ECU_ADDRESS 0xFEBE93DE /end MEASUREMENT
/begin MEASUREMENT lEndStopI_CenterOffset_xds16 "Mittelversatz [mm] / Endstop" SWORD RACKPOS128 1 100 -256 255.9922 FORMAT "%8.4" ECU_ADDRESS 0xFEBE93E0 /end MEASUREMENT
/begin MEASUREMENT lEndStopI_DistanceToEndstop_xds16 "Abstand vom Endanschlag in mm" SWORD RACKPOS128 1 100 -125 125 FORMAT "%8.4" ECU_ADDRESS 0xFEBE93E2 /end MEASUREMENT
/begin MEASUREMENT lEndStopI_EndstopPosLeft_xds16 "aktuelle SW-Endstop-Position links" SWORD RACKPOS128 1 100 -200 200 FORMAT "%8.4" ECU_ADDRESS 0xFEBE93E4 /end MEASUREMENT
/begin MEASUREMENT lEndStopI_EndstopPosRight_xds16 "aktuelle SW-Endstop-Position rechts" SWORD RACKPOS128 1 100 -200 200 FORMAT "%8.4" ECU_ADDRESS 0xFEBE93E6 /end MEASUREMENT
/begin MEASUREMENT lEndStopI_RackPosition_xds16 " " SWORD RACKPOS128 1 100 -200 200 FORMAT "%8.4" ECU_ADDRESS 0xFEBE93E8 /end MEASUREMENT
/begin MEASUREMENT lEndStopI_RackPosMax_xds16 "Max Zahnstangenhub" SWORD RACKPOS128 1 100 -200 200 FORMAT "%8.4" ECU_ADDRESS 0xFEBE93EA /end MEASUREMENT
/begin MEASUREMENT lEndStopI_RackPosMin_xds16 "Min Zahnstangenhub" SWORD RACKPOS128 1 100 -200 200 FORMAT "%8.4" ECU_ADDRESS 0xFEBE93EC /end MEASUREMENT
/begin MEASUREMENT lEndStopI_ReqRackPosMax_xds16 "Geforderte Endstopposition aus VSE (Distanz Nulllage-alternative Endstopposition). Wenn EndStopSupp nicht benutzt, wird dieser Wert nur initial geschrieben" SWORD RACKPOS128 1 100 0 200 FORMAT "%8.4" ECU_ADDRESS 0xFEBE93EE /end MEASUREMENT
/begin MEASUREMENT lEndStopI_ReqRackPosMin_xds16 "Geforderte Endstopposition aus VSE (Distanz Nulllage-alternative Endstopposition). Wenn EndStopSupp nicht benutzt, wird dieser Wert nur initial geschrieben" SWORD RACKPOS128 1 100 -200 0 FORMAT "%8.4" ECU_ADDRESS 0xFEBE93F0 /end MEASUREMENT
/begin MEASUREMENT lEndStop_AllowedDynPosBorder_xdu16 "max. erlaubte Zahnstangenpositon, abhaenig von dynamic endstop (virtual endstop) aktiv/inaktiv" UWORD RACKPOS128 1 100 0 200 FORMAT "%8.4" ECU_ADDRESS 0xFEBE93F2 /end MEASUREMENT
/begin MEASUREMENT lEndStop_DistanceToEndstopOrg_xds16 "Originaler Abstand vom Endanschlag in mm" SWORD RACKPOS128 1 100 -125 125 FORMAT "%8.4" ECU_ADDRESS 0xFEBE93F4 /end MEASUREMENT
/begin MEASUREMENT lEndStop_ESAbsRackPos_xdu16 "Statische Groeße: absolute Zahnstangenpositon mit Offset aus EndStopSupp" UWORD RACKPOS128 1 100 0 200 FORMAT "%8.4" ECU_ADDRESS 0xFEBE93F6 /end MEASUREMENT
/begin MEASUREMENT lEndStop_ESRackPos_xds16 "Statische Groeße: Zahnstangenpositon mit Offset aus EndStopSupp" SWORD RACKPOS128 1 100 -200 200 FORMAT "%8.4" ECU_ADDRESS 0xFEBE93F8 /end MEASUREMENT
/begin MEASUREMENT lEndStop_RackposMaxStoredinNVRam_out_xds16 "lEndStop_RackposMaxStoredinNVRam_out_xds16" SWORD RACKPOS128 1 100 -200 200 FORMAT "%8.4" ECU_ADDRESS 0xFEBE93FA /end MEASUREMENT
/begin MEASUREMENT lEndStop_RackposMinStoredinNVRam_out_xds16 "lEndStop_RackposMinStoredinNVRam_out_xds16" SWORD RACKPOS128 1 100 -200 200 FORMAT "%8.4" ECU_ADDRESS 0xFEBE93FC /end MEASUREMENT
/begin MEASUREMENT mBci_BSTCurveYAxisBackwardL2_xaf32 "level2 rückgerechnete y-Achsenwerte der BasicSteerTorque-Kennlinie (nominales Handmoment)" FLOAT32_IEEE ZU0 1 100 -15 15 FORMAT "%10.7" ECU_ADDRESS 0xFEBE9B18 MATRIX_DIM 10 1 1 /end MEASUREMENT
/begin MEASUREMENT mBci_BSTCurveYAxisBackwardRescaledL2_xaf32 "level2 rückgerechnete und rückskalierte y-Achsenwerte der BasicSteerTorque-Kennlinie (nominales Handmoment)" FLOAT32_IEEE ZU0 1 100 -15 15 FORMAT "%10.7" ECU_ADDRESS 0xFEBE9B40 MATRIX_DIM 10 1 1 /end MEASUREMENT
/begin MEASUREMENT mCentFeelI_NominalSteerTorque_xds16 "nominal center feel torque" SWORD TBTHIGH 1 100 -1 1 FORMAT "%8.6" ECU_ADDRESS 0xFEBE9450 /end MEASUREMENT
/begin MEASUREMENT mCJCI_DesMotTrqOffset4Check_xds16 "Desired motor torque offset of Cardan Joint Compensation to be read by Check component only" SWORD MMOT 1 100 -0.5 0.5 FORMAT "%9.7" ECU_ADDRESS 0xFEBE9452 /end MEASUREMENT
/begin MEASUREMENT mCJCI_DesMotTrqOffset_xds16 "Desired motor torque offset of Cardan Joint Compensation" SWORD MMOT 1 100 -0.5 0.5 FORMAT "%9.7" ECU_ADDRESS 0xFEBE9454 /end MEASUREMENT
/begin MEASUREMENT mCJCI_DesSteerTrqOffset4Check_xds16 "Desired steering torque offset from Cardan Joint Compensation to be read by Check component only" SWORD TBTHIGH 1 100 -3 3 FORMAT "%8.6" ECU_ADDRESS 0xFEBE9456 /end MEASUREMENT
/begin MEASUREMENT mCJCI_DesSteerTrqOffset_xds16 "Desired steer torque offset of Cardan Joint Compensation" SWORD TBTHIGH 1 100 -3 3 FORMAT "%8.6" ECU_ADDRESS 0xFEBE9458 /end MEASUREMENT
/begin MEASUREMENT mCJC_DesSteerTrqOffsetChecked_xds16 "Steer torque offset which has been subjected to the MakeSafe measures" SWORD TBTHIGH 1 100 -3 3 FORMAT "%8.6" ECU_ADDRESS 0xFEBE9372 /end MEASUREMENT
/begin MEASUREMENT mDrvTorque_InertiaTorque_xds32 "Moment aus Lenkradtraegheit für Fahrerhandmomentberechner (Nm)" SLONG TBTHIGH 1 100 -24.9990234375 24.9990234375 FORMAT "%13.10" ECU_ADDRESS 0xFEBE9084 /end MEASUREMENT
/begin MEASUREMENT mDrvTorque_TBTfilt_xds32 "Moment aus gefiltertem Drehstabmoment für Fahrerhandmomentberechner (Nm)" SLONG TBTHIGH 1 100 -24.9990234375 24.9990234375 FORMAT "%13.10" ECU_ADDRESS 0xFEBE9088 /end MEASUREMENT
/begin MEASUREMENT mDsrI_MotorTorqueOffset_xds16 "Final DSR motor torque offset" SWORD MMOT 1 100 -2 2 FORMAT "%8.6" ECU_ADDRESS 0xFEBE945A /end MEASUREMENT
/begin MEASUREMENT mDsrI_SteerTorqueOffset_xds16 "Final DSR TBT offset" SWORD TBTHIGH 1 100 -8 8 FORMAT "%8.6" ECU_ADDRESS 0xFEBE945C /end MEASUREMENT
/begin MEASUREMENT mDSR_currentRampValue_xds32 "DSR aktuelles Rampenwert des Handmoments-Offset" SLONG TBTHIGH 1 100 -25 25 FORMAT "%13.10" ECU_ADDRESS 0xFEBE908C /end MEASUREMENT
/begin MEASUREMENT mDSR_FilteredAbsTBTPlausiDelay_xds32 "Letzter Wert des tiefpaßgefilterten Torsionbartorque für plausi" SLONG RIGHTSH14NP 1 100 0 25 FORMAT "%13.10" ECU_ADDRESS 0xFEBE9090 /end MEASUREMENT
/begin MEASUREMENT mDSR_FilteredAbsTBTPlausi_xds16 "Tiefpass gefiltertes Drehstabmoment" SWORD TBTHIGH 1 100 0 25 FORMAT "%8.5" ECU_ADDRESS 0xFEBE945E /end MEASUREMENT
/begin MEASUREMENT mDSR_FilteredTBTDelay_xds32 "Letzter Wert des tiefpaßgefilterten Torsionbartorque" SLONG RIGHTSH14NP 1 100 -25 25 FORMAT "%13.10" ECU_ADDRESS 0xFEBE9094 /end MEASUREMENT
/begin MEASUREMENT mDSR_FilteredTBT_xds16 "Tiefpass gefiltertes Drehstabmoment" SWORD TBTHIGH 1 100 -25 25 FORMAT "%8.5" ECU_ADDRESS 0xFEBE9460 /end MEASUREMENT
/begin MEASUREMENT mDSR_MMot4Check_xds16 "DSR Motormomenten Offset" SWORD MMOT 1 100 -0.5 0.5 FORMAT "%9.7" ECU_ADDRESS 0xFEBE9462 /end MEASUREMENT
/begin MEASUREMENT mDsr_MotorTrqOffsetChecked_xds16 "Checked DSR Motor offset" SWORD TBTHIGH 1 100 -32 31.99902 FORMAT "%8.5" ECU_ADDRESS 0xFEBE9464 /end MEASUREMENT
/begin MEASUREMENT mDsr_SteerTrqOffsetChecked_xds16 "Checked DSR TBT offset" SWORD TBTHIGH 1 100 -32 31.99902 FORMAT "%8.5" ECU_ADDRESS 0xFEBE9466 /end MEASUREMENT
/begin MEASUREMENT mDSR_TBT4Check_xds16 "DSR Handmomenten Offset" SWORD TBTHIGH 1 100 -25 25 FORMAT "%8.5" ECU_ADDRESS 0xFEBE9468 /end MEASUREMENT
/begin MEASUREMENT mDthrCtrlI_RequestedTrq_xds16 "DitherControl Motor-Moment" SWORD MMOT 1 100 -10 10 FORMAT "%8.5" ECU_ADDRESS 0xFEBE946A /end MEASUREMENT
/begin MEASUREMENT mDthrCtrl_DesMotTrqOffsetChecked_xds16 "Steer torque offset which has been subjected to the MakeSafe measures" SWORD MMOT 1 100 -16 16 FORMAT "%8.5" ECU_ADDRESS 0xFEBE9374 /end MEASUREMENT
/begin MEASUREMENT mDthrCtrl_MotorTorque4Check_xds16 "Dither Soll-Moment" SWORD MMOT 1 100 -10 10 FORMAT "%8.5" ECU_ADDRESS 0xFEBE946C /end MEASUREMENT
/begin MEASUREMENT mDthrCtrl_SpeedCtrlIPart_xds16 "DitherControl Speed-Ctrl I-Part" SWORD MMOT 1 100 -32 31.99902 FORMAT "%8.5" ECU_ADDRESS 0xFEBE946E /end MEASUREMENT
/begin MEASUREMENT mDthrCtrl_SpeedCtrlPPart_xds16 "DitherControl Speed-Ctrl P-Part" SWORD MMOT 1 100 -32 31.99902 FORMAT "%8.5" ECU_ADDRESS 0xFEBE9470 /end MEASUREMENT
/begin MEASUREMENT mDTSCI_MotorTorque4Check_xds16 "Motormomentenoffset DriveTorqueSteeringCompensation zur Absicherung" SWORD MMOT 1 100 -8 8 FORMAT "%8.6" ECU_ADDRESS 0xFEBE9472 /end MEASUREMENT
/begin MEASUREMENT mDTSCI_MotorTorqueOffset_xds16 "Abgesichertes Motormomentoffset Drive Torque Steer Compensation" SWORD MMOT 1 100 -1 1 FORMAT "%8.6" ECU_ADDRESS 0xFEBE9474 /end MEASUREMENT
/begin MEASUREMENT mDTSC_AdaptiveValueInt_xds32 "Integrator Lernwert" SLONG MMOT 1 100 -2000000 2000000 FORMAT "%13.5" ECU_ADDRESS 0xFEBE9098 /end MEASUREMENT
/begin MEASUREMENT mDTSC_AdaptValue_xds16 "DriveTorqueSteerCompensation Adaptive Value" SWORD MMOT 1 100 -32 31.99902 FORMAT "%8.5" ECU_ADDRESS 0xFEBE9476 /end MEASUREMENT
/begin MEASUREMENT mDTSC_EffectiveTorque_xds16 "Wirkmoment (Motormoment + umgerechnetes Drehstabmoment - Reibung)" SWORD MMOT 1 100 -25 25 FORMAT "%8.5" ECU_ADDRESS 0xFEBE9478 /end MEASUREMENT
/begin MEASUREMENT mDTSC_MotorTorqueSaturated_xds16 "saturated Motormoment DTSC" SWORD MMOT 1 100 -1 1 FORMAT "%8.6" ECU_ADDRESS 0xFEBE947A /end MEASUREMENT
/begin MEASUREMENT mDTSC_TorsionBarTorqueDiffInt_xds32 "Abweichung Drehstabmoment bei der Validierung" SLONG TBTHIGH 1 100 -2000000 2000000 FORMAT "%13.5" ECU_ADDRESS 0xFEBE909C /end MEASUREMENT
/begin MEASUREMENT mDTSC_TorsionBarTorqueDiff_xds16 "Abweichung Drehstabmoment bei der Validierung" SWORD TBTHIGH 1 100 -25 25 FORMAT "%8.5" ECU_ADDRESS 0xFEBE947C /end MEASUREMENT
/begin MEASUREMENT mELKI_ELKStatus_xdu8 "ELK Status" UBYTE ZU0 1 100 0 7 FORMAT "%5.3" ECU_ADDRESS 0xFEBE98FA /end MEASUREMENT
/begin MEASUREMENT mEndStopHsdI_MotTrq4Check_xds16 "Daempfungsmoment bei hohen Drehzahlen fuer Ueberpruefung" SWORD MMOT 1 100 -12 12 FORMAT "%8.5" ECU_ADDRESS 0xFEBE947E /end MEASUREMENT
/begin MEASUREMENT mEndStopHsdI_MotTrq_xds16 "Dï¿½mpfungsmoment bei hohen Drehzahlen" SWORD MMOT 1 100 -12 12 FORMAT "%8.5" ECU_ADDRESS 0xFEBE9480 /end MEASUREMENT
/begin MEASUREMENT mEndStopHsd_MotTrqSaturated_xds16 "Begrenztes Dï¿½mpfungsmoment bei hohen Drehzahlen" SWORD MMOT 1 100 -12 12 FORMAT "%8.5" ECU_ADDRESS 0xFEBE9482 /end MEASUREMENT
/begin MEASUREMENT mEndStopI_Damping4Check_xds16 "Endanschlag Daempfung für Überprüfung" SWORD MMOT 1 100 -8 8 FORMAT "%8.6" ECU_ADDRESS 0xFEBE9484 /end MEASUREMENT
/begin MEASUREMENT mEndStopI_MotorTorque_xds16 "Endanschlagsmoment" SWORD MMOT 1 100 -24 24 FORMAT "%8.5" ECU_ADDRESS 0xFEBE9486 /end MEASUREMENT
/begin MEASUREMENT mEndStopI_SpringTorque4Check_xds16 "Endanschlag Federmoment für Überprüfung" SWORD MMOT 1 100 -23.99902 23.99902 FORMAT "%8.5" ECU_ADDRESS 0xFEBE9488 /end MEASUREMENT
/begin MEASUREMENT mEndStop_AbsLimSpring_xdu16 "Absolutes limitiertes Federmoment" UWORD MMOT 1 100 0 10 FORMAT "%8.5" ECU_ADDRESS 0xFEBE948A /end MEASUREMENT
/begin MEASUREMENT mEndStop_AbsMotTrqRateDownLimiter_xdu16 "Statische Größe: Absolutes saturiertes und gradientenbegrenztes Endanschlagsmoment" UWORD MMOT 1 100 0 24 FORMAT "%8.5" ECU_ADDRESS 0xFEBE948C /end MEASUREMENT
/begin MEASUREMENT mEndStop_AbsUnlimSpring_xdu16 "Absolutes nicht limitiertes Federmoment" UWORD MMOT 1 100 0 24 FORMAT "%8.5" ECU_ADDRESS 0xFEBE948E /end MEASUREMENT
/begin MEASUREMENT mEndStop_MotTrqRateDownLimiter_xds16 "Saturiertes und gradientenbegrenztes Endanschlagsmoment zur Überwachung" SWORD MMOT 1 100 -24 24 FORMAT "%8.5" ECU_ADDRESS 0xFEBE9490 /end MEASUREMENT
/begin MEASUREMENT mEndStop_MotTrqRateLimited_xds32 "Endanschlagsmoment" SLONG RIGHTSH15NP 1 100 -24 24 FORMAT "%13.10" ECU_ADDRESS 0xFEBE90A0 /end MEASUREMENT
/begin MEASUREMENT mEndStop_MotTrqSaturated_xds16 "Saturiertes Endanschlagsmoment zur Überwachung" SWORD MMOT 1 100 -24 24 FORMAT "%8.5" ECU_ADDRESS 0xFEBE9492 /end MEASUREMENT
/begin MEASUREMENT mEndStop_SpringTorque_xds16 "Endanschlag Federmoment" SWORD MMOT 1 100 -23.99902 23.99902 FORMAT "%8.5" ECU_ADDRESS 0xFEBE9494 /end MEASUREMENT
/begin MEASUREMENT mLDWI_LDWStatus_xdu8 "LDW Status" UBYTE ZU0 1 100 0 7 FORMAT "%5.3" ECU_ADDRESS 0xFEBE98FB /end MEASUREMENT
/begin MEASUREMENT mLKAI_LKAStatus_xdu8 "LKA Status" UBYTE ZU0 1 100 0 7 FORMAT "%5.3" ECU_ADDRESS 0xFEBE98FC /end MEASUREMENT
/begin MEASUREMENT nDsrI_AbsRotorSpeedFilt_xdu16 "absolute, gefilterte Rotorgeschwindigkeit" UWORD VROT 1 100 0 13000 FORMAT "%3.0" ECU_ADDRESS 0xFEBE95C2 /end MEASUREMENT
/begin MEASUREMENT nEndStopHsd_HystRotorSpeed_xds16 "verwendete Rotorgeschwindigkeit fuer HighSpeedDamping, mit Hysterese beaufschlagt" SWORD VROT 1 100 -13000 13000 FORMAT "%3.0" ECU_ADDRESS 0xFEBE95C4 /end MEASUREMENT
/begin MEASUREMENT nEpsInI_EMSMotorSpeed_xdu16 "Fahrzeug Motor Drehzahl" UWORD VROT 1 100 0 65535 FORMAT "%3.0" ECU_ADDRESS 0xFEBE95C6 /end MEASUREMENT
/begin MEASUREMENT sApplI_AdasSteerTqSts_xdu8 "APC SG-Status 0-normal, 1-APC Versagt" UBYTE ZU0 1 100 0 255 FORMAT "%5.1" ECU_ADDRESS 0xFEBE9904 /end MEASUREMENT
/begin MEASUREMENT sApplI_ApxFailureStatus_xdu8 "APC SG-Status 0-normal, 1-APC Versagt" UBYTE ZU0 1 100 0 1 FORMAT "%5.3" ECU_ADDRESS 0xFEBE9905 /end MEASUREMENT
/begin MEASUREMENT sApplI_AutoBrakeState_xdu8 "Current State of Auto Brake State: 0 - STATE_AUTOBRAKE_FAULSE, 1 - STATE_AUTOBRAKE_TRUE" UBYTE ZU0 1 100 0 1 FORMAT "%5.3" ECU_ADDRESS 0xFEBE9908 /end MEASUREMENT
/begin MEASUREMENT sApplI_DrvrSteerActvInv_xds8 "Inverser Status eines aktive lenkenden Fahrers, aktive = 0" SBYTE ZU0 1 100 -1 1 FORMAT "%5.3" ECU_ADDRESS 0xFEBE990C /end MEASUREMENT
/begin MEASUREMENT sApplI_DrvrSteerActv_xds8 "Status eines aktive lenkenden Fahrers, aktive = 1" SBYTE ZU0 1 100 -1 1 FORMAT "%5.3" ECU_ADDRESS 0xFEBE990D /end MEASUREMENT
/begin MEASUREMENT sApplI_DsrState_xdu8 "DSR Status" UBYTE STATUS 1 100 0 4 FORMAT "%5.3" ECU_ADDRESS 0xFEBE990E /end MEASUREMENT
/begin MEASUREMENT sCJC_FctCoCtrlState_xdu8 "Return value of the FunctionCoordinator." UBYTE ZU0 1 100 0 99 FORMAT "%5.2" ECU_ADDRESS 0xFEBE9946 /end MEASUREMENT
/begin MEASUREMENT sCJC_FeatureState_xdu8 "Internal feature state for FunctionCoordinator." UBYTE ZU0 1 100 0 3 FORMAT "%5.3" ECU_ADDRESS 0xFEBE9947 /end MEASUREMENT
/begin MEASUREMENT scnBusOffState_xdu8 "Zustand des BusOff-Zustandsautomaten" UBYTE ZU0 1 100 0 2 FORMAT "%5.3" ECU_ADDRESS 0xFEBE9948 /end MEASUREMENT
/begin MEASUREMENT scpI_SwFault_ErrLvl_Red_xdu8 "Error Level Compare Red" UBYTE ZU0 1 100 0 2 FORMAT "%5.3" ECU_ADDRESS 0xFEBE4281 /end MEASUREMENT
/begin MEASUREMENT scpI_SwFault_ErrLvl_xdu8 "Error Level Compare" UBYTE ZU0 1 100 0 2 FORMAT "%5.3" ECU_ADDRESS 0xFEBE994A /end MEASUREMENT
/begin MEASUREMENT scrChatterMode_xdu8 "Normal mode = 0, APC mode = 1, LALowSpd mode = 2 ,LAHighSpd=3" UBYTE ZU0 1 100 0 3 FORMAT "%5.3" ECU_ADDRESS 0xFEBE994B /end MEASUREMENT
/begin MEASUREMENT scrChatterSensIsActive_xdu8 "ChatterSensor is active => not deactivated by an other component" UBYTE ZU0 1 100 0 1 FORMAT "%5.3" ECU_ADDRESS 0xFEBE9834 /end MEASUREMENT
/begin MEASUREMENT scrChatterState_xdu8 "state of the chatter detection (0=Init, 1=PositiveAcceleration, 2=NegativeAcceleration)" UBYTE ZU0 1 100 0 2 FORMAT "%5.3" ECU_ADDRESS 0xFEBE9835 /end MEASUREMENT
/begin MEASUREMENT sCrpI_CurrentRecalibPermissionOem_xdu8 "Aktuelle Wiederkalibrierungserlaubnis durch den OEM" UBYTE ZU0 1 100 0 255 FORMAT "%5.1" ECU_ADDRESS 0xFEBE4B1F /end MEASUREMENT
/begin MEASUREMENT sCrpI_CurrentRecalibPermission_xdu8 "Aktuelle Wiederkalibrierungserlaubnis" UBYTE ZU0 1 100 0 255 FORMAT "%5.1" ECU_ADDRESS 0xFEBE4B20 /end MEASUREMENT
/begin MEASUREMENT sDCMNVM_EPSConfig_xdu8 "Remote EcuState" UBYTE ZU0 1 100 0 255 FORMAT "%5.1" ECU_ADDRESS 0xFEBE994C /end MEASUREMENT
/begin MEASUREMENT sDCMNVM_VehcfgFlag_xdu8 "Remote EcuState" UBYTE ZU0 1 100 0 255 FORMAT "%5.1" ECU_ADDRESS 0xFEBE994D /end MEASUREMENT
/begin MEASUREMENT sDCMNVM_VehConfig_xdu8 "Remote EcuState" UBYTE ZU0 1 100 0 255 FORMAT "%5.1" ECU_ADDRESS 0xFEBE994E /end MEASUREMENT
/begin MEASUREMENT sDCMNVM_VINFlag_xdu8 "Remote EcuState" UBYTE ZU0 1 100 0 255 FORMAT "%5.1" ECU_ADDRESS 0xFEBE994F /end MEASUREMENT
/begin MEASUREMENT sDMSI_SetAssociateSts_xdu8 "" UBYTE ZU0 1 100 0 1 FORMAT "%5.3" ECU_ADDRESS 0xFEBE9950 /end MEASUREMENT
/begin MEASUREMENT sDMS_JobResultOk_xdu8 "So Ã¼berprÃ¼fen Sie den Status von JobResult und die Service-ID von DriveModeSwitch" UBYTE ZU0 1 100 0 2 FORMAT "%5.3" ECU_ADDRESS 0xFEBE9951 /end MEASUREMENT
/begin MEASUREMENT sDsd_EvalStateVehSpeed_xdu8 "Status Geschwindigkeitsauswertung:0=passiv;1=stillstand;2=vorwaerts;3=rueckwaerts;4=v_max" UBYTE STATUS 1 100 0 10 FORMAT "%5.2" ECU_ADDRESS 0xFEBE9952 /end MEASUREMENT
/begin MEASUREMENT sDsd_StateZPCorr_xdu8 "Status Nullpunktabgleich: 0:ReLrn; 1:YR_LrnInit; 2:YR_Update; 3:YR_Stable; 4:YR_LrnFine; 5:YR_LrnFineWait" UBYTE STATUS 1 100 0 10 FORMAT "%5.2" ECU_ADDRESS 0xFEBE9953 /end MEASUREMENT
/begin MEASUREMENT sDSR_ActivationRequest_xdu8 "Flag für den ActivationRequest des FunctionCoordinators" UBYTE ZU0 1 100 0 1 FORMAT "%5.3" ECU_ADDRESS 0xFEBE9954 /end MEASUREMENT
/begin MEASUREMENT sDSR_FailureCause_xdu8 "Grund der Fehlererkennung" UBYTE ZU0 1 100 0 1 FORMAT "%5.3" ECU_ADDRESS 0xFEBE9955 /end MEASUREMENT
/begin MEASUREMENT sDSR_FctCoCtrlState_xdu8 "Rueckgabe Function Coordinator" UBYTE ZU0 1 100 0 99 FORMAT "%5.2" ECU_ADDRESS 0xFEBE9956 /end MEASUREMENT
/begin MEASUREMENT sDSR_FeatureState_xdu8 "DSR Status FunctionCoordinatorRequest" UBYTE STATUS 1 100 0 10 FORMAT "%5.2" ECU_ADDRESS 0xFEBE9957 /end MEASUREMENT
/begin MEASUREMENT sDSR_InternalState_xdu8 "DSR Status der interen Statusmaschine" UBYTE STATUS 1 100 0 10 FORMAT "%5.2" ECU_ADDRESS 0xFEBE9958 /end MEASUREMENT
/begin MEASUREMENT sDthrCtrlI_ErrorMask_xdu16 "Dither control abort reason (Bitmask, 1=Error)" UWORD ZU0 1 100 0 65535 FORMAT "%8.2" ECU_ADDRESS 0xFEBE95F2 /end MEASUREMENT
/begin MEASUREMENT sDthrCtrlI_ExclusiveMMotSwitch_xdu8 "DitherControl exklusiv Aktivierung" UBYTE ZU0 1 100 75 180 FORMAT "%5.1" ECU_ADDRESS 0xFEBE9959 /end MEASUREMENT
/begin MEASUREMENT sDthrCtrlI_LearnStatLeft_xdu8 "Lernzustand links / Endstop" UBYTE ZU0 1 100 0 255 FORMAT "%5.1" ECU_ADDRESS 0xFEBE995A /end MEASUREMENT
/begin MEASUREMENT sDthrCtrlI_LearnStatRight_xdu8 "lerne Zustand richtig / Endstop" UBYTE ZU0 1 100 0 255 FORMAT "%5.1" ECU_ADDRESS 0xFEBE995B /end MEASUREMENT
/begin MEASUREMENT sDthrCtrlI_MakeSafeAndMonState_xdu8 "Indicates whether the MakeSafe and MonitorSafe checks report OK (0) or if they have detected a problem (1) or if HandsOn was detected (2) or if invalid arbitration was detected (3)." UBYTE ZU0 1 100 0 3 FORMAT "%5.3" ECU_ADDRESS 0xFEBE995C /end MEASUREMENT
/begin MEASUREMENT sDthrCtrlI_NvMWriteRequest_xdu8 "Dither Control NvM Write Status: 0 - No Request, 1 - NvM Write Trigerred, 2 - NvM Write Done" UBYTE ZU0 1 100 0 2 FORMAT "%5.3" ECU_ADDRESS 0xFEBE995D /end MEASUREMENT
/begin MEASUREMENT sDthrCtrlI_NvWriteState_xdu8 "State of Write chart (0-Ready;1-Request is pushed ; 2- Error shall be locked)" UBYTE ZU0 1 100 0 3 FORMAT "%5.3" ECU_ADDRESS 0xFEBE995E /end MEASUREMENT
/begin MEASUREMENT sDthrCtrlI_RackPosControllerState_xdu8 "Status des Reglers" UBYTE STATUS 1 100 0 2 FORMAT "%5.3" ECU_ADDRESS 0xFEBE995F /end MEASUREMENT
/begin MEASUREMENT sDthrCtrlI_WarningLamp_xdu8 "Dither control warning signal - Anforderung an Warnlampe" UBYTE ZU0 1 100 0 10 FORMAT "%5.2" ECU_ADDRESS 0xFEBE9960 /end MEASUREMENT
/begin MEASUREMENT sDthrCtrl_CallFcnID_xdu8 "Called Dither-Function: 0=IndexSearch, 1=MidHold, 2=Endstop Learning AZG, 3=Endstop Learning UDS" UBYTE ZU0 1 100 0 254 FORMAT "%5.1" ECU_ADDRESS 0xFEBE9961 /end MEASUREMENT
/begin MEASUREMENT sDthrCtrl_CoordRequest_xdu8 "Anfrage der Dither-Funktion (start, stop)" UBYTE STATUS 1 100 0 254 FORMAT "%5.1" ECU_ADDRESS 0xFEBE9962 /end MEASUREMENT
/begin MEASUREMENT sDthrCtrl_CoordState_xdu8 "Status der Dither-Funktion (off, busy, finished, error)" UBYTE STATUS 1 100 0 254 FORMAT "%5.1" ECU_ADDRESS 0xFEBE9963 /end MEASUREMENT
/begin MEASUREMENT sDthrCtrl_DtrCtrlDesPosReached_xdu8 "Mittenhalt: Zielposition wurde erreicht (+-0.1° LW, für >100ms)" UBYTE STATUS 1 100 0 2 FORMAT "%5.3" ECU_ADDRESS 0xFEBE9964 /end MEASUREMENT
/begin MEASUREMENT sDthrCtrl_DummyEslState_xdu8 "Statusmaschine Endstopsuche" UBYTE STATUS 1 100 0 250 FORMAT "%5.1" ECU_ADDRESS 0xFEBE9965 /end MEASUREMENT
/begin MEASUREMENT sDthrCtrl_DummyIndexState_xdu8 "Statusmaschine Indexsuche" UBYTE STATUS 1 100 0 250 FORMAT "%5.1" ECU_ADDRESS 0xFEBE9966 /end MEASUREMENT
/begin MEASUREMENT sDthrCtrl_DummyMidHoldState_xdu8 "Statusmaschine Mittenhalt" UBYTE STATUS 1 100 0 250 FORMAT "%5.1" ECU_ADDRESS 0xFEBE9967 /end MEASUREMENT
/begin MEASUREMENT sDthrCtrl_ESNvMErrorstatus_xdu8 "NvM Error Status for EndStop Block" UBYTE ZU0 1 100 0 8 FORMAT "%5.3" ECU_ADDRESS 0xFEBE9968 /end MEASUREMENT
/begin MEASUREMENT sDthrCtrl_FailureCauseCDD_xdu8 "Cause of failure (0= no failure, 1=ES NVM BLOCK BUSY, 2 - DITHER NVM BLOCK BUSY, 3 -  DITHER NVM WRITE NOK)" UBYTE ZU0 1 100 0 4 FORMAT "%5.3" ECU_ADDRESS 0xFEBE9969 /end MEASUREMENT
/begin MEASUREMENT sDthrCtrl_FailureCauseRTE_xdu8 "Cause of failure (0= no failure, 1= RTE NvM Read Failed, 2 - RTE NvM Write Failed)" UBYTE ZU0 1 100 0 2 FORMAT "%5.3" ECU_ADDRESS 0xFEBE996A /end MEASUREMENT
/begin MEASUREMENT sDthrCtrl_FunctionReturn_xdu8 "Rückgabewert der Ditherfunktion (off,busy,finished,error)" UBYTE STATUS 1 100 0 254 FORMAT "%5.1" ECU_ADDRESS 0xFEBE996B /end MEASUREMENT
/begin MEASUREMENT sDthrCtrl_JobResultOk_xdu8 " To check NvM status of JobResult and Service ID of DitherControl" UBYTE ZU0 1 100 0 2 FORMAT "%5.3" ECU_ADDRESS 0xFEBE996C /end MEASUREMENT
/begin MEASUREMENT sDthrCtrl_MakeSafeState_xdu8 "Indicates whether the MakeSafe checks report OK (0), if they have detected a problem (1) or if HandsOn was detected (2)." UBYTE ZU0 1 100 0 2 FORMAT "%5.3" ECU_ADDRESS 0xFEBE996D /end MEASUREMENT
/begin MEASUREMENT sDthrCtrl_SyncActionsSuppReturn_xdu8 "RackPosition Synchronization Supp function Return" UBYTE ZU0 1 100 0 8 FORMAT "%5.3" ECU_ADDRESS 0xFEBE996E /end MEASUREMENT
/begin MEASUREMENT sDthrCtrl_UDSRequest_xdu8 "Anfrage der Dither-Funktion (start, stop)" UBYTE STATUS 1 100 0 255 FORMAT "%5.1" ECU_ADDRESS 0xFEBE996F /end MEASUREMENT
/begin MEASUREMENT sDthrCtrl_UDSStateRequest_xdu8 "Request of Dither Function (0=IndexLearning, 1=MidHold, 2=ESLearn AZG, 3= ESLearn UDS)" UBYTE STATUS 1 100 0 254 FORMAT "%5.1" ECU_ADDRESS 0xFEBE9970 /end MEASUREMENT
/begin MEASUREMENT sDTSC_ActivationRequest_xdu8 "Flag für den ActivationRequest des FunctionCoordinators" UBYTE ZU0 1 100 0 1 FORMAT "%5.3" ECU_ADDRESS 0xFEBE9971 /end MEASUREMENT
/begin MEASUREMENT sDTSC_CtrlState_xdu8 "DTSC Rückgabewert des Function Coordinators" UBYTE ZU0 1 100 0 99 FORMAT "%5.2" ECU_ADDRESS 0xFEBE9972 /end MEASUREMENT
/begin MEASUREMENT sDTSC_ErrorDetected_xdu16 "Bitmuster far Eingang Fehler" UBYTE ZU0 1 100 0 32768 FORMAT "%5.0" ECU_ADDRESS 0xFEBE9973 /end MEASUREMENT
/begin MEASUREMENT sDTSC_EstActivationRequest_xdu8 "Flag für den ActivationRequest des DTSC Estimator FunctionCoordinators" UBYTE ZU0 1 100 0 1 FORMAT "%5.3" ECU_ADDRESS 0xFEBE9974 /end MEASUREMENT
/begin MEASUREMENT sDTSC_EstCtrlState_xdu8 "DTSC Estimator Rückgabewert des Function Coordinators" UBYTE ZU0 1 100 0 99 FORMAT "%5.2" ECU_ADDRESS 0xFEBE9975 /end MEASUREMENT
/begin MEASUREMENT sDTSC_EstFeatureState_xdu8 "Drive Torque Steer Compensation  Estimator interner Mode Manager Status" UBYTE ZU0 1 100 0 5 FORMAT "%5.3" ECU_ADDRESS 0xFEBE9976 /end MEASUREMENT
/begin MEASUREMENT sDTSC_FailureCause_xdu8 "Grund der Fehlererkennung" UBYTE ZU0 1 100 0 4 FORMAT "%5.3" ECU_ADDRESS 0xFEBE9977 /end MEASUREMENT
/begin MEASUREMENT sDTSC_FeatureState_xdu8 "Drive Torque Steer Compensation interner Mode Manager Status" UBYTE ZU0 1 100 0 5 FORMAT "%5.3" ECU_ADDRESS 0xFEBE9978 /end MEASUREMENT
/begin MEASUREMENT sDTSC_JobResultOk_xdu8 " To check status of JobResult and Service ID of DTSC" UBYTE ZU0 1 100 0 2 FORMAT "%5.3" ECU_ADDRESS 0xFEBE9979 /end MEASUREMENT
/begin MEASUREMENT sDTSC_RampedIn_xdu8 "Flag für den RampedIn-Status des FunctionCoordinators" UBYTE ZU0 1 100 0 1 FORMAT "%5.3" ECU_ADDRESS 0xFEBE997A /end MEASUREMENT
/begin MEASUREMENT sDTSC_RampedOut_xdu8 "Flag für den RampedOut-Status des FunctionCoordinators" UBYTE ZU0 1 100 0 1 FORMAT "%5.3" ECU_ADDRESS 0xFEBE997B /end MEASUREMENT
/begin MEASUREMENT sDTSC_RequestOffsetState_xdu8 "Status der Statusmaschine für die Anforderung des Motormomentenoffsets (0=passive, 1=activation requested, 2=ramp in, 3=active, 4=ramp out)" UBYTE ZU0 1 100 0 4 FORMAT "%5.3" ECU_ADDRESS 0xFEBE997C /end MEASUREMENT
/begin MEASUREMENT sDTSC_State_xdu8 "Status der Statusmaschine (0 = Calibration_Inactive, 1 = Calibration_Activate, 2 = Calibration_Active, 3 = Calibration_Calibrate, 4 = Validation_Inactive, 5 = Validation_Activate, 6 = Validation_Active, 7 = Validation_Validate)" UBYTE DTSC_STATE 1 100 0 7 FORMAT "%13.11" ECU_ADDRESS 0xFEBE997D /end MEASUREMENT
/begin MEASUREMENT sEndStopI_LearnStatLeft_xdu8 "Lernzustand links / Endstop" UBYTE ZU0 1 100 0 255 FORMAT "%5.1" ECU_ADDRESS 0xFEBE997E /end MEASUREMENT
/begin MEASUREMENT sEndStopI_LearnStatRight_xdu8 "lerne Zustand richtig / Endstop" UBYTE ZU0 1 100 0 255 FORMAT "%5.1" ECU_ADDRESS 0xFEBE997F /end MEASUREMENT
/begin MEASUREMENT sEndStopI_ReqStateEsMax_xdu8 " " UBYTE ZU0 1 100 0 2 FORMAT "%5.3" ECU_ADDRESS 0xFEBE9980 /end MEASUREMENT
/begin MEASUREMENT sEndStopI_ReqStateEsMin_xdu8 " " UBYTE ZU0 1 100 0 2 FORMAT "%5.3" ECU_ADDRESS 0xFEBE9981 /end MEASUREMENT
/begin MEASUREMENT sEndStopI_SALinState_xdu8 "EndStopSupp steering angle status (0=Error, 1=RawInit, 2=ExactlyInit, 3=NotInit)" UBYTE ZU0 1 100 0 3 FORMAT "%5.3" ECU_ADDRESS 0xFEBE9982 /end MEASUREMENT
/begin MEASUREMENT sEndStop_EndstopState_xdu8 "Status des zu verwendenden Endstops (0-nicht/1-tlw/2-fertig gelernt)" UBYTE ZU0 1 100 0 2 FORMAT "%5.3" ECU_ADDRESS 0xFEBE9983 /end MEASUREMENT
/begin MEASUREMENT sEndStop_ErrorStatus_xdu8 "Errorstatus Endstop Monitoring" UBYTE ZU0 1 100 0 25 FORMAT "%5.2" ECU_ADDRESS 0xFEBE9984 /end MEASUREMENT
/begin MEASUREMENT sEndStop_NvWriteState_xdu8 "Status der Nv-Datenschreibaktion" UBYTE ZU0 1 100 0 3 FORMAT "%5.3" ECU_ADDRESS 0xFEBE9985 /end MEASUREMENT
/begin MEASUREMENT sEpsInI_BCMOperModCmd_xdu8 "Remote EcuState" UBYTE ZU0 1 100 0 255 FORMAT "%5.1" ECU_ADDRESS 0xFEBE9989 /end MEASUREMENT
/begin MEASUREMENT sEpsInI_BCMT15DState_xdu8 "Remote EcuState" UBYTE ZU0 1 100 0 255 FORMAT "%5.1" ECU_ADDRESS 0xFEBE998A /end MEASUREMENT
/begin MEASUREMENT sEpsInI_BCMVehicleState_xdu8 "Remote EcuState" UBYTE ZU0 1 100 0 255 FORMAT "%5.1" ECU_ADDRESS 0xFEBE998B /end MEASUREMENT
/begin MEASUREMENT sEpsInI_CalenderData_xau8 "CalenderData" UBYTE ZU0 1 100 0 255 FORMAT "%5.1" ECU_ADDRESS 0xFEBE95F8 MATRIX_DIM 6 1 1 /end MEASUREMENT
/begin MEASUREMENT sEpsInI_ESCBrakeState_xdu8 "ESC Status" UBYTE ZU0 1 100 0 1 FORMAT "%5.3" ECU_ADDRESS 0xFEBE998D /end MEASUREMENT
/begin MEASUREMENT sEpsInI_FootBrakeState_xdu8 "FuÃŸbremse betÃ¤tigt" UBYTE ZU0 1 100 0 1 FORMAT "%5.3" ECU_ADDRESS 0xFEBE998E /end MEASUREMENT
/begin MEASUREMENT sEpsInI_GlobalKL15Status_xdb "GlobalKL15Status" UWORD BIT 1 100 0 1 BIT_MASK 0x1 FORMAT "%5.3" ECU_ADDRESS 0xFEBE998F /end MEASUREMENT
/begin MEASUREMENT sEpsInI_GlobalKLRStatus_xdb "GlobalKLRStatus" UWORD BIT 1 100 0 1 BIT_MASK 0x1 FORMAT "%5.3" ECU_ADDRESS 0xFEBE9990 /end MEASUREMENT
/begin MEASUREMENT sEpsInI_ParkingBrakeState_xdu8 "Handbremse betÃ¤tigt" UBYTE ZU0 1 100 0 1 FORMAT "%5.3" ECU_ADDRESS 0xFEBE9992 /end MEASUREMENT
/begin MEASUREMENT sEpsInI_RemoteAssistControlRx_xdu8 "AssistControllerSync" UBYTE ZU0 1 100 0 255 FORMAT "%5.1" ECU_ADDRESS 0xFEBE9993 /end MEASUREMENT
/begin MEASUREMENT sEpsInI_RemoteEcuState_xdu8 "Remote EcuState" UBYTE ZU0 1 100 0 255 FORMAT "%5.1" ECU_ADDRESS 0xFEBE9994 /end MEASUREMENT
/begin MEASUREMENT sEpsInI_RemoteShutdownSync_xdu8 "ResetControllerSync" UBYTE ZU0 1 100 0 255 FORMAT "%5.1" ECU_ADDRESS 0xFEBE9995 /end MEASUREMENT
/begin MEASUREMENT sEpsInI_RemoteUcSync_xdu8 "ApplicationStateSync" UBYTE ZU0 1 100 0 255 FORMAT "%5.1" ECU_ADDRESS 0xFEBE9996 /end MEASUREMENT
/begin MEASUREMENT sEpsOut_WarningLampState_xdu8 "Warning Lamp Status" UBYTE ZU0 1 100 0 2 FORMAT "%5.3" ECU_ADDRESS 0xFEBE9998 /end MEASUREMENT
/begin MEASUREMENT sUdsIOCtrlWarningLmp_xdu8 "" UBYTE ZU0 1 100 0 2 FORMAT "%5.3" ECU_ADDRESS 0xFEBE9A3D /end MEASUREMENT
/begin MEASUREMENT sUds_InhibitTracker_xdu8 "Tracker-Variable fÃ¼r UDS-Vorbedingung" ULONG ZU0 1 100 0 4294967295 FORMAT "%13.2" ECU_ADDRESS 0xFEBE911C /end MEASUREMENT
/begin MEASUREMENT tcrChatterTime_xdu8 "time since last torque gradient has occurred" UBYTE TIMSEC_1000 1 100 0 0.254 FORMAT "%6.4" ECU_ADDRESS 0xFEBE9837 /end MEASUREMENT
/begin MEASUREMENT tcrDelayTimerResetChatterCycle_xdu16 "delay timer until reset of chatter cycle" UWORD TIMSEC_1000 1 100 0 60 FORMAT "%8.5" ECU_ADDRESS 0xFEBE9392 /end MEASUREMENT
/begin MEASUREMENT tDrvExit_HwlShutdownTimerUs_xdu16 "" UWORD TIMMS 1 100 0 65535 FORMAT "%8.2" ECU_ADDRESS 0xFEBE9610 /end MEASUREMENT
/begin MEASUREMENT tDrvExit_TimeDiffUs_xdu16 "" UWORD TIMMS 1 100 0 65535 FORMAT "%8.2" ECU_ADDRESS 0xFEBE9612 /end MEASUREMENT
/begin MEASUREMENT tEndStop_TimeIncrDampingL2_xdu8 "Zeit fuer erhoehte Daempfung Level2" UBYTE TIMMS 1 100 0 100 FORMAT "%5.1" ECU_ADDRESS 0xFEBE9A42 /end MEASUREMENT
/begin MEASUREMENT tEndStop_TimeIncrDamping_xdu8 "Zeit fuer erhoehte Daempfung" UBYTE TIMMS 1 100 0 100 FORMAT "%5.1" ECU_ADDRESS 0xFEBE9A43 /end MEASUREMENT
/begin MEASUREMENT vApplI_Batteryvol_xdu16 "BMS Battery Voltage" UWORD ZU0 1 100 0 1000 FORMAT "%8.3" ECU_ADDRESS 0xFEBE964C /end MEASUREMENT
/begin MEASUREMENT vApplI_CurrentDay_xdu8 "Current Day" UBYTE ZU0 1 100 1 31 FORMAT "%5.2" ECU_ADDRESS 0xFEBE9A4A /end MEASUREMENT
/begin MEASUREMENT vApplI_CurrentHour_xdu8 "Current Hour" UBYTE ZU0 1 100 0 23 FORMAT "%5.2" ECU_ADDRESS 0xFEBE9A4B /end MEASUREMENT
/begin MEASUREMENT vApplI_CurrentMin_xdu8 "Current Min" UBYTE ZU0 1 100 0 59 FORMAT "%5.2" ECU_ADDRESS 0xFEBE9A4C /end MEASUREMENT
/begin MEASUREMENT vApplI_CurrentMonth_xdu8 "Current Month" UBYTE ZU0 1 100 0 12 FORMAT "%5.2" ECU_ADDRESS 0xFEBE9A4D /end MEASUREMENT
/begin MEASUREMENT vApplI_CurrentMsec_xdu16 "Current Milliscond" UWORD ZU0 1 100 1 999 FORMAT "%8.4" ECU_ADDRESS 0xFEBE964E /end MEASUREMENT
/begin MEASUREMENT vApplI_CurrentSec_xdu8 "Current Seconds" UBYTE ZU0 1 100 0 59 FORMAT "%5.2" ECU_ADDRESS 0xFEBE9A4E /end MEASUREMENT
/begin MEASUREMENT vApplI_CurrentYear_xdu8 "Current Year" UBYTE ZU0 1 100 0 254 FORMAT "%5.1" ECU_ADDRESS 0xFEBE9A4F /end MEASUREMENT
/begin MEASUREMENT vApplI_DmsErrorStatus_xdu8 "DMS Error Status" UBYTE ZU0 1 100 0 7 FORMAT "%5.3" ECU_ADDRESS 0xFEBE9A50 /end MEASUREMENT
/begin MEASUREMENT vApplI_FrontAxleRotorSpeed_xdu16 "Front Axle Rotor Speed" UWORD ZU0 1 100 -20000 45531 FORMAT "%8.2" ECU_ADDRESS 0xFEBE9650 /end MEASUREMENT
/begin MEASUREMENT vApplI_LvBatteryVol_xdu16 "LV Battery Voltage" UWORD ZU0 1 100 0 28 FORMAT "%8.5" ECU_ADDRESS 0xFEBE9652 /end MEASUREMENT
/begin MEASUREMENT vApplI_SteeringAngleSpeedSnapshot_xds16 "Lenkwinkelgeschwindigkeit" SWORD SAS_8 1 100 -1500 1500 FORMAT "%8.3" ECU_ADDRESS 0xFEBE9656 /end MEASUREMENT
/begin MEASUREMENT vApplI_TimeDomainSync_xdu8 "Time Domain Synchronized" UBYTE ZU0 1 100 0 15 FORMAT "%5.2" ECU_ADDRESS 0xFEBE9A51 /end MEASUREMENT
/begin MEASUREMENT vApplI_VehErrorStatus_xdu8 "Vehicle Error Status" UBYTE ZU0 1 100 0 31 FORMAT "%5.2" ECU_ADDRESS 0xFEBE9A52 /end MEASUREMENT
/begin MEASUREMENT vApplI_VehOutTemp_xdu8 "Environment temperature of Vehicle" UBYTE TEMP 1 100 -45 85 FORMAT "%5.2" ECU_ADDRESS 0xFEBE9A53 /end MEASUREMENT
/begin MEASUREMENT vApplI_VehTotalOdo_xdu32 "Total Odometer of Vehicle" ULONG ZU0 1 100 0 1000000 FORMAT "%13.6" ECU_ADDRESS 0xFEBE9174 /end MEASUREMENT
/begin MEASUREMENT vBci_AbsSafeNssVehicleSpeedCalcCurvesL2_xdf32 "zwischengespeicherte Fahrzeuggeschwindigkeit fuer die Level2 Überwachung" FLOAT32_IEEE ZU0 1 100 0 500 FORMAT "%10.6" ECU_ADDRESS 0xFEBE917C /end MEASUREMENT
/begin MEASUREMENT vDrvTorque_SWSpeedDynPart_xdf32 "Rotorgeschwindigkeit dynamisch" FLOAT32_IEEE FLOAT 1 100 -20000 20000 FORMAT "%16.10" ECU_ADDRESS 0xFEBE9180 /end MEASUREMENT
/begin MEASUREMENT vDrvTorque_SWSpeed_xdf32 "Rotorgeschwindigkeit raw" FLOAT32_IEEE FLOAT 1 100 -30000 30000 FORMAT "%16.10" ECU_ADDRESS 0xFEBE9184 /end MEASUREMENT
/begin MEASUREMENT vDrvTorque_velSW_xdf32 "Rotorgeschwindigkeit" FLOAT32_IEEE FLOAT 1 100 -30000 30000 FORMAT "%16.10" ECU_ADDRESS 0xFEBE9188 /end MEASUREMENT
/begin MEASUREMENT vDsdI_YawVelocity_xdf32 "Gierrate mit Nullpunktabgleich [rad/s]" FLOAT32_IEEE ZU0 1 100 -10 10 FORMAT "%10.7" ECU_ADDRESS 0xFEBE918C /end MEASUREMENT
/begin MEASUREMENT vDsd_Vehicle_xdf32 "Fzg. Geschwindigkeit [m/s]; dummyvariable damit a2l generiert werden kann (Eingangsgröße für Kennlinie)" FLOAT32_IEEE ZU0 1 100 -100 100 FORMAT "%10.6" ECU_ADDRESS 0xFEBE9190 /end MEASUREMENT
/begin MEASUREMENT vDsd_velVehPT1_xdf32 "gefilterte Fzg.Geschwindigkeit [m/s]; dummyvariable damit a2l generiert werden kann (Eingangsgröße für Kennlinie)" FLOAT32_IEEE ZU0 1 100 0 300 FORMAT "%10.6" ECU_ADDRESS 0xFEBE9194 /end MEASUREMENT
/begin MEASUREMENT vDsd_YawRateNP_xdf32 "Nullpunkt Gierrate [°/s]" FLOAT32_IEEE ZU0 1 100 -100 100 FORMAT "%10.6" ECU_ADDRESS 0xFEBE9198 /end MEASUREMENT
/begin MEASUREMENT vDsd_YawSetOversteer_xdf32 "Sollgierrate Übersteuern [rad/s]" FLOAT32_IEEE ZU0 1 100 0 100 FORMAT "%10.6" ECU_ADDRESS 0xFEBE919C /end MEASUREMENT
/begin MEASUREMENT vDsd_YawSetUndersteer_xdf32 "Sollgierrate Untersteuern [rad/s]" FLOAT32_IEEE ZU0 1 100 0 100 FORMAT "%10.6" ECU_ADDRESS 0xFEBE91A0 /end MEASUREMENT
/begin MEASUREMENT vDsd_YawSumAvg_xdf32 "aufsummierte u. gemittelte Gierrate aus Nullpunktabgleich [°/s]" FLOAT32_IEEE ZU0 1 100 -100 100 FORMAT "%10.6" ECU_ADDRESS 0xFEBE91A4 /end MEASUREMENT
/begin MEASUREMENT vDSR_FilteredAbsSASpeedPlausiDelay_xds32 "Letzte Wert des tiefpaßgefilterten Geschwindigkeit des Lenkwinkels für plausi" SLONG RIGHTSH7NP 1 100 0 2000 FORMAT "%13.8" ECU_ADDRESS 0xFEBE91A8 /end MEASUREMENT
/begin MEASUREMENT vDSR_FilteredAbsSASpeedPlausi_xds16 "Tiefpaßgefilterte Geschwindigkeit des Lenkwinkels für plausi" SWORD SAS_8 1 100 0 2000 FORMAT "%8.3" ECU_ADDRESS 0xFEBE9662 /end MEASUREMENT
/begin MEASUREMENT vDSR_FilteredSASpeedDelay_xds32 "Letzte Wert des tiefpaßgefilterten Geschwindigkeit des Lenkwinkels" SLONG RIGHTSH7NP 1 100 -2000 2000 FORMAT "%13.8" ECU_ADDRESS 0xFEBE91AC /end MEASUREMENT
/begin MEASUREMENT vDSR_FilteredSASpeed_xds16 "Tiefpass gefilterte Lenkwinkelgeschwindigkeit" SWORD SAS_8 1 100 -2000 2000 FORMAT "%8.3" ECU_ADDRESS 0xFEBE9664 /end MEASUREMENT
/begin MEASUREMENT vDthrCtrl_DesiredSpeed_xds16 "Dither Control Desired Speed in MidHold" SWORD SAS 1 100 -30000 30000 FORMAT "%8.2" ECU_ADDRESS 0xFEBE9666 /end MEASUREMENT
/begin MEASUREMENT vDthrCtrl_PositionCtrlPPart_xds16 "DitherControl Position-Ctrl P-Part" SWORD RACKSPEED128 1 100 -256 255.9922 FORMAT "%8.4" ECU_ADDRESS 0xFEBE9668 /end MEASUREMENT
/begin MEASUREMENT vEpsInI_VehicleSpeedForUDS_xds16 "Fahrzeug Geschwindigkeit Rohwert" SWORD VFZHIGH 1 100 -100 500 FORMAT "%8.4" ECU_ADDRESS 0xFEBE966A /end MEASUREMENT
/begin MEASUREMENT wApplI_SteeringAngleSnapshot_xds16 "korrigierter Lenkwinkel" SWORD SA_10 1 100 -1000 1000 FORMAT "%8.3" ECU_ADDRESS 0xFEBE96BE /end MEASUREMENT
/begin MEASUREMENT wBci_AbsSteeringAngleL2_xdf32 "zwischengespeicherter Lenkwinkel fuer die Level2 Überwachung" FLOAT32_IEEE ZU0 1 100 0 1000 FORMAT "%10.5" ECU_ADDRESS 0xFEBE91D0 /end MEASUREMENT
/begin MEASUREMENT wDsd_FrontWheelAngle_xdf32 "Radlenkwinkel [rad]" FLOAT32_IEEE ZU0 1 100 -10 10 FORMAT "%10.7" ECU_ADDRESS 0xFEBE91F8 /end MEASUREMENT
/begin MEASUREMENT wDsd_RollAngleAtBankedCurve_xdf32 "berechneter Neigungswinkel in erkannter Steilkurve [°]" FLOAT32_IEEE ZU0 1 100 0 90 FORMAT "%10.7" ECU_ADDRESS 0xFEBE91FC /end MEASUREMENT
/begin MEASUREMENT wDsd_RollAngle_xdf32 "berechneter Neigungswinkel [°]" FLOAT32_IEEE ZU0 1 100 0 90 FORMAT "%10.7" ECU_ADDRESS 0xFEBE9200 /end MEASUREMENT
/begin MEASUREMENT wDthrCtrlI_CenterOffsetToSA_xds16 "Steering Angle value of CenterOffset" SWORD SA_10 1 100 -1000 1000 FORMAT "%8.3" ECU_ADDRESS 0xFEBE96C2 /end MEASUREMENT
/begin MEASUREMENT wDthrCtrlI_RaPoRefToSA_xds16 "Steering Angle value of RackPosition Reference" SWORD SA_10 1 100 -1000 1000 FORMAT "%8.3" ECU_ADDRESS 0xFEBE96C4 /end MEASUREMENT
/begin MEASUREMENT xBci_AssistPostscalerGradLimL2_xdf32 "level2 gradientenbegrenzter Faktor auf das angeforderte Moment nach Assist/BST" FLOAT32_IEEE ZU0 1 100 0.19921875 5 FORMAT "%10.8" ECU_ADDRESS 0xFEBE925C /end MEASUREMENT
/begin MEASUREMENT xBci_AssistPostscalerGradLim_xdu16 "gradientenbegrenzter Faktor auf das angeforderte Moment nach Assist/BST" UWORD RIGHTSH10NP 1 100 0.1992188 5 FORMAT "%8.6" ECU_ADDRESS 0xFEBE9740 /end MEASUREMENT
/begin MEASUREMENT xBci_AssistPostscalerL2_xdf32 "zwischengespeicherter Faktor auf das angeforderte Moment nach Assist/BST fuer die Level2 Überwachung" FLOAT32_IEEE ZU0 1 100 0.19921875 5 FORMAT "%10.8" ECU_ADDRESS 0xFEBE9260 /end MEASUREMENT
/begin MEASUREMENT xBci_AssistPrescalerGradLimL2_xdf32 "level2 gradientenbegrenzter Faktor auf die Zahnstangenkraft vor Assist/BST" FLOAT32_IEEE ZU0 1 100 0.19921875 5 FORMAT "%10.8" ECU_ADDRESS 0xFEBE9264 /end MEASUREMENT
/begin MEASUREMENT xBci_AssistPrescalerGradLim_xdu16 "gradientenbegrenzter Faktor auf die Zahnstangenkraft vor Assist/BST" UWORD RIGHTSH10NP 1 100 0.1992188 5 FORMAT "%8.6" ECU_ADDRESS 0xFEBE9742 /end MEASUREMENT
/begin MEASUREMENT xBci_AssistPrescalerL2_xdf32 "zwischengespeicherter Faktor auf die Zahnstangenkraft vor Assist/BST fuer die Level2 Überwachung" FLOAT32_IEEE ZU0 1 100 0.19921875 5 FORMAT "%10.8" ECU_ADDRESS 0xFEBE9268 /end MEASUREMENT
/begin MEASUREMENT xCalDatHdl_DriveRefOffset_xdu32 "Adressoffsets für den Zugriff auf Safety Kalibrierdaten Referenz (Drive, kein DSDL)" ULONG ZU0 1 100 0 4294967295 FORMAT "%13.2" ECU_ADDRESS 0xFEBE926C /end MEASUREMENT
/begin MEASUREMENT xCalDatHdl_SystemRefOffset_xdu32 "Adressoffsets für den Zugriff auf Systemdaten-Referenz" ULONG ZU0 1 100 0 4294967295 FORMAT "%13.2" ECU_ADDRESS 0xFEBE9270 /end MEASUREMENT
/begin MEASUREMENT xCalDatHdl_TuningRefOffset_xdu32 "Adressoffsets für den Zugriff auf Fahrzeug-Kalibrierdaten-Referenz" ULONG ZU0 1 100 0 4294967295 FORMAT "%13.2" ECU_ADDRESS 0xFEBE9274 /end MEASUREMENT
/begin MEASUREMENT xCentFeel_CenterFeelTorqueFact_xdu16 "factor of nominal center feel torque" UWORD RIGHTSH10NP 1 100 0 1 FORMAT "%8.6" ECU_ADDRESS 0xFEBE9744 /end MEASUREMENT
/begin MEASUREMENT xDrvStrRec_RampInMonSafe_xdu16 "RampIn Gradient für DSR Monsafe" UWORD TORGRAD_10MS 1 100 0 4 FORMAT "%8.6" ECU_ADDRESS 0xFEBE9746 /end MEASUREMENT
/begin MEASUREMENT xDrvStrRec_RampOutMonSafe_xdu16 "RampOut Gradient für DSR Monsafe" UWORD TORGRAD_10MS 1 100 0 4 FORMAT "%8.6" ECU_ADDRESS 0xFEBE974A /end MEASUREMENT
/begin MEASUREMENT xDTSC_InputValueNorm_xdu16 "Inputvalue" UWORD RIGHTSH12NP 1 100 0 15 FORMAT "%8.5" ECU_ADDRESS 0xFEBE974E /end MEASUREMENT
/begin MEASUREMENT xEndStopI_OversteerabilityFactor_xdu16 "Ueberlenkbarkeitsfaktor (1=ueberlenkbar). Wenn EndStopSupp nicht benutzt, wird dieser Wert nur initial geschrieben. Achtung: Ueberstimmt fEndStop_LimitEnable_XDU8 wenn fEndStop_EnableDyn_XDU8=1!" UWORD RIGHTSH15NP 1 100 0 1 FORMAT "%8.6" ECU_ADDRESS 0xFEBE9750 /end MEASUREMENT
/begin MEASUREMENT xEndStop_FactorLimTorque_xdu16 "Faktor des ueberlenkbaren Endanschlagsmoment [0..1]" UWORD RIGHTSH10NP 1 100 0 1 FORMAT "%8.6" ECU_ADDRESS 0xFEBE9752 /end MEASUREMENT
/begin MEASUREMENT xEndStop_SpringFactor_xdu16 "Statische Größe: Reduzierungsfaktor fuer Federmoment am Endanschlag, wenn noch nicht Eingelernt" UWORD RIGHTSH15NP 1 100 0 1 FORMAT "%8.6" ECU_ADDRESS 0xFEBE9754 /end MEASUREMENT
/begin MEASUREMENT xEpsInI_AccelPedalPosition_xdu16 "Position des Gaspedals" UWORD RIGHTSH10NP 1 100 0 1 FORMAT "%8.6" ECU_ADDRESS 0xFEBE9756 /end MEASUREMENT
/begin MEASUREMENT yApplI_Batterystatus_xdu8 "BMS Battery Status" UBYTE ZU0 1 100 0 15 FORMAT "%5.2" ECU_ADDRESS 0xFEBE9A60 /end MEASUREMENT
/begin MEASUREMENT yApplI_HWAstatus_xdu8 "HWA status" UBYTE ZU0 1 100 1 8 FORMAT "%5.3" ECU_ADDRESS 0xFEBE9A64 /end MEASUREMENT
/begin MEASUREMENT yApplI_LaneChangeStatus_xdu8 "Lane Change Status" UBYTE ZU0 1 100 0 15 FORMAT "%5.2" ECU_ADDRESS 0xFEBE9A65 /end MEASUREMENT
/begin MEASUREMENT yApplI_LogicalGearSelected_xdu8 "Gear selected" UBYTE ZU0 1 100 0 15 FORMAT "%5.2" ECU_ADDRESS 0xFEBE9A66 /end MEASUREMENT
/begin MEASUREMENT yApplI_ParkStatusIndication_xdu8 "Park Status Indication" UBYTE ZU0 1 100 0 15 FORMAT "%5.2" ECU_ADDRESS 0xFEBE9A68 /end MEASUREMENT
/begin MEASUREMENT yApplI_Powertrainstate_xdu8 "Powertrain State" UBYTE ZU0 1 100 0 7 FORMAT "%5.3" ECU_ADDRESS 0xFEBE9A69 /end MEASUREMENT
/begin MEASUREMENT yApplI_VehOdometer_xdu32 "Vehicle Odometer" ULONG ZU0 1 100 0 4294967295 FORMAT "%13.2" ECU_ADDRESS 0xFEBE9290 /end MEASUREMENT
/begin MEASUREMENT yBci_CalcBoostCurvesL1PosVal_xds16 "BoostCurveInterpolation - CalcBoostCurves - level 1 pos value" SWORD ZU0 1 100 -32768 32767 FORMAT "%8.2" ECU_ADDRESS 0xFEBE97D6 /end MEASUREMENT
/begin MEASUREMENT yBci_CalcBoostCurvesL2PosVal_xds16 "BoostCurveInterpolation - CalcBoostCurves - level 2 pos value" SWORD ZU0 1 100 -32768 32767 FORMAT "%8.2" ECU_ADDRESS 0xFEBE97D8 /end MEASUREMENT
/begin MEASUREMENT yDMSI_EpsDMSMode_xdu8 "Aktuelles Status Kennlinienumschaltung (DMS DriveModeSelect): 0=Unavailable , 1=Normal, 2=Comfort, 3=Sport" UBYTE ZU0 1 100 0 4 FORMAT "%5.3" ECU_ADDRESS 0xFEBE9A6B /end MEASUREMENT
/begin MEASUREMENT yDMSI_UserSelectedMode_xdu8 "" UBYTE ZU0 1 100 0 4 FORMAT "%5.3" ECU_ADDRESS 0xFEBE9A6C /end MEASUREMENT
/begin MEASUREMENT yDMSI_VehicleDriveMode_xdu8 "" UBYTE ZU0 1 100 0 15 FORMAT "%5.2" ECU_ADDRESS 0xFEBE9A6D /end MEASUREMENT
/begin MEASUREMENT yDMS_EpsCharismaState_xdu8 "Aktuelles Status Kennlinienumschaltung (DMS DriveModeSelect): 0=not available , 1=available, 2=in transition, 3=faulty,4=Disable lka mode" UBYTE ZU0 1 100 0 4 FORMAT "%5.3" ECU_ADDRESS 0xFEBE9A6E /end MEASUREMENT
/begin MEASUREMENT yeeDCMNvMDataVINInfo_xau8 "" UBYTE ZU0 1 100 0 255 FORMAT "%5.1" ECU_ADDRESS 0xFEBEA00C MATRIX_DIM 17 1 1 /end MEASUREMENT
/begin MEASUREMENT yeeDCMNvMRepairInfo_xau8 "original vehicle ident number" UBYTE ZU0 1 100 0 255 FORMAT "%5.1" ECU_ADDRESS 0xFEBE9EF4 MATRIX_DIM 20 1 1 /end MEASUREMENT
/begin MEASUREMENT yeeDMSTuningSet_xdu8 "" UBYTE ZU0 1 100 0 4 FORMAT "%5.3" ECU_ADDRESS 0xFEBE9A6F /end MEASUREMENT
/begin MEASUREMENT yeeVehCustomCod1_xdu32 "Coding for customer funktionality 1" ULONG ZU0 1 100 0 4294967295 FORMAT "%13.2" ECU_ADDRESS 0xFEBE92B4 /end MEASUREMENT
/begin MEASUREMENT yeeVehCustomCod2_xdu32 "Coding for customer funktionality 2" ULONG ZU0 1 100 0 4294967295 FORMAT "%13.2" ECU_ADDRESS 0xFEBE92B8 /end MEASUREMENT
/begin MEASUREMENT yeeVehVarTuningSet_xdu8 "" UBYTE ZU0 1 100 0 5 FORMAT "%5.3" ECU_ADDRESS 0xFEBE9A70 /end MEASUREMENT
/begin MEASUREMENT yeeVINOriginal_xau8 "original vehicle ident number" UBYTE ZU0 1 100 0 255 FORMAT "%5.1" ECU_ADDRESS 0xFEBEA020 MATRIX_DIM 17 1 1 /end MEASUREMENT
/begin MEASUREMENT yEpsInI_RemoteHwLibStdSyncData_xau8 "Empfangsarray fuer die SyncBotschaft von der HWlib Schnittstelle yHwlI_LocalHwLibStdSyncData" UBYTE ZU0 1 100 0 255 FORMAT "%5.1" ECU_ADDRESS 0xFEBE97E0 MATRIX_DIM 2 1 1 /end MEASUREMENT
/begin MEASUREMENT yEpsOutI_LocalSyncMessage_xau32 "Local Sync Message" ULONG ZU0 1 100 0 4294967295 FORMAT "%13.2" ECU_ADDRESS 0xFEBE9034 MATRIX_DIM 2 1 1 /end MEASUREMENT
/begin MEASUREMENT zBci_AssistPostscalerSync_xdu8 "diversitaer abgelegter Zaehler fuer Anzahl Aufsyncronisationen von xBci_AssistPostscalerGradLimL2_xdf32" UBYTE ZU0 1 100 0 10 FORMAT "%5.2" ECU_ADDRESS 0xFEBE9A87 /end MEASUREMENT
/begin MEASUREMENT zBci_AssistPrescalerSync_xdu8 "diversitaer abgelegter Zaehler fuer Anzahl Aufsyncronisationen von xBci_AssistPrescalerGradLimL2_xdf32" UBYTE ZU0 1 100 0 10 FORMAT "%5.2" ECU_ADDRESS 0xFEBE9A88 /end MEASUREMENT
/begin MEASUREMENT zcrChatterPeriodsCount_xdu8 "counter of the chatter oscillations" UBYTE ZU0 1 100 0 254 FORMAT "%5.1" ECU_ADDRESS 0xFEBE983A /end MEASUREMENT
/begin MEASUREMENT zDthrCtrl_CheckHandsOnCounter_xdu16 "Diverse stored counter value of HandsOnDetection" UWORD TIMMS 1 100 0 1000 FORMAT "%8.3" ECU_ADDRESS 0xFEBE9806 /end MEASUREMENT
/begin MEASUREMENT zDthrCtrl_CheckTorqueOffCounter_xdu8 "Diverse stored counter value of torque off filter" UBYTE ZU0 1 100 0 3 FORMAT "%5.3" ECU_ADDRESS 0xFEBE9A8A /end MEASUREMENT
/begin MEASUREMENT zDthrCtrl_JobcallCounter_xdu16 "Jobcallback Counter" UWORD ZU0 1 100 0 65535 FORMAT "%8.2" ECU_ADDRESS 0xFEBE9808 /end MEASUREMENT
/begin MEASUREMENT zDTSC_ActivationCycles_xdu8 "Aktivierungszyklen für Kalibrierung / Validierung" UBYTE ZU0 1 100 0 255 FORMAT "%5.1" ECU_ADDRESS 0xFEBE9A8B /end MEASUREMENT
/begin MEASUREMENT zDTSC_ActiveCycles_xdu16 "Zyklen für Kalibrierung / Validierung" UWORD ZU0 1 100 0 65535 FORMAT "%8.2" ECU_ADDRESS 0xFEBE980A /end MEASUREMENT
/begin MEASUREMENT zEpsInI_OdometerValue_xdu32 "Kilometerstand des Fahrzeugs" ULONG ZU0 1 100 0 4294967295 FORMAT "%13.2" ECU_ADDRESS 0xFEBE9308 /end MEASUREMENT
/begin COMPU_METHOD AFZ "" RAT_FUNC "%6.5" "m/s^2" COEFFS 0 1024 0 0 0 1 /end COMPU_METHOD
/begin COMPU_METHOD BIT "" RAT_FUNC "%6.2" "Bitanzeige" COEFFS 0 1 0 0 0 1 /end COMPU_METHOD
/begin COMPU_METHOD DTSC_STATE "" TAB_VERB "%6.3" "Status" COMPU_TAB_REF DTSC_STATE /end COMPU_METHOD
/begin COMPU_METHOD FLOAT "" RAT_FUNC "%16.7" "NA" COEFFS 0 1 0 0 0 1 /end COMPU_METHOD
/begin COMPU_METHOD FRACK "" RAT_FUNC "%6.2" "N" COEFFS 0 1 0 0 0 1 /end COMPU_METHOD
/begin COMPU_METHOD INERTOR_HIGH "" RAT_FUNC "%7.6" "g * mÂ²" COEFFS 0 16384 0 0 0 1 /end COMPU_METHOD
/begin COMPU_METHOD MMOT "" RAT_FUNC "%6.5" "Nm" COEFFS 0 1024 0 0 0 1 /end COMPU_METHOD
/begin COMPU_METHOD NM_MIN_1024 "" RAT_FUNC "%6.5" "Nm/(1024/min)" COEFFS 0 1024 0 0 0 1 /end COMPU_METHOD
/begin COMPU_METHOD PDC_FRACK "" RAT_FUNC "%6.3" "N" COEFFS 0 2 0 0 0 1 /end COMPU_METHOD
/begin COMPU_METHOD RACKACC128 "" RAT_FUNC "%6.4" "mm/sÂ²" COEFFS 0 128 0 0 0 1 /end COMPU_METHOD
/begin COMPU_METHOD RACKPOS128 "" RAT_FUNC "%6.4" "mm" COEFFS 0 128 0 0 0 1 /end COMPU_METHOD
/begin COMPU_METHOD RACKSPEED128 "" RAT_FUNC "%6.4" "mm/s" COEFFS 0 128 0 0 0 1 /end COMPU_METHOD
/begin COMPU_METHOD RIGHTSH10NP "" RAT_FUNC "%6.5" "" COEFFS 0 1024 0 0 0 1 /end COMPU_METHOD
/begin COMPU_METHOD RIGHTSH10NP_10MS "" RAT_FUNC "%6.5" "1/10ms" COEFFS 0 1024 0 0 0 1 /end COMPU_METHOD
/begin COMPU_METHOD RIGHTSH10NP_1MS "" RAT_FUNC "%6.5" "1/1ms" COEFFS 0 1024 0 0 0 1 /end COMPU_METHOD
/begin COMPU_METHOD RIGHTSH12NP "" RAT_FUNC "%6.5" "" COEFFS 0 4096 0 0 0 1 /end COMPU_METHOD
/begin COMPU_METHOD RIGHTSH14NP "" RAT_FUNC "%7.6" "" COEFFS 0 16384 0 0 0 1 /end COMPU_METHOD
/begin COMPU_METHOD RIGHTSH15NP "" RAT_FUNC "%7.6" "" COEFFS 0 32768 0 0 0 1 /end COMPU_METHOD
/begin COMPU_METHOD RIGHTSH2NP "" RAT_FUNC "%6.3" "" COEFFS 0 4 0 0 0 1 /end COMPU_METHOD
/begin COMPU_METHOD RIGHTSH7NP "" RAT_FUNC "%6.4" "" COEFFS 0 128 0 0 0 1 /end COMPU_METHOD
/begin COMPU_METHOD RIGHTSH8NP "" RAT_FUNC "%6.4" "" COEFFS 0 256 0 0 0 1 /end COMPU_METHOD
/begin COMPU_METHOD ROTACC "" RAT_FUNC "%6.4" "1/min/ms" COEFFS 0 64 0 0 0 1 /end COMPU_METHOD
/begin COMPU_METHOD RSH15 "" RAT_FUNC "%6.4" "%" COEFFS 0 327.68 0 0 0 1 /end COMPU_METHOD
/begin COMPU_METHOD SA "" RAT_FUNC "%6.4" "Â°" COEFFS 0 22.857 0 0 0 1 /end COMPU_METHOD
/begin COMPU_METHOD SAA "" RAT_FUNC "%6.2" "Â°/sÂ²" COEFFS 0 1 0 0 0 1 /end COMPU_METHOD
/begin COMPU_METHOD SAS "" RAT_FUNC "%6.3" "Â°/s" COEFFS 0 2 0 0 0 1 /end COMPU_METHOD
/begin COMPU_METHOD SAS_8 "" RAT_FUNC "%6.3" "Â°/s" COEFFS 0 8 0 0 0 1 /end COMPU_METHOD
/begin COMPU_METHOD SA_10 "" RAT_FUNC "%6.3" "Â°" COEFFS 0 10 0 0 0 1 /end COMPU_METHOD
/begin COMPU_METHOD STATUS "" RAT_FUNC "%6.2" "Status" COEFFS 0 1 0 0 0 1 /end COMPU_METHOD
/begin COMPU_METHOD TBTHIGH "" RAT_FUNC "%6.5" "Nm" COEFFS 0 1024 0 0 0 1 /end COMPU_METHOD
/begin COMPU_METHOD TBTSTIFFHIGH "" RAT_FUNC "%6.5" "NM / Â°" COEFFS 0 1024 0 0 0 1 /end COMPU_METHOD
/begin COMPU_METHOD TEMP "" RAT_FUNC "%6.2" "Â°C" COEFFS 0 1 0 0 0 1 /end COMPU_METHOD
/begin COMPU_METHOD TIMMS "" RAT_FUNC "%6.2" "ms" COEFFS 0 1 0 0 0 1 /end COMPU_METHOD
/begin COMPU_METHOD TIMMS_10 "" RAT_FUNC "%6.1" "ms" COEFFS 0 0.1 0 0 0 1 /end COMPU_METHOD
/begin COMPU_METHOD TIMSEC "" RAT_FUNC "%6.4" "SEC" COEFFS 0 100 0 0 0 1 /end COMPU_METHOD
/begin COMPU_METHOD TIMSEC_1000 "" RAT_FUNC "%6.5" "s" COEFFS 0 1000 0 0 0 1 /end COMPU_METHOD
/begin COMPU_METHOD TORGRAD_10MS "" RAT_FUNC "%6.5" "Nm/10ms" COEFFS 0 1024 0 0 0 1 /end COMPU_METHOD
/begin COMPU_METHOD U64V "" RAT_FUNC "%6.4" "V" COEFFS 0 64 0 0 0 1 /end COMPU_METHOD
/begin COMPU_METHOD VENG "" RAT_FUNC "%6.2" "1/min" COEFFS 0 1 0 0 0 1 /end COMPU_METHOD
/begin COMPU_METHOD VFZ "" RAT_FUNC "%6.2" "km/h" COEFFS 0 1 0 0 0 1 /end COMPU_METHOD
/begin COMPU_METHOD VFZHIGH "" RAT_FUNC "%6.4" "km/h" COEFFS 0 64 0 0 0 1 /end COMPU_METHOD
/begin COMPU_METHOD VROT "" RAT_FUNC "%3.1" "1/min" COEFFS 0 1 0 0 0 1 /end COMPU_METHOD
/begin COMPU_METHOD ZU0 "" RAT_FUNC "%6.2" "" COEFFS 0 1 0 0 0 1 /end COMPU_METHOD
/begin COMPU_VTAB DTSC_STATE "" TAB_VERB 8 0 "Calibration_Inactive" 1 "Calibration_Activate" 2 "Calibration_Active" 3 "Calibration_Calibrate" 4 "Validation_Inactive" 5 "Validation_Activate" 6 "Validation_Active" 7 "Validation_Validate" DEFAULT_VALUE "undefined" /end COMPU_VTAB
/begin FUNCTION BoostCurveInterpolationMain "Unterstuetzungskennlinien (calculate boost curves)"
 /begin DEF_CHARACTERISTIC fBci_Level1CheckActivated_XDU8 kBci_MaxRackForceOnVehicleSpeed_XAU16 kBci_MaxRackForce_XDU16 kBci_SafetyLimiterMinRackForce1_XDU16 kBci_SafetyLimiterMinRackForce2_XDU16 mBci_MaxAssistanceTorque_XDU16 mBci_SafetyLimiterMinTorsionBarTorque1_XDU16 mBci_SafetyLimiterMinTorsionBarTorque2_XDU16 vBci_SafetyLimiterMinSpeed_XDU16 xBci_MaxAssistPostscaler_XDU16 xBci_MaxAssistPrescaler_XDU16 xBci_MaxAssistXxxscalerNoGradient_XDU16 xBci_MaxGradAssistXxxscalerOnEntering_XDU16 xBci_MaxGradAssistXxxscalerOnExceeding_XDU16 xBci_MinAssistPostscaler_XDU16 xBci_MinAssistPrescaler_XDU16 xBci_MinAssistXxxscalerNoGradient_XDU16 /end DEF_CHARACTERISTIC
 /begin IN_MEASUREMENT vApplI_AbsSafeNssVehicleSpeed_xdu16 /end IN_MEASUREMENT
 /begin OUT_MEASUREMENT vBci_AbsSafeNssVehicleSpeedCalcCurvesL2_xdf32 wBci_AbsSteeringAngleL2_xdf32 xBci_AssistPostscalerGradLim_xdu16 xBci_AssistPostscalerL2_xdf32 xBci_AssistPrescalerGradLim_xdu16 xBci_AssistPrescalerL2_xdf32 yBci_CalcBoostCurvesL1PosVal_xds16 /end OUT_MEASUREMENT
/end FUNCTION
/begin FUNCTION BoostCurveInterpolationPlausi "Unterstuetzungskennlinien (calculate boost curves level 2)"
 /begin DEF_CHARACTERISTIC fBci_Level2CheckActivated_XDU8 kBci_MaxRackForceOnVehicleSpeed_XAF32 mBci_ErrorInjectionMotorTorqueOnAssistChar_XAS16 mBci_ErrorInjectionTorsionBarTorqueOnAssistChar_XAS16 xBci_InvSteeringRatioVarFact_XAF32 /end DEF_CHARACTERISTIC
 /begin IN_MEASUREMENT vBci_AbsSafeNssVehicleSpeedCalcCurvesL2_xdf32 wBci_AbsSteeringAngleL2_xdf32 /end IN_MEASUREMENT
 /begin OUT_MEASUREMENT kBci_BSTCurveXAxisBackwardL2_xaf32 kBci_BSTCurveXAxisBackwardRescaledL2_xaf32 mBci_BSTCurveYAxisBackwardL2_xaf32 mBci_BSTCurveYAxisBackwardRescaledL2_xaf32 xBci_AssistPostscalerGradLimL2_xdf32 xBci_AssistPrescalerGradLimL2_xdf32 yBci_CalcBoostCurvesL2PosVal_xds16 zBci_AssistPostscalerSync_xdu8 zBci_AssistPrescalerSync_xdu8 /end OUT_MEASUREMENT
/end FUNCTION
/begin FUNCTION CalDatHdl_RefOffset "Berechnung der Adressoffsets für den Zugriff auf Kalibrierdaten" /begin DEF_CHARACTERISTIC xCalDatHdl_StartXcpFlash_XDU8 /end DEF_CHARACTERISTIC
 /begin OUT_MEASUREMENT xCalDatHdl_DriveRefOffset_xdu32 xCalDatHdl_SystemRefOffset_xdu32 xCalDatHdl_TuningRefOffset_xdu32 /end OUT_MEASUREMENT
/end FUNCTION
/begin FUNCTION CardanJointCompensation "CardanJointCompensation"
 /begin DEF_CHARACTERISTIC mCJC_LimitSteerTorqueOffset_XDU16 wCJC_AngleOffset_XDS16 xCJC_AmplitudeFactor_XAS16 xCJC_ControlRatio_XDU16 xCJC_SubVehSpeedFactor_XDU16 xCJC_VehicleSpeedFactor_XAU16 /end DEF_CHARACTERISTIC
 /begin IN_MEASUREMENT vVehSpI_AbsAvgVehSpd_xdu16 wApplI_PinionAngle_xds16 /end IN_MEASUREMENT
 /begin OUT_MEASUREMENT fCJC_Activate_xdb sCJC_FctCoCtrlState_xdu8 sCJC_FeatureState_xdu8 /end OUT_MEASUREMENT
/end FUNCTION
/begin FUNCTION CardanJointCompensationCheck "CardanJointCompensationCheck" /begin DEF_CHARACTERISTIC mCJC_SafetyLimitSteerTorque_XDU16 /end DEF_CHARACTERISTIC /begin OUT_MEASUREMENT fCJC_LastCJCArbPas_xdb mCJC_DesSteerTrqOffsetChecked_xds16 /end OUT_MEASUREMENT /end FUNCTION
/begin FUNCTION CardanJointCompensationCheckI "CardanJointCompensationCheckI"
 /begin OUT_MEASUREMENT fCJCI_MonSafeOk_xdb mCJCI_DesMotTrqOffset_xds16 mCJCI_DesSteerTrqOffset_xds16 /end OUT_MEASUREMENT
/end FUNCTION
/begin FUNCTION CardanJointCompensationI "CardanJointCompensationI"
 /begin OUT_MEASUREMENT mCJCI_DesMotTrqOffset4Check_xds16 mCJCI_DesSteerTrqOffset4Check_xds16 /end OUT_MEASUREMENT
/end FUNCTION
/begin FUNCTION CenterFeelTorque "CenterFeelTorque"
 /begin DEF_CHARACTERISTIC mCentFeel_MaxCenterFeelTorque_XDU16 mCentFeel_NormCenterFeelTorque_XAU16_00___A mCentFeel_NormCenterFeelTorque_XAU16_01___A mCentFeel_NormCenterFeelTorque_XAU16_02___A mCentFeel_NormCenterFeelTorque_XAU16_03___A mCentFeel_NormCenterFeelTorque_XAU16_04___A mCentFeel_NormCenterFeelTorque_XAU16_05___A mCentFeel_NormCenterFeelTorque_XAU16_06___A mCentFeel_NormCenterFeelTorque_XAU16_07___A mCentFeel_NormCenterFeelTorque_XAU16_08___A mCentFeel_NormCenterFeelTorque_XAU16_09___A mCentFeel_NormCenterFeelTorque_XAU16_10___A mCentFeel_NormCenterFeelTorque_XAU16_11___A mCentFeel_NormCenterFeelTorque_XAU16_12___A mCentFeel_NormCenterFeelTorque_XAU16_13___A mCentFeel_NormCenterFeelTorque_XAU16_14___A mCentFeel_NormCenterFeelTorque_XAU16_15___A mCentFeel_NormCenterFeelTorque_XAU16_16___A mCentFeel_NormCenterFeelTorque_XAU16_17___A mCentFeel_NormCenterFeelTorque_XAU16_18___A mCentFeel_NormCenterFeelTorque_XAU16_19___A mCentFeel_NormCenterFeelTorque_XAU16_20___A mCentFeel_NormCenterFeelTorque_XAU16_21___A mCentFeel_NormCenterFeelTorque_XAU16_22___A mCentFeel_NormCenterFeelTorque_XAU16_23___A mCentFeel_NormCenterFeelTorque_XAU16_24___A mCentFeel_NormCenterFeelTorque_XAU16_25___A mCentFeel_NormCenterFeelTorque_XAU16_26___A mCentFeel_NormCenterFeelTorque_XAU16_27___A mCentFeel_NormCenterFeelTorque_XAU16_28___A mCentFeel_NormCenterFeelTorque_XAU16_29___A mCentFeel_NormCenterFeelTorque_XAU16_30___A mCentFeel_NormCenterFeelTorque_XAU16_31___A mCentFeel_NormCenterFeelTorque_XAU16_32___A mCentFeel_NormCenterFeelTorque_XAU16_33___A mCentFeel_NormCenterFeelTorque_XAU16_34___A mCentFeel_NormCenterFeelTorque_XAU16_35___A xCentFeel_CenterFeelTorqueFact_XAU16_00___A xCentFeel_CenterFeelTorqueFact_XAU16_01___A xCentFeel_CenterFeelTorqueFact_XAU16_02___A xCentFeel_CenterFeelTorqueFact_XAU16_03___A xCentFeel_CenterFeelTorqueFact_XAU16_04___A xCentFeel_CenterFeelTorqueFact_XAU16_05___A xCentFeel_CenterFeelTorqueFact_XAU16_06___A xCentFeel_CenterFeelTorqueFact_XAU16_07___A xCentFeel_CenterFeelTorqueFact_XAU16_08___A xCentFeel_CenterFeelTorqueFact_XAU16_09___A xCentFeel_CenterFeelTorqueFact_XAU16_10___A xCentFeel_CenterFeelTorqueFact_XAU16_11___A xCentFeel_CenterFeelTorqueFact_XAU16_12___A xCentFeel_CenterFeelTorqueFact_XAU16_13___A xCentFeel_CenterFeelTorqueFact_XAU16_14___A xCentFeel_CenterFeelTorqueFact_XAU16_15___A xCentFeel_CenterFeelTorqueFact_XAU16_16___A xCentFeel_CenterFeelTorqueFact_XAU16_17___A xCentFeel_CenterFeelTorqueFact_XAU16_18___A xCentFeel_CenterFeelTorqueFact_XAU16_19___A xCentFeel_CenterFeelTorqueFact_XAU16_20___A xCentFeel_CenterFeelTorqueFact_XAU16_21___A xCentFeel_CenterFeelTorqueFact_XAU16_22___A xCentFeel_CenterFeelTorqueFact_XAU16_23___A xCentFeel_CenterFeelTorqueFact_XAU16_24___A xCentFeel_CenterFeelTorqueFact_XAU16_25___A xCentFeel_CenterFeelTorqueFact_XAU16_26___A xCentFeel_CenterFeelTorqueFact_XAU16_27___A xCentFeel_CenterFeelTorqueFact_XAU16_28___A xCentFeel_CenterFeelTorqueFact_XAU16_29___A xCentFeel_CenterFeelTorqueFact_XAU16_30___A xCentFeel_CenterFeelTorqueFact_XAU16_31___A xCentFeel_CenterFeelTorqueFact_XAU16_32___A xCentFeel_CenterFeelTorqueFact_XAU16_33___A xCentFeel_CenterFeelTorqueFact_XAU16_34___A xCentFeel_CenterFeelTorqueFact_XAU16_35___A /end DEF_CHARACTERISTIC
 /begin IN_MEASUREMENT vApplI_AbsVehicleSpeedFilt_xdu16 wApplI_AbsDynSteerAngle_xdu16 /end IN_MEASUREMENT
 /begin OUT_MEASUREMENT xCentFeel_CenterFeelTorqueFact_xdu16 /end OUT_MEASUREMENT
/end FUNCTION
/begin FUNCTION CenterFeelTorqueI "CenterFeelTorque - Interface" /begin OUT_MEASUREMENT mCentFeelI_NominalSteerTorque_xds16 /end OUT_MEASUREMENT /end FUNCTION
/begin FUNCTION ChatterSensor "ChatterSensor"
 /begin DEF_CHARACTERISTIC ncruAbsChatterGrad_XDU16 tcrChatterCycleResetDelay_XDU16 tcroChatterTime_XDU8 vcrVehSpeedLimit_XDU16_0__A vcrVehSpeedLimit_XDU16_1__A vcrVehSpeedLimit_XDU16_2__A vcrVehSpeedLimit_XDU16_3__A zcrMinChatterPeriodsCountDelayed_XDU8 /end DEF_CHARACTERISTIC
 /begin OUT_MEASUREMENT scrChatterState_xdu8 tcrChatterTime_xdu8 tcrDelayTimerResetChatterCycle_xdu16 /end OUT_MEASUREMENT
/end FUNCTION
/begin FUNCTION ChatterSensorI "ChatterSensorI" /begin OUT_MEASUREMENT zcrChatterPeriodsCount_xdu8 /end OUT_MEASUREMENT /end FUNCTION
/begin FUNCTION ChatterSensorSupp "ChatterSensorSupp"
 /begin DEF_CHARACTERISTIC vcrChatterSensr_MaxRackSpeed4RecoverDController_XDU16 vcrChatterSensr_MaxVehicleSpeed4RecoverDController_XDU16 /end DEF_CHARACTERISTIC
/end FUNCTION
/begin FUNCTION ChatterSensorSuppI "ChatterSensorSuppI"
 /begin DEF_CHARACTERISTIC sChatterSnsr_ConfigFlag_XDU8 vcrChatterSensr_VehicleSpeedLA_XDU16 /end DEF_CHARACTERISTIC
 /begin OUT_MEASUREMENT scrChatterMode_xdu8 scrChatterSensIsActive_xdu8 /end OUT_MEASUREMENT
/end FUNCTION
/begin FUNCTION ChatterSensorSuppInterface "Interface of the ChatterSensorSupp" /begin OUT_MEASUREMENT sApplI_AutoBrakeState_xdu8 /end OUT_MEASUREMENT /end FUNCTION
/begin FUNCTION Compare "L1 L2 Vergleicher" /begin OUT_MEASUREMENT scpI_SwFault_ErrLvl_Red_xdu8 scpI_SwFault_ErrLvl_xdu8 /end OUT_MEASUREMENT /end FUNCTION
/begin FUNCTION CurrentRecalibPermission "Aktuelle Wiederkalibrierungserlaubnis"
 /begin DEF_CHARACTERISTIC mCrpI_MaxThresholdMotTor_XDU16 mCrpI_MaxThresholdTBT_XDU16 nCrpI_MaxThresholdRotorSpeed_XDU16 tCrpI_MinConditionTime_XDU8 /end DEF_CHARACTERISTIC
 /begin OUT_MEASUREMENT sCrpI_CurrentRecalibPermission_xdu8 /end OUT_MEASUREMENT
/end FUNCTION
/begin FUNCTION CurrentRecalibPermissionSupp "Aktuelle Wiederkalibrierungserlaubnis Supp" /begin OUT_MEASUREMENT sCrpI_CurrentRecalibPermissionOem_xdu8 /end OUT_MEASUREMENT /end FUNCTION
/begin FUNCTION CustomerData "CustomerData" /begin OUT_MEASUREMENT yeeVehCustomCod1_xdu32 yeeVehCustomCod2_xdu32 /end OUT_MEASUREMENT /end FUNCTION
/begin FUNCTION DCMNVData "DCMNVData"
 /begin OUT_MEASUREMENT yeeDMSTuningSet_xdu8 yeeVehVarTuningSet_xdu8 yeeVINOriginal_xau8 /end OUT_MEASUREMENT
/end FUNCTION
/begin FUNCTION DCMNvMData "DCMNvMData"
 /begin OUT_MEASUREMENT sDCMNVM_EPSConfig_xdu8 sDCMNVM_VehcfgFlag_xdu8 sDCMNVM_VehConfig_xdu8 sDCMNVM_VINFlag_xdu8 yeeDCMNvMDataVINInfo_xau8 yeeDCMNvMRepairInfo_xau8 /end OUT_MEASUREMENT
/end FUNCTION
/begin FUNCTION DcmUserAbstraction "DcmUserAbstraction"
 /begin DEF_CHARACTERISTIC uds_HighVoltForCalib_XDU16 uds_HighVoltForDither_XDU16 uds_LowVoltForCalib_XDU16 uds_LowVoltForDither_XDU16 uds_MaxWaitTimeForNvmWrite_XDU8 uds_TBTTuning_XDU16 uds_VehSpeedTuning_XDU8 /end DEF_CHARACTERISTIC
 /begin OUT_MEASUREMENT sUds_InhibitTracker_xdu8 /end OUT_MEASUREMENT
/end FUNCTION
/begin FUNCTION DitherControlCheck "DitherControlCheck"
 /begin DEF_CHARACTERISTIC mDthrCtrl_CheckHandsOnTorqLim_XDU16 tDthrCtrl_CheckHandsOnSwOffTime_XDU16 vDthrCtrl_SafetyLimitMaxVehicleSpeed_XDU16 /end DEF_CHARACTERISTIC
 /begin OUT_MEASUREMENT fDthrCtrl_MonSafeOk_xdb mDthrCtrl_DesMotTrqOffsetChecked_xds16 sDthrCtrl_MakeSafeState_xdu8 zDthrCtrl_CheckHandsOnCounter_xdu16 zDthrCtrl_CheckTorqueOffCounter_xdu8 /end OUT_MEASUREMENT
/end FUNCTION
/begin FUNCTION DitherControlCheckI "DitherControlCheckI - interface"
 /begin OUT_MEASUREMENT mDthrCtrlI_RequestedTrq_xds16 sDthrCtrlI_ExclusiveMMotSwitch_xdu8 sDthrCtrlI_MakeSafeAndMonState_xdu8 /end OUT_MEASUREMENT
/end FUNCTION
/begin FUNCTION DitherControlSuppInterface "DitherControlSupp Interface"
 /begin OUT_MEASUREMENT lDthrCtrlI_AddSteerRange_xdu16 lDthrCtrlI_CenterOffset_xds16 lDthrCtrlI_SteerRngProd_xdu16 sDthrCtrlI_LearnStatLeft_xdu8 sDthrCtrlI_LearnStatRight_xdu8 sDthrCtrlI_NvMWriteRequest_xdu8 sDthrCtrlI_NvWriteState_xdu8 sDthrCtrlI_WarningLamp_xdu8 /end OUT_MEASUREMENT
/end FUNCTION
/begin FUNCTION DMS_InputMappingI "Drive Mode Switch Input Mapping Interface" /begin OUT_MEASUREMENT fDMSI_LkaActiveRequest_xdb /end OUT_MEASUREMENT /end FUNCTION
/begin FUNCTION DriveExitHandler ""
 /begin DEF_CHARACTERISTIC tDrvExit_CycleCounter_XDU16 tDrvExit_MaxTimeRetryShutdown_XDU16 /end DEF_CHARACTERISTIC
 /begin OUT_MEASUREMENT tDrvExit_HwlShutdownTimerUs_xdu16 tDrvExit_TimeDiffUs_xdu16 /end OUT_MEASUREMENT
/end FUNCTION
/begin FUNCTION DriveModeSwitch "Auswahl Unterstï¿½tzungskennlinien"
 /begin DEF_CHARACTERISTIC mDMS_CharShiftBorder_XDU16 NvData_DMSActCharacteresiticValue sDMS_ConfigMain_XDU8 sDMS_DefaultVehicleModeTable_XAU8 sDMS_MaxUserSelectedMode_XDU8 tDMS_CycleTime_XDU8 tDMS_HandsOffTime_XDU16 tDMS_HandsOnTime_XDU16 tDMS_SpecialModeQuitTime_XDU16 tDMS_SteeringAngleSpeedInRange_XDU16 tDMS_UserSelectedModeVerifyTime_XDU16 tDMS_VehicleSpeedInRange_XDU16 vDMS_SteeringAngleSpeedBorder_XDU16 vDMS_VehSpeedBorder_XDU16 yDMS_DefaultActCharacteristic_XDU8 zDMS_MaxVehicleModeIndex_XDU8 /end DEF_CHARACTERISTIC
/end FUNCTION
/begin FUNCTION DriveModeSwitchInterface "Auswahl Unterstï¿½tzungskennlinien Interface"
 /begin OUT_MEASUREMENT sDMSI_SetAssociateSts_xdu8 sDMS_JobResultOk_xdu8 yDMSI_EpsDMSMode_xdu8 yDMSI_UserSelectedMode_xdu8 yDMSI_VehicleDriveMode_xdu8 yDMS_EpsCharismaState_xdu8 /end OUT_MEASUREMENT
/end FUNCTION
/begin FUNCTION DriverSteeringRecommendationCheck "Fahrer Lenkempfehlung Check"
 /begin DEF_CHARACTERISTIC mDsr_SafetyLimitDSRMotorTorque_XDU16 mDsr_SafetyLimitDSRSteerTorque_XDU16 mDsr_SafetyLimitEMAMotorTorque_XDU16 mDsr_SafetyLimitEMASteerTorque_XDU16 mDsr_SafetyLimitSteerTorque_XDU16 xDSR_DefaultBypassFactor_XDU16 xDsr_DefaultGradient_XDU16 xDSR_DSRSafetyBypassFactor_XDU16 xDSR_EMASafetyBypassFactor_XDU16 xDSR_SafetyErrorRampRate_XDU16 /end DEF_CHARACTERISTIC
 /begin OUT_MEASUREMENT fApplI_DsrErrorModeMonSafe_xdb fDsrI_MonSafeOk_xdb fDsr_EmaActivatedMonSafe_xdb fDsr_LastLdwArbitrationResultPassive_xdb mDsrI_MotorTorqueOffset_xds16 mDsrI_SteerTorqueOffset_xds16 mDSR_FilteredAbsTBTPlausiDelay_xds32 mDSR_FilteredAbsTBTPlausi_xds16 mDsr_MotorTrqOffsetChecked_xds16 mDsr_SteerTrqOffsetChecked_xds16 nDsrI_AbsRotorSpeedFilt_xdu16 sApplI_DrvrSteerActvInv_xds8 sDSR_FailureCause_xdu8 vDSR_FilteredAbsSASpeedPlausiDelay_xds32 vDSR_FilteredAbsSASpeedPlausi_xds16 xDrvStrRec_RampInMonSafe_xdu16 xDrvStrRec_RampOutMonSafe_xdu16 /end OUT_MEASUREMENT
/end FUNCTION
/begin FUNCTION DriverSteerRecommendation "Mess- und Applikationsgrößen DriverSteerRecommendation"
 /begin DEF_CHARACTERISTIC mDSR_EMA_MaxMotorTrq_XDU16 mDSR_EMA_MaxTBTOffset_XDU16 mDSR_EMA_MinTBT_XDU16 mDSR_MaxMotorTrq_XDU16 mDSR_MaxTBTOffset_XDU16 qDSR_LowPassCutOffFrequency_XDU8 sDSR_RecErrortoInactive_XDU8 vDSR_EMA_MinSteeringAngleSpeed_XDU16 xDSR_DSRBypassFactor_XDU16 xDSR_EMABypassFactor_XDU16 xDSR_ErrorModeRampRate_XDU16 /end DEF_CHARACTERISTIC
 /begin OUT_MEASUREMENT fApplI_DSRTorqueLimited_xdb mDSR_currentRampValue_xds32 mDSR_FilteredTBTDelay_xds32 mDSR_FilteredTBT_xds16 mDSR_MMot4Check_xds16 mDSR_TBT4Check_xds16 sApplI_DrvrSteerActv_xds8 sApplI_DsrState_xdu8 sDSR_ActivationRequest_xdu8 sDSR_FctCoCtrlState_xdu8 sDSR_FeatureState_xdu8 sDSR_InternalState_xdu8 vDSR_FilteredSASpeedDelay_xds32 vDSR_FilteredSASpeed_xds16 /end OUT_MEASUREMENT
/end FUNCTION
/begin FUNCTION DriverTorque "DriverTorque"
 /begin DEF_CHARACTERISTIC sDrvTorque_UseDynSteerAngle_XDU8 xDrvTorque_G_N1_XDF32 xDrvTorque_G_N2_XDF32 xDrvTorque_G_N3_XDF32 xDrvTorque_RotAccFilterFact_XDU16 xDrvTorque_Sign_XDS16 xDrvTorque_SWRotorInertia_XDU16 xDrvTorque_TBTFilterFact_XDU16 xDrvTorque_TorsionBarStiffnessMod_XDS16 /end DEF_CHARACTERISTIC
 /begin OUT_MEASUREMENT mDrvTorque_InertiaTorque_xds32 mDrvTorque_TBTfilt_xds32 vDrvTorque_SWSpeedDynPart_xdf32 vDrvTorque_SWSpeed_xdf32 vDrvTorque_velSW_xdf32 /end OUT_MEASUREMENT
/end FUNCTION
/begin FUNCTION DriveTorqueSteerCompensation "DriveTorqueSteerCompensation"
 /begin DEF_CHARACTERISTIC aDTSC_MaxLatAcceleration_XDU16 fDTSC_Enable_XDU8 fDTSC_UseDTSCEstimator_XDU8 fDTSC_UseLongAcceleration_XDU8 mDTSC_DefaultAdaptiveValueCorner_XDS16 mDTSC_DefaultAdaptiveValueStraight_XDS16 mDTSC_FadeOutRate_XDU16 mDTSC_MaxNegGradient_XAU16 mDTSC_MaxNegGradient_XDU16 mDTSC_MaxNegMotorTorqueOffset_XDS16 mDTSC_MaxPosGradient_XAU16 mDTSC_MaxPosGradient_XDU16 mDTSC_MaxPosMotorTorqueOffset_XDS16 mDTSC_MaxTorsionBarTorqueDiff_XDU16 mDTSC_MinEffectiveTorque_XDU16 sDTSC_ConfigFlagsMainActivErr_XDU16 vDTSC_MaxYawVelocity_XAU16 vDTSC_MinVehicleSpeed_XDU16 wDTSC_MaxSteeringAngle_XDU16 xDTSC_EffectiveTorqueFactor_XDS16_0___A xDTSC_EffectiveTorqueFactor_XDS16_1___A xDTSC_EffectiveTorqueFactor_XDS16_2___A xDTSC_EffectiveTorqueFactor_XDS16_3___A xDTSC_EffectiveTorqueFactor_XDS16_4___A xDTSC_EffectiveTorqueFactor_XDS16_5___A xDTSC_MaxInputValueNorm4Switch_XDU16 xDTSC_MinInputValueNormCorner_XDU16 xDTSC_MinInputValueNormStraight_XDU16 xDTSC_MinInputValueNorm_XDU16 xDTSC_NormInputValue_XDU16 xDTSC_SteeringAngleCorrCorner_XAU16 xDTSC_SteeringAngleCorrStraight_XAU16_0___A xDTSC_SteeringAngleCorrStraight_XAU16_1___A xDTSC_SteeringAngleCorrStraight_XAU16_2___A xDTSC_SteeringAngleCorrStraight_XAU16_3___A xDTSC_SteeringAngleCorrStraight_XAU16_4___A xDTSC_SteeringAngleCorrStraight_XAU16_5___A xDTSC_VehicleSpeedCorrCorner_XAU16 xDTSC_VehicleSpeedCorrStraight_XAU16_0___A xDTSC_VehicleSpeedCorrStraight_XAU16_1___A xDTSC_VehicleSpeedCorrStraight_XAU16_2___A xDTSC_VehicleSpeedCorrStraight_XAU16_3___A xDTSC_VehicleSpeedCorrStraight_XAU16_4___A xDTSC_VehicleSpeedCorrStraight_XAU16_5___A zDTSC_MinActivationCycles4Calibration_XDU8 zDTSC_MinActivationCycles4Validation_XDU8 zDTSC_MinActiveCycles4Calibration_XDU16 zDTSC_MinActiveCycles4Validation_XDU16 /end DEF_CHARACTERISTIC
 /begin IN_MEASUREMENT vVehSpI_AbsMaxSafeVehSpd_xdu16 wApplI_AbsSteeringAngle_xdu16 /end IN_MEASUREMENT
 /begin OUT_MEASUREMENT fDTSC_ActivateFctCo_xdb fDTSC_NvMReadError_xdb fDTSC_StateIsActive_xdb mDTSC_AdaptiveValueInt_xds32 mDTSC_AdaptValue_xds16 mDTSC_EffectiveTorque_xds16 mDTSC_TorsionBarTorqueDiffInt_xds32 mDTSC_TorsionBarTorqueDiff_xds16 sDTSC_ActivationRequest_xdu8 sDTSC_CtrlState_xdu8 sDTSC_ErrorDetected_xdu16 sDTSC_EstActivationRequest_xdu8 sDTSC_EstCtrlState_xdu8 sDTSC_EstFeatureState_xdu8 sDTSC_FeatureState_xdu8 sDTSC_JobResultOk_xdu8 sDTSC_RampedIn_xdu8 sDTSC_RampedOut_xdu8 sDTSC_RequestOffsetState_xdu8 sDTSC_State_xdu8 xDTSC_InputValueNorm_xdu16 zDTSC_ActivationCycles_xdu8 zDTSC_ActiveCycles_xdu16 /end OUT_MEASUREMENT
/end FUNCTION
/begin FUNCTION DriveTorqueSteerCompensationCheck "Drive Torque Steer Compensation Check"
 /begin DEF_CHARACTERISTIC mDTSC_MaxMonSafeNegGradient_XAU16 mDTSC_MaxMonSafePosGradient_XAU16 mDTSC_MaxSafetyMotorTorq_XDU16 mDTSC_SafeFadeOutRate_XDU16 /end DEF_CHARACTERISTIC
 /begin IN_MEASUREMENT vVehSpI_AbsMaxSafeVehSpd_xdu16 /end IN_MEASUREMENT
 /begin OUT_MEASUREMENT fDTSC_PrevArbitrationResultPassive_xdb mDTSC_MotorTorqueSaturated_xds16 sDTSC_FailureCause_xdu8 /end OUT_MEASUREMENT
/end FUNCTION
/begin FUNCTION DriveTorqueSteerCompensationCheckInterface "Drive Torque Steer Compensation Check Interface" /begin OUT_MEASUREMENT fDTSCI_MonSafeOk_xdb mDTSCI_MotorTorqueOffset_xds16 /end OUT_MEASUREMENT /end FUNCTION
/begin FUNCTION DriveTorqueSteerCompensationInterface "DriveTorqueSteerCompensation Interface" /begin OUT_MEASUREMENT mDTSCI_MotorTorque4Check_xds16 /end OUT_MEASUREMENT /end FUNCTION
/begin FUNCTION DriveTorqueSteerCompensationSupp "" /begin OUT_MEASUREMENT fDTSC_ActivateRequestSupp_xdb /end OUT_MEASUREMENT /end FUNCTION
/begin FUNCTION DrvStateDetection "Fahrzustandsbeurteilung Untersteuern/Uebersteuern"
 /begin DEF_CHARACTERISTIC aDsd_MaxDeltaLatAccSpeed_SK_XDF32 aDsd_Th_DeltaLatAcc_SK_XDF32 qDsd_FreqFilt_anvYaw_XDF32 qDsd_YawRef_a_freq_XDF32 qDsd_YawRef_b_freq_XDF32 qDsd_YawRef_c_freq_XDF32 qDsd_YawRef_freqFilt_XDF32 tDsd_YawRef_Ts_XDF32 vDsd_MaxDeltaYawSpeed_SK_XDF32 vDsd_MaxRollAngleSpeed_SK_XDF32 vDsd_Threshold_anvYaw_XAF32 vDsd_Th_DeltaYaw_SK_XDF32 vDsd_Th_RollAngleSpeed_SK_XDF32 vDsd_Th_YawHyst_XDF32 vDsd_Th_Yaw_OS_XDF32 vDsd_Th_Yaw_US_XDF32 vDsd_VelVeh_Init_XDF32 vDsd_VelVeh_max_XDF32 wDsd_Th_RollAngle_SK_off_XDF32 wDsd_Th_RollAngle_SK_on_XDF32 xDsd_Kd_Yaw_OS_XDF32 xDsd_Kd_Yaw_US_XDF32 xDsd_Th_GradOS_SK_off_XDF32 xDsd_Th_GradOS_SK_on_XDF32 xDsd_YawRef_a_damp_XDF32 xDsd_YawRef_a_stat_XDF32 xDsd_YawRef_a_t_XDF32 xDsd_YawRef_b_stat_neg_XDF32 xDsd_YawRef_b_stat_pos_XDF32 xDsd_YawRef_k_wu_ayshape_XAF32 /end DEF_CHARACTERISTIC
 /begin OUT_MEASUREMENT aDsd_AccLatByYawSetUndersteer_xdf32 fDsd_ValidVehSpeed_xdb fDsd_YawLearnedFine_xdb fDsd_YawLearnedInit_xdb fDsd_ZeroPntYawRateLearned_xdb hDsd_NumOversteer_xdf32 hDsd_NumUndersteer_xdf32 sDsd_EvalStateVehSpeed_xdu8 sDsd_StateZPCorr_xdu8 vDsd_Vehicle_xdf32 vDsd_velVehPT1_xdf32 vDsd_YawRateNP_xdf32 vDsd_YawSetOversteer_xdf32 vDsd_YawSetUndersteer_xdf32 vDsd_YawSumAvg_xdf32 wDsd_FrontWheelAngle_xdf32 wDsd_RollAngleAtBankedCurve_xdf32 wDsd_RollAngle_xdf32 /end OUT_MEASUREMENT
/end FUNCTION
/begin FUNCTION DrvStateDetectionI "Fahrzustandsbeurteilung Untersteuern/Uebersteuern und Steilkurvenerkennung- Interface"
 /begin OUT_MEASUREMENT aDsdI_LateralAcceleration_xdf32 fDsdI_BankedCurveDetected_xdb vDsdI_YawVelocity_xdf32 /end OUT_MEASUREMENT
/end FUNCTION
/begin FUNCTION DthrCtrlI "Zitter Berechnung"
 /begin DEF_CHARACTERISTIC aDthrCtrl_ESLRackAccelBrake_XDU16 aDthrCtrl_ESLRackAccel_XDU16 aDthrCtrl_IDAngleAcc_XDU16 aDthrCtrl_MidhAngleacc_XDU16 kDthrCtrl_MidhRackforceMax_XDU16 lDthrCtrl_CenterPositionTolerance_XDU16 lDthrCtrl_ESLIndexWidthHalf_XDU16 lDthrCtrl_ESLLock2Lock_XDU16 lDthrCtrl_ESLLockMin_XDU16 lDthrCtrl_ESLRackRangeFine_XDU16 lDthrCtrl_ESLRackRange_XDU16 lDthrCtrl_ESLRangeCorrection_XDS16 lDthrCtrl_IDFFinishTolerance_XDU16 lDthrCtrl_RackPosDiffMax_XDU16 mDthrCtrl_EslTensionReleaseThres_XDU16 mDthrCtrl_HandTorqueMax_XDU16 mDthrCtrl_MotTorqThresholdEsUds_XDU16 mDthrCtrl_MotTorqThresholdES_XDU16 mDthrCtrl_RotDampMaxMotTorque_XDU16 sDthrCtrl_Request_XDU8 sDthrCtrl_StateRequest_XDU8 tDthrCtrl_CenterPositionHoldTime_XDU8 tDthrCtrl_HandsOnTime_XDU16 tDthrCtrl_MidhMaxRackforceTime_XDU16 tDthrCtrl_NvMStatusCheckTime_XDU16 tDthrCtrl_Steptime_XDU8 tDthrCtrl_TargetCorridorReachedDelay_XDU16 vDthrCtrl_EslLockSpeedTresh_XDU8 vDthrCtrl_ESLLockSpeed_XDU16 vDthrCtrl_ESLRackSpeedFine_XDU16 vDthrCtrl_ESLRackSpeed_XDU16 vDthrCtrl_IDFAngleSpeed_XDU16 vDthrCtrl_IDSAngleSpeed_XDU16 vDthrCtrl_MidhAngleSpeed_XDU16 vDthrCtrl_VehicleSpeedMax_XDU16 wDthrCtrl_IDFAngle_XDU16 wDthrCtrl_IDFIndexWidthMax_XDU16 wDthrCtrl_IDFIndexWidthMin_XDU16 wDthrCtrl_IDSAngle_XDU16 wDthrCtrl_TargetAngleCorridor_XDU16 xDthrCtrl_DPartFactor_XDU16 xDthrCtrl_InertiaRotAccFactor_XDS16 zDthrCtrl_IDFcnt_XDU8 zDthrCtrl_IDScnt_XDU8 /end DEF_CHARACTERISTIC
 /begin OUT_MEASUREMENT fDthrCtrl_NvMWriteError_xdb fDthrCtrl_ResetRequest_xdb lDthrCtrlI_RelRackPosition_xds16 sDthrCtrlI_ErrorMask_xdu16 sDthrCtrl_CallFcnID_xdu8 sDthrCtrl_CoordRequest_xdu8 sDthrCtrl_CoordState_xdu8 sDthrCtrl_DtrCtrlDesPosReached_xdu8 sDthrCtrl_DummyEslState_xdu8 sDthrCtrl_DummyIndexState_xdu8 sDthrCtrl_DummyMidHoldState_xdu8 sDthrCtrl_ESNvMErrorstatus_xdu8 sDthrCtrl_FailureCauseCDD_xdu8 sDthrCtrl_FailureCauseRTE_xdu8 sDthrCtrl_FunctionReturn_xdu8 sDthrCtrl_JobResultOk_xdu8 sDthrCtrl_SyncActionsSuppReturn_xdu8 sDthrCtrl_UDSRequest_xdu8 sDthrCtrl_UDSStateRequest_xdu8 vDthrCtrl_DesiredSpeed_xds16 wDthrCtrlI_CenterOffsetToSA_xds16 wDthrCtrlI_RaPoRefToSA_xds16 zDthrCtrl_JobcallCounter_xdu16 /end OUT_MEASUREMENT
/end FUNCTION
/begin FUNCTION DthrRackCtrl "Dither Positionsregler"
 /begin DEF_CHARACTERISTIC fDthrCtrl_BypassEnable_XDU8 mDthrCtrl_DeadbandTobato_XDU16 mDthrCtrl_MaxMotTorqEsSearch_XDU16 vDthrCtrl_DeadBandRackSpeed_XDU16 vDthrCtrl_MaxGradRackSpeed_XDU16 vDthrCtrl_MaxRackSpeed_XDU16 xDthrCtrl_BypassFiltFac_XDF32 xDthrCtrl_DeadbandTobatoFact_XDS16 xDthrCtrl_PositionDPart_XDF32 xDthrCtrl_PositionIMax_XDF32 xDthrCtrl_PositionIPart_XDF32 xDthrCtrl_PositionPPart_XDF32 xDthrCtrl_RackSpeedDPart_XDF32 xDthrCtrl_RackSpeedIMax_XDF32 xDthrCtrl_RackSpeedIPart_XDF32 xDthrCtrl_RackSpeedPPart_XDF32 /end DEF_CHARACTERISTIC
 /begin OUT_MEASUREMENT fDthrCtrl_RackCtrlEnable_xdb lDthrCtrlI_DesiredRackPosition_xds16 lDthrCtrl_RackPositionDiff_xds16 mDthrCtrl_MotorTorque4Check_xds16 mDthrCtrl_SpeedCtrlIPart_xds16 mDthrCtrl_SpeedCtrlPPart_xds16 sDthrCtrlI_RackPosControllerState_xdu8 vDthrCtrl_PositionCtrlPPart_xds16 /end OUT_MEASUREMENT
/end FUNCTION
/begin FUNCTION EndStop "Endanschlag"
 /begin DEF_CHARACTERISTIC fEndStop_DisableReactivation_XDU8 fEndStop_EnableDyn_XDU8 fEndStop_LimitEnable_XDU8 fEndStop_ResetLearnedEndstopPosition_XDU8 lEndStop_AllowedPosBorderHigh_XDU16 lEndStop_AllowedPosBorder_XDU16 lEndStop_EsMechIndentLeft_XDU16 lEndStop_EsMechIndentRight_XDU16 lEndStop_MinSteerRangeLearned_XDU16 lEndStop_oAbsSteerLearn_XDU16 lEndStop_OffsetNotExactlyInit_XDU16 lEndStop_RelearnOffset_XDU16 lEndStop_StatusChangeAllowedOffset_XDU16 lEndStop_SteerRangeLimit_XDU16 lEndStop_SteerRange_XDU16 lEndStop_uAbsSteerLearn_XDU16 lEndStop_uDistanceLearnCondition_XDU16 mEndStop_LimitDamping_XDU16 mEndStop_MaxTorquePointingOutwards_XDU16 mEndStop_oMaxDamping_XDU16_0___A mEndStop_oMaxDamping_XDU16_1___A mEndStop_oMaxDamping_XDU16_2___A mEndStop_oMaxDamping_XDU16_3___A mEndStop_oMaxDamping_XDU16_4___A mEndStop_oMaxDamping_XDU16_5___A mEndStop_SpringTorque_XAS16_0___A mEndStop_SpringTorque_XAS16_1___A mEndStop_SpringTorque_XAS16_2___A mEndStop_SpringTorque_XAS16_3___A mEndStop_SpringTorque_XAS16_4___A mEndStop_SpringTorque_XAS16_5___A mEndStop_uMotorTorque_XDU16 mEndStop_uSpringTorque_XDU16 mEndStop_uTBTLearn_XDU16 nEndStop_oRotSpeedLearnFinished_XDU16 nEndStop_oRotSpeedLearn_XDU16 nEndStop_oRotSpeedRedSpringTorque_XDU16 tEndStop_DebounceTimeLearnFin_XDU8 tEndStop_MaxTimeIncrDamping_XDU8 vEndStop_uVehSpeedLearnFinished_XDU16 xEndStop_Damping_XAS16_0___A xEndStop_Damping_XAS16_1___A xEndStop_Damping_XAS16_2___A xEndStop_Damping_XAS16_3___A xEndStop_Damping_XAS16_4___A xEndStop_Damping_XAS16_5___A xEndStop_FadeFactorLimitation_XAU16 xEndStop_FadeFactorMotTrq_XAU16 xEndStop_FadeRateTorqueLim_XDU16 xEndStop_RateLimiterToZeroRate_XDU32 xEndStop_ResidualAssistance_XDU16_0___A xEndStop_ResidualAssistance_XDU16_1___A xEndStop_ResidualAssistance_XDU16_2___A xEndStop_ResidualAssistance_XDU16_3___A xEndStop_ResidualAssistance_XDU16_4___A xEndStop_ResidualAssistance_XDU16_5___A xEndStop_RotSpeedFact_XAU16 xEndStop_RotSpeedFiltFact_XDU16 xEndStop_SpringFactorGrad_XDU16 xEndStop_uTotalMotTorLimLearnFinished_XDU16 zEndStop_MaxChancesWriteTrigger_XDU8 /end DEF_CHARACTERISTIC
 /begin IN_MEASUREMENT lEndStopI_DistanceToEndstop_xds16 mApplI_AbsTorsionBarTorque_xdu16 nApplI_AbsRotorSpeedFilt_xdu16 /end IN_MEASUREMENT
 /begin OUT_MEASUREMENT fEndStop_AllowSpringReduction_xdu8 fEndStop_Disable_xdb fEndStop_JobCallCounter_xdu16 fEndStop_JobResultOK_xdu8 fEndStop_NoLearnFlag_xdu8 fEndStop_RateDownLimiterActive_xdu8 fEndStop_RequestPendingRangeOffset_xdb fEndStop_RequestPushed_xdb fEndStop_ResetFlag_xdb fEndStop_SpringActiveCheck_xdu8 fRequestPendingLearnState_xdb lEndStop_AllowedDynPosBorder_xdu16 lEndStop_DistanceToEndstopOrg_xds16 lEndStop_ESAbsRackPos_xdu16 lEndStop_ESRackPos_xds16 lEndStop_RackposMaxStoredinNVRam_out_xds16 lEndStop_RackposMinStoredinNVRam_out_xds16 mEndStop_AbsLimSpring_xdu16 mEndStop_AbsMotTrqRateDownLimiter_xdu16 mEndStop_AbsUnlimSpring_xdu16 mEndStop_MotTrqRateDownLimiter_xds16 mEndStop_MotTrqRateLimited_xds32 mEndStop_MotTrqSaturated_xds16 mEndStop_SpringTorque_xds16 sEndStop_EndstopState_xdu8 sEndStop_ErrorStatus_xdu8 sEndStop_NvWriteState_xdu8 tEndStop_TimeIncrDampingL2_xdu8 tEndStop_TimeIncrDamping_xdu8 xEndStop_FactorLimTorque_xdu16 xEndStop_SpringFactor_xdu16 /end OUT_MEASUREMENT
/end FUNCTION
/begin FUNCTION EndStopHsd "Daempfung bei hohen Rotorgeschwindigkeiten"
 /begin DEF_CHARACTERISTIC fEndStopHsd_EnableUnFiltRotSpeed_XDU8 lEndStopHsd_SubstDistToES_XDU16 nEndStopHsd_HighSpeedDampingStartReverse_XAS16 nEndStopHsd_HighSpeedDampingStart_XAS16 nEndStopHsd_RotSpeedFallingHysteresisReverse_XAU16 nEndStopHsd_RotSpeedFallingHysteresis_XAU16 nEndStopHsd_UnderVoltageStartOffset_XAU16 tEndStopHsd_SpeedTooHighTol_XDU16 tEndStopHsd_VehDirDebounceTime_XDU16 vEndStopHsd_BackwardDisableTh_XDU8 vEndStopHsd_BackwardEnableTh_XDU8 vEndStopHsd_MaxAllowedBackward_XDU8 xEndStopHsd_HighSpeedDampingFactorReverse_XAU16 xEndStopHsd_HighSpeedDampingFactor_XAU16 xEndStopHsd_SubstHighSpeedDampingFactorReverse_XDU16 xEndStopHsd_SubstHighSpeedDampingFactor_XDU16 /end DEF_CHARACTERISTIC
 /begin IN_MEASUREMENT uApplI_SupplyVoltage_xdu16 vApplI_AbsVehicleSpeedFilt_xdu16 /end IN_MEASUREMENT
 /begin OUT_MEASUREMENT fEndStopHsd_ForwardDrv_xdb lEndStopHsd_InternDistToES_xds16 nEndStopHsd_HystRotorSpeed_xds16 /end OUT_MEASUREMENT
/end FUNCTION
/begin FUNCTION EndStopHsdCheck "Dï¿½mpfung bei hohen Rotorgeschwindigkeiten"
 /begin DEF_CHARACTERISTIC lEndStopHsdCheck_SubstDistToES_XDU16 lEndStopHsd_DistanceToEndStop_LastP_XDU16 mEndStopHsd_DontCareMMotTh_XDU16 mEndStopHsd_MaxAllwdMMotVHigh_XDU16 mEndStopHsd_MaxAllwdMMotVLow_XDU16 mEndStopHsd_MaxMotorTorque_FirstP_XDU16 mEndStopHsd_MaxMotorTorque_LastP_XDU16 mEndStopHsd_MaxMotorTorque_XAS16 nEndStopHsdCheck_HighSpeedDampingStart_XAS16 nEndStopHsd_MinNeededRotSpdVHigh_XDU16 nEndStopHsd_MinNeededRotSpdVLow_XDU16 nEndStopHsd_MinRotSpd_XDU16 nEndStopHsd_UndervoltOffset_XDU16 uEndStopHsd_ApplyUOffsetTh_XDU16 /end DEF_CHARACTERISTIC
 /begin OUT_MEASUREMENT fEndStopHsd_Disable_xdb lEndStopHsd_InternDistToESCheck_xds16 mEndStopHsd_MotTrqSaturated_xds16 /end OUT_MEASUREMENT
/end FUNCTION
/begin FUNCTION EndStopHsdCheckI "ï¿½berprï¿½fung der Dï¿½mpfung hoher Rotorgeschwindigkeiten - Interface" /begin OUT_MEASUREMENT mEndStopHsdI_MotTrq_xds16 /end OUT_MEASUREMENT /end FUNCTION
/begin FUNCTION EndStopHsdI "Daempfung bei hohen Rotorgeschwindigkeiten - Interface" /begin OUT_MEASUREMENT mEndStopHsdI_MotTrq4Check_xds16 /end OUT_MEASUREMENT /end FUNCTION
/begin FUNCTION EndStopHsdSupp "EndStopHsdSupp" /begin DEF_CHARACTERISTIC fEndStopHsd_EnableUndervoltOffset_XDU8 /end DEF_CHARACTERISTIC /end FUNCTION
/begin FUNCTION EndStopHsdSuppI "EndStopHsdSupp - interface" /begin OUT_MEASUREMENT fEndStopHsdI_EnableUndervoltOffset_xdb /end OUT_MEASUREMENT /end FUNCTION
/begin FUNCTION EndStopSuppI "EndStopSuppI - interface"
 /begin OUT_MEASUREMENT lEndStopI_AbsPosOffset_xdu16 lEndStopI_RackPosition_xds16 lEndStopI_ReqRackPosMax_xds16 lEndStopI_ReqRackPosMin_xds16 sEndStopI_ReqStateEsMax_xdu8 sEndStopI_ReqStateEsMin_xdu8 sEndStopI_SALinState_xdu8 xEndStopI_OversteerabilityFactor_xdu16 /end OUT_MEASUREMENT
/end FUNCTION
/begin FUNCTION EndStop_I "Endanschlag"
 /begin OUT_MEASUREMENT fEndStopI_EndStopActive_xdu8 fEndStopI_LimitEnable_xdu8 fEndStopI_ReduceSpring_xdu8 fEndStopI_SpringActive_xdu8 lEndStopI_AddSteerRange_xdu16 lEndStopI_CenterOffset_xds16 lEndStopI_DistanceToEndstop_xds16 lEndStopI_EndstopPosLeft_xds16 lEndStopI_EndstopPosRight_xds16 lEndStopI_RackPosMax_xds16 lEndStopI_RackPosMin_xds16 mEndStopI_Damping4Check_xds16 mEndStopI_MotorTorque_xds16 mEndStopI_SpringTorque4Check_xds16 sEndStopI_LearnStatLeft_xdu8 sEndStopI_LearnStatRight_xdu8 /end OUT_MEASUREMENT
/end FUNCTION
/begin FUNCTION EngineRun "Mess- und Applikationsgrößen EngineRun"
 /begin DEF_CHARACTERISTIC nEngRn_EngineNotRunning_XDU16 nEngRn_EngineRunning_XDU16 tEngRn_Running2Stable_XDU16 tEngRn_Stable2NotRunning_XDU16 /end DEF_CHARACTERISTIC
/end FUNCTION
/begin FUNCTION EngineRunInterface "Interfacegrößen des Verbrennungsmotorsensors" /end FUNCTION
/begin FUNCTION EpsInputAbstractionInterface ""
 /begin OUT_MEASUREMENT fcnBusOffFlag_xdb fDTCReport_Allow_xdu8 fVolDTCReport_Notallow_xdu8 mELKI_ELKStatus_xdu8 mLDWI_LDWStatus_xdu8 mLKAI_LKAStatus_xdu8 nEpsInI_EMSMotorSpeed_xdu16 sApplI_AdasSteerTqSts_xdu8 sApplI_ApxFailureStatus_xdu8 sEpsInI_BCMOperModCmd_xdu8 sEpsInI_BCMT15DState_xdu8 sEpsInI_BCMVehicleState_xdu8 sEpsInI_CalenderData_xau8 sEpsInI_ESCBrakeState_xdu8 sEpsInI_FootBrakeState_xdu8 sEpsInI_GlobalKL15Status_xdb sEpsInI_GlobalKLRStatus_xdb sEpsInI_ParkingBrakeState_xdu8 sEpsInI_RemoteAssistControlRx_xdu8 sEpsInI_RemoteEcuState_xdu8 sEpsInI_RemoteShutdownSync_xdu8 sEpsInI_RemoteUcSync_xdu8 vApplI_Batteryvol_xdu16 vApplI_CurrentDay_xdu8 vApplI_CurrentHour_xdu8 vApplI_CurrentMin_xdu8 vApplI_CurrentMonth_xdu8 vApplI_CurrentMsec_xdu16 vApplI_CurrentSec_xdu8 vApplI_CurrentYear_xdu8 vApplI_DmsErrorStatus_xdu8 vApplI_FrontAxleRotorSpeed_xdu16 vApplI_LvBatteryVol_xdu16 vApplI_TimeDomainSync_xdu8 vApplI_VehErrorStatus_xdu8 vApplI_VehOutTemp_xdu8 vApplI_VehTotalOdo_xdu32 vEpsInI_VehicleSpeedForUDS_xds16 xEpsInI_AccelPedalPosition_xdu16 yApplI_Batterystatus_xdu8 yApplI_HWAstatus_xdu8 yApplI_LaneChangeStatus_xdu8 yApplI_LogicalGearSelected_xdu8 yApplI_ParkStatusIndication_xdu8 yApplI_Powertrainstate_xdu8 yApplI_VehOdometer_xdu32 yEpsInI_RemoteHwLibStdSyncData_xau8 yEpsOutI_LocalSyncMessage_xau32 zEpsInI_OdometerValue_xdu32 /end OUT_MEASUREMENT
/end FUNCTION
/begin FUNCTION EpsOutput "Senden der EPS Botschaften"
 /begin DEF_CHARACTERISTIC tcnCycleTime_EPS_HSC_FrP00_XDU16 zcnBusOffSilentTime_XDU8 zcnTxRecoveryMax_XDU8 zcnTxTimeoutMax_XDU8 /end DEF_CHARACTERISTIC
 /begin OUT_MEASUREMENT fcnCanBusOffTransmissionStopped_xdb fcnTxEnable_xdb scnBusOffState_xdu8 sEpsOut_WarningLampState_xdu8 sUdsIOCtrlWarningLmp_xdu8 vApplI_SteeringAngleSpeedSnapshot_xds16 wApplI_SteeringAngleSnapshot_xds16 /end OUT_MEASUREMENT
/end FUNCTION
/begin RECORD_LAYOUT AblGLKLfl4 FNC_VALUES 3 FLOAT32_IEEE COLUMN_DIR DIRECT AXIS_PTS_X 2 FLOAT32_IEEE INDEX_INCR DIRECT NO_AXIS_PTS_X 1 ULONG /end RECORD_LAYOUT
/begin RECORD_LAYOUT AblGLKLsw FNC_VALUES 3 SWORD COLUMN_DIR DIRECT AXIS_PTS_X 2 SWORD INDEX_INCR DIRECT NO_AXIS_PTS_X 1 UWORD /end RECORD_LAYOUT
/begin RECORD_LAYOUT AblGLKLuw FNC_VALUES 3 UWORD COLUMN_DIR DIRECT AXIS_PTS_X 2 UWORD INDEX_INCR DIRECT NO_AXIS_PTS_X 1 UWORD /end RECORD_LAYOUT
/begin RECORD_LAYOUT AblGLKWBsw FNC_VALUES 1 SWORD COLUMN_DIR DIRECT /end RECORD_LAYOUT
/begin RECORD_LAYOUT AblGLKWBub FNC_VALUES 1 UBYTE COLUMN_DIR DIRECT /end RECORD_LAYOUT
/begin RECORD_LAYOUT AblGLKWfl4 FNC_VALUES 1 FLOAT32_IEEE COLUMN_DIR DIRECT /end RECORD_LAYOUT
/begin RECORD_LAYOUT AblGLKWsw FNC_VALUES 1 SWORD COLUMN_DIR DIRECT /end RECORD_LAYOUT
/begin RECORD_LAYOUT AblGLKWub FNC_VALUES 1 UBYTE COLUMN_DIR DIRECT /end RECORD_LAYOUT
/begin RECORD_LAYOUT AblGLKWul FNC_VALUES 1 ULONG COLUMN_DIR DIRECT /end RECORD_LAYOUT
/begin RECORD_LAYOUT AblGLKWuw FNC_VALUES 1 UWORD COLUMN_DIR DIRECT /end RECORD_LAYOUT
/end MODULE
/end PROJECT
