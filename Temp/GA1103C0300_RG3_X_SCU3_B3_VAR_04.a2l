ASAP2_VERSION 1 70
/begin PROJECT _GA1_103 "SCU3_B3_VAR_04"
/begin HEADER "" VERSION "GA1_103_C_03_00" PROJECT_NO _GA1_103 /end HEADER
/begin MODULE XCP_EPS_ECU "G08"
/begin MOD_COMMON "" BYTE_ORDER MSB_LAST ALIGNMENT_BYTE 1 ALIGNMENT_WORD 2 ALIGNMENT_LONG 4 ALIGNMENT_FLOAT32_IEEE 4 ALIGNMENT_FLOAT64_IEEE 8 /end MOD_COMMON
/begin CHARACTERISTIC AZG_SecurityAccessDeliveredPublicKey "Array mit Public Key" VAL_BLK 0x148000 AblGLKWBub 255 ZU0 0 255 NUMBER 270 FORMAT "%5.1" /end CHARACTERISTIC
/begin CHARACTERISTIC AZG_SecurityAccessDevelopmentPublicKey "Array mit Public Key" VAL_BLK 0x148110 AblGLKWBub 255 ZU0 0 255 NUMBER 270 FORMAT "%5.1" /end CHARACTERISTIC
/begin CHARACTERISTIC AZG_SecurityAccessProductionPublicKey "Array mit Public Key" VAL_BLK 0x148220 AblGLKWBub 255 ZU0 0 255 NUMBER 270 FORMAT "%5.1" /end CHARACTERISTIC
/begin CHARACTERISTIC cBsd_TempratureLimit_XDU8 "Temprature border for PCB temprature" VALUE 0x150AA6 AblGLKWub 210 TMPOUTS -70 140 FORMAT "%5.1" /end CHARACTERISTIC
/begin CHARACTERISTIC fAPA_AngDeviationCheckOn_XDU8 "Angle deviation check" VALUE 0x150AA8 AblGLKWub 1 ZU0 0 1 FORMAT "%5.3" /end CHARACTERISTIC
/begin CHARACTERISTIC fatAllowAssistReduction_XDB "Erlaubt eine Reduzierung der Unterstuetzung aufgrund (mApplI_HWLMaxUsableTorque * xHwlWrapI_MinRedLevel)" VALUE 0x150AAA AblGLKWub 1 BIT 0 1 FORMAT "%5.3" /end CHARACTERISTIC
/begin CHARACTERISTIC fatAllowMaxReqMMotReduction_XDB "Erlaubt eine Reduzierung von MaxRequiredMotorTorque aufgrund (mApplI_HWLMaxUsableTorque * xHwlWrapI_MinRedLevel)" VALUE 0x150AAB AblGLKWub 1 BIT 0 1 FORMAT "%5.3" /end CHARACTERISTIC
/begin CHARACTERISTIC fatUseBandsperre_XDU8 "Bandsperre bei Rattermaßnahme aktiv" VALUE 0x150AAC AblGLKWub 1 ZU0 0 1 FORMAT "%5.3" /end CHARACTERISTIC
/begin CHARACTERISTIC fAutParkCtrl_APCalwaysOn_XDU8 "Schalter um APC auch bei nicht verbautem APC zu aktivieren" VALUE 0x150AAD AblGLKWub 1 ZU0 0 1 FORMAT "%5.3" /end CHARACTERISTIC
/begin CHARACTERISTIC fAutParkCtrl_EnableDesRackPosFilt_XDU8 "enable filtering of the desired rack position due to an interpolation between the steps (macros shall be configured)" VALUE 0x150AAE AblGLKWub 1 ZU0 0 1 FORMAT "%5.3" /end CHARACTERISTIC
/begin CHARACTERISTIC fAutParkCtrl_EnableFeedForward_XDU8 "enable feed-forward controlled nominal rack position (formerly known as bypass)" VALUE 0x150AAF AblGLKWub 1 ZU0 0 1 FORMAT "%5.3" /end CHARACTERISTIC
/begin CHARACTERISTIC fAutParkCtrl_LtStCorrActive_XDB "" VALUE 0x150AB0 AblGLKWub 1 ZU0 0 1 FORMAT "%5.3" /end CHARACTERISTIC
/begin CHARACTERISTIC mAutParkCtrl_CheckHandsOnTorqLim_XDU16 "threshold of driver's steering torque to detect HandsOn" VALUE 0x15059A AblGLKWuw 6.5 TBTHIGH 0.5 7 FORMAT "%8.6" /end CHARACTERISTIC
/begin CHARACTERISTIC mAutParkCtrl_ColumnTorqueLim_XDU16 "Tiefer Grenze fÃ¼r Fahrerhandmoment" VALUE 0x15059C AblGLKWuw 1.5 TBTHIGH 0 1.5 FORMAT "%8.6" /end CHARACTERISTIC
/begin CHARACTERISTIC mAutParkCtrl_DeadBandTBT_XDU16 "maximum allowed steering torque offset (formerly known as dead band)" VALUE 0x15059E AblGLKWuw 6.5 TBTHIGH 0 6.5 FORMAT "%8.6" /end CHARACTERISTIC
/begin CHARACTERISTIC mAutParkCtrl_HandsOffTorqLim_XDU16 "Tiefer Grenze fÃ¼r Fahrerhandmoment" VALUE 0x1505A0 AblGLKWuw 3 TBTHIGH 0 3 FORMAT "%8.6" /end CHARACTERISTIC
/begin CHARACTERISTIC mAutParkCtrl_HandsOnTorqLim_XDU16 "Tiefer Grenze fÃ¼r Fahrerhandmoment" VALUE 0x1505A2 AblGLKWuw 3 TBTHIGH 0 3 FORMAT "%8.6" /end CHARACTERISTIC
/begin CHARACTERISTIC mAutParkCtrl_HandsOnTrqLim2Active_XDU16 "obere Grenze fÃ¼r Fahrerhandmoment" VALUE 0x1505A4 AblGLKWuw 2.5 TBTHIGH 0.5 3 FORMAT "%8.6" /end CHARACTERISTIC
/begin CHARACTERISTIC mBci_V0BaseTorque_XAS16_00___A "nominelles Handmoment abhängig von der Zahnstangenkraft bei Geschwindigkeit v0" CURVE 0x158914 AblGLKLsw 15 TBTHIGH 0 15 FORMAT "%8.5"
 /begin AXIS_DESCR STD_AXIS kApplI_AbsRackForce_xdu16 FRACK 9 0 30000 FORMAT "%8.2" DEPOSIT ABSOLUTE /end AXIS_DESCR
/end CHARACTERISTIC
/begin CHARACTERISTIC mBci_V0BaseTorque_XAS16_01___A "nominelles Handmoment abhängig von der Zahnstangenkraft bei Geschwindigkeit v0" CURVE 0x15893C AblGLKLsw 15 TBTHIGH 0 15 FORMAT "%8.5"
 /begin AXIS_DESCR STD_AXIS kApplI_AbsRackForce_xdu16 FRACK 9 0 30000 FORMAT "%8.2" DEPOSIT ABSOLUTE /end AXIS_DESCR
/end CHARACTERISTIC
/begin CHARACTERISTIC mBci_V0BaseTorque_XAS16_02___A "nominelles Handmoment abhängig von der Zahnstangenkraft bei Geschwindigkeit v0" CURVE 0x158964 AblGLKLsw 15 TBTHIGH 0 15 FORMAT "%8.5"
 /begin AXIS_DESCR STD_AXIS kApplI_AbsRackForce_xdu16 FRACK 9 0 30000 FORMAT "%8.2" DEPOSIT ABSOLUTE /end AXIS_DESCR
/end CHARACTERISTIC
/begin CHARACTERISTIC mBci_V0BaseTorque_XAS16_03___A "nominelles Handmoment abhängig von der Zahnstangenkraft bei Geschwindigkeit v0" CURVE 0x15898C AblGLKLsw 15 TBTHIGH 0 15 FORMAT "%8.5"
 /begin AXIS_DESCR STD_AXIS kApplI_AbsRackForce_xdu16 FRACK 9 0 30000 FORMAT "%8.2" DEPOSIT ABSOLUTE /end AXIS_DESCR
/end CHARACTERISTIC
/begin CHARACTERISTIC mBci_V0BaseTorque_XAS16_04___A "nominelles Handmoment abhängig von der Zahnstangenkraft bei Geschwindigkeit v0" CURVE 0x1589B4 AblGLKLsw 15 TBTHIGH 0 15 FORMAT "%8.5"
 /begin AXIS_DESCR STD_AXIS kApplI_AbsRackForce_xdu16 FRACK 9 0 30000 FORMAT "%8.2" DEPOSIT ABSOLUTE /end AXIS_DESCR
/end CHARACTERISTIC
/begin CHARACTERISTIC mBci_V0BaseTorque_XAS16_05___A "nominelles Handmoment abhängig von der Zahnstangenkraft bei Geschwindigkeit v0" CURVE 0x1589DC AblGLKLsw 15 TBTHIGH 0 15 FORMAT "%8.5"
 /begin AXIS_DESCR STD_AXIS kApplI_AbsRackForce_xdu16 FRACK 9 0 30000 FORMAT "%8.2" DEPOSIT ABSOLUTE /end AXIS_DESCR
/end CHARACTERISTIC
/begin CHARACTERISTIC mBci_V0BaseTorque_XAS16_06___A "nominelles Handmoment abhängig von der Zahnstangenkraft bei Geschwindigkeit v0" CURVE 0x158A04 AblGLKLsw 15 TBTHIGH 0 15 FORMAT "%8.5"
 /begin AXIS_DESCR STD_AXIS kApplI_AbsRackForce_xdu16 FRACK 9 0 30000 FORMAT "%8.2" DEPOSIT ABSOLUTE /end AXIS_DESCR
/end CHARACTERISTIC
/begin CHARACTERISTIC mBci_V0BaseTorque_XAS16_07___A "nominelles Handmoment abhängig von der Zahnstangenkraft bei Geschwindigkeit v0" CURVE 0x158A2C AblGLKLsw 15 TBTHIGH 0 15 FORMAT "%8.5"
 /begin AXIS_DESCR STD_AXIS kApplI_AbsRackForce_xdu16 FRACK 9 0 30000 FORMAT "%8.2" DEPOSIT ABSOLUTE /end AXIS_DESCR
/end CHARACTERISTIC
/begin CHARACTERISTIC mBci_V0BaseTorque_XAS16_08___A "nominelles Handmoment abhängig von der Zahnstangenkraft bei Geschwindigkeit v0" CURVE 0x158A54 AblGLKLsw 15 TBTHIGH 0 15 FORMAT "%8.5"
 /begin AXIS_DESCR STD_AXIS kApplI_AbsRackForce_xdu16 FRACK 9 0 30000 FORMAT "%8.2" DEPOSIT ABSOLUTE /end AXIS_DESCR
/end CHARACTERISTIC
/begin CHARACTERISTIC mBci_V0BaseTorque_XAS16_09___A "nominelles Handmoment abhängig von der Zahnstangenkraft bei Geschwindigkeit v0" CURVE 0x158A7C AblGLKLsw 15 TBTHIGH 0 15 FORMAT "%8.5"
 /begin AXIS_DESCR STD_AXIS kApplI_AbsRackForce_xdu16 FRACK 9 0 30000 FORMAT "%8.2" DEPOSIT ABSOLUTE /end AXIS_DESCR
/end CHARACTERISTIC
/begin CHARACTERISTIC mBci_V0BaseTorque_XAS16_10___A "nominelles Handmoment abhängig von der Zahnstangenkraft bei Geschwindigkeit v0" CURVE 0x158AA4 AblGLKLsw 15 TBTHIGH 0 15 FORMAT "%8.5"
 /begin AXIS_DESCR STD_AXIS kApplI_AbsRackForce_xdu16 FRACK 9 0 30000 FORMAT "%8.2" DEPOSIT ABSOLUTE /end AXIS_DESCR
/end CHARACTERISTIC
/begin CHARACTERISTIC mBci_V0BaseTorque_XAS16_11___A "nominelles Handmoment abhängig von der Zahnstangenkraft bei Geschwindigkeit v0" CURVE 0x158ACC AblGLKLsw 15 TBTHIGH 0 15 FORMAT "%8.5"
 /begin AXIS_DESCR STD_AXIS kApplI_AbsRackForce_xdu16 FRACK 9 0 30000 FORMAT "%8.2" DEPOSIT ABSOLUTE /end AXIS_DESCR
/end CHARACTERISTIC
/begin CHARACTERISTIC mBci_V0BaseTorque_XAS16_12___A "nominelles Handmoment abhängig von der Zahnstangenkraft bei Geschwindigkeit v0" CURVE 0x158AF4 AblGLKLsw 15 TBTHIGH 0 15 FORMAT "%8.5"
 /begin AXIS_DESCR STD_AXIS kApplI_AbsRackForce_xdu16 FRACK 9 0 30000 FORMAT "%8.2" DEPOSIT ABSOLUTE /end AXIS_DESCR
/end CHARACTERISTIC
/begin CHARACTERISTIC mBci_V0BaseTorque_XAS16_13___A "nominelles Handmoment abhängig von der Zahnstangenkraft bei Geschwindigkeit v0" CURVE 0x158B1C AblGLKLsw 15 TBTHIGH 0 15 FORMAT "%8.5"
 /begin AXIS_DESCR STD_AXIS kApplI_AbsRackForce_xdu16 FRACK 9 0 30000 FORMAT "%8.2" DEPOSIT ABSOLUTE /end AXIS_DESCR
/end CHARACTERISTIC
/begin CHARACTERISTIC mBci_V0BaseTorque_XAS16_14___A "nominelles Handmoment abhängig von der Zahnstangenkraft bei Geschwindigkeit v0" CURVE 0x158B44 AblGLKLsw 15 TBTHIGH 0 15 FORMAT "%8.5"
 /begin AXIS_DESCR STD_AXIS kApplI_AbsRackForce_xdu16 FRACK 9 0 30000 FORMAT "%8.2" DEPOSIT ABSOLUTE /end AXIS_DESCR
/end CHARACTERISTIC
/begin CHARACTERISTIC mBci_V0BaseTorque_XAS16_15___A "nominelles Handmoment abhängig von der Zahnstangenkraft bei Geschwindigkeit v0" CURVE 0x158B6C AblGLKLsw 15 TBTHIGH 0 15 FORMAT "%8.5"
 /begin AXIS_DESCR STD_AXIS kApplI_AbsRackForce_xdu16 FRACK 9 0 30000 FORMAT "%8.2" DEPOSIT ABSOLUTE /end AXIS_DESCR
/end CHARACTERISTIC
/begin CHARACTERISTIC mBci_V0BaseTorque_XAS16_16___A "nominelles Handmoment abhängig von der Zahnstangenkraft bei Geschwindigkeit v0" CURVE 0x158B94 AblGLKLsw 15 TBTHIGH 0 15 FORMAT "%8.5"
 /begin AXIS_DESCR STD_AXIS kApplI_AbsRackForce_xdu16 FRACK 9 0 30000 FORMAT "%8.2" DEPOSIT ABSOLUTE /end AXIS_DESCR
/end CHARACTERISTIC
/begin CHARACTERISTIC mBci_V0BaseTorque_XAS16_17___A "nominelles Handmoment abhängig von der Zahnstangenkraft bei Geschwindigkeit v0" CURVE 0x158BBC AblGLKLsw 15 TBTHIGH 0 15 FORMAT "%8.5"
 /begin AXIS_DESCR STD_AXIS kApplI_AbsRackForce_xdu16 FRACK 9 0 30000 FORMAT "%8.2" DEPOSIT ABSOLUTE /end AXIS_DESCR
/end CHARACTERISTIC
/begin CHARACTERISTIC mBci_V0BaseTorque_XAS16_18___A "nominelles Handmoment abhängig von der Zahnstangenkraft bei Geschwindigkeit v0" CURVE 0x158BE4 AblGLKLsw 15 TBTHIGH 0 15 FORMAT "%8.5"
 /begin AXIS_DESCR STD_AXIS kApplI_AbsRackForce_xdu16 FRACK 9 0 30000 FORMAT "%8.2" DEPOSIT ABSOLUTE /end AXIS_DESCR
/end CHARACTERISTIC
/begin CHARACTERISTIC mBci_V0BaseTorque_XAS16_19___A "nominelles Handmoment abhängig von der Zahnstangenkraft bei Geschwindigkeit v0" CURVE 0x158C0C AblGLKLsw 15 TBTHIGH 0 15 FORMAT "%8.5"
 /begin AXIS_DESCR STD_AXIS kApplI_AbsRackForce_xdu16 FRACK 9 0 30000 FORMAT "%8.2" DEPOSIT ABSOLUTE /end AXIS_DESCR
/end CHARACTERISTIC
/begin CHARACTERISTIC mBci_V0BaseTorque_XAS16_20___A "nominelles Handmoment abhängig von der Zahnstangenkraft bei Geschwindigkeit v0" CURVE 0x158C34 AblGLKLsw 15 TBTHIGH 0 15 FORMAT "%8.5"
 /begin AXIS_DESCR STD_AXIS kApplI_AbsRackForce_xdu16 FRACK 9 0 30000 FORMAT "%8.2" DEPOSIT ABSOLUTE /end AXIS_DESCR
/end CHARACTERISTIC
/begin CHARACTERISTIC mBci_V0BaseTorque_XAS16_21___A "nominelles Handmoment abhängig von der Zahnstangenkraft bei Geschwindigkeit v0" CURVE 0x158C5C AblGLKLsw 15 TBTHIGH 0 15 FORMAT "%8.5"
 /begin AXIS_DESCR STD_AXIS kApplI_AbsRackForce_xdu16 FRACK 9 0 30000 FORMAT "%8.2" DEPOSIT ABSOLUTE /end AXIS_DESCR
/end CHARACTERISTIC
/begin CHARACTERISTIC mBci_V0BaseTorque_XAS16_22___A "nominelles Handmoment abhängig von der Zahnstangenkraft bei Geschwindigkeit v0" CURVE 0x158C84 AblGLKLsw 15 TBTHIGH 0 15 FORMAT "%8.5"
 /begin AXIS_DESCR STD_AXIS kApplI_AbsRackForce_xdu16 FRACK 9 0 30000 FORMAT "%8.2" DEPOSIT ABSOLUTE /end AXIS_DESCR
/end CHARACTERISTIC
/begin CHARACTERISTIC mBci_V0BaseTorque_XAS16_23___A "nominelles Handmoment abhängig von der Zahnstangenkraft bei Geschwindigkeit v0" CURVE 0x158CAC AblGLKLsw 15 TBTHIGH 0 15 FORMAT "%8.5"
 /begin AXIS_DESCR STD_AXIS kApplI_AbsRackForce_xdu16 FRACK 9 0 30000 FORMAT "%8.2" DEPOSIT ABSOLUTE /end AXIS_DESCR
/end CHARACTERISTIC
/begin CHARACTERISTIC mBci_V0BaseTorque_XAS16_24___A "nominelles Handmoment abhängig von der Zahnstangenkraft bei Geschwindigkeit v0" CURVE 0x158CD4 AblGLKLsw 15 TBTHIGH 0 15 FORMAT "%8.5"
 /begin AXIS_DESCR STD_AXIS kApplI_AbsRackForce_xdu16 FRACK 9 0 30000 FORMAT "%8.2" DEPOSIT ABSOLUTE /end AXIS_DESCR
/end CHARACTERISTIC
/begin CHARACTERISTIC mBci_V0BaseTorque_XAS16_25___A "nominelles Handmoment abhängig von der Zahnstangenkraft bei Geschwindigkeit v0" CURVE 0x158CFC AblGLKLsw 15 TBTHIGH 0 15 FORMAT "%8.5"
 /begin AXIS_DESCR STD_AXIS kApplI_AbsRackForce_xdu16 FRACK 9 0 30000 FORMAT "%8.2" DEPOSIT ABSOLUTE /end AXIS_DESCR
/end CHARACTERISTIC
/begin CHARACTERISTIC mBci_V0BaseTorque_XAS16_26___A "nominelles Handmoment abhängig von der Zahnstangenkraft bei Geschwindigkeit v0" CURVE 0x158D24 AblGLKLsw 15 TBTHIGH 0 15 FORMAT "%8.5"
 /begin AXIS_DESCR STD_AXIS kApplI_AbsRackForce_xdu16 FRACK 9 0 30000 FORMAT "%8.2" DEPOSIT ABSOLUTE /end AXIS_DESCR
/end CHARACTERISTIC
/begin CHARACTERISTIC mBci_V0BaseTorque_XAS16_27___A "nominelles Handmoment abhängig von der Zahnstangenkraft bei Geschwindigkeit v0" CURVE 0x158D4C AblGLKLsw 15 TBTHIGH 0 15 FORMAT "%8.5"
 /begin AXIS_DESCR STD_AXIS kApplI_AbsRackForce_xdu16 FRACK 9 0 30000 FORMAT "%8.2" DEPOSIT ABSOLUTE /end AXIS_DESCR
/end CHARACTERISTIC
/begin CHARACTERISTIC mBci_V0BaseTorque_XAS16_28___A "nominelles Handmoment abhängig von der Zahnstangenkraft bei Geschwindigkeit v0" CURVE 0x158D74 AblGLKLsw 15 TBTHIGH 0 15 FORMAT "%8.5"
 /begin AXIS_DESCR STD_AXIS kApplI_AbsRackForce_xdu16 FRACK 9 0 30000 FORMAT "%8.2" DEPOSIT ABSOLUTE /end AXIS_DESCR
/end CHARACTERISTIC
/begin CHARACTERISTIC mBci_V0BaseTorque_XAS16_29___A "nominelles Handmoment abhängig von der Zahnstangenkraft bei Geschwindigkeit v0" CURVE 0x158D9C AblGLKLsw 15 TBTHIGH 0 15 FORMAT "%8.5"
 /begin AXIS_DESCR STD_AXIS kApplI_AbsRackForce_xdu16 FRACK 9 0 30000 FORMAT "%8.2" DEPOSIT ABSOLUTE /end AXIS_DESCR
/end CHARACTERISTIC
/begin CHARACTERISTIC mBci_V0BaseTorque_XAS16_30___A "nominelles Handmoment abhängig von der Zahnstangenkraft bei Geschwindigkeit v0" CURVE 0x158DC4 AblGLKLsw 15 TBTHIGH 0 15 FORMAT "%8.5"
 /begin AXIS_DESCR STD_AXIS kApplI_AbsRackForce_xdu16 FRACK 9 0 30000 FORMAT "%8.2" DEPOSIT ABSOLUTE /end AXIS_DESCR
/end CHARACTERISTIC
/begin CHARACTERISTIC mBci_V0BaseTorque_XAS16_31___A "nominelles Handmoment abhängig von der Zahnstangenkraft bei Geschwindigkeit v0" CURVE 0x158DEC AblGLKLsw 15 TBTHIGH 0 15 FORMAT "%8.5"
 /begin AXIS_DESCR STD_AXIS kApplI_AbsRackForce_xdu16 FRACK 9 0 30000 FORMAT "%8.2" DEPOSIT ABSOLUTE /end AXIS_DESCR
/end CHARACTERISTIC
/begin CHARACTERISTIC mBci_V0BaseTorque_XAS16_32___A "nominelles Handmoment abhängig von der Zahnstangenkraft bei Geschwindigkeit v0" CURVE 0x158E14 AblGLKLsw 15 TBTHIGH 0 15 FORMAT "%8.5"
 /begin AXIS_DESCR STD_AXIS kApplI_AbsRackForce_xdu16 FRACK 9 0 30000 FORMAT "%8.2" DEPOSIT ABSOLUTE /end AXIS_DESCR
/end CHARACTERISTIC
/begin CHARACTERISTIC mBci_V0BaseTorque_XAS16_33___A "nominelles Handmoment abhängig von der Zahnstangenkraft bei Geschwindigkeit v0" CURVE 0x158E3C AblGLKLsw 15 TBTHIGH 0 15 FORMAT "%8.5"
 /begin AXIS_DESCR STD_AXIS kApplI_AbsRackForce_xdu16 FRACK 9 0 30000 FORMAT "%8.2" DEPOSIT ABSOLUTE /end AXIS_DESCR
/end CHARACTERISTIC
/begin CHARACTERISTIC mBci_V0BaseTorque_XAS16_34___A "nominelles Handmoment abhängig von der Zahnstangenkraft bei Geschwindigkeit v0" CURVE 0x158E64 AblGLKLsw 15 TBTHIGH 0 15 FORMAT "%8.5"
 /begin AXIS_DESCR STD_AXIS kApplI_AbsRackForce_xdu16 FRACK 9 0 30000 FORMAT "%8.2" DEPOSIT ABSOLUTE /end AXIS_DESCR
/end CHARACTERISTIC
/begin CHARACTERISTIC mBci_V0BaseTorque_XAS16_35___A "nominelles Handmoment abhängig von der Zahnstangenkraft bei Geschwindigkeit v0" CURVE 0x158E8C AblGLKLsw 15 TBTHIGH 0 15 FORMAT "%8.5"
 /begin AXIS_DESCR STD_AXIS kApplI_AbsRackForce_xdu16 FRACK 9 0 30000 FORMAT "%8.2" DEPOSIT ABSOLUTE /end AXIS_DESCR
/end CHARACTERISTIC
/begin CHARACTERISTIC mBci_V1BaseTorque_XAS16_00___A "nominelles Handmoment abhängig von der Zahnstangenkraft bei Geschwindigkeit v1" CURVE 0x158EB4 AblGLKLsw 15 TBTHIGH 0 15 FORMAT "%8.5"
 /begin AXIS_DESCR STD_AXIS kApplI_AbsRackForce_xdu16 FRACK 9 0 30000 FORMAT "%8.2" DEPOSIT ABSOLUTE /end AXIS_DESCR
/end CHARACTERISTIC
/begin CHARACTERISTIC mBci_V1BaseTorque_XAS16_01___A "nominelles Handmoment abhängig von der Zahnstangenkraft bei Geschwindigkeit v1" CURVE 0x158EDC AblGLKLsw 15 TBTHIGH 0 15 FORMAT "%8.5"
 /begin AXIS_DESCR STD_AXIS kApplI_AbsRackForce_xdu16 FRACK 9 0 30000 FORMAT "%8.2" DEPOSIT ABSOLUTE /end AXIS_DESCR
/end CHARACTERISTIC
/begin CHARACTERISTIC mBci_V1BaseTorque_XAS16_02___A "nominelles Handmoment abhängig von der Zahnstangenkraft bei Geschwindigkeit v1" CURVE 0x158F04 AblGLKLsw 15 TBTHIGH 0 15 FORMAT "%8.5"
 /begin AXIS_DESCR STD_AXIS kApplI_AbsRackForce_xdu16 FRACK 9 0 30000 FORMAT "%8.2" DEPOSIT ABSOLUTE /end AXIS_DESCR
/end CHARACTERISTIC
/begin CHARACTERISTIC mBci_V1BaseTorque_XAS16_03___A "nominelles Handmoment abhängig von der Zahnstangenkraft bei Geschwindigkeit v1" CURVE 0x158F2C AblGLKLsw 15 TBTHIGH 0 15 FORMAT "%8.5"
 /begin AXIS_DESCR STD_AXIS kApplI_AbsRackForce_xdu16 FRACK 9 0 30000 FORMAT "%8.2" DEPOSIT ABSOLUTE /end AXIS_DESCR
/end CHARACTERISTIC
/begin CHARACTERISTIC mBci_V1BaseTorque_XAS16_04___A "nominelles Handmoment abhängig von der Zahnstangenkraft bei Geschwindigkeit v1" CURVE 0x158F54 AblGLKLsw 15 TBTHIGH 0 15 FORMAT "%8.5"
 /begin AXIS_DESCR STD_AXIS kApplI_AbsRackForce_xdu16 FRACK 9 0 30000 FORMAT "%8.2" DEPOSIT ABSOLUTE /end AXIS_DESCR
/end CHARACTERISTIC
/begin CHARACTERISTIC mBci_V1BaseTorque_XAS16_05___A "nominelles Handmoment abhängig von der Zahnstangenkraft bei Geschwindigkeit v1" CURVE 0x158F7C AblGLKLsw 15 TBTHIGH 0 15 FORMAT "%8.5"
 /begin AXIS_DESCR STD_AXIS kApplI_AbsRackForce_xdu16 FRACK 9 0 30000 FORMAT "%8.2" DEPOSIT ABSOLUTE /end AXIS_DESCR
/end CHARACTERISTIC
/begin CHARACTERISTIC mBci_V1BaseTorque_XAS16_06___A "nominelles Handmoment abhängig von der Zahnstangenkraft bei Geschwindigkeit v1" CURVE 0x158FA4 AblGLKLsw 15 TBTHIGH 0 15 FORMAT "%8.5"
 /begin AXIS_DESCR STD_AXIS kApplI_AbsRackForce_xdu16 FRACK 9 0 30000 FORMAT "%8.2" DEPOSIT ABSOLUTE /end AXIS_DESCR
/end CHARACTERISTIC
/begin CHARACTERISTIC mBci_V1BaseTorque_XAS16_07___A "nominelles Handmoment abhängig von der Zahnstangenkraft bei Geschwindigkeit v1" CURVE 0x158FCC AblGLKLsw 15 TBTHIGH 0 15 FORMAT "%8.5"
 /begin AXIS_DESCR STD_AXIS kApplI_AbsRackForce_xdu16 FRACK 9 0 30000 FORMAT "%8.2" DEPOSIT ABSOLUTE /end AXIS_DESCR
/end CHARACTERISTIC
/begin CHARACTERISTIC mBci_V1BaseTorque_XAS16_08___A "nominelles Handmoment abhängig von der Zahnstangenkraft bei Geschwindigkeit v1" CURVE 0x158FF4 AblGLKLsw 15 TBTHIGH 0 15 FORMAT "%8.5"
 /begin AXIS_DESCR STD_AXIS kApplI_AbsRackForce_xdu16 FRACK 9 0 30000 FORMAT "%8.2" DEPOSIT ABSOLUTE /end AXIS_DESCR
/end CHARACTERISTIC
/begin CHARACTERISTIC mBci_V1BaseTorque_XAS16_09___A "nominelles Handmoment abhängig von der Zahnstangenkraft bei Geschwindigkeit v1" CURVE 0x15901C AblGLKLsw 15 TBTHIGH 0 15 FORMAT "%8.5"
 /begin AXIS_DESCR STD_AXIS kApplI_AbsRackForce_xdu16 FRACK 9 0 30000 FORMAT "%8.2" DEPOSIT ABSOLUTE /end AXIS_DESCR
/end CHARACTERISTIC
/begin CHARACTERISTIC mBci_V1BaseTorque_XAS16_10___A "nominelles Handmoment abhängig von der Zahnstangenkraft bei Geschwindigkeit v1" CURVE 0x159044 AblGLKLsw 15 TBTHIGH 0 15 FORMAT "%8.5"
 /begin AXIS_DESCR STD_AXIS kApplI_AbsRackForce_xdu16 FRACK 9 0 30000 FORMAT "%8.2" DEPOSIT ABSOLUTE /end AXIS_DESCR
/end CHARACTERISTIC
/begin CHARACTERISTIC mBci_V1BaseTorque_XAS16_11___A "nominelles Handmoment abhängig von der Zahnstangenkraft bei Geschwindigkeit v1" CURVE 0x15906C AblGLKLsw 15 TBTHIGH 0 15 FORMAT "%8.5"
 /begin AXIS_DESCR STD_AXIS kApplI_AbsRackForce_xdu16 FRACK 9 0 30000 FORMAT "%8.2" DEPOSIT ABSOLUTE /end AXIS_DESCR
/end CHARACTERISTIC
/begin CHARACTERISTIC mBci_V1BaseTorque_XAS16_12___A "nominelles Handmoment abhängig von der Zahnstangenkraft bei Geschwindigkeit v1" CURVE 0x159094 AblGLKLsw 15 TBTHIGH 0 15 FORMAT "%8.5"
 /begin AXIS_DESCR STD_AXIS kApplI_AbsRackForce_xdu16 FRACK 9 0 30000 FORMAT "%8.2" DEPOSIT ABSOLUTE /end AXIS_DESCR
/end CHARACTERISTIC
/begin CHARACTERISTIC mBci_V1BaseTorque_XAS16_13___A "nominelles Handmoment abhängig von der Zahnstangenkraft bei Geschwindigkeit v1" CURVE 0x1590BC AblGLKLsw 15 TBTHIGH 0 15 FORMAT "%8.5"
 /begin AXIS_DESCR STD_AXIS kApplI_AbsRackForce_xdu16 FRACK 9 0 30000 FORMAT "%8.2" DEPOSIT ABSOLUTE /end AXIS_DESCR
/end CHARACTERISTIC
/begin CHARACTERISTIC mBci_V1BaseTorque_XAS16_14___A "nominelles Handmoment abhängig von der Zahnstangenkraft bei Geschwindigkeit v1" CURVE 0x1590E4 AblGLKLsw 15 TBTHIGH 0 15 FORMAT "%8.5"
 /begin AXIS_DESCR STD_AXIS kApplI_AbsRackForce_xdu16 FRACK 9 0 30000 FORMAT "%8.2" DEPOSIT ABSOLUTE /end AXIS_DESCR
/end CHARACTERISTIC
/begin CHARACTERISTIC mBci_V1BaseTorque_XAS16_15___A "nominelles Handmoment abhängig von der Zahnstangenkraft bei Geschwindigkeit v1" CURVE 0x15910C AblGLKLsw 15 TBTHIGH 0 15 FORMAT "%8.5"
 /begin AXIS_DESCR STD_AXIS kApplI_AbsRackForce_xdu16 FRACK 9 0 30000 FORMAT "%8.2" DEPOSIT ABSOLUTE /end AXIS_DESCR
/end CHARACTERISTIC
/begin CHARACTERISTIC mBci_V1BaseTorque_XAS16_16___A "nominelles Handmoment abhängig von der Zahnstangenkraft bei Geschwindigkeit v1" CURVE 0x159134 AblGLKLsw 15 TBTHIGH 0 15 FORMAT "%8.5"
 /begin AXIS_DESCR STD_AXIS kApplI_AbsRackForce_xdu16 FRACK 9 0 30000 FORMAT "%8.2" DEPOSIT ABSOLUTE /end AXIS_DESCR
/end CHARACTERISTIC
/begin CHARACTERISTIC mBci_V1BaseTorque_XAS16_17___A "nominelles Handmoment abhängig von der Zahnstangenkraft bei Geschwindigkeit v1" CURVE 0x15915C AblGLKLsw 15 TBTHIGH 0 15 FORMAT "%8.5"
 /begin AXIS_DESCR STD_AXIS kApplI_AbsRackForce_xdu16 FRACK 9 0 30000 FORMAT "%8.2" DEPOSIT ABSOLUTE /end AXIS_DESCR
/end CHARACTERISTIC
/begin CHARACTERISTIC mBci_V1BaseTorque_XAS16_18___A "nominelles Handmoment abhängig von der Zahnstangenkraft bei Geschwindigkeit v1" CURVE 0x159184 AblGLKLsw 15 TBTHIGH 0 15 FORMAT "%8.5"
 /begin AXIS_DESCR STD_AXIS kApplI_AbsRackForce_xdu16 FRACK 9 0 30000 FORMAT "%8.2" DEPOSIT ABSOLUTE /end AXIS_DESCR
/end CHARACTERISTIC
/begin CHARACTERISTIC mBci_V1BaseTorque_XAS16_19___A "nominelles Handmoment abhängig von der Zahnstangenkraft bei Geschwindigkeit v1" CURVE 0x1591AC AblGLKLsw 15 TBTHIGH 0 15 FORMAT "%8.5"
 /begin AXIS_DESCR STD_AXIS kApplI_AbsRackForce_xdu16 FRACK 9 0 30000 FORMAT "%8.2" DEPOSIT ABSOLUTE /end AXIS_DESCR
/end CHARACTERISTIC
/begin CHARACTERISTIC mBci_V1BaseTorque_XAS16_20___A "nominelles Handmoment abhängig von der Zahnstangenkraft bei Geschwindigkeit v1" CURVE 0x1591D4 AblGLKLsw 15 TBTHIGH 0 15 FORMAT "%8.5"
 /begin AXIS_DESCR STD_AXIS kApplI_AbsRackForce_xdu16 FRACK 9 0 30000 FORMAT "%8.2" DEPOSIT ABSOLUTE /end AXIS_DESCR
/end CHARACTERISTIC
/begin CHARACTERISTIC mBci_V1BaseTorque_XAS16_21___A "nominelles Handmoment abhängig von der Zahnstangenkraft bei Geschwindigkeit v1" CURVE 0x1591FC AblGLKLsw 15 TBTHIGH 0 15 FORMAT "%8.5"
 /begin AXIS_DESCR STD_AXIS kApplI_AbsRackForce_xdu16 FRACK 9 0 30000 FORMAT "%8.2" DEPOSIT ABSOLUTE /end AXIS_DESCR
/end CHARACTERISTIC
/begin CHARACTERISTIC mBci_V1BaseTorque_XAS16_22___A "nominelles Handmoment abhängig von der Zahnstangenkraft bei Geschwindigkeit v1" CURVE 0x159224 AblGLKLsw 15 TBTHIGH 0 15 FORMAT "%8.5"
 /begin AXIS_DESCR STD_AXIS kApplI_AbsRackForce_xdu16 FRACK 9 0 30000 FORMAT "%8.2" DEPOSIT ABSOLUTE /end AXIS_DESCR
/end CHARACTERISTIC
/begin CHARACTERISTIC mBci_V1BaseTorque_XAS16_23___A "nominelles Handmoment abhängig von der Zahnstangenkraft bei Geschwindigkeit v1" CURVE 0x15924C AblGLKLsw 15 TBTHIGH 0 15 FORMAT "%8.5"
 /begin AXIS_DESCR STD_AXIS kApplI_AbsRackForce_xdu16 FRACK 9 0 30000 FORMAT "%8.2" DEPOSIT ABSOLUTE /end AXIS_DESCR
/end CHARACTERISTIC
/begin CHARACTERISTIC mBci_V1BaseTorque_XAS16_24___A "nominelles Handmoment abhängig von der Zahnstangenkraft bei Geschwindigkeit v1" CURVE 0x159274 AblGLKLsw 15 TBTHIGH 0 15 FORMAT "%8.5"
 /begin AXIS_DESCR STD_AXIS kApplI_AbsRackForce_xdu16 FRACK 9 0 30000 FORMAT "%8.2" DEPOSIT ABSOLUTE /end AXIS_DESCR
/end CHARACTERISTIC
/begin CHARACTERISTIC mBci_V1BaseTorque_XAS16_25___A "nominelles Handmoment abhängig von der Zahnstangenkraft bei Geschwindigkeit v1" CURVE 0x15929C AblGLKLsw 15 TBTHIGH 0 15 FORMAT "%8.5"
 /begin AXIS_DESCR STD_AXIS kApplI_AbsRackForce_xdu16 FRACK 9 0 30000 FORMAT "%8.2" DEPOSIT ABSOLUTE /end AXIS_DESCR
/end CHARACTERISTIC
/begin CHARACTERISTIC mBci_V1BaseTorque_XAS16_26___A "nominelles Handmoment abhängig von der Zahnstangenkraft bei Geschwindigkeit v1" CURVE 0x1592C4 AblGLKLsw 15 TBTHIGH 0 15 FORMAT "%8.5"
 /begin AXIS_DESCR STD_AXIS kApplI_AbsRackForce_xdu16 FRACK 9 0 30000 FORMAT "%8.2" DEPOSIT ABSOLUTE /end AXIS_DESCR
/end CHARACTERISTIC
/begin CHARACTERISTIC mBci_V1BaseTorque_XAS16_27___A "nominelles Handmoment abhängig von der Zahnstangenkraft bei Geschwindigkeit v1" CURVE 0x1592EC AblGLKLsw 15 TBTHIGH 0 15 FORMAT "%8.5"
 /begin AXIS_DESCR STD_AXIS kApplI_AbsRackForce_xdu16 FRACK 9 0 30000 FORMAT "%8.2" DEPOSIT ABSOLUTE /end AXIS_DESCR
/end CHARACTERISTIC
/begin CHARACTERISTIC mBci_V1BaseTorque_XAS16_28___A "nominelles Handmoment abhängig von der Zahnstangenkraft bei Geschwindigkeit v1" CURVE 0x159314 AblGLKLsw 15 TBTHIGH 0 15 FORMAT "%8.5"
 /begin AXIS_DESCR STD_AXIS kApplI_AbsRackForce_xdu16 FRACK 9 0 30000 FORMAT "%8.2" DEPOSIT ABSOLUTE /end AXIS_DESCR
/end CHARACTERISTIC
/begin CHARACTERISTIC mBci_V1BaseTorque_XAS16_29___A "nominelles Handmoment abhängig von der Zahnstangenkraft bei Geschwindigkeit v1" CURVE 0x15933C AblGLKLsw 15 TBTHIGH 0 15 FORMAT "%8.5"
 /begin AXIS_DESCR STD_AXIS kApplI_AbsRackForce_xdu16 FRACK 9 0 30000 FORMAT "%8.2" DEPOSIT ABSOLUTE /end AXIS_DESCR
/end CHARACTERISTIC
/begin CHARACTERISTIC mBci_V1BaseTorque_XAS16_30___A "nominelles Handmoment abhängig von der Zahnstangenkraft bei Geschwindigkeit v1" CURVE 0x159364 AblGLKLsw 15 TBTHIGH 0 15 FORMAT "%8.5"
 /begin AXIS_DESCR STD_AXIS kApplI_AbsRackForce_xdu16 FRACK 9 0 30000 FORMAT "%8.2" DEPOSIT ABSOLUTE /end AXIS_DESCR
/end CHARACTERISTIC
/begin CHARACTERISTIC mBci_V1BaseTorque_XAS16_31___A "nominelles Handmoment abhängig von der Zahnstangenkraft bei Geschwindigkeit v1" CURVE 0x15938C AblGLKLsw 15 TBTHIGH 0 15 FORMAT "%8.5"
 /begin AXIS_DESCR STD_AXIS kApplI_AbsRackForce_xdu16 FRACK 9 0 30000 FORMAT "%8.2" DEPOSIT ABSOLUTE /end AXIS_DESCR
/end CHARACTERISTIC
/begin CHARACTERISTIC mBci_V1BaseTorque_XAS16_32___A "nominelles Handmoment abhängig von der Zahnstangenkraft bei Geschwindigkeit v1" CURVE 0x1593B4 AblGLKLsw 15 TBTHIGH 0 15 FORMAT "%8.5"
 /begin AXIS_DESCR STD_AXIS kApplI_AbsRackForce_xdu16 FRACK 9 0 30000 FORMAT "%8.2" DEPOSIT ABSOLUTE /end AXIS_DESCR
/end CHARACTERISTIC
/begin CHARACTERISTIC mBci_V1BaseTorque_XAS16_33___A "nominelles Handmoment abhängig von der Zahnstangenkraft bei Geschwindigkeit v1" CURVE 0x1593DC AblGLKLsw 15 TBTHIGH 0 15 FORMAT "%8.5"
 /begin AXIS_DESCR STD_AXIS kApplI_AbsRackForce_xdu16 FRACK 9 0 30000 FORMAT "%8.2" DEPOSIT ABSOLUTE /end AXIS_DESCR
/end CHARACTERISTIC
/begin CHARACTERISTIC mBci_V1BaseTorque_XAS16_34___A "nominelles Handmoment abhängig von der Zahnstangenkraft bei Geschwindigkeit v1" CURVE 0x159404 AblGLKLsw 15 TBTHIGH 0 15 FORMAT "%8.5"
 /begin AXIS_DESCR STD_AXIS kApplI_AbsRackForce_xdu16 FRACK 9 0 30000 FORMAT "%8.2" DEPOSIT ABSOLUTE /end AXIS_DESCR
/end CHARACTERISTIC
/begin CHARACTERISTIC mBci_V1BaseTorque_XAS16_35___A "nominelles Handmoment abhängig von der Zahnstangenkraft bei Geschwindigkeit v1" CURVE 0x15942C AblGLKLsw 15 TBTHIGH 0 15 FORMAT "%8.5"
 /begin AXIS_DESCR STD_AXIS kApplI_AbsRackForce_xdu16 FRACK 9 0 30000 FORMAT "%8.2" DEPOSIT ABSOLUTE /end AXIS_DESCR
/end CHARACTERISTIC
/begin CHARACTERISTIC mBci_V2BaseTorque_XAS16_00___A "nominelles Handmoment abhängig von der Zahnstangenkraft bei Geschwindigkeit v2" CURVE 0x159454 AblGLKLsw 15 TBTHIGH 0 15 FORMAT "%8.5"
 /begin AXIS_DESCR STD_AXIS kApplI_AbsRackForce_xdu16 FRACK 9 0 30000 FORMAT "%8.2" DEPOSIT ABSOLUTE /end AXIS_DESCR
/end CHARACTERISTIC
/begin CHARACTERISTIC mBci_V2BaseTorque_XAS16_01___A "nominelles Handmoment abhängig von der Zahnstangenkraft bei Geschwindigkeit v2" CURVE 0x15947C AblGLKLsw 15 TBTHIGH 0 15 FORMAT "%8.5"
 /begin AXIS_DESCR STD_AXIS kApplI_AbsRackForce_xdu16 FRACK 9 0 30000 FORMAT "%8.2" DEPOSIT ABSOLUTE /end AXIS_DESCR
/end CHARACTERISTIC
/begin CHARACTERISTIC mBci_V2BaseTorque_XAS16_02___A "nominelles Handmoment abhängig von der Zahnstangenkraft bei Geschwindigkeit v2" CURVE 0x1594A4 AblGLKLsw 15 TBTHIGH 0 15 FORMAT "%8.5"
 /begin AXIS_DESCR STD_AXIS kApplI_AbsRackForce_xdu16 FRACK 9 0 30000 FORMAT "%8.2" DEPOSIT ABSOLUTE /end AXIS_DESCR
/end CHARACTERISTIC
/begin CHARACTERISTIC mBci_V2BaseTorque_XAS16_03___A "nominelles Handmoment abhängig von der Zahnstangenkraft bei Geschwindigkeit v2" CURVE 0x1594CC AblGLKLsw 15 TBTHIGH 0 15 FORMAT "%8.5"
 /begin AXIS_DESCR STD_AXIS kApplI_AbsRackForce_xdu16 FRACK 9 0 30000 FORMAT "%8.2" DEPOSIT ABSOLUTE /end AXIS_DESCR
/end CHARACTERISTIC
/begin CHARACTERISTIC mBci_V2BaseTorque_XAS16_04___A "nominelles Handmoment abhängig von der Zahnstangenkraft bei Geschwindigkeit v2" CURVE 0x1594F4 AblGLKLsw 15 TBTHIGH 0 15 FORMAT "%8.5"
 /begin AXIS_DESCR STD_AXIS kApplI_AbsRackForce_xdu16 FRACK 9 0 30000 FORMAT "%8.2" DEPOSIT ABSOLUTE /end AXIS_DESCR
/end CHARACTERISTIC
/begin CHARACTERISTIC mBci_V2BaseTorque_XAS16_05___A "nominelles Handmoment abhängig von der Zahnstangenkraft bei Geschwindigkeit v2" CURVE 0x15951C AblGLKLsw 15 TBTHIGH 0 15 FORMAT "%8.5"
 /begin AXIS_DESCR STD_AXIS kApplI_AbsRackForce_xdu16 FRACK 9 0 30000 FORMAT "%8.2" DEPOSIT ABSOLUTE /end AXIS_DESCR
/end CHARACTERISTIC
/begin CHARACTERISTIC mBci_V2BaseTorque_XAS16_06___A "nominelles Handmoment abhängig von der Zahnstangenkraft bei Geschwindigkeit v2" CURVE 0x159544 AblGLKLsw 15 TBTHIGH 0 15 FORMAT "%8.5"
 /begin AXIS_DESCR STD_AXIS kApplI_AbsRackForce_xdu16 FRACK 9 0 30000 FORMAT "%8.2" DEPOSIT ABSOLUTE /end AXIS_DESCR
/end CHARACTERISTIC
/begin CHARACTERISTIC mBci_V2BaseTorque_XAS16_07___A "nominelles Handmoment abhängig von der Zahnstangenkraft bei Geschwindigkeit v2" CURVE 0x15956C AblGLKLsw 15 TBTHIGH 0 15 FORMAT "%8.5"
 /begin AXIS_DESCR STD_AXIS kApplI_AbsRackForce_xdu16 FRACK 9 0 30000 FORMAT "%8.2" DEPOSIT ABSOLUTE /end AXIS_DESCR
/end CHARACTERISTIC
/begin CHARACTERISTIC mBci_V2BaseTorque_XAS16_08___A "nominelles Handmoment abhängig von der Zahnstangenkraft bei Geschwindigkeit v2" CURVE 0x159594 AblGLKLsw 15 TBTHIGH 0 15 FORMAT "%8.5"
 /begin AXIS_DESCR STD_AXIS kApplI_AbsRackForce_xdu16 FRACK 9 0 30000 FORMAT "%8.2" DEPOSIT ABSOLUTE /end AXIS_DESCR
/end CHARACTERISTIC
/begin CHARACTERISTIC mBci_V2BaseTorque_XAS16_09___A "nominelles Handmoment abhängig von der Zahnstangenkraft bei Geschwindigkeit v2" CURVE 0x1595BC AblGLKLsw 15 TBTHIGH 0 15 FORMAT "%8.5"
 /begin AXIS_DESCR STD_AXIS kApplI_AbsRackForce_xdu16 FRACK 9 0 30000 FORMAT "%8.2" DEPOSIT ABSOLUTE /end AXIS_DESCR
/end CHARACTERISTIC
/begin CHARACTERISTIC mBci_V2BaseTorque_XAS16_10___A "nominelles Handmoment abhängig von der Zahnstangenkraft bei Geschwindigkeit v2" CURVE 0x1595E4 AblGLKLsw 15 TBTHIGH 0 15 FORMAT "%8.5"
 /begin AXIS_DESCR STD_AXIS kApplI_AbsRackForce_xdu16 FRACK 9 0 30000 FORMAT "%8.2" DEPOSIT ABSOLUTE /end AXIS_DESCR
/end CHARACTERISTIC
/begin CHARACTERISTIC mBci_V2BaseTorque_XAS16_11___A "nominelles Handmoment abhängig von der Zahnstangenkraft bei Geschwindigkeit v2" CURVE 0x15960C AblGLKLsw 15 TBTHIGH 0 15 FORMAT "%8.5"
 /begin AXIS_DESCR STD_AXIS kApplI_AbsRackForce_xdu16 FRACK 9 0 30000 FORMAT "%8.2" DEPOSIT ABSOLUTE /end AXIS_DESCR
/end CHARACTERISTIC
/begin CHARACTERISTIC mBci_V2BaseTorque_XAS16_12___A "nominelles Handmoment abhängig von der Zahnstangenkraft bei Geschwindigkeit v2" CURVE 0x159634 AblGLKLsw 15 TBTHIGH 0 15 FORMAT "%8.5"
 /begin AXIS_DESCR STD_AXIS kApplI_AbsRackForce_xdu16 FRACK 9 0 30000 FORMAT "%8.2" DEPOSIT ABSOLUTE /end AXIS_DESCR
/end CHARACTERISTIC
/begin CHARACTERISTIC mBci_V2BaseTorque_XAS16_13___A "nominelles Handmoment abhängig von der Zahnstangenkraft bei Geschwindigkeit v2" CURVE 0x15965C AblGLKLsw 15 TBTHIGH 0 15 FORMAT "%8.5"
 /begin AXIS_DESCR STD_AXIS kApplI_AbsRackForce_xdu16 FRACK 9 0 30000 FORMAT "%8.2" DEPOSIT ABSOLUTE /end AXIS_DESCR
/end CHARACTERISTIC
/begin CHARACTERISTIC mBci_V2BaseTorque_XAS16_14___A "nominelles Handmoment abhängig von der Zahnstangenkraft bei Geschwindigkeit v2" CURVE 0x159684 AblGLKLsw 15 TBTHIGH 0 15 FORMAT "%8.5"
 /begin AXIS_DESCR STD_AXIS kApplI_AbsRackForce_xdu16 FRACK 9 0 30000 FORMAT "%8.2" DEPOSIT ABSOLUTE /end AXIS_DESCR
/end CHARACTERISTIC
/begin CHARACTERISTIC mBci_V2BaseTorque_XAS16_15___A "nominelles Handmoment abhängig von der Zahnstangenkraft bei Geschwindigkeit v2" CURVE 0x1596AC AblGLKLsw 15 TBTHIGH 0 15 FORMAT "%8.5"
 /begin AXIS_DESCR STD_AXIS kApplI_AbsRackForce_xdu16 FRACK 9 0 30000 FORMAT "%8.2" DEPOSIT ABSOLUTE /end AXIS_DESCR
/end CHARACTERISTIC
/begin CHARACTERISTIC mBci_V2BaseTorque_XAS16_16___A "nominelles Handmoment abhängig von der Zahnstangenkraft bei Geschwindigkeit v2" CURVE 0x1596D4 AblGLKLsw 15 TBTHIGH 0 15 FORMAT "%8.5"
 /begin AXIS_DESCR STD_AXIS kApplI_AbsRackForce_xdu16 FRACK 9 0 30000 FORMAT "%8.2" DEPOSIT ABSOLUTE /end AXIS_DESCR
/end CHARACTERISTIC
/begin CHARACTERISTIC mBci_V2BaseTorque_XAS16_17___A "nominelles Handmoment abhängig von der Zahnstangenkraft bei Geschwindigkeit v2" CURVE 0x1596FC AblGLKLsw 15 TBTHIGH 0 15 FORMAT "%8.5"
 /begin AXIS_DESCR STD_AXIS kApplI_AbsRackForce_xdu16 FRACK 9 0 30000 FORMAT "%8.2" DEPOSIT ABSOLUTE /end AXIS_DESCR
/end CHARACTERISTIC
/begin CHARACTERISTIC mBci_V2BaseTorque_XAS16_18___A "nominelles Handmoment abhängig von der Zahnstangenkraft bei Geschwindigkeit v2" CURVE 0x159724 AblGLKLsw 15 TBTHIGH 0 15 FORMAT "%8.5"
 /begin AXIS_DESCR STD_AXIS kApplI_AbsRackForce_xdu16 FRACK 9 0 30000 FORMAT "%8.2" DEPOSIT ABSOLUTE /end AXIS_DESCR
/end CHARACTERISTIC
/begin CHARACTERISTIC mBci_V2BaseTorque_XAS16_19___A "nominelles Handmoment abhängig von der Zahnstangenkraft bei Geschwindigkeit v2" CURVE 0x15974C AblGLKLsw 15 TBTHIGH 0 15 FORMAT "%8.5"
 /begin AXIS_DESCR STD_AXIS kApplI_AbsRackForce_xdu16 FRACK 9 0 30000 FORMAT "%8.2" DEPOSIT ABSOLUTE /end AXIS_DESCR
/end CHARACTERISTIC
/begin CHARACTERISTIC mBci_V2BaseTorque_XAS16_20___A "nominelles Handmoment abhängig von der Zahnstangenkraft bei Geschwindigkeit v2" CURVE 0x159774 AblGLKLsw 15 TBTHIGH 0 15 FORMAT "%8.5"
 /begin AXIS_DESCR STD_AXIS kApplI_AbsRackForce_xdu16 FRACK 9 0 30000 FORMAT "%8.2" DEPOSIT ABSOLUTE /end AXIS_DESCR
/end CHARACTERISTIC
/begin CHARACTERISTIC mBci_V2BaseTorque_XAS16_21___A "nominelles Handmoment abhängig von der Zahnstangenkraft bei Geschwindigkeit v2" CURVE 0x15979C AblGLKLsw 15 TBTHIGH 0 15 FORMAT "%8.5"
 /begin AXIS_DESCR STD_AXIS kApplI_AbsRackForce_xdu16 FRACK 9 0 30000 FORMAT "%8.2" DEPOSIT ABSOLUTE /end AXIS_DESCR
/end CHARACTERISTIC
/begin CHARACTERISTIC mBci_V2BaseTorque_XAS16_22___A "nominelles Handmoment abhängig von der Zahnstangenkraft bei Geschwindigkeit v2" CURVE 0x1597C4 AblGLKLsw 15 TBTHIGH 0 15 FORMAT "%8.5"
 /begin AXIS_DESCR STD_AXIS kApplI_AbsRackForce_xdu16 FRACK 9 0 30000 FORMAT "%8.2" DEPOSIT ABSOLUTE /end AXIS_DESCR
/end CHARACTERISTIC
/begin CHARACTERISTIC mBci_V2BaseTorque_XAS16_23___A "nominelles Handmoment abhängig von der Zahnstangenkraft bei Geschwindigkeit v2" CURVE 0x1597EC AblGLKLsw 15 TBTHIGH 0 15 FORMAT "%8.5"
 /begin AXIS_DESCR STD_AXIS kApplI_AbsRackForce_xdu16 FRACK 9 0 30000 FORMAT "%8.2" DEPOSIT ABSOLUTE /end AXIS_DESCR
/end CHARACTERISTIC
/begin CHARACTERISTIC mBci_V2BaseTorque_XAS16_24___A "nominelles Handmoment abhängig von der Zahnstangenkraft bei Geschwindigkeit v2" CURVE 0x159814 AblGLKLsw 15 TBTHIGH 0 15 FORMAT "%8.5"
 /begin AXIS_DESCR STD_AXIS kApplI_AbsRackForce_xdu16 FRACK 9 0 30000 FORMAT "%8.2" DEPOSIT ABSOLUTE /end AXIS_DESCR
/end CHARACTERISTIC
/begin CHARACTERISTIC mBci_V2BaseTorque_XAS16_25___A "nominelles Handmoment abhängig von der Zahnstangenkraft bei Geschwindigkeit v2" CURVE 0x15983C AblGLKLsw 15 TBTHIGH 0 15 FORMAT "%8.5"
 /begin AXIS_DESCR STD_AXIS kApplI_AbsRackForce_xdu16 FRACK 9 0 30000 FORMAT "%8.2" DEPOSIT ABSOLUTE /end AXIS_DESCR
/end CHARACTERISTIC
/begin CHARACTERISTIC mBci_V2BaseTorque_XAS16_26___A "nominelles Handmoment abhängig von der Zahnstangenkraft bei Geschwindigkeit v2" CURVE 0x159864 AblGLKLsw 15 TBTHIGH 0 15 FORMAT "%8.5"
 /begin AXIS_DESCR STD_AXIS kApplI_AbsRackForce_xdu16 FRACK 9 0 30000 FORMAT "%8.2" DEPOSIT ABSOLUTE /end AXIS_DESCR
/end CHARACTERISTIC
/begin CHARACTERISTIC mBci_V2BaseTorque_XAS16_27___A "nominelles Handmoment abhängig von der Zahnstangenkraft bei Geschwindigkeit v2" CURVE 0x15988C AblGLKLsw 15 TBTHIGH 0 15 FORMAT "%8.5"
 /begin AXIS_DESCR STD_AXIS kApplI_AbsRackForce_xdu16 FRACK 9 0 30000 FORMAT "%8.2" DEPOSIT ABSOLUTE /end AXIS_DESCR
/end CHARACTERISTIC
/begin CHARACTERISTIC mBci_V2BaseTorque_XAS16_28___A "nominelles Handmoment abhängig von der Zahnstangenkraft bei Geschwindigkeit v2" CURVE 0x1598B4 AblGLKLsw 15 TBTHIGH 0 15 FORMAT "%8.5"
 /begin AXIS_DESCR STD_AXIS kApplI_AbsRackForce_xdu16 FRACK 9 0 30000 FORMAT "%8.2" DEPOSIT ABSOLUTE /end AXIS_DESCR
/end CHARACTERISTIC
/begin CHARACTERISTIC mBci_V2BaseTorque_XAS16_29___A "nominelles Handmoment abhängig von der Zahnstangenkraft bei Geschwindigkeit v2" CURVE 0x1598DC AblGLKLsw 15 TBTHIGH 0 15 FORMAT "%8.5"
 /begin AXIS_DESCR STD_AXIS kApplI_AbsRackForce_xdu16 FRACK 9 0 30000 FORMAT "%8.2" DEPOSIT ABSOLUTE /end AXIS_DESCR
/end CHARACTERISTIC
/begin CHARACTERISTIC mBci_V2BaseTorque_XAS16_30___A "nominelles Handmoment abhängig von der Zahnstangenkraft bei Geschwindigkeit v2" CURVE 0x159904 AblGLKLsw 15 TBTHIGH 0 15 FORMAT "%8.5"
 /begin AXIS_DESCR STD_AXIS kApplI_AbsRackForce_xdu16 FRACK 9 0 30000 FORMAT "%8.2" DEPOSIT ABSOLUTE /end AXIS_DESCR
/end CHARACTERISTIC
/begin CHARACTERISTIC mBci_V2BaseTorque_XAS16_31___A "nominelles Handmoment abhängig von der Zahnstangenkraft bei Geschwindigkeit v2" CURVE 0x15992C AblGLKLsw 15 TBTHIGH 0 15 FORMAT "%8.5"
 /begin AXIS_DESCR STD_AXIS kApplI_AbsRackForce_xdu16 FRACK 9 0 30000 FORMAT "%8.2" DEPOSIT ABSOLUTE /end AXIS_DESCR
/end CHARACTERISTIC
/begin CHARACTERISTIC mBci_V2BaseTorque_XAS16_32___A "nominelles Handmoment abhängig von der Zahnstangenkraft bei Geschwindigkeit v2" CURVE 0x159954 AblGLKLsw 15 TBTHIGH 0 15 FORMAT "%8.5"
 /begin AXIS_DESCR STD_AXIS kApplI_AbsRackForce_xdu16 FRACK 9 0 30000 FORMAT "%8.2" DEPOSIT ABSOLUTE /end AXIS_DESCR
/end CHARACTERISTIC
/begin CHARACTERISTIC mBci_V2BaseTorque_XAS16_33___A "nominelles Handmoment abhängig von der Zahnstangenkraft bei Geschwindigkeit v2" CURVE 0x15997C AblGLKLsw 15 TBTHIGH 0 15 FORMAT "%8.5"
 /begin AXIS_DESCR STD_AXIS kApplI_AbsRackForce_xdu16 FRACK 9 0 30000 FORMAT "%8.2" DEPOSIT ABSOLUTE /end AXIS_DESCR
/end CHARACTERISTIC
/begin CHARACTERISTIC mBci_V2BaseTorque_XAS16_34___A "nominelles Handmoment abhängig von der Zahnstangenkraft bei Geschwindigkeit v2" CURVE 0x1599A4 AblGLKLsw 15 TBTHIGH 0 15 FORMAT "%8.5"
 /begin AXIS_DESCR STD_AXIS kApplI_AbsRackForce_xdu16 FRACK 9 0 30000 FORMAT "%8.2" DEPOSIT ABSOLUTE /end AXIS_DESCR
/end CHARACTERISTIC
/begin CHARACTERISTIC mBci_V2BaseTorque_XAS16_35___A "nominelles Handmoment abhängig von der Zahnstangenkraft bei Geschwindigkeit v2" CURVE 0x1599CC AblGLKLsw 15 TBTHIGH 0 15 FORMAT "%8.5"
 /begin AXIS_DESCR STD_AXIS kApplI_AbsRackForce_xdu16 FRACK 9 0 30000 FORMAT "%8.2" DEPOSIT ABSOLUTE /end AXIS_DESCR
/end CHARACTERISTIC
/begin CHARACTERISTIC mBci_V3BaseTorque_XAS16_00___A "nominelles Handmoment abhängig von der Zahnstangenkraft bei Geschwindigkeit v3" CURVE 0x1599F4 AblGLKLsw 15 TBTHIGH 0 15 FORMAT "%8.5"
 /begin AXIS_DESCR STD_AXIS kApplI_AbsRackForce_xdu16 FRACK 9 0 30000 FORMAT "%8.2" DEPOSIT ABSOLUTE /end AXIS_DESCR
/end CHARACTERISTIC
/begin CHARACTERISTIC mBci_V3BaseTorque_XAS16_01___A "nominelles Handmoment abhängig von der Zahnstangenkraft bei Geschwindigkeit v3" CURVE 0x159A1C AblGLKLsw 15 TBTHIGH 0 15 FORMAT "%8.5"
 /begin AXIS_DESCR STD_AXIS kApplI_AbsRackForce_xdu16 FRACK 9 0 30000 FORMAT "%8.2" DEPOSIT ABSOLUTE /end AXIS_DESCR
/end CHARACTERISTIC
/begin CHARACTERISTIC mBci_V3BaseTorque_XAS16_02___A "nominelles Handmoment abhängig von der Zahnstangenkraft bei Geschwindigkeit v3" CURVE 0x159A44 AblGLKLsw 15 TBTHIGH 0 15 FORMAT "%8.5"
 /begin AXIS_DESCR STD_AXIS kApplI_AbsRackForce_xdu16 FRACK 9 0 30000 FORMAT "%8.2" DEPOSIT ABSOLUTE /end AXIS_DESCR
/end CHARACTERISTIC
/begin CHARACTERISTIC mBci_V3BaseTorque_XAS16_03___A "nominelles Handmoment abhängig von der Zahnstangenkraft bei Geschwindigkeit v3" CURVE 0x159A6C AblGLKLsw 15 TBTHIGH 0 15 FORMAT "%8.5"
 /begin AXIS_DESCR STD_AXIS kApplI_AbsRackForce_xdu16 FRACK 9 0 30000 FORMAT "%8.2" DEPOSIT ABSOLUTE /end AXIS_DESCR
/end CHARACTERISTIC
/begin CHARACTERISTIC mBci_V3BaseTorque_XAS16_04___A "nominelles Handmoment abhängig von der Zahnstangenkraft bei Geschwindigkeit v3" CURVE 0x159A94 AblGLKLsw 15 TBTHIGH 0 15 FORMAT "%8.5"
 /begin AXIS_DESCR STD_AXIS kApplI_AbsRackForce_xdu16 FRACK 9 0 30000 FORMAT "%8.2" DEPOSIT ABSOLUTE /end AXIS_DESCR
/end CHARACTERISTIC
/begin CHARACTERISTIC mBci_V3BaseTorque_XAS16_05___A "nominelles Handmoment abhängig von der Zahnstangenkraft bei Geschwindigkeit v3" CURVE 0x159ABC AblGLKLsw 15 TBTHIGH 0 15 FORMAT "%8.5"
 /begin AXIS_DESCR STD_AXIS kApplI_AbsRackForce_xdu16 FRACK 9 0 30000 FORMAT "%8.2" DEPOSIT ABSOLUTE /end AXIS_DESCR
/end CHARACTERISTIC
/begin CHARACTERISTIC mBci_V3BaseTorque_XAS16_06___A "nominelles Handmoment abhängig von der Zahnstangenkraft bei Geschwindigkeit v3" CURVE 0x159AE4 AblGLKLsw 15 TBTHIGH 0 15 FORMAT "%8.5"
 /begin AXIS_DESCR STD_AXIS kApplI_AbsRackForce_xdu16 FRACK 9 0 30000 FORMAT "%8.2" DEPOSIT ABSOLUTE /end AXIS_DESCR
/end CHARACTERISTIC
/begin CHARACTERISTIC mBci_V3BaseTorque_XAS16_07___A "nominelles Handmoment abhängig von der Zahnstangenkraft bei Geschwindigkeit v3" CURVE 0x159B0C AblGLKLsw 15 TBTHIGH 0 15 FORMAT "%8.5"
 /begin AXIS_DESCR STD_AXIS kApplI_AbsRackForce_xdu16 FRACK 9 0 30000 FORMAT "%8.2" DEPOSIT ABSOLUTE /end AXIS_DESCR
/end CHARACTERISTIC
/begin CHARACTERISTIC mBci_V3BaseTorque_XAS16_08___A "nominelles Handmoment abhängig von der Zahnstangenkraft bei Geschwindigkeit v3" CURVE 0x159B34 AblGLKLsw 15 TBTHIGH 0 15 FORMAT "%8.5"
 /begin AXIS_DESCR STD_AXIS kApplI_AbsRackForce_xdu16 FRACK 9 0 30000 FORMAT "%8.2" DEPOSIT ABSOLUTE /end AXIS_DESCR
/end CHARACTERISTIC
/begin CHARACTERISTIC mBci_V3BaseTorque_XAS16_09___A "nominelles Handmoment abhängig von der Zahnstangenkraft bei Geschwindigkeit v3" CURVE 0x159B5C AblGLKLsw 15 TBTHIGH 0 15 FORMAT "%8.5"
 /begin AXIS_DESCR STD_AXIS kApplI_AbsRackForce_xdu16 FRACK 9 0 30000 FORMAT "%8.2" DEPOSIT ABSOLUTE /end AXIS_DESCR
/end CHARACTERISTIC
/begin CHARACTERISTIC mBci_V3BaseTorque_XAS16_10___A "nominelles Handmoment abhängig von der Zahnstangenkraft bei Geschwindigkeit v3" CURVE 0x159B84 AblGLKLsw 15 TBTHIGH 0 15 FORMAT "%8.5"
 /begin AXIS_DESCR STD_AXIS kApplI_AbsRackForce_xdu16 FRACK 9 0 30000 FORMAT "%8.2" DEPOSIT ABSOLUTE /end AXIS_DESCR
/end CHARACTERISTIC
/begin CHARACTERISTIC mBci_V3BaseTorque_XAS16_11___A "nominelles Handmoment abhängig von der Zahnstangenkraft bei Geschwindigkeit v3" CURVE 0x159BAC AblGLKLsw 15 TBTHIGH 0 15 FORMAT "%8.5"
 /begin AXIS_DESCR STD_AXIS kApplI_AbsRackForce_xdu16 FRACK 9 0 30000 FORMAT "%8.2" DEPOSIT ABSOLUTE /end AXIS_DESCR
/end CHARACTERISTIC
/begin CHARACTERISTIC mBci_V3BaseTorque_XAS16_12___A "nominelles Handmoment abhängig von der Zahnstangenkraft bei Geschwindigkeit v3" CURVE 0x159BD4 AblGLKLsw 15 TBTHIGH 0 15 FORMAT "%8.5"
 /begin AXIS_DESCR STD_AXIS kApplI_AbsRackForce_xdu16 FRACK 9 0 30000 FORMAT "%8.2" DEPOSIT ABSOLUTE /end AXIS_DESCR
/end CHARACTERISTIC
/begin CHARACTERISTIC mBci_V3BaseTorque_XAS16_13___A "nominelles Handmoment abhängig von der Zahnstangenkraft bei Geschwindigkeit v3" CURVE 0x159BFC AblGLKLsw 15 TBTHIGH 0 15 FORMAT "%8.5"
 /begin AXIS_DESCR STD_AXIS kApplI_AbsRackForce_xdu16 FRACK 9 0 30000 FORMAT "%8.2" DEPOSIT ABSOLUTE /end AXIS_DESCR
/end CHARACTERISTIC
/begin CHARACTERISTIC mBci_V3BaseTorque_XAS16_14___A "nominelles Handmoment abhängig von der Zahnstangenkraft bei Geschwindigkeit v3" CURVE 0x159C24 AblGLKLsw 15 TBTHIGH 0 15 FORMAT "%8.5"
 /begin AXIS_DESCR STD_AXIS kApplI_AbsRackForce_xdu16 FRACK 9 0 30000 FORMAT "%8.2" DEPOSIT ABSOLUTE /end AXIS_DESCR
/end CHARACTERISTIC
/begin CHARACTERISTIC mBci_V3BaseTorque_XAS16_15___A "nominelles Handmoment abhängig von der Zahnstangenkraft bei Geschwindigkeit v3" CURVE 0x159C4C AblGLKLsw 15 TBTHIGH 0 15 FORMAT "%8.5"
 /begin AXIS_DESCR STD_AXIS kApplI_AbsRackForce_xdu16 FRACK 9 0 30000 FORMAT "%8.2" DEPOSIT ABSOLUTE /end AXIS_DESCR
/end CHARACTERISTIC
/begin CHARACTERISTIC mBci_V3BaseTorque_XAS16_16___A "nominelles Handmoment abhängig von der Zahnstangenkraft bei Geschwindigkeit v3" CURVE 0x159C74 AblGLKLsw 15 TBTHIGH 0 15 FORMAT "%8.5"
 /begin AXIS_DESCR STD_AXIS kApplI_AbsRackForce_xdu16 FRACK 9 0 30000 FORMAT "%8.2" DEPOSIT ABSOLUTE /end AXIS_DESCR
/end CHARACTERISTIC
/begin CHARACTERISTIC mBci_V3BaseTorque_XAS16_17___A "nominelles Handmoment abhängig von der Zahnstangenkraft bei Geschwindigkeit v3" CURVE 0x159C9C AblGLKLsw 15 TBTHIGH 0 15 FORMAT "%8.5"
 /begin AXIS_DESCR STD_AXIS kApplI_AbsRackForce_xdu16 FRACK 9 0 30000 FORMAT "%8.2" DEPOSIT ABSOLUTE /end AXIS_DESCR
/end CHARACTERISTIC
/begin CHARACTERISTIC mBci_V3BaseTorque_XAS16_18___A "nominelles Handmoment abhängig von der Zahnstangenkraft bei Geschwindigkeit v3" CURVE 0x159CC4 AblGLKLsw 15 TBTHIGH 0 15 FORMAT "%8.5"
 /begin AXIS_DESCR STD_AXIS kApplI_AbsRackForce_xdu16 FRACK 9 0 30000 FORMAT "%8.2" DEPOSIT ABSOLUTE /end AXIS_DESCR
/end CHARACTERISTIC
/begin CHARACTERISTIC mBci_V3BaseTorque_XAS16_19___A "nominelles Handmoment abhängig von der Zahnstangenkraft bei Geschwindigkeit v3" CURVE 0x159CEC AblGLKLsw 15 TBTHIGH 0 15 FORMAT "%8.5"
 /begin AXIS_DESCR STD_AXIS kApplI_AbsRackForce_xdu16 FRACK 9 0 30000 FORMAT "%8.2" DEPOSIT ABSOLUTE /end AXIS_DESCR
/end CHARACTERISTIC
/begin CHARACTERISTIC mBci_V3BaseTorque_XAS16_20___A "nominelles Handmoment abhängig von der Zahnstangenkraft bei Geschwindigkeit v3" CURVE 0x159D14 AblGLKLsw 15 TBTHIGH 0 15 FORMAT "%8.5"
 /begin AXIS_DESCR STD_AXIS kApplI_AbsRackForce_xdu16 FRACK 9 0 30000 FORMAT "%8.2" DEPOSIT ABSOLUTE /end AXIS_DESCR
/end CHARACTERISTIC
/begin CHARACTERISTIC mBci_V3BaseTorque_XAS16_21___A "nominelles Handmoment abhängig von der Zahnstangenkraft bei Geschwindigkeit v3" CURVE 0x159D3C AblGLKLsw 15 TBTHIGH 0 15 FORMAT "%8.5"
 /begin AXIS_DESCR STD_AXIS kApplI_AbsRackForce_xdu16 FRACK 9 0 30000 FORMAT "%8.2" DEPOSIT ABSOLUTE /end AXIS_DESCR
/end CHARACTERISTIC
/begin CHARACTERISTIC mBci_V3BaseTorque_XAS16_22___A "nominelles Handmoment abhängig von der Zahnstangenkraft bei Geschwindigkeit v3" CURVE 0x159D64 AblGLKLsw 15 TBTHIGH 0 15 FORMAT "%8.5"
 /begin AXIS_DESCR STD_AXIS kApplI_AbsRackForce_xdu16 FRACK 9 0 30000 FORMAT "%8.2" DEPOSIT ABSOLUTE /end AXIS_DESCR
/end CHARACTERISTIC
/begin CHARACTERISTIC mBci_V3BaseTorque_XAS16_23___A "nominelles Handmoment abhängig von der Zahnstangenkraft bei Geschwindigkeit v3" CURVE 0x159D8C AblGLKLsw 15 TBTHIGH 0 15 FORMAT "%8.5"
 /begin AXIS_DESCR STD_AXIS kApplI_AbsRackForce_xdu16 FRACK 9 0 30000 FORMAT "%8.2" DEPOSIT ABSOLUTE /end AXIS_DESCR
/end CHARACTERISTIC
/begin CHARACTERISTIC mBci_V3BaseTorque_XAS16_24___A "nominelles Handmoment abhängig von der Zahnstangenkraft bei Geschwindigkeit v3" CURVE 0x159DB4 AblGLKLsw 15 TBTHIGH 0 15 FORMAT "%8.5"
 /begin AXIS_DESCR STD_AXIS kApplI_AbsRackForce_xdu16 FRACK 9 0 30000 FORMAT "%8.2" DEPOSIT ABSOLUTE /end AXIS_DESCR
/end CHARACTERISTIC
/begin CHARACTERISTIC mBci_V3BaseTorque_XAS16_25___A "nominelles Handmoment abhängig von der Zahnstangenkraft bei Geschwindigkeit v3" CURVE 0x159DDC AblGLKLsw 15 TBTHIGH 0 15 FORMAT "%8.5"
 /begin AXIS_DESCR STD_AXIS kApplI_AbsRackForce_xdu16 FRACK 9 0 30000 FORMAT "%8.2" DEPOSIT ABSOLUTE /end AXIS_DESCR
/end CHARACTERISTIC
/begin CHARACTERISTIC mBci_V3BaseTorque_XAS16_26___A "nominelles Handmoment abhängig von der Zahnstangenkraft bei Geschwindigkeit v3" CURVE 0x159E04 AblGLKLsw 15 TBTHIGH 0 15 FORMAT "%8.5"
 /begin AXIS_DESCR STD_AXIS kApplI_AbsRackForce_xdu16 FRACK 9 0 30000 FORMAT "%8.2" DEPOSIT ABSOLUTE /end AXIS_DESCR
/end CHARACTERISTIC
/begin CHARACTERISTIC mBci_V3BaseTorque_XAS16_27___A "nominelles Handmoment abhängig von der Zahnstangenkraft bei Geschwindigkeit v3" CURVE 0x159E2C AblGLKLsw 15 TBTHIGH 0 15 FORMAT "%8.5"
 /begin AXIS_DESCR STD_AXIS kApplI_AbsRackForce_xdu16 FRACK 9 0 30000 FORMAT "%8.2" DEPOSIT ABSOLUTE /end AXIS_DESCR
/end CHARACTERISTIC
/begin CHARACTERISTIC mBci_V3BaseTorque_XAS16_28___A "nominelles Handmoment abhängig von der Zahnstangenkraft bei Geschwindigkeit v3" CURVE 0x159E54 AblGLKLsw 15 TBTHIGH 0 15 FORMAT "%8.5"
 /begin AXIS_DESCR STD_AXIS kApplI_AbsRackForce_xdu16 FRACK 9 0 30000 FORMAT "%8.2" DEPOSIT ABSOLUTE /end AXIS_DESCR
/end CHARACTERISTIC
/begin CHARACTERISTIC mBci_V3BaseTorque_XAS16_29___A "nominelles Handmoment abhängig von der Zahnstangenkraft bei Geschwindigkeit v3" CURVE 0x159E7C AblGLKLsw 15 TBTHIGH 0 15 FORMAT "%8.5"
 /begin AXIS_DESCR STD_AXIS kApplI_AbsRackForce_xdu16 FRACK 9 0 30000 FORMAT "%8.2" DEPOSIT ABSOLUTE /end AXIS_DESCR
/end CHARACTERISTIC
/begin CHARACTERISTIC mBci_V3BaseTorque_XAS16_30___A "nominelles Handmoment abhängig von der Zahnstangenkraft bei Geschwindigkeit v3" CURVE 0x159EA4 AblGLKLsw 15 TBTHIGH 0 15 FORMAT "%8.5"
 /begin AXIS_DESCR STD_AXIS kApplI_AbsRackForce_xdu16 FRACK 9 0 30000 FORMAT "%8.2" DEPOSIT ABSOLUTE /end AXIS_DESCR
/end CHARACTERISTIC
/begin CHARACTERISTIC mBci_V3BaseTorque_XAS16_31___A "nominelles Handmoment abhängig von der Zahnstangenkraft bei Geschwindigkeit v3" CURVE 0x159ECC AblGLKLsw 15 TBTHIGH 0 15 FORMAT "%8.5"
 /begin AXIS_DESCR STD_AXIS kApplI_AbsRackForce_xdu16 FRACK 9 0 30000 FORMAT "%8.2" DEPOSIT ABSOLUTE /end AXIS_DESCR
/end CHARACTERISTIC
/begin CHARACTERISTIC mBci_V3BaseTorque_XAS16_32___A "nominelles Handmoment abhängig von der Zahnstangenkraft bei Geschwindigkeit v3" CURVE 0x159EF4 AblGLKLsw 15 TBTHIGH 0 15 FORMAT "%8.5"
 /begin AXIS_DESCR STD_AXIS kApplI_AbsRackForce_xdu16 FRACK 9 0 30000 FORMAT "%8.2" DEPOSIT ABSOLUTE /end AXIS_DESCR
/end CHARACTERISTIC
/begin CHARACTERISTIC mBci_V3BaseTorque_XAS16_33___A "nominelles Handmoment abhängig von der Zahnstangenkraft bei Geschwindigkeit v3" CURVE 0x159F1C AblGLKLsw 15 TBTHIGH 0 15 FORMAT "%8.5"
 /begin AXIS_DESCR STD_AXIS kApplI_AbsRackForce_xdu16 FRACK 9 0 30000 FORMAT "%8.2" DEPOSIT ABSOLUTE /end AXIS_DESCR
/end CHARACTERISTIC
/begin CHARACTERISTIC mBci_V3BaseTorque_XAS16_34___A "nominelles Handmoment abhängig von der Zahnstangenkraft bei Geschwindigkeit v3" CURVE 0x159F44 AblGLKLsw 15 TBTHIGH 0 15 FORMAT "%8.5"
 /begin AXIS_DESCR STD_AXIS kApplI_AbsRackForce_xdu16 FRACK 9 0 30000 FORMAT "%8.2" DEPOSIT ABSOLUTE /end AXIS_DESCR
/end CHARACTERISTIC
/begin CHARACTERISTIC mBci_V3BaseTorque_XAS16_35___A "nominelles Handmoment abhängig von der Zahnstangenkraft bei Geschwindigkeit v3" CURVE 0x159F6C AblGLKLsw 15 TBTHIGH 0 15 FORMAT "%8.5"
 /begin AXIS_DESCR STD_AXIS kApplI_AbsRackForce_xdu16 FRACK 9 0 30000 FORMAT "%8.2" DEPOSIT ABSOLUTE /end AXIS_DESCR
/end CHARACTERISTIC
/begin CHARACTERISTIC mBci_V4BaseTorque_XAS16_00___A "nominelles Handmoment abhängig von der Zahnstangenkraft bei Geschwindigkeit v4" CURVE 0x159F94 AblGLKLsw 15 TBTHIGH 0 15 FORMAT "%8.5"
 /begin AXIS_DESCR STD_AXIS kApplI_AbsRackForce_xdu16 FRACK 9 0 30000 FORMAT "%8.2" DEPOSIT ABSOLUTE /end AXIS_DESCR
/end CHARACTERISTIC
/begin CHARACTERISTIC mBci_V4BaseTorque_XAS16_01___A "nominelles Handmoment abhängig von der Zahnstangenkraft bei Geschwindigkeit v4" CURVE 0x159FBC AblGLKLsw 15 TBTHIGH 0 15 FORMAT "%8.5"
 /begin AXIS_DESCR STD_AXIS kApplI_AbsRackForce_xdu16 FRACK 9 0 30000 FORMAT "%8.2" DEPOSIT ABSOLUTE /end AXIS_DESCR
/end CHARACTERISTIC
/begin CHARACTERISTIC mBci_V4BaseTorque_XAS16_02___A "nominelles Handmoment abhängig von der Zahnstangenkraft bei Geschwindigkeit v4" CURVE 0x159FE4 AblGLKLsw 15 TBTHIGH 0 15 FORMAT "%8.5"
 /begin AXIS_DESCR STD_AXIS kApplI_AbsRackForce_xdu16 FRACK 9 0 30000 FORMAT "%8.2" DEPOSIT ABSOLUTE /end AXIS_DESCR
/end CHARACTERISTIC
/begin CHARACTERISTIC mBci_V4BaseTorque_XAS16_03___A "nominelles Handmoment abhängig von der Zahnstangenkraft bei Geschwindigkeit v4" CURVE 0x15A00C AblGLKLsw 15 TBTHIGH 0 15 FORMAT "%8.5"
 /begin AXIS_DESCR STD_AXIS kApplI_AbsRackForce_xdu16 FRACK 9 0 30000 FORMAT "%8.2" DEPOSIT ABSOLUTE /end AXIS_DESCR
/end CHARACTERISTIC
/begin CHARACTERISTIC mBci_V4BaseTorque_XAS16_04___A "nominelles Handmoment abhängig von der Zahnstangenkraft bei Geschwindigkeit v4" CURVE 0x15A034 AblGLKLsw 15 TBTHIGH 0 15 FORMAT "%8.5"
 /begin AXIS_DESCR STD_AXIS kApplI_AbsRackForce_xdu16 FRACK 9 0 30000 FORMAT "%8.2" DEPOSIT ABSOLUTE /end AXIS_DESCR
/end CHARACTERISTIC
/begin CHARACTERISTIC mBci_V4BaseTorque_XAS16_05___A "nominelles Handmoment abhängig von der Zahnstangenkraft bei Geschwindigkeit v4" CURVE 0x15A05C AblGLKLsw 15 TBTHIGH 0 15 FORMAT "%8.5"
 /begin AXIS_DESCR STD_AXIS kApplI_AbsRackForce_xdu16 FRACK 9 0 30000 FORMAT "%8.2" DEPOSIT ABSOLUTE /end AXIS_DESCR
/end CHARACTERISTIC
/begin CHARACTERISTIC mBci_V4BaseTorque_XAS16_06___A "nominelles Handmoment abhängig von der Zahnstangenkraft bei Geschwindigkeit v4" CURVE 0x15A084 AblGLKLsw 15 TBTHIGH 0 15 FORMAT "%8.5"
 /begin AXIS_DESCR STD_AXIS kApplI_AbsRackForce_xdu16 FRACK 9 0 30000 FORMAT "%8.2" DEPOSIT ABSOLUTE /end AXIS_DESCR
/end CHARACTERISTIC
/begin CHARACTERISTIC mBci_V4BaseTorque_XAS16_07___A "nominelles Handmoment abhängig von der Zahnstangenkraft bei Geschwindigkeit v4" CURVE 0x15A0AC AblGLKLsw 15 TBTHIGH 0 15 FORMAT "%8.5"
 /begin AXIS_DESCR STD_AXIS kApplI_AbsRackForce_xdu16 FRACK 9 0 30000 FORMAT "%8.2" DEPOSIT ABSOLUTE /end AXIS_DESCR
/end CHARACTERISTIC
/begin CHARACTERISTIC mBci_V4BaseTorque_XAS16_08___A "nominelles Handmoment abhängig von der Zahnstangenkraft bei Geschwindigkeit v4" CURVE 0x15A0D4 AblGLKLsw 15 TBTHIGH 0 15 FORMAT "%8.5"
 /begin AXIS_DESCR STD_AXIS kApplI_AbsRackForce_xdu16 FRACK 9 0 30000 FORMAT "%8.2" DEPOSIT ABSOLUTE /end AXIS_DESCR
/end CHARACTERISTIC
/begin CHARACTERISTIC mBci_V4BaseTorque_XAS16_09___A "nominelles Handmoment abhängig von der Zahnstangenkraft bei Geschwindigkeit v4" CURVE 0x15A0FC AblGLKLsw 15 TBTHIGH 0 15 FORMAT "%8.5"
 /begin AXIS_DESCR STD_AXIS kApplI_AbsRackForce_xdu16 FRACK 9 0 30000 FORMAT "%8.2" DEPOSIT ABSOLUTE /end AXIS_DESCR
/end CHARACTERISTIC
/begin CHARACTERISTIC mBci_V4BaseTorque_XAS16_10___A "nominelles Handmoment abhängig von der Zahnstangenkraft bei Geschwindigkeit v4" CURVE 0x15A124 AblGLKLsw 15 TBTHIGH 0 15 FORMAT "%8.5"
 /begin AXIS_DESCR STD_AXIS kApplI_AbsRackForce_xdu16 FRACK 9 0 30000 FORMAT "%8.2" DEPOSIT ABSOLUTE /end AXIS_DESCR
/end CHARACTERISTIC
/begin CHARACTERISTIC mBci_V4BaseTorque_XAS16_11___A "nominelles Handmoment abhängig von der Zahnstangenkraft bei Geschwindigkeit v4" CURVE 0x15A14C AblGLKLsw 15 TBTHIGH 0 15 FORMAT "%8.5"
 /begin AXIS_DESCR STD_AXIS kApplI_AbsRackForce_xdu16 FRACK 9 0 30000 FORMAT "%8.2" DEPOSIT ABSOLUTE /end AXIS_DESCR
/end CHARACTERISTIC
/begin CHARACTERISTIC mBci_V4BaseTorque_XAS16_12___A "nominelles Handmoment abhängig von der Zahnstangenkraft bei Geschwindigkeit v4" CURVE 0x15A174 AblGLKLsw 15 TBTHIGH 0 15 FORMAT "%8.5"
 /begin AXIS_DESCR STD_AXIS kApplI_AbsRackForce_xdu16 FRACK 9 0 30000 FORMAT "%8.2" DEPOSIT ABSOLUTE /end AXIS_DESCR
/end CHARACTERISTIC
/begin CHARACTERISTIC mBci_V4BaseTorque_XAS16_13___A "nominelles Handmoment abhängig von der Zahnstangenkraft bei Geschwindigkeit v4" CURVE 0x15A19C AblGLKLsw 15 TBTHIGH 0 15 FORMAT "%8.5"
 /begin AXIS_DESCR STD_AXIS kApplI_AbsRackForce_xdu16 FRACK 9 0 30000 FORMAT "%8.2" DEPOSIT ABSOLUTE /end AXIS_DESCR
/end CHARACTERISTIC
/begin CHARACTERISTIC mBci_V4BaseTorque_XAS16_14___A "nominelles Handmoment abhängig von der Zahnstangenkraft bei Geschwindigkeit v4" CURVE 0x15A1C4 AblGLKLsw 15 TBTHIGH 0 15 FORMAT "%8.5"
 /begin AXIS_DESCR STD_AXIS kApplI_AbsRackForce_xdu16 FRACK 9 0 30000 FORMAT "%8.2" DEPOSIT ABSOLUTE /end AXIS_DESCR
/end CHARACTERISTIC
/begin CHARACTERISTIC mBci_V4BaseTorque_XAS16_15___A "nominelles Handmoment abhängig von der Zahnstangenkraft bei Geschwindigkeit v4" CURVE 0x15A1EC AblGLKLsw 15 TBTHIGH 0 15 FORMAT "%8.5"
 /begin AXIS_DESCR STD_AXIS kApplI_AbsRackForce_xdu16 FRACK 9 0 30000 FORMAT "%8.2" DEPOSIT ABSOLUTE /end AXIS_DESCR
/end CHARACTERISTIC
/begin CHARACTERISTIC mBci_V4BaseTorque_XAS16_16___A "nominelles Handmoment abhängig von der Zahnstangenkraft bei Geschwindigkeit v4" CURVE 0x15A214 AblGLKLsw 15 TBTHIGH 0 15 FORMAT "%8.5"
 /begin AXIS_DESCR STD_AXIS kApplI_AbsRackForce_xdu16 FRACK 9 0 30000 FORMAT "%8.2" DEPOSIT ABSOLUTE /end AXIS_DESCR
/end CHARACTERISTIC
/begin CHARACTERISTIC mBci_V4BaseTorque_XAS16_17___A "nominelles Handmoment abhängig von der Zahnstangenkraft bei Geschwindigkeit v4" CURVE 0x15A23C AblGLKLsw 15 TBTHIGH 0 15 FORMAT "%8.5"
 /begin AXIS_DESCR STD_AXIS kApplI_AbsRackForce_xdu16 FRACK 9 0 30000 FORMAT "%8.2" DEPOSIT ABSOLUTE /end AXIS_DESCR
/end CHARACTERISTIC
/begin CHARACTERISTIC mBci_V4BaseTorque_XAS16_18___A "nominelles Handmoment abhängig von der Zahnstangenkraft bei Geschwindigkeit v4" CURVE 0x15A264 AblGLKLsw 15 TBTHIGH 0 15 FORMAT "%8.5"
 /begin AXIS_DESCR STD_AXIS kApplI_AbsRackForce_xdu16 FRACK 9 0 30000 FORMAT "%8.2" DEPOSIT ABSOLUTE /end AXIS_DESCR
/end CHARACTERISTIC
/begin CHARACTERISTIC mBci_V4BaseTorque_XAS16_19___A "nominelles Handmoment abhängig von der Zahnstangenkraft bei Geschwindigkeit v4" CURVE 0x15A28C AblGLKLsw 15 TBTHIGH 0 15 FORMAT "%8.5"
 /begin AXIS_DESCR STD_AXIS kApplI_AbsRackForce_xdu16 FRACK 9 0 30000 FORMAT "%8.2" DEPOSIT ABSOLUTE /end AXIS_DESCR
/end CHARACTERISTIC
/begin CHARACTERISTIC mBci_V4BaseTorque_XAS16_20___A "nominelles Handmoment abhängig von der Zahnstangenkraft bei Geschwindigkeit v4" CURVE 0x15A2B4 AblGLKLsw 15 TBTHIGH 0 15 FORMAT "%8.5"
 /begin AXIS_DESCR STD_AXIS kApplI_AbsRackForce_xdu16 FRACK 9 0 30000 FORMAT "%8.2" DEPOSIT ABSOLUTE /end AXIS_DESCR
/end CHARACTERISTIC
/begin CHARACTERISTIC mBci_V4BaseTorque_XAS16_21___A "nominelles Handmoment abhängig von der Zahnstangenkraft bei Geschwindigkeit v4" CURVE 0x15A2DC AblGLKLsw 15 TBTHIGH 0 15 FORMAT "%8.5"
 /begin AXIS_DESCR STD_AXIS kApplI_AbsRackForce_xdu16 FRACK 9 0 30000 FORMAT "%8.2" DEPOSIT ABSOLUTE /end AXIS_DESCR
/end CHARACTERISTIC
/begin CHARACTERISTIC mBci_V4BaseTorque_XAS16_22___A "nominelles Handmoment abhängig von der Zahnstangenkraft bei Geschwindigkeit v4" CURVE 0x15A304 AblGLKLsw 15 TBTHIGH 0 15 FORMAT "%8.5"
 /begin AXIS_DESCR STD_AXIS kApplI_AbsRackForce_xdu16 FRACK 9 0 30000 FORMAT "%8.2" DEPOSIT ABSOLUTE /end AXIS_DESCR
/end CHARACTERISTIC
/begin CHARACTERISTIC mBci_V4BaseTorque_XAS16_23___A "nominelles Handmoment abhängig von der Zahnstangenkraft bei Geschwindigkeit v4" CURVE 0x15A32C AblGLKLsw 15 TBTHIGH 0 15 FORMAT "%8.5"
 /begin AXIS_DESCR STD_AXIS kApplI_AbsRackForce_xdu16 FRACK 9 0 30000 FORMAT "%8.2" DEPOSIT ABSOLUTE /end AXIS_DESCR
/end CHARACTERISTIC
/begin CHARACTERISTIC mBci_V4BaseTorque_XAS16_24___A "nominelles Handmoment abhängig von der Zahnstangenkraft bei Geschwindigkeit v4" CURVE 0x15A354 AblGLKLsw 15 TBTHIGH 0 15 FORMAT "%8.5"
 /begin AXIS_DESCR STD_AXIS kApplI_AbsRackForce_xdu16 FRACK 9 0 30000 FORMAT "%8.2" DEPOSIT ABSOLUTE /end AXIS_DESCR
/end CHARACTERISTIC
/begin CHARACTERISTIC mBci_V4BaseTorque_XAS16_25___A "nominelles Handmoment abhängig von der Zahnstangenkraft bei Geschwindigkeit v4" CURVE 0x15A37C AblGLKLsw 15 TBTHIGH 0 15 FORMAT "%8.5"
 /begin AXIS_DESCR STD_AXIS kApplI_AbsRackForce_xdu16 FRACK 9 0 30000 FORMAT "%8.2" DEPOSIT ABSOLUTE /end AXIS_DESCR
/end CHARACTERISTIC
/begin CHARACTERISTIC mBci_V4BaseTorque_XAS16_26___A "nominelles Handmoment abhängig von der Zahnstangenkraft bei Geschwindigkeit v4" CURVE 0x15A3A4 AblGLKLsw 15 TBTHIGH 0 15 FORMAT "%8.5"
 /begin AXIS_DESCR STD_AXIS kApplI_AbsRackForce_xdu16 FRACK 9 0 30000 FORMAT "%8.2" DEPOSIT ABSOLUTE /end AXIS_DESCR
/end CHARACTERISTIC
/begin CHARACTERISTIC mBci_V4BaseTorque_XAS16_27___A "nominelles Handmoment abhängig von der Zahnstangenkraft bei Geschwindigkeit v4" CURVE 0x15A3CC AblGLKLsw 15 TBTHIGH 0 15 FORMAT "%8.5"
 /begin AXIS_DESCR STD_AXIS kApplI_AbsRackForce_xdu16 FRACK 9 0 30000 FORMAT "%8.2" DEPOSIT ABSOLUTE /end AXIS_DESCR
/end CHARACTERISTIC
/begin CHARACTERISTIC mBci_V4BaseTorque_XAS16_28___A "nominelles Handmoment abhängig von der Zahnstangenkraft bei Geschwindigkeit v4" CURVE 0x15A3F4 AblGLKLsw 15 TBTHIGH 0 15 FORMAT "%8.5"
 /begin AXIS_DESCR STD_AXIS kApplI_AbsRackForce_xdu16 FRACK 9 0 30000 FORMAT "%8.2" DEPOSIT ABSOLUTE /end AXIS_DESCR
/end CHARACTERISTIC
/begin CHARACTERISTIC mBci_V4BaseTorque_XAS16_29___A "nominelles Handmoment abhängig von der Zahnstangenkraft bei Geschwindigkeit v4" CURVE 0x15A41C AblGLKLsw 15 TBTHIGH 0 15 FORMAT "%8.5"
 /begin AXIS_DESCR STD_AXIS kApplI_AbsRackForce_xdu16 FRACK 9 0 30000 FORMAT "%8.2" DEPOSIT ABSOLUTE /end AXIS_DESCR
/end CHARACTERISTIC
/begin CHARACTERISTIC mBci_V4BaseTorque_XAS16_30___A "nominelles Handmoment abhängig von der Zahnstangenkraft bei Geschwindigkeit v4" CURVE 0x15A444 AblGLKLsw 15 TBTHIGH 0 15 FORMAT "%8.5"
 /begin AXIS_DESCR STD_AXIS kApplI_AbsRackForce_xdu16 FRACK 9 0 30000 FORMAT "%8.2" DEPOSIT ABSOLUTE /end AXIS_DESCR
/end CHARACTERISTIC
/begin CHARACTERISTIC mBci_V4BaseTorque_XAS16_31___A "nominelles Handmoment abhängig von der Zahnstangenkraft bei Geschwindigkeit v4" CURVE 0x15A46C AblGLKLsw 15 TBTHIGH 0 15 FORMAT "%8.5"
 /begin AXIS_DESCR STD_AXIS kApplI_AbsRackForce_xdu16 FRACK 9 0 30000 FORMAT "%8.2" DEPOSIT ABSOLUTE /end AXIS_DESCR
/end CHARACTERISTIC
/begin CHARACTERISTIC mBci_V4BaseTorque_XAS16_32___A "nominelles Handmoment abhängig von der Zahnstangenkraft bei Geschwindigkeit v4" CURVE 0x15A494 AblGLKLsw 15 TBTHIGH 0 15 FORMAT "%8.5"
 /begin AXIS_DESCR STD_AXIS kApplI_AbsRackForce_xdu16 FRACK 9 0 30000 FORMAT "%8.2" DEPOSIT ABSOLUTE /end AXIS_DESCR
/end CHARACTERISTIC
/begin CHARACTERISTIC mBci_V4BaseTorque_XAS16_33___A "nominelles Handmoment abhängig von der Zahnstangenkraft bei Geschwindigkeit v4" CURVE 0x15A4BC AblGLKLsw 15 TBTHIGH 0 15 FORMAT "%8.5"
 /begin AXIS_DESCR STD_AXIS kApplI_AbsRackForce_xdu16 FRACK 9 0 30000 FORMAT "%8.2" DEPOSIT ABSOLUTE /end AXIS_DESCR
/end CHARACTERISTIC
/begin CHARACTERISTIC mBci_V4BaseTorque_XAS16_34___A "nominelles Handmoment abhängig von der Zahnstangenkraft bei Geschwindigkeit v4" CURVE 0x15A4E4 AblGLKLsw 15 TBTHIGH 0 15 FORMAT "%8.5"
 /begin AXIS_DESCR STD_AXIS kApplI_AbsRackForce_xdu16 FRACK 9 0 30000 FORMAT "%8.2" DEPOSIT ABSOLUTE /end AXIS_DESCR
/end CHARACTERISTIC
/begin CHARACTERISTIC mBci_V4BaseTorque_XAS16_35___A "nominelles Handmoment abhängig von der Zahnstangenkraft bei Geschwindigkeit v4" CURVE 0x15A50C AblGLKLsw 15 TBTHIGH 0 15 FORMAT "%8.5"
 /begin AXIS_DESCR STD_AXIS kApplI_AbsRackForce_xdu16 FRACK 9 0 30000 FORMAT "%8.2" DEPOSIT ABSOLUTE /end AXIS_DESCR
/end CHARACTERISTIC
/begin CHARACTERISTIC mBci_V5BaseTorque_XAS16_00___A "nominelles Handmoment abhängig von der Zahnstangenkraft bei Geschwindigkeit v5" CURVE 0x15A534 AblGLKLsw 15 TBTHIGH 0 15 FORMAT "%8.5"
 /begin AXIS_DESCR STD_AXIS kApplI_AbsRackForce_xdu16 FRACK 9 0 30000 FORMAT "%8.2" DEPOSIT ABSOLUTE /end AXIS_DESCR
/end CHARACTERISTIC
/begin CHARACTERISTIC mBci_V5BaseTorque_XAS16_01___A "nominelles Handmoment abhängig von der Zahnstangenkraft bei Geschwindigkeit v5" CURVE 0x15A55C AblGLKLsw 15 TBTHIGH 0 15 FORMAT "%8.5"
 /begin AXIS_DESCR STD_AXIS kApplI_AbsRackForce_xdu16 FRACK 9 0 30000 FORMAT "%8.2" DEPOSIT ABSOLUTE /end AXIS_DESCR
/end CHARACTERISTIC
/begin CHARACTERISTIC mBci_V5BaseTorque_XAS16_02___A "nominelles Handmoment abhängig von der Zahnstangenkraft bei Geschwindigkeit v5" CURVE 0x15A584 AblGLKLsw 15 TBTHIGH 0 15 FORMAT "%8.5"
 /begin AXIS_DESCR STD_AXIS kApplI_AbsRackForce_xdu16 FRACK 9 0 30000 FORMAT "%8.2" DEPOSIT ABSOLUTE /end AXIS_DESCR
/end CHARACTERISTIC
/begin CHARACTERISTIC mBci_V5BaseTorque_XAS16_03___A "nominelles Handmoment abhängig von der Zahnstangenkraft bei Geschwindigkeit v5" CURVE 0x15A5AC AblGLKLsw 15 TBTHIGH 0 15 FORMAT "%8.5"
 /begin AXIS_DESCR STD_AXIS kApplI_AbsRackForce_xdu16 FRACK 9 0 30000 FORMAT "%8.2" DEPOSIT ABSOLUTE /end AXIS_DESCR
/end CHARACTERISTIC
/begin CHARACTERISTIC mBci_V5BaseTorque_XAS16_04___A "nominelles Handmoment abhängig von der Zahnstangenkraft bei Geschwindigkeit v5" CURVE 0x15A5D4 AblGLKLsw 15 TBTHIGH 0 15 FORMAT "%8.5"
 /begin AXIS_DESCR STD_AXIS kApplI_AbsRackForce_xdu16 FRACK 9 0 30000 FORMAT "%8.2" DEPOSIT ABSOLUTE /end AXIS_DESCR
/end CHARACTERISTIC
/begin CHARACTERISTIC mBci_V5BaseTorque_XAS16_05___A "nominelles Handmoment abhängig von der Zahnstangenkraft bei Geschwindigkeit v5" CURVE 0x15A5FC AblGLKLsw 15 TBTHIGH 0 15 FORMAT "%8.5"
 /begin AXIS_DESCR STD_AXIS kApplI_AbsRackForce_xdu16 FRACK 9 0 30000 FORMAT "%8.2" DEPOSIT ABSOLUTE /end AXIS_DESCR
/end CHARACTERISTIC
/begin CHARACTERISTIC mBci_V5BaseTorque_XAS16_06___A "nominelles Handmoment abhängig von der Zahnstangenkraft bei Geschwindigkeit v5" CURVE 0x15A624 AblGLKLsw 15 TBTHIGH 0 15 FORMAT "%8.5"
 /begin AXIS_DESCR STD_AXIS kApplI_AbsRackForce_xdu16 FRACK 9 0 30000 FORMAT "%8.2" DEPOSIT ABSOLUTE /end AXIS_DESCR
/end CHARACTERISTIC
/begin CHARACTERISTIC mBci_V5BaseTorque_XAS16_07___A "nominelles Handmoment abhängig von der Zahnstangenkraft bei Geschwindigkeit v5" CURVE 0x15A64C AblGLKLsw 15 TBTHIGH 0 15 FORMAT "%8.5"
 /begin AXIS_DESCR STD_AXIS kApplI_AbsRackForce_xdu16 FRACK 9 0 30000 FORMAT "%8.2" DEPOSIT ABSOLUTE /end AXIS_DESCR
/end CHARACTERISTIC
/begin CHARACTERISTIC mBci_V5BaseTorque_XAS16_08___A "nominelles Handmoment abhängig von der Zahnstangenkraft bei Geschwindigkeit v5" CURVE 0x15A674 AblGLKLsw 15 TBTHIGH 0 15 FORMAT "%8.5"
 /begin AXIS_DESCR STD_AXIS kApplI_AbsRackForce_xdu16 FRACK 9 0 30000 FORMAT "%8.2" DEPOSIT ABSOLUTE /end AXIS_DESCR
/end CHARACTERISTIC
/begin CHARACTERISTIC mBci_V5BaseTorque_XAS16_09___A "nominelles Handmoment abhängig von der Zahnstangenkraft bei Geschwindigkeit v5" CURVE 0x15A69C AblGLKLsw 15 TBTHIGH 0 15 FORMAT "%8.5"
 /begin AXIS_DESCR STD_AXIS kApplI_AbsRackForce_xdu16 FRACK 9 0 30000 FORMAT "%8.2" DEPOSIT ABSOLUTE /end AXIS_DESCR
/end CHARACTERISTIC
/begin CHARACTERISTIC mBci_V5BaseTorque_XAS16_10___A "nominelles Handmoment abhängig von der Zahnstangenkraft bei Geschwindigkeit v5" CURVE 0x15A6C4 AblGLKLsw 15 TBTHIGH 0 15 FORMAT "%8.5"
 /begin AXIS_DESCR STD_AXIS kApplI_AbsRackForce_xdu16 FRACK 9 0 30000 FORMAT "%8.2" DEPOSIT ABSOLUTE /end AXIS_DESCR
/end CHARACTERISTIC
/begin CHARACTERISTIC mBci_V5BaseTorque_XAS16_11___A "nominelles Handmoment abhängig von der Zahnstangenkraft bei Geschwindigkeit v5" CURVE 0x15A6EC AblGLKLsw 15 TBTHIGH 0 15 FORMAT "%8.5"
 /begin AXIS_DESCR STD_AXIS kApplI_AbsRackForce_xdu16 FRACK 9 0 30000 FORMAT "%8.2" DEPOSIT ABSOLUTE /end AXIS_DESCR
/end CHARACTERISTIC
/begin CHARACTERISTIC mBci_V5BaseTorque_XAS16_12___A "nominelles Handmoment abhängig von der Zahnstangenkraft bei Geschwindigkeit v5" CURVE 0x15A714 AblGLKLsw 15 TBTHIGH 0 15 FORMAT "%8.5"
 /begin AXIS_DESCR STD_AXIS kApplI_AbsRackForce_xdu16 FRACK 9 0 30000 FORMAT "%8.2" DEPOSIT ABSOLUTE /end AXIS_DESCR
/end CHARACTERISTIC
/begin CHARACTERISTIC mBci_V5BaseTorque_XAS16_13___A "nominelles Handmoment abhängig von der Zahnstangenkraft bei Geschwindigkeit v5" CURVE 0x15A73C AblGLKLsw 15 TBTHIGH 0 15 FORMAT "%8.5"
 /begin AXIS_DESCR STD_AXIS kApplI_AbsRackForce_xdu16 FRACK 9 0 30000 FORMAT "%8.2" DEPOSIT ABSOLUTE /end AXIS_DESCR
/end CHARACTERISTIC
/begin CHARACTERISTIC mBci_V5BaseTorque_XAS16_14___A "nominelles Handmoment abhängig von der Zahnstangenkraft bei Geschwindigkeit v5" CURVE 0x15A764 AblGLKLsw 15 TBTHIGH 0 15 FORMAT "%8.5"
 /begin AXIS_DESCR STD_AXIS kApplI_AbsRackForce_xdu16 FRACK 9 0 30000 FORMAT "%8.2" DEPOSIT ABSOLUTE /end AXIS_DESCR
/end CHARACTERISTIC
/begin CHARACTERISTIC mBci_V5BaseTorque_XAS16_15___A "nominelles Handmoment abhängig von der Zahnstangenkraft bei Geschwindigkeit v5" CURVE 0x15A78C AblGLKLsw 15 TBTHIGH 0 15 FORMAT "%8.5"
 /begin AXIS_DESCR STD_AXIS kApplI_AbsRackForce_xdu16 FRACK 9 0 30000 FORMAT "%8.2" DEPOSIT ABSOLUTE /end AXIS_DESCR
/end CHARACTERISTIC
/begin CHARACTERISTIC mBci_V5BaseTorque_XAS16_16___A "nominelles Handmoment abhängig von der Zahnstangenkraft bei Geschwindigkeit v5" CURVE 0x15A7B4 AblGLKLsw 15 TBTHIGH 0 15 FORMAT "%8.5"
 /begin AXIS_DESCR STD_AXIS kApplI_AbsRackForce_xdu16 FRACK 9 0 30000 FORMAT "%8.2" DEPOSIT ABSOLUTE /end AXIS_DESCR
/end CHARACTERISTIC
/begin CHARACTERISTIC mBci_V5BaseTorque_XAS16_17___A "nominelles Handmoment abhängig von der Zahnstangenkraft bei Geschwindigkeit v5" CURVE 0x15A7DC AblGLKLsw 15 TBTHIGH 0 15 FORMAT "%8.5"
 /begin AXIS_DESCR STD_AXIS kApplI_AbsRackForce_xdu16 FRACK 9 0 30000 FORMAT "%8.2" DEPOSIT ABSOLUTE /end AXIS_DESCR
/end CHARACTERISTIC
/begin CHARACTERISTIC mBci_V5BaseTorque_XAS16_18___A "nominelles Handmoment abhängig von der Zahnstangenkraft bei Geschwindigkeit v5" CURVE 0x15A804 AblGLKLsw 15 TBTHIGH 0 15 FORMAT "%8.5"
 /begin AXIS_DESCR STD_AXIS kApplI_AbsRackForce_xdu16 FRACK 9 0 30000 FORMAT "%8.2" DEPOSIT ABSOLUTE /end AXIS_DESCR
/end CHARACTERISTIC
/begin CHARACTERISTIC mBci_V5BaseTorque_XAS16_19___A "nominelles Handmoment abhängig von der Zahnstangenkraft bei Geschwindigkeit v5" CURVE 0x15A82C AblGLKLsw 15 TBTHIGH 0 15 FORMAT "%8.5"
 /begin AXIS_DESCR STD_AXIS kApplI_AbsRackForce_xdu16 FRACK 9 0 30000 FORMAT "%8.2" DEPOSIT ABSOLUTE /end AXIS_DESCR
/end CHARACTERISTIC
/begin CHARACTERISTIC mBci_V5BaseTorque_XAS16_20___A "nominelles Handmoment abhängig von der Zahnstangenkraft bei Geschwindigkeit v5" CURVE 0x15A854 AblGLKLsw 15 TBTHIGH 0 15 FORMAT "%8.5"
 /begin AXIS_DESCR STD_AXIS kApplI_AbsRackForce_xdu16 FRACK 9 0 30000 FORMAT "%8.2" DEPOSIT ABSOLUTE /end AXIS_DESCR
/end CHARACTERISTIC
/begin CHARACTERISTIC mBci_V5BaseTorque_XAS16_21___A "nominelles Handmoment abhängig von der Zahnstangenkraft bei Geschwindigkeit v5" CURVE 0x15A87C AblGLKLsw 15 TBTHIGH 0 15 FORMAT "%8.5"
 /begin AXIS_DESCR STD_AXIS kApplI_AbsRackForce_xdu16 FRACK 9 0 30000 FORMAT "%8.2" DEPOSIT ABSOLUTE /end AXIS_DESCR
/end CHARACTERISTIC
/begin CHARACTERISTIC mBci_V5BaseTorque_XAS16_22___A "nominelles Handmoment abhängig von der Zahnstangenkraft bei Geschwindigkeit v5" CURVE 0x15A8A4 AblGLKLsw 15 TBTHIGH 0 15 FORMAT "%8.5"
 /begin AXIS_DESCR STD_AXIS kApplI_AbsRackForce_xdu16 FRACK 9 0 30000 FORMAT "%8.2" DEPOSIT ABSOLUTE /end AXIS_DESCR
/end CHARACTERISTIC
/begin CHARACTERISTIC mBci_V5BaseTorque_XAS16_23___A "nominelles Handmoment abhängig von der Zahnstangenkraft bei Geschwindigkeit v5" CURVE 0x15A8CC AblGLKLsw 15 TBTHIGH 0 15 FORMAT "%8.5"
 /begin AXIS_DESCR STD_AXIS kApplI_AbsRackForce_xdu16 FRACK 9 0 30000 FORMAT "%8.2" DEPOSIT ABSOLUTE /end AXIS_DESCR
/end CHARACTERISTIC
/begin CHARACTERISTIC mBci_V5BaseTorque_XAS16_24___A "nominelles Handmoment abhängig von der Zahnstangenkraft bei Geschwindigkeit v5" CURVE 0x15A8F4 AblGLKLsw 15 TBTHIGH 0 15 FORMAT "%8.5"
 /begin AXIS_DESCR STD_AXIS kApplI_AbsRackForce_xdu16 FRACK 9 0 30000 FORMAT "%8.2" DEPOSIT ABSOLUTE /end AXIS_DESCR
/end CHARACTERISTIC
/begin CHARACTERISTIC mBci_V5BaseTorque_XAS16_25___A "nominelles Handmoment abhängig von der Zahnstangenkraft bei Geschwindigkeit v5" CURVE 0x15A91C AblGLKLsw 15 TBTHIGH 0 15 FORMAT "%8.5"
 /begin AXIS_DESCR STD_AXIS kApplI_AbsRackForce_xdu16 FRACK 9 0 30000 FORMAT "%8.2" DEPOSIT ABSOLUTE /end AXIS_DESCR
/end CHARACTERISTIC
/begin CHARACTERISTIC mBci_V5BaseTorque_XAS16_26___A "nominelles Handmoment abhängig von der Zahnstangenkraft bei Geschwindigkeit v5" CURVE 0x15A944 AblGLKLsw 15 TBTHIGH 0 15 FORMAT "%8.5"
 /begin AXIS_DESCR STD_AXIS kApplI_AbsRackForce_xdu16 FRACK 9 0 30000 FORMAT "%8.2" DEPOSIT ABSOLUTE /end AXIS_DESCR
/end CHARACTERISTIC
/begin CHARACTERISTIC mBci_V5BaseTorque_XAS16_27___A "nominelles Handmoment abhängig von der Zahnstangenkraft bei Geschwindigkeit v5" CURVE 0x15A96C AblGLKLsw 15 TBTHIGH 0 15 FORMAT "%8.5"
 /begin AXIS_DESCR STD_AXIS kApplI_AbsRackForce_xdu16 FRACK 9 0 30000 FORMAT "%8.2" DEPOSIT ABSOLUTE /end AXIS_DESCR
/end CHARACTERISTIC
/begin CHARACTERISTIC mBci_V5BaseTorque_XAS16_28___A "nominelles Handmoment abhängig von der Zahnstangenkraft bei Geschwindigkeit v5" CURVE 0x15A994 AblGLKLsw 15 TBTHIGH 0 15 FORMAT "%8.5"
 /begin AXIS_DESCR STD_AXIS kApplI_AbsRackForce_xdu16 FRACK 9 0 30000 FORMAT "%8.2" DEPOSIT ABSOLUTE /end AXIS_DESCR
/end CHARACTERISTIC
/begin CHARACTERISTIC mBci_V5BaseTorque_XAS16_29___A "nominelles Handmoment abhängig von der Zahnstangenkraft bei Geschwindigkeit v5" CURVE 0x15A9BC AblGLKLsw 15 TBTHIGH 0 15 FORMAT "%8.5"
 /begin AXIS_DESCR STD_AXIS kApplI_AbsRackForce_xdu16 FRACK 9 0 30000 FORMAT "%8.2" DEPOSIT ABSOLUTE /end AXIS_DESCR
/end CHARACTERISTIC
/begin CHARACTERISTIC mBci_V5BaseTorque_XAS16_30___A "nominelles Handmoment abhängig von der Zahnstangenkraft bei Geschwindigkeit v5" CURVE 0x15A9E4 AblGLKLsw 15 TBTHIGH 0 15 FORMAT "%8.5"
 /begin AXIS_DESCR STD_AXIS kApplI_AbsRackForce_xdu16 FRACK 9 0 30000 FORMAT "%8.2" DEPOSIT ABSOLUTE /end AXIS_DESCR
/end CHARACTERISTIC
/begin CHARACTERISTIC mBci_V5BaseTorque_XAS16_31___A "nominelles Handmoment abhängig von der Zahnstangenkraft bei Geschwindigkeit v5" CURVE 0x15AA0C AblGLKLsw 15 TBTHIGH 0 15 FORMAT "%8.5"
 /begin AXIS_DESCR STD_AXIS kApplI_AbsRackForce_xdu16 FRACK 9 0 30000 FORMAT "%8.2" DEPOSIT ABSOLUTE /end AXIS_DESCR
/end CHARACTERISTIC
/begin CHARACTERISTIC mBci_V5BaseTorque_XAS16_32___A "nominelles Handmoment abhängig von der Zahnstangenkraft bei Geschwindigkeit v5" CURVE 0x15AA34 AblGLKLsw 15 TBTHIGH 0 15 FORMAT "%8.5"
 /begin AXIS_DESCR STD_AXIS kApplI_AbsRackForce_xdu16 FRACK 9 0 30000 FORMAT "%8.2" DEPOSIT ABSOLUTE /end AXIS_DESCR
/end CHARACTERISTIC
/begin CHARACTERISTIC mBci_V5BaseTorque_XAS16_33___A "nominelles Handmoment abhängig von der Zahnstangenkraft bei Geschwindigkeit v5" CURVE 0x15AA5C AblGLKLsw 15 TBTHIGH 0 15 FORMAT "%8.5"
 /begin AXIS_DESCR STD_AXIS kApplI_AbsRackForce_xdu16 FRACK 9 0 30000 FORMAT "%8.2" DEPOSIT ABSOLUTE /end AXIS_DESCR
/end CHARACTERISTIC
/begin CHARACTERISTIC mBci_V5BaseTorque_XAS16_34___A "nominelles Handmoment abhängig von der Zahnstangenkraft bei Geschwindigkeit v5" CURVE 0x15AA84 AblGLKLsw 15 TBTHIGH 0 15 FORMAT "%8.5"
 /begin AXIS_DESCR STD_AXIS kApplI_AbsRackForce_xdu16 FRACK 9 0 30000 FORMAT "%8.2" DEPOSIT ABSOLUTE /end AXIS_DESCR
/end CHARACTERISTIC
/begin CHARACTERISTIC mBci_V5BaseTorque_XAS16_35___A "nominelles Handmoment abhängig von der Zahnstangenkraft bei Geschwindigkeit v5" CURVE 0x15AAAC AblGLKLsw 15 TBTHIGH 0 15 FORMAT "%8.5"
 /begin AXIS_DESCR STD_AXIS kApplI_AbsRackForce_xdu16 FRACK 9 0 30000 FORMAT "%8.2" DEPOSIT ABSOLUTE /end AXIS_DESCR
/end CHARACTERISTIC
/begin CHARACTERISTIC mBci_V6BaseTorque_XAS16_00___A "nominelles Handmoment abhängig von der Zahnstangenkraft bei Geschwindigkeit v6" CURVE 0x15AAD4 AblGLKLsw 15 TBTHIGH 0 15 FORMAT "%8.5"
 /begin AXIS_DESCR STD_AXIS kApplI_AbsRackForce_xdu16 FRACK 9 0 30000 FORMAT "%8.2" DEPOSIT ABSOLUTE /end AXIS_DESCR
/end CHARACTERISTIC
/begin CHARACTERISTIC mBci_V6BaseTorque_XAS16_01___A "nominelles Handmoment abhängig von der Zahnstangenkraft bei Geschwindigkeit v6" CURVE 0x15AAFC AblGLKLsw 15 TBTHIGH 0 15 FORMAT "%8.5"
 /begin AXIS_DESCR STD_AXIS kApplI_AbsRackForce_xdu16 FRACK 9 0 30000 FORMAT "%8.2" DEPOSIT ABSOLUTE /end AXIS_DESCR
/end CHARACTERISTIC
/begin CHARACTERISTIC mBci_V6BaseTorque_XAS16_02___A "nominelles Handmoment abhängig von der Zahnstangenkraft bei Geschwindigkeit v6" CURVE 0x15AB24 AblGLKLsw 15 TBTHIGH 0 15 FORMAT "%8.5"
 /begin AXIS_DESCR STD_AXIS kApplI_AbsRackForce_xdu16 FRACK 9 0 30000 FORMAT "%8.2" DEPOSIT ABSOLUTE /end AXIS_DESCR
/end CHARACTERISTIC
/begin CHARACTERISTIC mBci_V6BaseTorque_XAS16_03___A "nominelles Handmoment abhängig von der Zahnstangenkraft bei Geschwindigkeit v6" CURVE 0x15AB4C AblGLKLsw 15 TBTHIGH 0 15 FORMAT "%8.5"
 /begin AXIS_DESCR STD_AXIS kApplI_AbsRackForce_xdu16 FRACK 9 0 30000 FORMAT "%8.2" DEPOSIT ABSOLUTE /end AXIS_DESCR
/end CHARACTERISTIC
/begin CHARACTERISTIC mBci_V6BaseTorque_XAS16_04___A "nominelles Handmoment abhängig von der Zahnstangenkraft bei Geschwindigkeit v6" CURVE 0x15AB74 AblGLKLsw 15 TBTHIGH 0 15 FORMAT "%8.5"
 /begin AXIS_DESCR STD_AXIS kApplI_AbsRackForce_xdu16 FRACK 9 0 30000 FORMAT "%8.2" DEPOSIT ABSOLUTE /end AXIS_DESCR
/end CHARACTERISTIC
/begin CHARACTERISTIC mBci_V6BaseTorque_XAS16_05___A "nominelles Handmoment abhängig von der Zahnstangenkraft bei Geschwindigkeit v6" CURVE 0x15AB9C AblGLKLsw 15 TBTHIGH 0 15 FORMAT "%8.5"
 /begin AXIS_DESCR STD_AXIS kApplI_AbsRackForce_xdu16 FRACK 9 0 30000 FORMAT "%8.2" DEPOSIT ABSOLUTE /end AXIS_DESCR
/end CHARACTERISTIC
/begin CHARACTERISTIC mBci_V6BaseTorque_XAS16_06___A "nominelles Handmoment abhängig von der Zahnstangenkraft bei Geschwindigkeit v6" CURVE 0x15ABC4 AblGLKLsw 15 TBTHIGH 0 15 FORMAT "%8.5"
 /begin AXIS_DESCR STD_AXIS kApplI_AbsRackForce_xdu16 FRACK 9 0 30000 FORMAT "%8.2" DEPOSIT ABSOLUTE /end AXIS_DESCR
/end CHARACTERISTIC
/begin CHARACTERISTIC mBci_V6BaseTorque_XAS16_07___A "nominelles Handmoment abhängig von der Zahnstangenkraft bei Geschwindigkeit v6" CURVE 0x15ABEC AblGLKLsw 15 TBTHIGH 0 15 FORMAT "%8.5"
 /begin AXIS_DESCR STD_AXIS kApplI_AbsRackForce_xdu16 FRACK 9 0 30000 FORMAT "%8.2" DEPOSIT ABSOLUTE /end AXIS_DESCR
/end CHARACTERISTIC
/begin CHARACTERISTIC mBci_V6BaseTorque_XAS16_08___A "nominelles Handmoment abhängig von der Zahnstangenkraft bei Geschwindigkeit v6" CURVE 0x15AC14 AblGLKLsw 15 TBTHIGH 0 15 FORMAT "%8.5"
 /begin AXIS_DESCR STD_AXIS kApplI_AbsRackForce_xdu16 FRACK 9 0 30000 FORMAT "%8.2" DEPOSIT ABSOLUTE /end AXIS_DESCR
/end CHARACTERISTIC
/begin CHARACTERISTIC mBci_V6BaseTorque_XAS16_09___A "nominelles Handmoment abhängig von der Zahnstangenkraft bei Geschwindigkeit v6" CURVE 0x15AC3C AblGLKLsw 15 TBTHIGH 0 15 FORMAT "%8.5"
 /begin AXIS_DESCR STD_AXIS kApplI_AbsRackForce_xdu16 FRACK 9 0 30000 FORMAT "%8.2" DEPOSIT ABSOLUTE /end AXIS_DESCR
/end CHARACTERISTIC
/begin CHARACTERISTIC mBci_V6BaseTorque_XAS16_10___A "nominelles Handmoment abhängig von der Zahnstangenkraft bei Geschwindigkeit v6" CURVE 0x15AC64 AblGLKLsw 15 TBTHIGH 0 15 FORMAT "%8.5"
 /begin AXIS_DESCR STD_AXIS kApplI_AbsRackForce_xdu16 FRACK 9 0 30000 FORMAT "%8.2" DEPOSIT ABSOLUTE /end AXIS_DESCR
/end CHARACTERISTIC
/begin CHARACTERISTIC mBci_V6BaseTorque_XAS16_11___A "nominelles Handmoment abhängig von der Zahnstangenkraft bei Geschwindigkeit v6" CURVE 0x15AC8C AblGLKLsw 15 TBTHIGH 0 15 FORMAT "%8.5"
 /begin AXIS_DESCR STD_AXIS kApplI_AbsRackForce_xdu16 FRACK 9 0 30000 FORMAT "%8.2" DEPOSIT ABSOLUTE /end AXIS_DESCR
/end CHARACTERISTIC
/begin CHARACTERISTIC mBci_V6BaseTorque_XAS16_12___A "nominelles Handmoment abhängig von der Zahnstangenkraft bei Geschwindigkeit v6" CURVE 0x15ACB4 AblGLKLsw 15 TBTHIGH 0 15 FORMAT "%8.5"
 /begin AXIS_DESCR STD_AXIS kApplI_AbsRackForce_xdu16 FRACK 9 0 30000 FORMAT "%8.2" DEPOSIT ABSOLUTE /end AXIS_DESCR
/end CHARACTERISTIC
/begin CHARACTERISTIC mBci_V6BaseTorque_XAS16_13___A "nominelles Handmoment abhängig von der Zahnstangenkraft bei Geschwindigkeit v6" CURVE 0x15ACDC AblGLKLsw 15 TBTHIGH 0 15 FORMAT "%8.5"
 /begin AXIS_DESCR STD_AXIS kApplI_AbsRackForce_xdu16 FRACK 9 0 30000 FORMAT "%8.2" DEPOSIT ABSOLUTE /end AXIS_DESCR
/end CHARACTERISTIC
/begin CHARACTERISTIC mBci_V6BaseTorque_XAS16_14___A "nominelles Handmoment abhängig von der Zahnstangenkraft bei Geschwindigkeit v6" CURVE 0x15AD04 AblGLKLsw 15 TBTHIGH 0 15 FORMAT "%8.5"
 /begin AXIS_DESCR STD_AXIS kApplI_AbsRackForce_xdu16 FRACK 9 0 30000 FORMAT "%8.2" DEPOSIT ABSOLUTE /end AXIS_DESCR
/end CHARACTERISTIC
/begin CHARACTERISTIC mBci_V6BaseTorque_XAS16_15___A "nominelles Handmoment abhängig von der Zahnstangenkraft bei Geschwindigkeit v6" CURVE 0x15AD2C AblGLKLsw 15 TBTHIGH 0 15 FORMAT "%8.5"
 /begin AXIS_DESCR STD_AXIS kApplI_AbsRackForce_xdu16 FRACK 9 0 30000 FORMAT "%8.2" DEPOSIT ABSOLUTE /end AXIS_DESCR
/end CHARACTERISTIC
/begin CHARACTERISTIC mBci_V6BaseTorque_XAS16_16___A "nominelles Handmoment abhängig von der Zahnstangenkraft bei Geschwindigkeit v6" CURVE 0x15AD54 AblGLKLsw 15 TBTHIGH 0 15 FORMAT "%8.5"
 /begin AXIS_DESCR STD_AXIS kApplI_AbsRackForce_xdu16 FRACK 9 0 30000 FORMAT "%8.2" DEPOSIT ABSOLUTE /end AXIS_DESCR
/end CHARACTERISTIC
/begin CHARACTERISTIC mBci_V6BaseTorque_XAS16_17___A "nominelles Handmoment abhängig von der Zahnstangenkraft bei Geschwindigkeit v6" CURVE 0x15AD7C AblGLKLsw 15 TBTHIGH 0 15 FORMAT "%8.5"
 /begin AXIS_DESCR STD_AXIS kApplI_AbsRackForce_xdu16 FRACK 9 0 30000 FORMAT "%8.2" DEPOSIT ABSOLUTE /end AXIS_DESCR
/end CHARACTERISTIC
/begin CHARACTERISTIC mBci_V6BaseTorque_XAS16_18___A "nominelles Handmoment abhängig von der Zahnstangenkraft bei Geschwindigkeit v6" CURVE 0x15ADA4 AblGLKLsw 15 TBTHIGH 0 15 FORMAT "%8.5"
 /begin AXIS_DESCR STD_AXIS kApplI_AbsRackForce_xdu16 FRACK 9 0 30000 FORMAT "%8.2" DEPOSIT ABSOLUTE /end AXIS_DESCR
/end CHARACTERISTIC
/begin CHARACTERISTIC mBci_V6BaseTorque_XAS16_19___A "nominelles Handmoment abhängig von der Zahnstangenkraft bei Geschwindigkeit v6" CURVE 0x15ADCC AblGLKLsw 15 TBTHIGH 0 15 FORMAT "%8.5"
 /begin AXIS_DESCR STD_AXIS kApplI_AbsRackForce_xdu16 FRACK 9 0 30000 FORMAT "%8.2" DEPOSIT ABSOLUTE /end AXIS_DESCR
/end CHARACTERISTIC
/begin CHARACTERISTIC mBci_V6BaseTorque_XAS16_20___A "nominelles Handmoment abhängig von der Zahnstangenkraft bei Geschwindigkeit v6" CURVE 0x15ADF4 AblGLKLsw 15 TBTHIGH 0 15 FORMAT "%8.5"
 /begin AXIS_DESCR STD_AXIS kApplI_AbsRackForce_xdu16 FRACK 9 0 30000 FORMAT "%8.2" DEPOSIT ABSOLUTE /end AXIS_DESCR
/end CHARACTERISTIC
/begin CHARACTERISTIC mBci_V6BaseTorque_XAS16_21___A "nominelles Handmoment abhängig von der Zahnstangenkraft bei Geschwindigkeit v6" CURVE 0x15AE1C AblGLKLsw 15 TBTHIGH 0 15 FORMAT "%8.5"
 /begin AXIS_DESCR STD_AXIS kApplI_AbsRackForce_xdu16 FRACK 9 0 30000 FORMAT "%8.2" DEPOSIT ABSOLUTE /end AXIS_DESCR
/end CHARACTERISTIC
/begin CHARACTERISTIC mBci_V6BaseTorque_XAS16_22___A "nominelles Handmoment abhängig von der Zahnstangenkraft bei Geschwindigkeit v6" CURVE 0x15AE44 AblGLKLsw 15 TBTHIGH 0 15 FORMAT "%8.5"
 /begin AXIS_DESCR STD_AXIS kApplI_AbsRackForce_xdu16 FRACK 9 0 30000 FORMAT "%8.2" DEPOSIT ABSOLUTE /end AXIS_DESCR
/end CHARACTERISTIC
/begin CHARACTERISTIC mBci_V6BaseTorque_XAS16_23___A "nominelles Handmoment abhängig von der Zahnstangenkraft bei Geschwindigkeit v6" CURVE 0x15AE6C AblGLKLsw 15 TBTHIGH 0 15 FORMAT "%8.5"
 /begin AXIS_DESCR STD_AXIS kApplI_AbsRackForce_xdu16 FRACK 9 0 30000 FORMAT "%8.2" DEPOSIT ABSOLUTE /end AXIS_DESCR
/end CHARACTERISTIC
/begin CHARACTERISTIC mBci_V6BaseTorque_XAS16_24___A "nominelles Handmoment abhängig von der Zahnstangenkraft bei Geschwindigkeit v6" CURVE 0x15AE94 AblGLKLsw 15 TBTHIGH 0 15 FORMAT "%8.5"
 /begin AXIS_DESCR STD_AXIS kApplI_AbsRackForce_xdu16 FRACK 9 0 30000 FORMAT "%8.2" DEPOSIT ABSOLUTE /end AXIS_DESCR
/end CHARACTERISTIC
/begin CHARACTERISTIC mBci_V6BaseTorque_XAS16_25___A "nominelles Handmoment abhängig von der Zahnstangenkraft bei Geschwindigkeit v6" CURVE 0x15AEBC AblGLKLsw 15 TBTHIGH 0 15 FORMAT "%8.5"
 /begin AXIS_DESCR STD_AXIS kApplI_AbsRackForce_xdu16 FRACK 9 0 30000 FORMAT "%8.2" DEPOSIT ABSOLUTE /end AXIS_DESCR
/end CHARACTERISTIC
/begin CHARACTERISTIC mBci_V6BaseTorque_XAS16_26___A "nominelles Handmoment abhängig von der Zahnstangenkraft bei Geschwindigkeit v6" CURVE 0x15AEE4 AblGLKLsw 15 TBTHIGH 0 15 FORMAT "%8.5"
 /begin AXIS_DESCR STD_AXIS kApplI_AbsRackForce_xdu16 FRACK 9 0 30000 FORMAT "%8.2" DEPOSIT ABSOLUTE /end AXIS_DESCR
/end CHARACTERISTIC
/begin CHARACTERISTIC mBci_V6BaseTorque_XAS16_27___A "nominelles Handmoment abhängig von der Zahnstangenkraft bei Geschwindigkeit v6" CURVE 0x15AF0C AblGLKLsw 15 TBTHIGH 0 15 FORMAT "%8.5"
 /begin AXIS_DESCR STD_AXIS kApplI_AbsRackForce_xdu16 FRACK 9 0 30000 FORMAT "%8.2" DEPOSIT ABSOLUTE /end AXIS_DESCR
/end CHARACTERISTIC
/begin CHARACTERISTIC mBci_V6BaseTorque_XAS16_28___A "nominelles Handmoment abhängig von der Zahnstangenkraft bei Geschwindigkeit v6" CURVE 0x15AF34 AblGLKLsw 15 TBTHIGH 0 15 FORMAT "%8.5"
 /begin AXIS_DESCR STD_AXIS kApplI_AbsRackForce_xdu16 FRACK 9 0 30000 FORMAT "%8.2" DEPOSIT ABSOLUTE /end AXIS_DESCR
/end CHARACTERISTIC
/begin CHARACTERISTIC mBci_V6BaseTorque_XAS16_29___A "nominelles Handmoment abhängig von der Zahnstangenkraft bei Geschwindigkeit v6" CURVE 0x15AF5C AblGLKLsw 15 TBTHIGH 0 15 FORMAT "%8.5"
 /begin AXIS_DESCR STD_AXIS kApplI_AbsRackForce_xdu16 FRACK 9 0 30000 FORMAT "%8.2" DEPOSIT ABSOLUTE /end AXIS_DESCR
/end CHARACTERISTIC
/begin CHARACTERISTIC mBci_V6BaseTorque_XAS16_30___A "nominelles Handmoment abhängig von der Zahnstangenkraft bei Geschwindigkeit v6" CURVE 0x15AF84 AblGLKLsw 15 TBTHIGH 0 15 FORMAT "%8.5"
 /begin AXIS_DESCR STD_AXIS kApplI_AbsRackForce_xdu16 FRACK 9 0 30000 FORMAT "%8.2" DEPOSIT ABSOLUTE /end AXIS_DESCR
/end CHARACTERISTIC
/begin CHARACTERISTIC mBci_V6BaseTorque_XAS16_31___A "nominelles Handmoment abhängig von der Zahnstangenkraft bei Geschwindigkeit v6" CURVE 0x15AFAC AblGLKLsw 15 TBTHIGH 0 15 FORMAT "%8.5"
 /begin AXIS_DESCR STD_AXIS kApplI_AbsRackForce_xdu16 FRACK 9 0 30000 FORMAT "%8.2" DEPOSIT ABSOLUTE /end AXIS_DESCR
/end CHARACTERISTIC
/begin CHARACTERISTIC mBci_V6BaseTorque_XAS16_32___A "nominelles Handmoment abhängig von der Zahnstangenkraft bei Geschwindigkeit v6" CURVE 0x15AFD4 AblGLKLsw 15 TBTHIGH 0 15 FORMAT "%8.5"
 /begin AXIS_DESCR STD_AXIS kApplI_AbsRackForce_xdu16 FRACK 9 0 30000 FORMAT "%8.2" DEPOSIT ABSOLUTE /end AXIS_DESCR
/end CHARACTERISTIC
/begin CHARACTERISTIC mBci_V6BaseTorque_XAS16_33___A "nominelles Handmoment abhängig von der Zahnstangenkraft bei Geschwindigkeit v6" CURVE 0x15AFFC AblGLKLsw 15 TBTHIGH 0 15 FORMAT "%8.5"
 /begin AXIS_DESCR STD_AXIS kApplI_AbsRackForce_xdu16 FRACK 9 0 30000 FORMAT "%8.2" DEPOSIT ABSOLUTE /end AXIS_DESCR
/end CHARACTERISTIC
/begin CHARACTERISTIC mBci_V6BaseTorque_XAS16_34___A "nominelles Handmoment abhängig von der Zahnstangenkraft bei Geschwindigkeit v6" CURVE 0x15B024 AblGLKLsw 15 TBTHIGH 0 15 FORMAT "%8.5"
 /begin AXIS_DESCR STD_AXIS kApplI_AbsRackForce_xdu16 FRACK 9 0 30000 FORMAT "%8.2" DEPOSIT ABSOLUTE /end AXIS_DESCR
/end CHARACTERISTIC
/begin CHARACTERISTIC mBci_V6BaseTorque_XAS16_35___A "nominelles Handmoment abhängig von der Zahnstangenkraft bei Geschwindigkeit v6" CURVE 0x15B04C AblGLKLsw 15 TBTHIGH 0 15 FORMAT "%8.5"
 /begin AXIS_DESCR STD_AXIS kApplI_AbsRackForce_xdu16 FRACK 9 0 30000 FORMAT "%8.2" DEPOSIT ABSOLUTE /end AXIS_DESCR
/end CHARACTERISTIC
/begin CHARACTERISTIC mBsd_MaxSafetyMotorTorq_XDU16 "Max. Motormoment von Seiten Sicherheit" VALUE 0x1505AC AblGLKWuw 1 MMOT 0 1 FORMAT "%8.6" /end CHARACTERISTIC
/begin CHARACTERISTIC mBsd_TBTDeadband_XDU16 "Totband für Richtungsänderung für Motor Drehmoment" VALUE 0x1505AE AblGLKWuw 0.5 MMOT 0 0.5 FORMAT "%9.7" /end CHARACTERISTIC
/begin CHARACTERISTIC mBsd_VibrationTorque_XDU16 "Motormoment zum Vibrieren" VALUE 0x1505B0 AblGLKWuw 1 MMOT 0 1 FORMAT "%8.6" /end CHARACTERISTIC
/begin CHARACTERISTIC sAutParkCtrl_FctCoCtrlStateTest_XDU8 "FctCoCtrlState test for btc" VALUE 0x150B00 AblGLKWub 10 ZU0 0 10 FORMAT "%5.2" /end CHARACTERISTIC
/begin CHARACTERISTIC tArmI_ComSyncTimeout_XDU16 "" VALUE 0x150714 AblGLKWuw 300 TIMMS 0 300 FORMAT "%8.4" /end CHARACTERISTIC
/begin CHARACTERISTIC tArmI_HwLibFinishedTimeout_XDU16 "" VALUE 0x150716 AblGLKWuw 6000 TIMMS 0 6000 FORMAT "%8.3" /end CHARACTERISTIC
/begin CHARACTERISTIC tArmI_PollToOffTimeout_XDU16 "" VALUE 0x150718 AblGLKWuw 6000 TIMMS 0 6000 FORMAT "%8.3" /end CHARACTERISTIC
/begin CHARACTERISTIC tArmI_ProductionProcessingTimeout_XDU16 "" VALUE 0x15071A AblGLKWuw 6000 TIMMS 0 6000 FORMAT "%8.3" /end CHARACTERISTIC
/begin CHARACTERISTIC tArmI_ShutdownResyncTimeout_XDU16 "" VALUE 0x15071C AblGLKWuw 300 TIMMS 0 300 FORMAT "%8.4" /end CHARACTERISTIC
/begin CHARACTERISTIC tArmI_UartComSyncTimeout_XDU16 "" VALUE 0x15071E AblGLKWuw 3000 TIMMS 0 3000 FORMAT "%8.3" /end CHARACTERISTIC
/begin CHARACTERISTIC tArmI_WriteAllTimeout_XDU16 "" VALUE 0x150720 AblGLKWuw 1000 TIMMS 0 1000 FORMAT "%8.3" /end CHARACTERISTIC
/begin CHARACTERISTIC tAsmI_ApplicationInit_TimeOut_XDU16 "Time-out zeit für ApplicationInit state" VALUE 0x150722 AblGLKWuw 600 TIMS 0 600 /end CHARACTERISTIC
/begin CHARACTERISTIC tAsmI_OscillationMeasureTime_XDU16 "Messzeit in der die Heilungen gezählt werden sollen um eine Oszillation zu erkennen. Wichtig zur Vermeidung von Oscillating Assist." VALUE 0x150724 AblGLKWuw 5000 TIMMS 0 5000 FORMAT "%8.3" /end CHARACTERISTIC
/begin CHARACTERISTIC tAssCtrl_NoAssist_TimeOut_XDU16 "Time-out Zeit für Transition nach ReadyForPostRun" VALUE 0x150726 AblGLKWuw 600 TIMS 0 600 /end CHARACTERISTIC
/begin CHARACTERISTIC tAutParkCtrl_AngleDiffTooHighSwOTime_XDU16 "das Zeitlimit fÃ¼r die Differenz zwischen gewÃ¼nschtem Winkel und aktuellem Winkel auÃŸerhalb des Bereichs  " VALUE 0x150728 AblGLKWuw 980 TIMMS 20 1000 FORMAT "%8.3" /end CHARACTERISTIC
/begin CHARACTERISTIC tAutParkCtrl_CheckHandsOnSwOffTime_XDU16 "detection time for HandsOn" VALUE 0x15072A AblGLKWuw 980 TIMMS 20 1000 FORMAT "%8.3" /end CHARACTERISTIC
/begin CHARACTERISTIC tAutParkCtrl_CycleTimeController_XDU8 "Cycle time of controller function call" VALUE 0x150B21 AblGLKWub 9 TIMMS 1 10 FORMAT "%5.2" /end CHARACTERISTIC
/begin CHARACTERISTIC tAutParkCtrl_CycleTimeControlVariable_XDU8 "Cycle time of updating control variable (from bus) (shall be greater or equal than tAutParkCtrl_CycleTimeController_XDU8)" VALUE 0x150B22 AblGLKWub 240 TIMMS 10 250 FORMAT "%5.1" /end CHARACTERISTIC
/begin CHARACTERISTIC tAutParkCtrl_CycleTime_XDU8 "APC Zykluszeit [ms] (fÃ¼r Hands-On-Ãœberwachung)" VALUE 0x150B23 AblGLKWub 99 TIMMS 1 100 FORMAT "%5.1" /end CHARACTERISTIC
/begin CHARACTERISTIC tAutParkCtrl_EpsMaxRespondTime_XDU16 "das Zeitlimit fÃ¼r PAS_SteeringCtrlReq, feedback zu geben  " VALUE 0x15072C AblGLKWuw 9980 TIMMS 20 10000 FORMAT "%8.2" /end CHARACTERISTIC
/begin CHARACTERISTIC tAutParkCtrl_HandsOffSwTime_XDU16 "Erkennungzeit fÃ¼r Hands-Off-Ãœberwachung" VALUE 0x15072E AblGLKWuw 990 TIMMS 10 1000 FORMAT "%8.3" /end CHARACTERISTIC
/begin CHARACTERISTIC tAutParkCtrl_HandsOnSwTime2Active_XDU16 "Erkennungzeit fÃ¼r Hands-Off-Ãœberwachung" VALUE 0x150730 AblGLKWuw 980 TIMMS 20 1000 FORMAT "%8.3" /end CHARACTERISTIC
/begin CHARACTERISTIC tAutParkCtrl_HandsOnSwTime_XDU16 "Erkennungzeit fÃ¼r Hands-Off-Ãœberwachung" VALUE 0x150732 AblGLKWuw 980 TIMMS 20 1000 FORMAT "%8.3" /end CHARACTERISTIC
/begin CHARACTERISTIC tAutParkCtrl_OverAgGridCheckTime_XDU16 " Max allowed time of  over desiered angle gradient" VALUE 0x150734 AblGLKWuw 90 SAS_8 10 100 FORMAT "%8.4" /end CHARACTERISTIC
/begin CHARACTERISTIC tAutParkCtrl_ReqStsTimeOut_XDU16 "Erkennungzeit fÃ¼r Hands-On-Ãœberwachung" VALUE 0x150736 AblGLKWuw 9900 TIMMS 100 10000 FORMAT "%8.2" /end CHARACTERISTIC
/begin CHARACTERISTIC tBatVoltMon_HighVoltageValueLeft_XDU16 "Zeitbedingung bis Überspannung nicht mehr aktiv" VALUE 0x150738 AblGLKWuw 60 TIMS 0 60 FORMAT "%6.3" /end CHARACTERISTIC
/begin CHARACTERISTIC tBatVoltMon_HighVoltageValueReached_XDU16 "Zeitbedingung bis Überspannung aktiv" VALUE 0x15073A AblGLKWuw 60 TIMS 0 60 FORMAT "%6.3" /end CHARACTERISTIC
/begin CHARACTERISTIC tBatVoltMon_LowVoltageValueLeft_XDU16 "Zeitbedingung bis Unterspannung nicht mehr aktiv" VALUE 0x15073C AblGLKWuw 60 TIMS 0 60 FORMAT "%6.3" /end CHARACTERISTIC
/begin CHARACTERISTIC tBatVoltMon_LowVoltageValueReached_XDU16 "Zeitbedingung bis Unterspannung aktiv" VALUE 0x15073E AblGLKWuw 100 TIMS 0 100 /end CHARACTERISTIC
/begin CHARACTERISTIC tBatVoltMon_NormalVoltageThreshold_XDU16 "" VALUE 0x150740 AblGLKWuw 60 TIMS 0 60 FORMAT "%6.3" /end CHARACTERISTIC
/begin CHARACTERISTIC tBsd_MaxTimeTorqueActive_XDU16 "max time torque active:this time period is for a single wave, and depending on the value of zBsd_MaxRampUpCycles_XDU8, the number of waves will change" VALUE 0x150742 AblGLKWuw 5998 TIMMS 2 6000 FORMAT "%8.3" /end CHARACTERISTIC
/begin CHARACTERISTIC tBsd_StateCycletimer_XDU8 "Cycle Time of server call" VALUE 0x150B24 AblGLKWub 99 ZU0 1 100 FORMAT "%5.1" /end CHARACTERISTIC
/begin CHARACTERISTIC uBatVoltMon_HighVoltageValueLeft_XDU16 "Grenzwert Überspannungsschwelle verlassen" VALUE 0x150802 AblGLKWuw 30 U64V 0 30 FORMAT "%8.5" /end CHARACTERISTIC
/begin CHARACTERISTIC uBatVoltMon_HighVoltageValueReached_XDU16 "Grenzwert Überspannungsschwelle erreicht" VALUE 0x150804 AblGLKWuw 30 U64V 0 30 FORMAT "%8.5" /end CHARACTERISTIC
/begin CHARACTERISTIC uBatVoltMon_LowVoltageValueLeft_XDU16 "Grenzwert Unterspannungsschwelle verlassen" VALUE 0x150806 AblGLKWuw 30 U64V 0 30 FORMAT "%8.5" /end CHARACTERISTIC
/begin CHARACTERISTIC uBatVoltMon_LowVoltageValueReached_XDU16 "Grenzwert Unterspannungsschwelle erreicht" VALUE 0x150808 AblGLKWuw 30 U64V 0 30 FORMAT "%8.5" /end CHARACTERISTIC
/begin CHARACTERISTIC vAutParkCtrl_APAStandStillVehicleSpeed_XDU16 "Max allowed Vehicle speed to active state" VALUE 0x150828 AblGLKWuw 10 VFZHIGH 0 10 FORMAT "%8.5" /end CHARACTERISTIC
/begin CHARACTERISTIC vAutParkCtrl_DeadBandRackSpeed_XDU16 "dead band threshold of nominal rack speed" VALUE 0x15082A AblGLKWuw 100 RACKSPEED128 0 100 FORMAT "%8.4" /end CHARACTERISTIC
/begin CHARACTERISTIC vAutParkCtrl_MaxAPAVehicleSpeed_XDU16 "maximale Geschwindigkeit fÃ¼r APA" VALUE 0x15082C AblGLKWuw 15 VFZHIGH 0 15 FORMAT "%8.5" /end CHARACTERISTIC
/begin CHARACTERISTIC vAutParkCtrl_MaxGradRackSpeed_XDU16 "maximum allowed desired rack speed gradient" VALUE 0x15082E AblGLKWuw 10 RACKSPEED128 0 10 FORMAT "%8.5" /end CHARACTERISTIC
/begin CHARACTERISTIC vAutParkCtrl_MaxRackSpeed_XDU16 "maximum allowed desired rack speed" VALUE 0x150830 AblGLKWuw 200 RACKSPEED128 0 200 FORMAT "%8.4" /end CHARACTERISTIC
/begin CHARACTERISTIC vAutParkCtrl_SafetyLimitMaxVehicleSpeed_XDU16 "safety limit of maximum allowed vehicle speed" VALUE 0x150832 AblGLKWuw 10 VFZHIGH 0 10 FORMAT "%8.5" /end CHARACTERISTIC
/begin CHARACTERISTIC vBsd_LowVehSpeed_XDU16 "Low vehicle speed for stopping TorqueGeneration" VALUE 0x150836 AblGLKWuw 10 VFZHIGH 0 10 FORMAT "%8.5" /end CHARACTERISTIC
/begin CHARACTERISTIC vBsd_VehicleSpeedForBSDActivation_XDU16 "min Vehicle Speed to start detectiont" VALUE 0x150838 AblGLKWuw 100 VFZHIGH 0 100 FORMAT "%8.4" /end CHARACTERISTIC
/begin CHARACTERISTIC wAutParkCtrl_MaxAngleDiff_XDU16 "Maximum erlaubte gewÃ¼nschten Winkelantrag(Winkelwunsch) von APA" VALUE 0x1508D2 AblGLKWuw 500 SA_10 100 600 FORMAT "%8.4" /end CHARACTERISTIC
/begin CHARACTERISTIC wAutParkCtrl_MaxRequestAngle_XDU16 "Maximum erlaubte gewÃ¼nschten Winkelantrag(Winkelwunsch) von APA" VALUE 0x1508D4 AblGLKWuw 500 SA_10 100 600 FORMAT "%8.4" /end CHARACTERISTIC
/begin CHARACTERISTIC wBsd_MinRotPosChange_XDU16 "Minimale Änderung der Rotorlage, damit keine blockierte Lenkung vorliegt" VALUE 0x1508D6 AblGLKWuw 50.0098 ROTPOS 0 50.00977 FORMAT "%8.5" /end CHARACTERISTIC
/begin CHARACTERISTIC wBsd_MinSafetyRotPosChange_XDU16 "Min change in Rotpos to shutdown BSD" VALUE 0x1508D8 AblGLKWuw 50.0098 ROTPOS 0 50.00977 FORMAT "%8.5" /end CHARACTERISTIC
/begin CHARACTERISTIC wBsd_SteeringAngleLimit_XDU16 "steering angle border for Activation of BSD" VALUE 0x1508DA AblGLKWuw 600 SA_10 0 600 FORMAT "%8.4" /end CHARACTERISTIC
/begin CHARACTERISTIC xatAssistFilterFrequFast_XDU16 "Grenzfrequenz in kHz fuer AssistFilter fuer schnelles Zurueckfiltern" VALUE 0x150956 AblGLKWuw 0.0986328 RIGHTSH11NP 0.0009765625 0.09960938 FORMAT "%10.8" /end CHARACTERISTIC
/begin CHARACTERISTIC xatAssistFilterFrequ_XAU16 "Grenzfrequenz in kHz fuer AssistFilter, abhaengig von der Reduzierung durch Spannung" CURVE 0x151694 AblGLKLuw 0.0986328 RIGHTSH11NP 0.0009765625 0.09960938 FORMAT "%10.8"
 /begin AXIS_DESCR STD_AXIS xatActTorGradFact_xdu16 RSH15 4 0 100 FORMAT "%8.4" DEPOSIT ABSOLUTE /end AXIS_DESCR
/end CHARACTERISTIC
/begin CHARACTERISTIC xatBandsperre_A2_XDF32 "Parameter Bandsperre A2" VALUE 0x150468 AblGLKWfl4 18 ZU0 -9 9 FORMAT "%10.8" /end CHARACTERISTIC
/begin CHARACTERISTIC xatBandsperre_A3_XDF32 "Parameter Bandsperre A3" VALUE 0x15046C AblGLKWfl4 18 ZU0 -9 9 FORMAT "%10.8" /end CHARACTERISTIC
/begin CHARACTERISTIC xatBandsperre_B2_XDF32 "Parameter Bandsperre B2" VALUE 0x150470 AblGLKWfl4 18 ZU0 -9 9 FORMAT "%10.8" /end CHARACTERISTIC
/begin CHARACTERISTIC xatBandsperre_S1_XDF32 "Parameter Bandsperre S1" VALUE 0x150474 AblGLKWfl4 18 ZU0 -9 9 FORMAT "%10.8" /end CHARACTERISTIC
/begin CHARACTERISTIC xatBSTMaxgrad_XDU16 "Maximaler Kennliniengradient fuer AssistBerechnung" VALUE 0x150958 AblGLKWuw 4 TORGAINHIGH 1 5 FORMAT "%8.6" /end CHARACTERISTIC
/begin CHARACTERISTIC xatMaxGradChatterActive_XAU16 "Maximler Gradient wenn Rattern erkannt, abhaengig von v Fahrzeug " CURVE 0x1516A8 AblGLKLuw 1.99902 TORGAINHIGH 0.0009765625 2 FORMAT "%8.6"
 /begin AXIS_DESCR STD_AXIS vApplI_AbsSafeNssVehicleSpeed_xdu16 VFZHIGH 4 0 300 FORMAT "%8.4" DEPOSIT ABSOLUTE /end AXIS_DESCR
/end CHARACTERISTIC
/begin CHARACTERISTIC xatMaxGradGradDown_XDU16 "Maximale Aenderung der Gradientenbegrenzung in 1s in neg. Richtung" VALUE 0x15095A AblGLKWuw 1.99902 TORGAINHIGH 0.0009765625 2 FORMAT "%8.6" /end CHARACTERISTIC
/begin CHARACTERISTIC xatMaxGradGradUp_XDU16 "Maximale Aenderung der Gradientenbegrenzung in 1s in pos. Richtung" VALUE 0x15095C AblGLKWuw 1.99902 TORGAINHIGH 0.0009765625 2 FORMAT "%8.6" /end CHARACTERISTIC
/begin CHARACTERISTIC xatMaxGradTorGrad_XAU16 "Max Gradient fuer Steigungsbgrenzung DAC abhaengig vom Reduktionsfaktor" CURVE 0x1516BC AblGLKLuw 5 TORGAINHIGH 0 5 FORMAT "%8.6"
 /begin AXIS_DESCR STD_AXIS xatActTorGradFact_xdu16 RSH15 3 0 100 FORMAT "%8.4" DEPOSIT ABSOLUTE /end AXIS_DESCR
/end CHARACTERISTIC
/begin CHARACTERISTIC xatMaxGradvVehicleReverse_XAU16 "Max Gradient fuer Steigungsbgrenzung DAC abhaengig von v Fahrzeug bei Rueckwaertsfahrt" CURVE 0x1516CC AblGLKLuw 5 TORGAINHIGH 0 5 FORMAT "%8.6"
 /begin AXIS_DESCR STD_AXIS vApplI_AbsSafeNssVehicleSpeed_xdu16 VFZHIGH 4 0 300 FORMAT "%8.4" DEPOSIT ABSOLUTE /end AXIS_DESCR
/end CHARACTERISTIC
/begin CHARACTERISTIC xatMaxGradvVehicle_XAU16_00__A "Max Gradient fuer Steigungsbgrenzung DAC abhaengig von v Fahrzeug" CURVE 0x15D78C AblGLKLuw 5 TORGAINHIGH 0 5 FORMAT "%8.6"
 /begin AXIS_DESCR STD_AXIS vApplI_AbsSafeNssVehicleSpeed_xdu16 VFZHIGH 4 0 300 FORMAT "%8.4" DEPOSIT ABSOLUTE /end AXIS_DESCR
/end CHARACTERISTIC
/begin CHARACTERISTIC xatMaxGradvVehicle_XAU16_01__A "Max Gradient fuer Steigungsbgrenzung DAC abhaengig von v Fahrzeug" CURVE 0x15D7A0 AblGLKLuw 5 TORGAINHIGH 0 5 FORMAT "%8.6"
 /begin AXIS_DESCR STD_AXIS vApplI_AbsSafeNssVehicleSpeed_xdu16 VFZHIGH 4 0 300 FORMAT "%8.4" DEPOSIT ABSOLUTE /end AXIS_DESCR
/end CHARACTERISTIC
/begin CHARACTERISTIC xatMaxGradvVehicle_XAU16_02__A "Max Gradient fuer Steigungsbgrenzung DAC abhaengig von v Fahrzeug" CURVE 0x15D7B4 AblGLKLuw 5 TORGAINHIGH 0 5 FORMAT "%8.6"
 /begin AXIS_DESCR STD_AXIS vApplI_AbsSafeNssVehicleSpeed_xdu16 VFZHIGH 4 0 300 FORMAT "%8.4" DEPOSIT ABSOLUTE /end AXIS_DESCR
/end CHARACTERISTIC
/begin CHARACTERISTIC xatMaxGradvVehicle_XAU16_03__A "Max Gradient fuer Steigungsbgrenzung DAC abhaengig von v Fahrzeug" CURVE 0x15D7C8 AblGLKLuw 5 TORGAINHIGH 0 5 FORMAT "%8.6"
 /begin AXIS_DESCR STD_AXIS vApplI_AbsSafeNssVehicleSpeed_xdu16 VFZHIGH 4 0 300 FORMAT "%8.4" DEPOSIT ABSOLUTE /end AXIS_DESCR
/end CHARACTERISTIC
/begin CHARACTERISTIC xatMaxGradvVehicle_XAU16_04__A "Max Gradient fuer Steigungsbgrenzung DAC abhaengig von v Fahrzeug" CURVE 0x15D7DC AblGLKLuw 5 TORGAINHIGH 0 5 FORMAT "%8.6"
 /begin AXIS_DESCR STD_AXIS vApplI_AbsSafeNssVehicleSpeed_xdu16 VFZHIGH 4 0 300 FORMAT "%8.4" DEPOSIT ABSOLUTE /end AXIS_DESCR
/end CHARACTERISTIC
/begin CHARACTERISTIC xatMaxGradvVehicle_XAU16_05__A "Max Gradient fuer Steigungsbgrenzung DAC abhaengig von v Fahrzeug" CURVE 0x15D7F0 AblGLKLuw 5 TORGAINHIGH 0 5 FORMAT "%8.6"
 /begin AXIS_DESCR STD_AXIS vApplI_AbsSafeNssVehicleSpeed_xdu16 VFZHIGH 4 0 300 FORMAT "%8.4" DEPOSIT ABSOLUTE /end AXIS_DESCR
/end CHARACTERISTIC
/begin CHARACTERISTIC xatMaxGradvVehicle_XAU16_06__A "Max Gradient fuer Steigungsbgrenzung DAC abhaengig von v Fahrzeug" CURVE 0x15D804 AblGLKLuw 5 TORGAINHIGH 0 5 FORMAT "%8.6"
 /begin AXIS_DESCR STD_AXIS vApplI_AbsSafeNssVehicleSpeed_xdu16 VFZHIGH 4 0 300 FORMAT "%8.4" DEPOSIT ABSOLUTE /end AXIS_DESCR
/end CHARACTERISTIC
/begin CHARACTERISTIC xatMaxGradvVehicle_XAU16_07__A "Max Gradient fuer Steigungsbgrenzung DAC abhaengig von v Fahrzeug" CURVE 0x15D818 AblGLKLuw 5 TORGAINHIGH 0 5 FORMAT "%8.6"
 /begin AXIS_DESCR STD_AXIS vApplI_AbsSafeNssVehicleSpeed_xdu16 VFZHIGH 4 0 300 FORMAT "%8.4" DEPOSIT ABSOLUTE /end AXIS_DESCR
/end CHARACTERISTIC
/begin CHARACTERISTIC xatMaxGradvVehicle_XAU16_08__A "Max Gradient fuer Steigungsbgrenzung DAC abhaengig von v Fahrzeug" CURVE 0x15D82C AblGLKLuw 5 TORGAINHIGH 0 5 FORMAT "%8.6"
 /begin AXIS_DESCR STD_AXIS vApplI_AbsSafeNssVehicleSpeed_xdu16 VFZHIGH 4 0 300 FORMAT "%8.4" DEPOSIT ABSOLUTE /end AXIS_DESCR
/end CHARACTERISTIC
/begin CHARACTERISTIC xatMaxGradvVehicle_XAU16_09__A "Max Gradient fuer Steigungsbgrenzung DAC abhaengig von v Fahrzeug" CURVE 0x15D840 AblGLKLuw 5 TORGAINHIGH 0 5 FORMAT "%8.6"
 /begin AXIS_DESCR STD_AXIS vApplI_AbsSafeNssVehicleSpeed_xdu16 VFZHIGH 4 0 300 FORMAT "%8.4" DEPOSIT ABSOLUTE /end AXIS_DESCR
/end CHARACTERISTIC
/begin CHARACTERISTIC xatMaxGradvVehicle_XAU16_10__A "Max Gradient fuer Steigungsbgrenzung DAC abhaengig von v Fahrzeug" CURVE 0x15D854 AblGLKLuw 5 TORGAINHIGH 0 5 FORMAT "%8.6"
 /begin AXIS_DESCR STD_AXIS vApplI_AbsSafeNssVehicleSpeed_xdu16 VFZHIGH 4 0 300 FORMAT "%8.4" DEPOSIT ABSOLUTE /end AXIS_DESCR
/end CHARACTERISTIC
/begin CHARACTERISTIC xatMaxGradvVehicle_XAU16_11__A "Max Gradient fuer Steigungsbgrenzung DAC abhaengig von v Fahrzeug" CURVE 0x15D868 AblGLKLuw 5 TORGAINHIGH 0 5 FORMAT "%8.6"
 /begin AXIS_DESCR STD_AXIS vApplI_AbsSafeNssVehicleSpeed_xdu16 VFZHIGH 4 0 300 FORMAT "%8.4" DEPOSIT ABSOLUTE /end AXIS_DESCR
/end CHARACTERISTIC
/begin CHARACTERISTIC xatMaxGradvVehicle_XAU16_12__A "Max Gradient fuer Steigungsbgrenzung DAC abhaengig von v Fahrzeug" CURVE 0x15D87C AblGLKLuw 5 TORGAINHIGH 0 5 FORMAT "%8.6"
 /begin AXIS_DESCR STD_AXIS vApplI_AbsSafeNssVehicleSpeed_xdu16 VFZHIGH 4 0 300 FORMAT "%8.4" DEPOSIT ABSOLUTE /end AXIS_DESCR
/end CHARACTERISTIC
/begin CHARACTERISTIC xatMaxGradvVehicle_XAU16_13__A "Max Gradient fuer Steigungsbgrenzung DAC abhaengig von v Fahrzeug" CURVE 0x15D890 AblGLKLuw 5 TORGAINHIGH 0 5 FORMAT "%8.6"
 /begin AXIS_DESCR STD_AXIS vApplI_AbsSafeNssVehicleSpeed_xdu16 VFZHIGH 4 0 300 FORMAT "%8.4" DEPOSIT ABSOLUTE /end AXIS_DESCR
/end CHARACTERISTIC
/begin CHARACTERISTIC xatMaxGradvVehicle_XAU16_14__A "Max Gradient fuer Steigungsbgrenzung DAC abhaengig von v Fahrzeug" CURVE 0x15D8A4 AblGLKLuw 5 TORGAINHIGH 0 5 FORMAT "%8.6"
 /begin AXIS_DESCR STD_AXIS vApplI_AbsSafeNssVehicleSpeed_xdu16 VFZHIGH 4 0 300 FORMAT "%8.4" DEPOSIT ABSOLUTE /end AXIS_DESCR
/end CHARACTERISTIC
/begin CHARACTERISTIC xatMaxGradvVehicle_XAU16_15__A "Max Gradient fuer Steigungsbgrenzung DAC abhaengig von v Fahrzeug" CURVE 0x15D8B8 AblGLKLuw 5 TORGAINHIGH 0 5 FORMAT "%8.6"
 /begin AXIS_DESCR STD_AXIS vApplI_AbsSafeNssVehicleSpeed_xdu16 VFZHIGH 4 0 300 FORMAT "%8.4" DEPOSIT ABSOLUTE /end AXIS_DESCR
/end CHARACTERISTIC
/begin CHARACTERISTIC xatMaxGradvVehicle_XAU16_16__A "Max Gradient fuer Steigungsbgrenzung DAC abhaengig von v Fahrzeug" CURVE 0x15D8CC AblGLKLuw 5 TORGAINHIGH 0 5 FORMAT "%8.6"
 /begin AXIS_DESCR STD_AXIS vApplI_AbsSafeNssVehicleSpeed_xdu16 VFZHIGH 4 0 300 FORMAT "%8.4" DEPOSIT ABSOLUTE /end AXIS_DESCR
/end CHARACTERISTIC
/begin CHARACTERISTIC xatMaxGradvVehicle_XAU16_17__A "Max Gradient fuer Steigungsbgrenzung DAC abhaengig von v Fahrzeug" CURVE 0x15D8E0 AblGLKLuw 5 TORGAINHIGH 0 5 FORMAT "%8.6"
 /begin AXIS_DESCR STD_AXIS vApplI_AbsSafeNssVehicleSpeed_xdu16 VFZHIGH 4 0 300 FORMAT "%8.4" DEPOSIT ABSOLUTE /end AXIS_DESCR
/end CHARACTERISTIC
/begin CHARACTERISTIC xatMaxGradvVehicle_XAU16_18__A "Max Gradient fuer Steigungsbgrenzung DAC abhaengig von v Fahrzeug" CURVE 0x15D8F4 AblGLKLuw 5 TORGAINHIGH 0 5 FORMAT "%8.6"
 /begin AXIS_DESCR STD_AXIS vApplI_AbsSafeNssVehicleSpeed_xdu16 VFZHIGH 4 0 300 FORMAT "%8.4" DEPOSIT ABSOLUTE /end AXIS_DESCR
/end CHARACTERISTIC
/begin CHARACTERISTIC xatMaxGradvVehicle_XAU16_19__A "Max Gradient fuer Steigungsbgrenzung DAC abhaengig von v Fahrzeug" CURVE 0x15D908 AblGLKLuw 5 TORGAINHIGH 0 5 FORMAT "%8.6"
 /begin AXIS_DESCR STD_AXIS vApplI_AbsSafeNssVehicleSpeed_xdu16 VFZHIGH 4 0 300 FORMAT "%8.4" DEPOSIT ABSOLUTE /end AXIS_DESCR
/end CHARACTERISTIC
/begin CHARACTERISTIC xatMaxGradvVehicle_XAU16_20__A "Max Gradient fuer Steigungsbgrenzung DAC abhaengig von v Fahrzeug" CURVE 0x15D91C AblGLKLuw 5 TORGAINHIGH 0 5 FORMAT "%8.6"
 /begin AXIS_DESCR STD_AXIS vApplI_AbsSafeNssVehicleSpeed_xdu16 VFZHIGH 4 0 300 FORMAT "%8.4" DEPOSIT ABSOLUTE /end AXIS_DESCR
/end CHARACTERISTIC
/begin CHARACTERISTIC xatMaxGradvVehicle_XAU16_21__A "Max Gradient fuer Steigungsbgrenzung DAC abhaengig von v Fahrzeug" CURVE 0x15D930 AblGLKLuw 5 TORGAINHIGH 0 5 FORMAT "%8.6"
 /begin AXIS_DESCR STD_AXIS vApplI_AbsSafeNssVehicleSpeed_xdu16 VFZHIGH 4 0 300 FORMAT "%8.4" DEPOSIT ABSOLUTE /end AXIS_DESCR
/end CHARACTERISTIC
/begin CHARACTERISTIC xatMaxGradvVehicle_XAU16_22__A "Max Gradient fuer Steigungsbgrenzung DAC abhaengig von v Fahrzeug" CURVE 0x15D944 AblGLKLuw 5 TORGAINHIGH 0 5 FORMAT "%8.6"
 /begin AXIS_DESCR STD_AXIS vApplI_AbsSafeNssVehicleSpeed_xdu16 VFZHIGH 4 0 300 FORMAT "%8.4" DEPOSIT ABSOLUTE /end AXIS_DESCR
/end CHARACTERISTIC
/begin CHARACTERISTIC xatMaxGradvVehicle_XAU16_23__A "Max Gradient fuer Steigungsbgrenzung DAC abhaengig von v Fahrzeug" CURVE 0x15D958 AblGLKLuw 5 TORGAINHIGH 0 5 FORMAT "%8.6"
 /begin AXIS_DESCR STD_AXIS vApplI_AbsSafeNssVehicleSpeed_xdu16 VFZHIGH 4 0 300 FORMAT "%8.4" DEPOSIT ABSOLUTE /end AXIS_DESCR
/end CHARACTERISTIC
/begin CHARACTERISTIC xatMaxGradvVehicle_XAU16_24__A "Max Gradient fuer Steigungsbgrenzung DAC abhaengig von v Fahrzeug" CURVE 0x15D96C AblGLKLuw 5 TORGAINHIGH 0 5 FORMAT "%8.6"
 /begin AXIS_DESCR STD_AXIS vApplI_AbsSafeNssVehicleSpeed_xdu16 VFZHIGH 4 0 300 FORMAT "%8.4" DEPOSIT ABSOLUTE /end AXIS_DESCR
/end CHARACTERISTIC
/begin CHARACTERISTIC xatMaxGradvVehicle_XAU16_25__A "Max Gradient fuer Steigungsbgrenzung DAC abhaengig von v Fahrzeug" CURVE 0x15D980 AblGLKLuw 5 TORGAINHIGH 0 5 FORMAT "%8.6"
 /begin AXIS_DESCR STD_AXIS vApplI_AbsSafeNssVehicleSpeed_xdu16 VFZHIGH 4 0 300 FORMAT "%8.4" DEPOSIT ABSOLUTE /end AXIS_DESCR
/end CHARACTERISTIC
/begin CHARACTERISTIC xatMaxGradvVehicle_XAU16_26__A "Max Gradient fuer Steigungsbgrenzung DAC abhaengig von v Fahrzeug" CURVE 0x15D994 AblGLKLuw 5 TORGAINHIGH 0 5 FORMAT "%8.6"
 /begin AXIS_DESCR STD_AXIS vApplI_AbsSafeNssVehicleSpeed_xdu16 VFZHIGH 4 0 300 FORMAT "%8.4" DEPOSIT ABSOLUTE /end AXIS_DESCR
/end CHARACTERISTIC
/begin CHARACTERISTIC xatMaxGradvVehicle_XAU16_27__A "Max Gradient fuer Steigungsbgrenzung DAC abhaengig von v Fahrzeug" CURVE 0x15D9A8 AblGLKLuw 5 TORGAINHIGH 0 5 FORMAT "%8.6"
 /begin AXIS_DESCR STD_AXIS vApplI_AbsSafeNssVehicleSpeed_xdu16 VFZHIGH 4 0 300 FORMAT "%8.4" DEPOSIT ABSOLUTE /end AXIS_DESCR
/end CHARACTERISTIC
/begin CHARACTERISTIC xatMaxGradvVehicle_XAU16_28__A "Max Gradient fuer Steigungsbgrenzung DAC abhaengig von v Fahrzeug" CURVE 0x15D9BC AblGLKLuw 5 TORGAINHIGH 0 5 FORMAT "%8.6"
 /begin AXIS_DESCR STD_AXIS vApplI_AbsSafeNssVehicleSpeed_xdu16 VFZHIGH 4 0 300 FORMAT "%8.4" DEPOSIT ABSOLUTE /end AXIS_DESCR
/end CHARACTERISTIC
/begin CHARACTERISTIC xatMaxGradvVehicle_XAU16_29__A "Max Gradient fuer Steigungsbgrenzung DAC abhaengig von v Fahrzeug" CURVE 0x15D9D0 AblGLKLuw 5 TORGAINHIGH 0 5 FORMAT "%8.6"
 /begin AXIS_DESCR STD_AXIS vApplI_AbsSafeNssVehicleSpeed_xdu16 VFZHIGH 4 0 300 FORMAT "%8.4" DEPOSIT ABSOLUTE /end AXIS_DESCR
/end CHARACTERISTIC
/begin CHARACTERISTIC xatMaxGradvVehicle_XAU16_30__A "Max Gradient fuer Steigungsbgrenzung DAC abhaengig von v Fahrzeug" CURVE 0x15D9E4 AblGLKLuw 5 TORGAINHIGH 0 5 FORMAT "%8.6"
 /begin AXIS_DESCR STD_AXIS vApplI_AbsSafeNssVehicleSpeed_xdu16 VFZHIGH 4 0 300 FORMAT "%8.4" DEPOSIT ABSOLUTE /end AXIS_DESCR
/end CHARACTERISTIC
/begin CHARACTERISTIC xatMaxGradvVehicle_XAU16_31__A "Max Gradient fuer Steigungsbgrenzung DAC abhaengig von v Fahrzeug" CURVE 0x15D9F8 AblGLKLuw 5 TORGAINHIGH 0 5 FORMAT "%8.6"
 /begin AXIS_DESCR STD_AXIS vApplI_AbsSafeNssVehicleSpeed_xdu16 VFZHIGH 4 0 300 FORMAT "%8.4" DEPOSIT ABSOLUTE /end AXIS_DESCR
/end CHARACTERISTIC
/begin CHARACTERISTIC xatMaxGradvVehicle_XAU16_32__A "Max Gradient fuer Steigungsbgrenzung DAC abhaengig von v Fahrzeug" CURVE 0x15DA0C AblGLKLuw 5 TORGAINHIGH 0 5 FORMAT "%8.6"
 /begin AXIS_DESCR STD_AXIS vApplI_AbsSafeNssVehicleSpeed_xdu16 VFZHIGH 4 0 300 FORMAT "%8.4" DEPOSIT ABSOLUTE /end AXIS_DESCR
/end CHARACTERISTIC
/begin CHARACTERISTIC xatMaxGradvVehicle_XAU16_33__A "Max Gradient fuer Steigungsbgrenzung DAC abhaengig von v Fahrzeug" CURVE 0x15DA20 AblGLKLuw 5 TORGAINHIGH 0 5 FORMAT "%8.6"
 /begin AXIS_DESCR STD_AXIS vApplI_AbsSafeNssVehicleSpeed_xdu16 VFZHIGH 4 0 300 FORMAT "%8.4" DEPOSIT ABSOLUTE /end AXIS_DESCR
/end CHARACTERISTIC
/begin CHARACTERISTIC xatMaxGradvVehicle_XAU16_34__A "Max Gradient fuer Steigungsbgrenzung DAC abhaengig von v Fahrzeug" CURVE 0x15DA34 AblGLKLuw 5 TORGAINHIGH 0 5 FORMAT "%8.6"
 /begin AXIS_DESCR STD_AXIS vApplI_AbsSafeNssVehicleSpeed_xdu16 VFZHIGH 4 0 300 FORMAT "%8.4" DEPOSIT ABSOLUTE /end AXIS_DESCR
/end CHARACTERISTIC
/begin CHARACTERISTIC xatMaxGradvVehicle_XAU16_35__A "Max Gradient fuer Steigungsbgrenzung DAC abhaengig von v Fahrzeug" CURVE 0x15DA48 AblGLKLuw 5 TORGAINHIGH 0 5 FORMAT "%8.6"
 /begin AXIS_DESCR STD_AXIS vApplI_AbsSafeNssVehicleSpeed_xdu16 VFZHIGH 4 0 300 FORMAT "%8.4" DEPOSIT ABSOLUTE /end AXIS_DESCR
/end CHARACTERISTIC
/begin CHARACTERISTIC xAutParkCtrl_FeedForwardFiltFact_XDU16 "filter factor feed-forward controlled nominal rack position" VALUE 0x15095E AblGLKWuw 1 RIGHTSH10NP 0 1 FORMAT "%8.6" /end CHARACTERISTIC
/begin CHARACTERISTIC xAutParkCtrl_InterruptTorqueFactor_XDU16 "minimaler UnterstÃ¼tzungsfaktor fÃ¼r Abbruch" VALUE 0x150960 AblGLKWuw 100 RSH15 0 100 FORMAT "%8.4" /end CHARACTERISTIC
/begin CHARACTERISTIC xAutParkCtrl_MaxAngleGrad_XDU16 " Max allowed steering angle gradient in active state" VALUE 0x150962 AblGLKWuw 1000 SAS_8 500 1500 FORMAT "%8.3" /end CHARACTERISTIC
/begin CHARACTERISTIC xAutParkCtrl_PositionDPart_XDF32 "D-part position controller" VALUE 0x150478 AblGLKWfl4 100 ZU0 0 100 FORMAT "%10.6" /end CHARACTERISTIC
/begin CHARACTERISTIC xAutParkCtrl_PositionIMax_XDF32 "maximum allowed I-part position controller" VALUE 0x15047C AblGLKWfl4 2000 ZU0 0 2000 FORMAT "%10.5" /end CHARACTERISTIC
/begin CHARACTERISTIC xAutParkCtrl_PositionIPart_XDF32_0___A "I-part position controller" VALUE 0x158000 AblGLKWfl4 100 ZU0 0 100 FORMAT "%10.6" /end CHARACTERISTIC
/begin CHARACTERISTIC xAutParkCtrl_PositionIPart_XDF32_1___A "I-part position controller" VALUE 0x158004 AblGLKWfl4 100 ZU0 0 100 FORMAT "%10.6" /end CHARACTERISTIC
/begin CHARACTERISTIC xAutParkCtrl_PositionIPart_XDF32_2___A "I-part position controller" VALUE 0x158008 AblGLKWfl4 100 ZU0 0 100 FORMAT "%10.6" /end CHARACTERISTIC
/begin CHARACTERISTIC xAutParkCtrl_PositionIPart_XDF32_3___A "I-part position controller" VALUE 0x15800C AblGLKWfl4 100 ZU0 0 100 FORMAT "%10.6" /end CHARACTERISTIC
/begin CHARACTERISTIC xAutParkCtrl_PositionIPart_XDF32_4___A "I-part position controller" VALUE 0x158010 AblGLKWfl4 100 ZU0 0 100 FORMAT "%10.6" /end CHARACTERISTIC
/begin CHARACTERISTIC xAutParkCtrl_PositionIPart_XDF32_5___A "I-part position controller" VALUE 0x158014 AblGLKWfl4 100 ZU0 0 100 FORMAT "%10.6" /end CHARACTERISTIC
/begin CHARACTERISTIC xAutParkCtrl_PositionPPart_XDF32_0___A "P-part position controller" VALUE 0x158018 AblGLKWfl4 2000 ZU0 0 2000 FORMAT "%10.5" /end CHARACTERISTIC
/begin CHARACTERISTIC xAutParkCtrl_PositionPPart_XDF32_1___A "P-part position controller" VALUE 0x15801C AblGLKWfl4 2000 ZU0 0 2000 FORMAT "%10.5" /end CHARACTERISTIC
/begin CHARACTERISTIC xAutParkCtrl_PositionPPart_XDF32_2___A "P-part position controller" VALUE 0x158020 AblGLKWfl4 2000 ZU0 0 2000 FORMAT "%10.5" /end CHARACTERISTIC
/begin CHARACTERISTIC xAutParkCtrl_PositionPPart_XDF32_3___A "P-part position controller" VALUE 0x158024 AblGLKWfl4 2000 ZU0 0 2000 FORMAT "%10.5" /end CHARACTERISTIC
/begin CHARACTERISTIC xAutParkCtrl_PositionPPart_XDF32_4___A "P-part position controller" VALUE 0x158028 AblGLKWfl4 2000 ZU0 0 2000 FORMAT "%10.5" /end CHARACTERISTIC
/begin CHARACTERISTIC xAutParkCtrl_PositionPPart_XDF32_5___A "P-part position controller" VALUE 0x15802C AblGLKWfl4 2000 ZU0 0 2000 FORMAT "%10.5" /end CHARACTERISTIC
/begin CHARACTERISTIC xAutParkCtrl_RackSpeedDPart_XDF32 "D-part speed controller" VALUE 0x150480 AblGLKWfl4 2 ZU0 0 2 FORMAT "%10.8" /end CHARACTERISTIC
/begin CHARACTERISTIC xAutParkCtrl_RackSpeedIMax_XDF32 "maximum allowed I-part speed controller" VALUE 0x150484 AblGLKWfl4 8 ZU0 0 8 FORMAT "%10.8" /end CHARACTERISTIC
/begin CHARACTERISTIC xAutParkCtrl_RackSpeedIPart_XDF32_0___A "I-part speed controller" VALUE 0x158030 AblGLKWfl4 1 ZU0 0 1 FORMAT "%10.8" /end CHARACTERISTIC
/begin CHARACTERISTIC xAutParkCtrl_RackSpeedIPart_XDF32_1___A "I-part speed controller" VALUE 0x158034 AblGLKWfl4 1 ZU0 0 1 FORMAT "%10.8" /end CHARACTERISTIC
/begin CHARACTERISTIC xAutParkCtrl_RackSpeedIPart_XDF32_2___A "I-part speed controller" VALUE 0x158038 AblGLKWfl4 1 ZU0 0 1 FORMAT "%10.8" /end CHARACTERISTIC
/begin CHARACTERISTIC xAutParkCtrl_RackSpeedIPart_XDF32_3___A "I-part speed controller" VALUE 0x15803C AblGLKWfl4 1 ZU0 0 1 FORMAT "%10.8" /end CHARACTERISTIC
/begin CHARACTERISTIC xAutParkCtrl_RackSpeedIPart_XDF32_4___A "I-part speed controller" VALUE 0x158040 AblGLKWfl4 1 ZU0 0 1 FORMAT "%10.8" /end CHARACTERISTIC
/begin CHARACTERISTIC xAutParkCtrl_RackSpeedIPart_XDF32_5___A "I-part speed controller" VALUE 0x158044 AblGLKWfl4 1 ZU0 0 1 FORMAT "%10.8" /end CHARACTERISTIC
/begin CHARACTERISTIC xAutParkCtrl_RackSpeedPPart_XDF32_0___A "P-part speed controller" VALUE 0x158048 AblGLKWfl4 2 ZU0 0 2 FORMAT "%10.8" /end CHARACTERISTIC
/begin CHARACTERISTIC xAutParkCtrl_RackSpeedPPart_XDF32_1___A "P-part speed controller" VALUE 0x15804C AblGLKWfl4 2 ZU0 0 2 FORMAT "%10.8" /end CHARACTERISTIC
/begin CHARACTERISTIC xAutParkCtrl_RackSpeedPPart_XDF32_2___A "P-part speed controller" VALUE 0x158050 AblGLKWfl4 2 ZU0 0 2 FORMAT "%10.8" /end CHARACTERISTIC
/begin CHARACTERISTIC xAutParkCtrl_RackSpeedPPart_XDF32_3___A "P-part speed controller" VALUE 0x158054 AblGLKWfl4 2 ZU0 0 2 FORMAT "%10.8" /end CHARACTERISTIC
/begin CHARACTERISTIC xAutParkCtrl_RackSpeedPPart_XDF32_4___A "P-part speed controller" VALUE 0x158058 AblGLKWfl4 2 ZU0 0 2 FORMAT "%10.8" /end CHARACTERISTIC
/begin CHARACTERISTIC xAutParkCtrl_RackSpeedPPart_XDF32_5___A "P-part speed controller" VALUE 0x15805C AblGLKWfl4 2 ZU0 0 2 FORMAT "%10.8" /end CHARACTERISTIC
/begin CHARACTERISTIC xAutParkCtrl_RecoverTorqueFactor_XDU16 "minimaler UnterstÃ¼tzungsfaktor fÃ¼r Erholung" VALUE 0x150964 AblGLKWuw 4.99878 RSH15 95.00122 100 FORMAT "%8.4" /end CHARACTERISTIC
/begin CHARACTERISTIC xAutParkCtrl_RefuseTorqueFactor_XDU16 "minimaler UnterstÃ¼tzungsfaktor fÃ¼r Abweisung" VALUE 0x150966 AblGLKWuw 10.0006 RSH15 75 85.00061 FORMAT "%8.5" /end CHARACTERISTIC
/begin CHARACTERISTIC xBST_PT1FilterFactor_XDU16 "filter factor of disturbance torque (RG1-torques)" VALUE 0x150978 AblGLKWuw 1 RIGHTSH5NP 0 1 FORMAT "%8.6" /end CHARACTERISTIC
/begin CHARACTERISTIC xBST_RackForceScaleFact_XDU16 "rack force scaling factor" VALUE 0x15097A AblGLKWuw 1.79981 RIGHTSH10NP 0.2001953 2 FORMAT "%8.6" /end CHARACTERISTIC
/begin CHARACTERISTIC yAssCtrl_RampDownGradient_XDU16 "Reduktiongradient beim Ausschalten" VALUE 0x150A86 AblGLKWuw 0.00201416 RIGHTSH15NP 0 0.00201416 FORMAT "%11.9" /end CHARACTERISTIC
/begin CHARACTERISTIC yAssCtrl_VehicleNotRunningGradient_XDU16 "Reduktionsgradient während das Fahrzeug steht" VALUE 0x150A88 AblGLKWuw 0.00201416 RIGHTSH15NP 0 0.00201416 FORMAT "%11.9" /end CHARACTERISTIC
/begin CHARACTERISTIC yAssCtrl_VehicleRunningGradient_XDU16 "Reduktiongradient während das Fahrzeug fährt" VALUE 0x150A8A AblGLKWuw 0.00100708 RIGHTSH15NP 0 0.00100708 FORMAT "%11.9" /end CHARACTERISTIC
/begin CHARACTERISTIC zAsmI_MaxHealingPerIgnitionCycle_XDU8 "Maximalanzahl der erlaubten Heilungen (von FailOp nach Normal) in diesem Klemmenzyklus." VALUE 0x150B5F AblGLKWub 255 ZU0 0 255 FORMAT "%5.1" /end CHARACTERISTIC
/begin CHARACTERISTIC zAsmI_MaxHealingPerOscillation_XDU8 "Maximalanzahl der erlaubten Heilungen (von FailOp nach Normal) innerhalb der Zeit tAsmI_OscillationMeasureTime_XDU16. Wichtig zur Vermeidung von Oscillating Assist." VALUE 0x150B60 AblGLKWub 255 ZU0 0 255 FORMAT "%5.1" /end CHARACTERISTIC
/begin CHARACTERISTIC zBci_BaseTorqueCharSelect_XAS16_00___A "geschwindigkeitsabhängige BasicSteerTorque-Kennlinienauswahl" VAL_BLK 0x15FDCC AblGLKWBsw 500 VFZHIGH 0 500 NUMBER 7 FORMAT "%8.4" /end CHARACTERISTIC
/begin CHARACTERISTIC zBci_BaseTorqueCharSelect_XAS16_01___A "geschwindigkeitsabhängige BasicSteerTorque-Kennlinienauswahl" VAL_BLK 0x15FDDC AblGLKWBsw 500 VFZHIGH 0 500 NUMBER 7 FORMAT "%8.4" /end CHARACTERISTIC
/begin CHARACTERISTIC zBci_BaseTorqueCharSelect_XAS16_02___A "geschwindigkeitsabhängige BasicSteerTorque-Kennlinienauswahl" VAL_BLK 0x15FDEC AblGLKWBsw 500 VFZHIGH 0 500 NUMBER 7 FORMAT "%8.4" /end CHARACTERISTIC
/begin CHARACTERISTIC zBci_BaseTorqueCharSelect_XAS16_03___A "geschwindigkeitsabhängige BasicSteerTorque-Kennlinienauswahl" VAL_BLK 0x15FDFC AblGLKWBsw 500 VFZHIGH 0 500 NUMBER 7 FORMAT "%8.4" /end CHARACTERISTIC
/begin CHARACTERISTIC zBci_BaseTorqueCharSelect_XAS16_04___A "geschwindigkeitsabhängige BasicSteerTorque-Kennlinienauswahl" VAL_BLK 0x15FE0C AblGLKWBsw 500 VFZHIGH 0 500 NUMBER 7 FORMAT "%8.4" /end CHARACTERISTIC
/begin CHARACTERISTIC zBci_BaseTorqueCharSelect_XAS16_05___A "geschwindigkeitsabhängige BasicSteerTorque-Kennlinienauswahl" VAL_BLK 0x15FE1C AblGLKWBsw 500 VFZHIGH 0 500 NUMBER 7 FORMAT "%8.4" /end CHARACTERISTIC
/begin CHARACTERISTIC zBci_BaseTorqueCharSelect_XAS16_06___A "geschwindigkeitsabhängige BasicSteerTorque-Kennlinienauswahl" VAL_BLK 0x15FE2C AblGLKWBsw 500 VFZHIGH 0 500 NUMBER 7 FORMAT "%8.4" /end CHARACTERISTIC
/begin CHARACTERISTIC zBci_BaseTorqueCharSelect_XAS16_07___A "geschwindigkeitsabhängige BasicSteerTorque-Kennlinienauswahl" VAL_BLK 0x15FE3C AblGLKWBsw 500 VFZHIGH 0 500 NUMBER 7 FORMAT "%8.4" /end CHARACTERISTIC
/begin CHARACTERISTIC zBci_BaseTorqueCharSelect_XAS16_08___A "geschwindigkeitsabhängige BasicSteerTorque-Kennlinienauswahl" VAL_BLK 0x15FE4C AblGLKWBsw 500 VFZHIGH 0 500 NUMBER 7 FORMAT "%8.4" /end CHARACTERISTIC
/begin CHARACTERISTIC zBci_BaseTorqueCharSelect_XAS16_09___A "geschwindigkeitsabhängige BasicSteerTorque-Kennlinienauswahl" VAL_BLK 0x15FE5C AblGLKWBsw 500 VFZHIGH 0 500 NUMBER 7 FORMAT "%8.4" /end CHARACTERISTIC
/begin CHARACTERISTIC zBci_BaseTorqueCharSelect_XAS16_10___A "geschwindigkeitsabhängige BasicSteerTorque-Kennlinienauswahl" VAL_BLK 0x15FE6C AblGLKWBsw 500 VFZHIGH 0 500 NUMBER 7 FORMAT "%8.4" /end CHARACTERISTIC
/begin CHARACTERISTIC zBci_BaseTorqueCharSelect_XAS16_11___A "geschwindigkeitsabhängige BasicSteerTorque-Kennlinienauswahl" VAL_BLK 0x15FE7C AblGLKWBsw 500 VFZHIGH 0 500 NUMBER 7 FORMAT "%8.4" /end CHARACTERISTIC
/begin CHARACTERISTIC zBci_BaseTorqueCharSelect_XAS16_12___A "geschwindigkeitsabhängige BasicSteerTorque-Kennlinienauswahl" VAL_BLK 0x15FE8C AblGLKWBsw 500 VFZHIGH 0 500 NUMBER 7 FORMAT "%8.4" /end CHARACTERISTIC
/begin CHARACTERISTIC zBci_BaseTorqueCharSelect_XAS16_13___A "geschwindigkeitsabhängige BasicSteerTorque-Kennlinienauswahl" VAL_BLK 0x15FE9C AblGLKWBsw 500 VFZHIGH 0 500 NUMBER 7 FORMAT "%8.4" /end CHARACTERISTIC
/begin CHARACTERISTIC zBci_BaseTorqueCharSelect_XAS16_14___A "geschwindigkeitsabhängige BasicSteerTorque-Kennlinienauswahl" VAL_BLK 0x15FEAC AblGLKWBsw 500 VFZHIGH 0 500 NUMBER 7 FORMAT "%8.4" /end CHARACTERISTIC
/begin CHARACTERISTIC zBci_BaseTorqueCharSelect_XAS16_15___A "geschwindigkeitsabhängige BasicSteerTorque-Kennlinienauswahl" VAL_BLK 0x15FEBC AblGLKWBsw 500 VFZHIGH 0 500 NUMBER 7 FORMAT "%8.4" /end CHARACTERISTIC
/begin CHARACTERISTIC zBci_BaseTorqueCharSelect_XAS16_16___A "geschwindigkeitsabhängige BasicSteerTorque-Kennlinienauswahl" VAL_BLK 0x15FECC AblGLKWBsw 500 VFZHIGH 0 500 NUMBER 7 FORMAT "%8.4" /end CHARACTERISTIC
/begin CHARACTERISTIC zBci_BaseTorqueCharSelect_XAS16_17___A "geschwindigkeitsabhängige BasicSteerTorque-Kennlinienauswahl" VAL_BLK 0x15FEDC AblGLKWBsw 500 VFZHIGH 0 500 NUMBER 7 FORMAT "%8.4" /end CHARACTERISTIC
/begin CHARACTERISTIC zBci_BaseTorqueCharSelect_XAS16_18___A "geschwindigkeitsabhängige BasicSteerTorque-Kennlinienauswahl" VAL_BLK 0x15FEEC AblGLKWBsw 500 VFZHIGH 0 500 NUMBER 7 FORMAT "%8.4" /end CHARACTERISTIC
/begin CHARACTERISTIC zBci_BaseTorqueCharSelect_XAS16_19___A "geschwindigkeitsabhängige BasicSteerTorque-Kennlinienauswahl" VAL_BLK 0x15FEFC AblGLKWBsw 500 VFZHIGH 0 500 NUMBER 7 FORMAT "%8.4" /end CHARACTERISTIC
/begin CHARACTERISTIC zBci_BaseTorqueCharSelect_XAS16_20___A "geschwindigkeitsabhängige BasicSteerTorque-Kennlinienauswahl" VAL_BLK 0x15FF0C AblGLKWBsw 500 VFZHIGH 0 500 NUMBER 7 FORMAT "%8.4" /end CHARACTERISTIC
/begin CHARACTERISTIC zBci_BaseTorqueCharSelect_XAS16_21___A "geschwindigkeitsabhängige BasicSteerTorque-Kennlinienauswahl" VAL_BLK 0x15FF1C AblGLKWBsw 500 VFZHIGH 0 500 NUMBER 7 FORMAT "%8.4" /end CHARACTERISTIC
/begin CHARACTERISTIC zBci_BaseTorqueCharSelect_XAS16_22___A "geschwindigkeitsabhängige BasicSteerTorque-Kennlinienauswahl" VAL_BLK 0x15FF2C AblGLKWBsw 500 VFZHIGH 0 500 NUMBER 7 FORMAT "%8.4" /end CHARACTERISTIC
/begin CHARACTERISTIC zBci_BaseTorqueCharSelect_XAS16_23___A "geschwindigkeitsabhängige BasicSteerTorque-Kennlinienauswahl" VAL_BLK 0x15FF3C AblGLKWBsw 500 VFZHIGH 0 500 NUMBER 7 FORMAT "%8.4" /end CHARACTERISTIC
/begin CHARACTERISTIC zBci_BaseTorqueCharSelect_XAS16_24___A "geschwindigkeitsabhängige BasicSteerTorque-Kennlinienauswahl" VAL_BLK 0x15FF4C AblGLKWBsw 500 VFZHIGH 0 500 NUMBER 7 FORMAT "%8.4" /end CHARACTERISTIC
/begin CHARACTERISTIC zBci_BaseTorqueCharSelect_XAS16_25___A "geschwindigkeitsabhängige BasicSteerTorque-Kennlinienauswahl" VAL_BLK 0x15FF5C AblGLKWBsw 500 VFZHIGH 0 500 NUMBER 7 FORMAT "%8.4" /end CHARACTERISTIC
/begin CHARACTERISTIC zBci_BaseTorqueCharSelect_XAS16_26___A "geschwindigkeitsabhängige BasicSteerTorque-Kennlinienauswahl" VAL_BLK 0x15FF6C AblGLKWBsw 500 VFZHIGH 0 500 NUMBER 7 FORMAT "%8.4" /end CHARACTERISTIC
/begin CHARACTERISTIC zBci_BaseTorqueCharSelect_XAS16_27___A "geschwindigkeitsabhängige BasicSteerTorque-Kennlinienauswahl" VAL_BLK 0x15FF7C AblGLKWBsw 500 VFZHIGH 0 500 NUMBER 7 FORMAT "%8.4" /end CHARACTERISTIC
/begin CHARACTERISTIC zBci_BaseTorqueCharSelect_XAS16_28___A "geschwindigkeitsabhängige BasicSteerTorque-Kennlinienauswahl" VAL_BLK 0x15FF8C AblGLKWBsw 500 VFZHIGH 0 500 NUMBER 7 FORMAT "%8.4" /end CHARACTERISTIC
/begin CHARACTERISTIC zBci_BaseTorqueCharSelect_XAS16_29___A "geschwindigkeitsabhängige BasicSteerTorque-Kennlinienauswahl" VAL_BLK 0x15FF9C AblGLKWBsw 500 VFZHIGH 0 500 NUMBER 7 FORMAT "%8.4" /end CHARACTERISTIC
/begin CHARACTERISTIC zBci_BaseTorqueCharSelect_XAS16_30___A "geschwindigkeitsabhängige BasicSteerTorque-Kennlinienauswahl" VAL_BLK 0x15FFAC AblGLKWBsw 500 VFZHIGH 0 500 NUMBER 7 FORMAT "%8.4" /end CHARACTERISTIC
/begin CHARACTERISTIC zBci_BaseTorqueCharSelect_XAS16_31___A "geschwindigkeitsabhängige BasicSteerTorque-Kennlinienauswahl" VAL_BLK 0x15FFBC AblGLKWBsw 500 VFZHIGH 0 500 NUMBER 7 FORMAT "%8.4" /end CHARACTERISTIC
/begin CHARACTERISTIC zBci_BaseTorqueCharSelect_XAS16_32___A "geschwindigkeitsabhängige BasicSteerTorque-Kennlinienauswahl" VAL_BLK 0x15FFCC AblGLKWBsw 500 VFZHIGH 0 500 NUMBER 7 FORMAT "%8.4" /end CHARACTERISTIC
/begin CHARACTERISTIC zBci_BaseTorqueCharSelect_XAS16_33___A "geschwindigkeitsabhängige BasicSteerTorque-Kennlinienauswahl" VAL_BLK 0x15FFDC AblGLKWBsw 500 VFZHIGH 0 500 NUMBER 7 FORMAT "%8.4" /end CHARACTERISTIC
/begin CHARACTERISTIC zBci_BaseTorqueCharSelect_XAS16_34___A "geschwindigkeitsabhängige BasicSteerTorque-Kennlinienauswahl" VAL_BLK 0x15FFEC AblGLKWBsw 500 VFZHIGH 0 500 NUMBER 7 FORMAT "%8.4" /end CHARACTERISTIC
/begin CHARACTERISTIC zBci_BaseTorqueCharSelect_XAS16_35___A "geschwindigkeitsabhängige BasicSteerTorque-Kennlinienauswahl" VAL_BLK 0x15FFFC AblGLKWBsw 500 VFZHIGH 0 500 NUMBER 7 FORMAT "%8.4" /end CHARACTERISTIC
/begin CHARACTERISTIC zBsd_MaxRampUpCycles_XDU8 "Max. Drehmoment generation für Rotor bewegung" VALUE 0x150B61 AblGLKWub 2 ZU0 1 3 FORMAT "%5.3" /end CHARACTERISTIC
/begin MEASUREMENT aApplI_AbsLatAccel_xdu16 "Abs. Querbeschleunigung aus Fahrzeugmodell" UWORD AFZ 1 100 0 60 FORMAT "%8.5" ECU_ADDRESS 0xFEBE9398 /end MEASUREMENT
/begin MEASUREMENT aApplI_LateralAcceleration_xds16 "Querbeschleunigung" SWORD AFZ 1 100 -30 30 FORMAT "%8.5" ECU_ADDRESS 0xFEBE939A /end MEASUREMENT
/begin MEASUREMENT aApplI_LongitudeAcceleration_xds16 "Lï¿½ngsbeschleunigung" SWORD AFZ 1 100 -30 30 FORMAT "%8.5" ECU_ADDRESS 0xFEBE939C /end MEASUREMENT
/begin MEASUREMENT aApplI_RotAccelerationFilt_xds16 "gefilterte Rotorbeschleunigung" SWORD ROTACC 1 100 -500 500 FORMAT "%8.4" ECU_ADDRESS 0xFEBE939E /end MEASUREMENT
/begin MEASUREMENT aApplI_RotAcceleration_xds16 "Rotorbeschleunigung" SWORD ROTACC 1 100 -500 500 FORMAT "%8.4" ECU_ADDRESS 0xFEBE93A0 /end MEASUREMENT
/begin MEASUREMENT fApplI_ImproperShutdown_xdb "Flag will be set when Improper shutdown occurs" UWORD ZU0 1 100 0 1 BIT_MASK 0x1 FORMAT "%5.3" ECU_ADDRESS 0xFEBE9843 /end MEASUREMENT
/begin MEASUREMENT fApplI_LaErrorMode_xdb "Flag ob diverse CAN Eingangsignale gueltig sind" UWORD ZU0 1 100 0 1 BIT_MASK 0x1 FORMAT "%5.3" ECU_ADDRESS 0xFEBE9844 /end MEASUREMENT
/begin MEASUREMENT fApplI_LdwErrorMode_xdb "Flag ob diverse CAN Eingangsignale gueltig sind" UWORD ZU0 1 100 0 1 BIT_MASK 0x1 FORMAT "%5.3" ECU_ADDRESS 0xFEBE9845 /end MEASUREMENT
/begin MEASUREMENT fApplI_RscEpsFault_xdb "Flag will be set when exit rsc occurs" UWORD ZU0 1 100 0 1 BIT_MASK 0x1 FORMAT "%5.3" ECU_ADDRESS 0xFEBE9846 /end MEASUREMENT
/begin MEASUREMENT fAsm_MaxHealingsReached_gdb "Maximale Heilungszahl erreicht, keine weiteren Heilungen erlaubt." UBYTE BIT 1 100 0 1 BIT_MASK 0x1 FORMAT "%5.3" ECU_ADDRESS 0xFEBE9847 /end MEASUREMENT
/begin MEASUREMENT fAutParkCtrl_MonSafeOk_xdb "Indicates whether the MonitorSafe checks report OK (1) or if they have detected a problem (0)" UWORD ZU0 1 100 0 1 BIT_MASK 0x1 FORMAT "%5.3" ECU_ADDRESS 0xFEBE9848 /end MEASUREMENT
/begin MEASUREMENT fBatVolt_StartTimer_gdb "So stellen Sie den Timer basierend auf dem Batteriespannungsstatus ein und setzen ihn zurück." UBYTE BIT 1 100 0 1 BIT_MASK 0x1 FORMAT "%5.3" ECU_ADDRESS 0xFEBE9849 /end MEASUREMENT
/begin MEASUREMENT fBsdI_MonSafeOk_xdb "Indicates whether the MonitorSafe checks report OK (true) or if they have detected a problem (false)" UWORD ZU0 1 100 0 1 BIT_MASK 0x1 FORMAT "%5.3" ECU_ADDRESS 0xFEBE984A /end MEASUREMENT
/begin MEASUREMENT fBsd_ActivateTorqueGen_xdb "Flag for Activating BSD torque" UWORD ZU0 1 100 0 1 BIT_MASK 0x1 FORMAT "%5.3" ECU_ADDRESS 0xFEBE984B /end MEASUREMENT
/begin MEASUREMENT fBsd_EnableMonitoring_xdb " flag to enable the detection of Blocked steering Statemachine" UWORD ZU0 1 100 0 1 BIT_MASK 0x1 FORMAT "%5.3" ECU_ADDRESS 0xFEBE984C /end MEASUREMENT
/begin MEASUREMENT fBsd_FirstRunMonitorSafe_xdb "Initializing min-max values for deltaRotPos calculation in MonitorSafe" UWORD BIT 1 100 0 1 BIT_MASK 0x1 FORMAT "%5.3" ECU_ADDRESS 0xFEBE984D /end MEASUREMENT
/begin MEASUREMENT fBsd_JobResultOK_xdb " Flag to indicate the status of NvM Call Back" UWORD ZU0 1 100 0 1 BIT_MASK 0x1 FORMAT "%5.3" ECU_ADDRESS 0xFEBE984E /end MEASUREMENT
/begin MEASUREMENT fBswI_IsInitialized_gdb "fBswI_IsInitialized_gdb" UWORD ZU0 1 100 0 1 BIT_MASK 0x1 FORMAT "%5.3" ECU_ADDRESS 0xFEBE9850 /end MEASUREMENT
/begin MEASUREMENT iApplI_AllowedBattCurr_xdu16 " Externer Vorgabewert fï¿½r maximalen Batteriestrom " UWORD SM_I 1 100 0 150 FORMAT "%8.4" ECU_ADDRESS 0xFEBE93A8 /end MEASUREMENT
/begin MEASUREMENT iApplI_MaxBattCurr_xdu16 " maximal erlaubter Batteriestrom " UWORD SM_I 1 100 0 200 FORMAT "%8.4" ECU_ADDRESS 0xFEBE4AC0 /end MEASUREMENT
/begin MEASUREMENT kApplI_AbsRackForce_xdu16 "Zahnstangenkraft" UWORD FRACK 1 100 0 20000 FORMAT "%8.2" ECU_ADDRESS 0xFEBE93AA /end MEASUREMENT
/begin MEASUREMENT kApplI_RackForceComfortRaw_xds16 "Komfort-Zahnstangenkraft roh" SWORD FRACK 1 100 -20000 20000 FORMAT "%8.2" ECU_ADDRESS 0xFEBE93AC /end MEASUREMENT
/begin MEASUREMENT kApplI_RackForceComfort_xds16 "Komfort-Zahnstangenkraft" SWORD FRACK 1 100 -20000 20000 FORMAT "%8.2" ECU_ADDRESS 0xFEBE93AE /end MEASUREMENT
/begin MEASUREMENT kApplI_RackForceMerge_xds16 "Gemergte Zahnstangenkraft" SWORD FRACK 1 100 -20000 20000 FORMAT "%8.2" ECU_ADDRESS 0xFEBE93B0 /end MEASUREMENT
/begin MEASUREMENT kApplI_RackForceSimple_xds16 "Einfache Zahnstangenkraft" SWORD FRACK 1 100 -20000 20000 FORMAT "%8.2" ECU_ADDRESS 0xFEBE93B2 /end MEASUREMENT
/begin MEASUREMENT kApplI_RackForce_xds16 "Zahnstangenkraft" SWORD FRACK 1 100 -20000 20000 FORMAT "%8.2" ECU_ADDRESS 0xFEBE93B4 /end MEASUREMENT
/begin MEASUREMENT kBciI_BSTCurveRackForceXAxis_xau16 "x-Achsenwerte der interpolierten und umskalierten BasicSteerTorque-Kennlinie (Zahnstangenkraft)" UWORD FRACK 1 100 0 30000 FORMAT "%8.2" ECU_ADDRESS 0xFEBE9CC8 MATRIX_DIM 10 1 1 /end MEASUREMENT
/begin MEASUREMENT kBci_BSTCurveRackForceXAxisRawL2_xaf32 "x-Achsenwerte der level2 interpolierten BasicSteerTorque-Kennlinie (Zahnstangenkraft)" FLOAT32_IEEE ZU0 1 100 0 30000 FORMAT "%10.4" ECU_ADDRESS 0xFEBE9CDC MATRIX_DIM 9 1 1 /end MEASUREMENT
/begin MEASUREMENT kBci_BSTCurveRackForceXAxisRaw_xas16 "x-Achsenwerte der level1 interpolierten BasicSteerTorque-Kennlinie (Zahnstangenkraft)" SWORD FRACK 1 100 0 30000 FORMAT "%8.2" ECU_ADDRESS 0xFEBE9F1C MATRIX_DIM 9 1 1 /end MEASUREMENT
/begin MEASUREMENT lApplI_AbsRackPosition_xdu16 "BetragZahnstangenposition [mm]" UWORD RACKPOS128 1 100 0 200 FORMAT "%8.4" ECU_ADDRESS 0xFEBE93C0 /end MEASUREMENT
/begin MEASUREMENT lApplI_RackPositionLtCorr_xds16 "langzeitkorrigierte Zahnstangenposition [mm]" SWORD RACKPOS128 1 100 -200 200 FORMAT "%8.4" ECU_ADDRESS 0xFEBE93C2 /end MEASUREMENT
/begin MEASUREMENT lApplI_RackPosition_xds16 "Zahnstangenposition [mm]" SWORD RACKPOS128 1 100 -200 200 FORMAT "%8.4" ECU_ADDRESS 0xFEBE93C4 /end MEASUREMENT
/begin MEASUREMENT lApplI_VehCentRackPos_xds16 "Zahnstangenposition bezogen auf Fahrzeugmitte [mm]" SWORD RACKPOS128 1 100 -200 200 FORMAT "%8.4" ECU_ADDRESS 0xFEBE93C6 /end MEASUREMENT
/begin MEASUREMENT lAutParkCtrlI_DesiredRackPosition_xds16 "desired rack position" SWORD RACKPOS128 1 100 -200 200 FORMAT "%8.4" ECU_ADDRESS 0xFEBE93C8 /end MEASUREMENT
/begin MEASUREMENT lAutParkCtrl_DesiredRackPosFilt_xds16 "filtrated desired rack position" SWORD RACKPOS128 1 100 -200 200 FORMAT "%8.4" ECU_ADDRESS 0xFEBE93CA /end MEASUREMENT
/begin MEASUREMENT mApplI_AbsDriverTorque_xdu16 "Betrag berechnetes Fahrerhandmoment" UWORD TBTHIGH 1 100 0 25 FORMAT "%8.5" ECU_ADDRESS 0xFEBE941E /end MEASUREMENT
/begin MEASUREMENT mApplI_DriverTorque_xds16 "Berechnetes Fahrerhandmoment" SWORD TBTHIGH 1 100 -25 25 FORMAT "%8.5" ECU_ADDRESS 0xFEBE9422 /end MEASUREMENT
/begin MEASUREMENT mApplI_DriveShaftTorque_xds16 "Antriebswellenmomoment" SWORD MDRVSHAFT 1 100 -32000 32000 FORMAT "%8.2" ECU_ADDRESS 0xFEBE9424 /end MEASUREMENT
/begin MEASUREMENT mApplI_LkaTorqueRequest_xds16 "LKA: Torque Request from CAN" SWORD TBTHIGH 1 100 -10.24023 10.23047 FORMAT "%8.5" ECU_ADDRESS 0xFEBE9428 /end MEASUREMENT
/begin MEASUREMENT mApplI_MaxRequiredMotorTorque_xdu16 "max angefordertes Motormoment" UWORD MMOT 1 100 0 12 FORMAT "%8.5" ECU_ADDRESS 0xFEBE942C /end MEASUREMENT
/begin MEASUREMENT mApplI_NominalMotorTorque_xds16 "summation of all power assist motor torques including AddOnFunctions" SWORD MMOT 1 100 -12 12 FORMAT "%8.5" ECU_ADDRESS 0xFEBE942E /end MEASUREMENT
/begin MEASUREMENT mApplI_SSWarnTorque_xds16 "StickSlipWarning Moment das nach den Limitierungen aufgerechnet wird" SWORD MMOT 1 100 -12 12 FORMAT "%8.5" ECU_ADDRESS 0xFEBE4ACA /end MEASUREMENT
/begin MEASUREMENT matAbsTorsionBarTorque_xdu16 "Absolutes Drehstabmoment" UWORD TBTHIGH 1 100 0 25 FORMAT "%8.5" ECU_ADDRESS 0xFEBE9434 /end MEASUREMENT
/begin MEASUREMENT matAssistanceLimitedY_xau16 "Y-Werte der begrenzten Unterstuetzungskennlinie" UWORD MMOT 1 100 0 63.99902 FORMAT "%8.5" ECU_ADDRESS 0xFEBE9D00 MATRIX_DIM 10 1 1 /end MEASUREMENT
/begin MEASUREMENT matAssistanceX_xau16 "X-Stuetzstellen der interpolierten Unterstuetzungskennlinie" UWORD TBTHIGH 1 100 0 63.99902 FORMAT "%8.5" ECU_ADDRESS 0xFEBE9D14 MATRIX_DIM 10 1 1 /end MEASUREMENT
/begin MEASUREMENT matAssistanceY_xau16 "Y-Werte der interpolierten Unterstuetzungskennlinie" UWORD MMOT 1 100 0 63.99902 FORMAT "%8.5" ECU_ADDRESS 0xFEBE9D28 MATRIX_DIM 10 1 1 /end MEASUREMENT
/begin MEASUREMENT matAssistantTorque_xds16 "Unterstuetzungsmoment" SWORD MMOT 1 100 -12 12 FORMAT "%8.5" ECU_ADDRESS 0xFEBE9436 /end MEASUREMENT
/begin MEASUREMENT matFactRedAssistTrq_xds16 "Unterstuetzungsmoment vor DAC, limitiert auf Produkt aus MinRedLevel und MaxUseableTorque" SWORD MMOT 1 100 -12 12 FORMAT "%8.5" ECU_ADDRESS 0xFEBE9438 /end MEASUREMENT
/begin MEASUREMENT matLimitationDiff_xds16 "DAC Eingang PT1 Offset" SWORD MMOT 1 100 -12 12 FORMAT "%8.5" ECU_ADDRESS 0xFEBE943A /end MEASUREMENT
/begin MEASUREMENT matLimitation_xds16 "Steigungsbegrenztes Unterstuetzungsmoment ohne PT1 Offset" SWORD MMOT 1 100 -12 12 FORMAT "%8.5" ECU_ADDRESS 0xFEBE943C /end MEASUREMENT
/begin MEASUREMENT matMaxXLimitedAssistance_xdu16 "max x-Wert steigungsbegrenten Unterstuetzungskennlinie" UWORD TBTHIGH 1 100 0 15 FORMAT "%8.5" ECU_ADDRESS 0xFEBE943E /end MEASUREMENT
/begin MEASUREMENT matPT1Offset_xds16 "Ausgang PT1 Offset" SWORD MMOT 1 100 -12 12 FORMAT "%8.5" ECU_ADDRESS 0xFEBE9440 /end MEASUREMENT
/begin MEASUREMENT matTorsionBarTorque_xds16 "Drehstabmoment mit Servofaktor und Offset fuer Assist Berechnung" SWORD TBTHIGH 1 100 -25 25 FORMAT "%8.5" ECU_ADDRESS 0xFEBE9442 /end MEASUREMENT
/begin MEASUREMENT matUnlimitedAssistantTorque_xds16 "urspruengliches Unterstuetzungsmoment (nicht steigungsbegrenzt)" SWORD MMOT 1 100 -12 12 FORMAT "%8.5" ECU_ADDRESS 0xFEBE9444 /end MEASUREMENT
/begin MEASUREMENT mAutParkCtrlI_DesMotTrqOffset4Check_xds16 "Desired motor torque offset of Automatic Parking Control to be read by Check component only" SWORD MMOT 1 100 -16 16 FORMAT "%8.5" ECU_ADDRESS 0xFEBE9446 /end MEASUREMENT
/begin MEASUREMENT mAutParkCtrlI_DesMotTrqOffset_xds16 "Desired motor torque offset of Automatic Parking Control" SWORD MMOT 1 100 -16 16 FORMAT "%8.5" ECU_ADDRESS 0xFEBE9368 /end MEASUREMENT
/begin MEASUREMENT mAutParkCtrlI_DesSteerTrqOffset4Check_xds16 "Desired steering torque offset of Automatic Parking Control to be read by Check component only" SWORD TBTHIGH 1 100 -10 10 FORMAT "%8.5" ECU_ADDRESS 0xFEBE9448 /end MEASUREMENT
/begin MEASUREMENT mAutParkCtrlI_DesSteerTrqOffset_xds16 "Desired steer torque offset of Automatic Parking Control" SWORD TBTHIGH 1 100 -10 10 FORMAT "%8.5" ECU_ADDRESS 0xFEBE936A /end MEASUREMENT
/begin MEASUREMENT mAutParkCtrl_DesMotTrqOffsetChecked_xds16 "Steer torque offset which has been subjected to the MakeSafe measures" SWORD MMOT 1 100 -16 16 FORMAT "%8.5" ECU_ADDRESS 0xFEBE936C /end MEASUREMENT
/begin MEASUREMENT mAutParkCtrl_DesSteerTrqOffsetChecked_xds16 "Steer torque offset which has been subjected to the MakeSafe measures" SWORD TBTHIGH 1 100 -10 10 FORMAT "%8.5" ECU_ADDRESS 0xFEBE936E /end MEASUREMENT
/begin MEASUREMENT mBciI_AssistCurveMMotYAxis_xau16 "y-Achsenwerte der berechneten Unterstützungs-Kennlinie (nominelles Unterstützungsmoment)" UWORD MMOT 1 100 0 12 FORMAT "%8.5" ECU_ADDRESS 0xFEBE9D3C MATRIX_DIM 10 1 1 /end MEASUREMENT
/begin MEASUREMENT mBciI_AssistCurveTBTXAxis_xau16 "x-Achsenwerte der berechneten Unterstützungs-Kennlinie (Handmoment)" UWORD TBTHIGH 1 100 0 15 FORMAT "%8.5" ECU_ADDRESS 0xFEBE9D50 MATRIX_DIM 10 1 1 /end MEASUREMENT
/begin MEASUREMENT mBciI_BSTCurveSteerTorqueYAxis_xau16 "y-Achsenwerte der interpolierten und umskalierten BasicSteerTorque-Kennlinie (nominales Handmoment)" UWORD TBTHIGH 1 100 0 15 FORMAT "%8.5" ECU_ADDRESS 0xFEBE9D64 MATRIX_DIM 10 1 1 /end MEASUREMENT
/begin MEASUREMENT mBci_BSTCurveSteerTorqueYAxisRawL2_xaf32 "y-Achsenwerte der level2 interpolierten BasicSteerTorque-Kennlinie (nominales Handmoment)" FLOAT32_IEEE ZU0 1 100 0 15 FORMAT "%10.7" ECU_ADDRESS 0xFEBE9D78 MATRIX_DIM 9 1 1 /end MEASUREMENT
/begin MEASUREMENT mBci_BSTCurveSteerTorqueYAxisRaw_xas16 "y-Achsenwerte der level1 interpolierten BasicSteerTorque-Kennlinie (nominales Handmoment)" SWORD TBTHIGH 1 100 0 15 FORMAT "%8.5" ECU_ADDRESS 0xFEBE9F30 MATRIX_DIM 9 1 1 /end MEASUREMENT
/begin MEASUREMENT mBsdI_MotorTorque4Check_xds16 "blocked steering detection motor torque offset to be read by BSD Check component only" SWORD MMOT 1 100 -1 1 FORMAT "%8.6" ECU_ADDRESS 0xFEBE944A /end MEASUREMENT
/begin MEASUREMENT mBsdI_MotorTorqueOffset_xds16 "Motormomentenoffset blocked steering detection" SWORD MMOT 1 100 -1 1 FORMAT "%8.6" ECU_ADDRESS 0xFEBE944C /end MEASUREMENT
/begin MEASUREMENT mBsd_MotorTorqueSaturated_xds16 "Steer torque offset which has been subjected to the MakeSafe measures" SWORD MMOT 1 100 -1 1 FORMAT "%8.6" ECU_ADDRESS 0xFEBE9370 /end MEASUREMENT
/begin MEASUREMENT mBSTI_NominalSteerTorque_xds16 "Basislenkmoment" SWORD TBTHIGH 1 100 -10 10 FORMAT "%8.5" ECU_ADDRESS 0xFEBE944E /end MEASUREMENT
/begin MEASUREMENT nApplI_AbsGeneratoricRotorSpeed_xdu16 "Generatorische Geschwindigkeit" UWORD VROT 1 100 0 13000 FORMAT "%3.0" ECU_ADDRESS 0xFEBE95BC /end MEASUREMENT
/begin MEASUREMENT nApplI_AbsRotorSpeedFilt_xdu16 "absolute, gefilterte Rotorgeschwindigkeit" UWORD VROT 1 100 0 13000 FORMAT "%3.0" ECU_ADDRESS 0xFEBE95BE /end MEASUREMENT
/begin MEASUREMENT nApplI_RotorSpeedFilt_xds16 "gefilterte Rotorgeschwindigkeit" SWORD VROT 1 100 -13000 13000 FORMAT "%3.0" ECU_ADDRESS 0xFEBE95C0 /end MEASUREMENT
/begin MEASUREMENT nApplI_RotorSpeed_xds16 "ungefilterte Rotorgeschwindigkeit" SWORD VROT 1 100 -13000 13000 FORMAT "%3.0" ECU_ADDRESS 0xFEBE4AD2 /end MEASUREMENT
/begin MEASUREMENT qApplI_WheelFrequencyFL_xds16 "Rad Frequenz vorne links" SWORD FREQHZ 1 100 -20 80 FORMAT "%8.5" ECU_ADDRESS 0xFEBE95E0 /end MEASUREMENT
/begin MEASUREMENT qApplI_WheelFrequencyFR_xds16 "Rad Frequenz vorne rechts" SWORD FREQHZ 1 100 -20 80 FORMAT "%8.5" ECU_ADDRESS 0xFEBE95E2 /end MEASUREMENT
/begin MEASUREMENT qApplI_WheelFrequencyRL_xds16 "Rad Frequenz hinten links" SWORD FREQHZ 1 100 -20 80 FORMAT "%8.5" ECU_ADDRESS 0xFEBE95E4 /end MEASUREMENT
/begin MEASUREMENT qApplI_WheelFrequencyRR_xds16 "Rad Frequenz hinten rechts" SWORD FREQHZ 1 100 -20 80 FORMAT "%8.5" ECU_ADDRESS 0xFEBE95E6 /end MEASUREMENT
/begin MEASUREMENT sApplI_ABSActive_xdu8 " " UBYTE ZU0 1 100 0 1 FORMAT "%5.3" ECU_ADDRESS 0xFEBE9902 /end MEASUREMENT
/begin MEASUREMENT sApplI_ABSFailed_xdu8 " " UBYTE ZU0 1 100 0 1 FORMAT "%5.3" ECU_ADDRESS 0xFEBE9903 /end MEASUREMENT
/begin MEASUREMENT sApplI_ApxState_xdu8 "APC: state from external ECU: 0=inactive, 1=request rack position control" UBYTE ZU0 1 100 0 2 FORMAT "%5.3" ECU_ADDRESS 0xFEBE9906 /end MEASUREMENT
/begin MEASUREMENT sApplI_ApxSysStatus_xdu8 "APC: state from external ECU: 0=inactive, 1=request rack position control" UBYTE ZU0 1 100 0 8 FORMAT "%5.3" ECU_ADDRESS 0xFEBE9907 /end MEASUREMENT
/begin MEASUREMENT sApplI_BoostModeRequest_xdu8 "Flag die vom Kundenprojekt genutzt werden kann um der HwLib mitzuteilen, wann es ok ist den boost mode zu aktivieren" UBYTE ZU0 1 100 0 1 FORMAT "%5.3" ECU_ADDRESS 0xFEBE4B1D /end MEASUREMENT
/begin MEASUREMENT sApplI_CommBusTml50_xdu8 "Status Klemme 50" UBYTE ZU0 1 100 0 254 FORMAT "%5.1" ECU_ADDRESS 0xFEBE9909 /end MEASUREMENT
/begin MEASUREMENT sApplI_DesVoltRedState_xdu8 "Spannungs reduktions Faktor" UBYTE ZU0 1 100 0 1 FORMAT "%5.3" ECU_ADDRESS 0xFEBE990A /end MEASUREMENT
/begin MEASUREMENT sApplI_displayindicatorstate_xdu8 "display Status" UBYTE ZU0 1 100 0 4 FORMAT "%5.3" ECU_ADDRESS 0xFEBE990B /end MEASUREMENT
/begin MEASUREMENT sApplI_EcuState_xdu8 " Sicherer Status der Ecu " UBYTE ECU_STATE 1 100 0 8 FORMAT "%13.11" ECU_ADDRESS 0xFEBE9910 /end MEASUREMENT
/begin MEASUREMENT sApplI_EngineRunning_xdu8 "Status des Verbrennungsmotors (0 == EngineNotRunning, 1 == EngineRunning, 2 == EngineRunningStable)" UBYTE ZU0 1 100 0 2 FORMAT "%5.3" ECU_ADDRESS 0xFEBE9912 /end MEASUREMENT
/begin MEASUREMENT sApplI_EpsApcState_xdu8 "APC: internal state for external ECU: 0=inactive, 1=EPS error, 2=available, 3=temporary error, 4=request rejected, 5=active rack position control, 6=ramp out" UBYTE ZU0 1 100 0 8 FORMAT "%5.3" ECU_ADDRESS 0xFEBE9913 /end MEASUREMENT
/begin MEASUREMENT sApplI_EpsApxState_xdu8 "APC: internal state for external ECU: 0=inactive, 1=EPS error, 2=available, 3=temporary error, 4=request rejected, 5=active rack position control, 6=ramp out" UBYTE ZU0 1 100 0 8 FORMAT "%5.3" ECU_ADDRESS 0xFEBE9914 /end MEASUREMENT
/begin MEASUREMENT sApplI_EpsCharismaState_xdu8 "Current State of Charisma Mode (DMS State): 0 - DEFAULT, 1 - INITIAL, 2 - AVAILABLE, 3 - TEMPORARY_ERROR, 4 - PERMANENT_ERROR" UBYTE ZU0 1 100 0 4 FORMAT "%5.3" ECU_ADDRESS 0xFEBE9915 /end MEASUREMENT
/begin MEASUREMENT sApplI_EssMode_xdu8 "ESS Mode Request" UBYTE ZU0 1 100 0 1 FORMAT "%5.3" ECU_ADDRESS 0xFEBE9917 /end MEASUREMENT
/begin MEASUREMENT sApplI_FootBrakeState_xdu8 "Status Fuï¿½bremse 0=Fahrer bremst nicht/1=Fahrer bremst" UBYTE ZU0 1 100 0 1 FORMAT "%5.3" ECU_ADDRESS 0xFEBE9918 /end MEASUREMENT
/begin MEASUREMENT sApplI_HWAEnabled_xdu8 "HWA Enable" UBYTE ZU0 1 100 0 255 FORMAT "%5.1" ECU_ADDRESS 0xFEBE9919 /end MEASUREMENT
/begin MEASUREMENT sApplI_InterferDetdState_xdu8 "Driver_interfere_true; Driver_interfere_false" UBYTE ZU0 1 100 0 1 FORMAT "%5.3" ECU_ADDRESS 0xFEBE991A /end MEASUREMENT
/begin MEASUREMENT sApplI_LdwVibrationRequest_xdu8 "Anforderung haptische Fahrerrückmeldung von LDW/LKA(0 = Haptic warning not requested, 1 = Haptic warning requested, 2..255 = SNA)" UBYTE ZU0 1 100 0 1 FORMAT "%5.3" ECU_ADDRESS 0xFEBE991D /end MEASUREMENT
/begin MEASUREMENT sApplI_LkaActivationRequest_xdu8 "LKA Activation request from CAN" UBYTE ZU0 1 100 0 3 FORMAT "%5.3" ECU_ADDRESS 0xFEBE991E /end MEASUREMENT
/begin MEASUREMENT sApplI_LkaActive_xdu8 "LKA Status 1= Aktiv" UBYTE STATUS 1 100 0 1 FORMAT "%5.3" ECU_ADDRESS 0xFEBE991F /end MEASUREMENT
/begin MEASUREMENT sApplI_LkaEnabled_xdu8 "LKA enabled flag" UBYTE STATUS 1 100 0 1 FORMAT "%5.3" ECU_ADDRESS 0xFEBE9920 /end MEASUREMENT
/begin MEASUREMENT sApplI_LkaMode_xdu8 "" UBYTE ZU0 1 100 0 1 FORMAT "%5.3" ECU_ADDRESS 0xFEBE9921 /end MEASUREMENT
/begin MEASUREMENT sApplI_RackPosQualifier_xdu8 "Qualifier for RackPosition / RampedRotorAngle; includes results of Plausis" UBYTE ZU0 1 100 0 11 FORMAT "%5.2" ECU_ADDRESS 0xFEBE9924 /end MEASUREMENT
/begin MEASUREMENT sApplI_remotecontrolstate_xdu8 "RSH Status" UBYTE STATUS 1 100 0 1 FORMAT "%5.3" ECU_ADDRESS 0xFEBE9925 /end MEASUREMENT
/begin MEASUREMENT sApplI_RemoteSteerVehDirection_xdu16 "Remote steering and holding request" UBYTE ZU0 1 100 0 15 FORMAT "%5.2" ECU_ADDRESS 0xFEBE9926 /end MEASUREMENT
/begin MEASUREMENT sApplI_SteeringAngleLinState_xdu8 "Status LW aus RW nicht korrigiert" UBYTE ZU0 1 100 0 2 FORMAT "%5.3" ECU_ADDRESS 0xFEBE9927 /end MEASUREMENT
/begin MEASUREMENT sApplI_SteeringAngleState_xdu8 "steering angle status (0=Error, 1=RawInit, 2=ExactlyInit, 3=NotInit)" UBYTE ZU0 1 100 0 3 FORMAT "%5.3" ECU_ADDRESS 0xFEBE9928 /end MEASUREMENT
/begin MEASUREMENT sApplI_TjaEnabled_xdu8 "Traffic jam assist enable" UBYTE ZU0 1 100 0 255 FORMAT "%5.1" ECU_ADDRESS 0xFEBE992A /end MEASUREMENT
/begin MEASUREMENT sApplI_TjaMode_xdu8 "Traffic jam assist Mode Request from CAN" UBYTE ZU0 1 100 0 1 FORMAT "%5.3" ECU_ADDRESS 0xFEBE992B /end MEASUREMENT
/begin MEASUREMENT sApplI_VehicleRunning_xdu8 "Status Fahrzeug fï¿½hrt (0 Fahrzeug steht, 1 Fahrzeug fï¿½hrt)" UBYTE ZU0 1 100 0 1 FORMAT "%5.3" ECU_ADDRESS 0xFEBE992C /end MEASUREMENT
/begin MEASUREMENT sApplI_VehicleSpeedState_xdu8 "Gï¿½ltigkeitsflag fï¿½r die Fahrzeuggeschw. vApplI_AbsVehicleSpeedFilt_xdu16 (1 = gï¿½ltig; 0 = ungï¿½ltig oder Ersatzgeschw.)" UBYTE ZU0 1 100 0 1 FORMAT "%5.3" ECU_ADDRESS 0xFEBE992D /end MEASUREMENT
/begin MEASUREMENT sApplI_VSEActive_xdu8 " " UBYTE ZU0 1 100 0 1 FORMAT "%5.3" ECU_ADDRESS 0xFEBE992E /end MEASUREMENT
/begin MEASUREMENT sApplI_VSEStatus_xdu8 " " UBYTE ZU0 1 100 0 7 FORMAT "%5.3" ECU_ADDRESS 0xFEBE992F /end MEASUREMENT
/begin MEASUREMENT sArmI_LocalShutdownSync_xdu8 "Flag um die Shutdownszustand im dual uC System zu synchronisieren." UBYTE ZU0 1 100 0 2 FORMAT "%5.3" ECU_ADDRESS 0xFEBE9930 /end MEASUREMENT
/begin MEASUREMENT sArmI_ShutdownMode_xdu8 "Aktueller Shutdownszustand des AR Mode Manager" UBYTE ZU0 1 100 0 6 FORMAT "%5.3" ECU_ADDRESS 0xFEBE9931 /end MEASUREMENT
/begin MEASUREMENT sAsmI_ErrLvl_Red_xdu8 "Fehlerstufe der ApplicationStateMachinePlausi" UBYTE ZU0 1 100 0 2 FORMAT "%5.3" ECU_ADDRESS 0xFEBE9932 /end MEASUREMENT
/begin MEASUREMENT sAsmI_ErrLvl_xdu8 "Fehlerstufe der ApplicationStateMachinePlausi" UBYTE ZU0 1 100 0 2 FORMAT "%5.3" ECU_ADDRESS 0xFEBE9933 /end MEASUREMENT
/begin MEASUREMENT sAsmI_LocalUcSync_xdu8 "Flag um die Statusmaschinen im dual uC System zu synchronisieren." UBYTE ZU0 1 100 0 2 FORMAT "%5.3" ECU_ADDRESS 0xFEBE9934 /end MEASUREMENT
/begin MEASUREMENT sAsmI_MaxHealings_ErrLvl_Red_xdu8 "ErrorLevel falls die Maximalanzahl an Heilungen erreicht wurde." UBYTE ZU0 1 100 0 2 FORMAT "%5.3" ECU_ADDRESS 0xFEBE9935 /end MEASUREMENT
/begin MEASUREMENT sAsmI_MaxHealings_ErrLvl_xdu8 "ErrorLevel falls die Maximalanzahl an Heilungen erreicht wurde." UBYTE ZU0 1 100 0 2 FORMAT "%5.3" ECU_ADDRESS 0xFEBE9936 /end MEASUREMENT
/begin MEASUREMENT sAsmI_RequestBswShutdown_xdb "Flag für Bsw Shutdown Anfrage" UBYTE BIT 1 100 0 1 BIT_MASK 0x1 FORMAT "%5.3" ECU_ADDRESS 0xFEBE9937 /end MEASUREMENT
/begin MEASUREMENT sAsmPlausi_EcuState_xdu8 "Application State Machine Plausi - ECU Zustand" UBYTE ZU0 1 100 0 7 FORMAT "%5.3" ECU_ADDRESS 0xFEBE9938 /end MEASUREMENT
/begin MEASUREMENT sAsm_StoredEcuState_xdu8 "EcuState des letzten Aufrufs um zu prüfen, ob eine Heilung aufgetreten ist." UBYTE ZU0 1 100 0 255 FORMAT "%5.1" ECU_ADDRESS 0xFEBE9939 /end MEASUREMENT
/begin MEASUREMENT sAssCtrlI_AssistMode_xdu8 "Aktueller Unterstuetzungszustand des AssistanceController" UBYTE ZU0 1 100 0 4 FORMAT "%5.3" ECU_ADDRESS 0xFEBE993A /end MEASUREMENT
/begin MEASUREMENT sAssCtrl_InternalAssistState_xdu8 "Aktueller Status der internen AssistanceController Statusmaschine" UBYTE ZU0 1 100 0 7 FORMAT "%5.3" ECU_ADDRESS 0xFEBE993B /end MEASUREMENT
/begin MEASUREMENT sAutParkCtrlI_Activate_xdu8 "Indicates whether APC shall actively calculate and request a torque (1 means active)." UBYTE ZU0 1 100 0 1 FORMAT "%5.3" ECU_ADDRESS 0xFEBE993C /end MEASUREMENT
/begin MEASUREMENT sAutParkCtrlI_MakeSafeAndMonState_xdu8 "Indicates whether the MakeSafe and MonitorSafe checks report OK (0) or if they have detected a problem (1) or if HandsOn was detected (2) or if invalid arbitration was detected (3)." UBYTE ZU0 1 100 0 3 FORMAT "%5.3" ECU_ADDRESS 0xFEBE993D /end MEASUREMENT
/begin MEASUREMENT sAutParkCtrl_CancelState_xdu16 "flags are set when EpsApcState changes to REQUEST_REJECTED: Bit0=EPS-Error, Bit1=SignalsInvalid, Bit2=ApcSignalsInvalid, Bit3=VehSpeedRangeInvalid, Bit4=RackPosRequestInvalid, Bit5=MakeSafeAndMonNotOk, Bit6=ArbitrationFailed, Bit7=HandsOn, Bit8=FctCoRetur" UWORD ZU0 1 100 0 511 FORMAT "%8.4" ECU_ADDRESS 0xFEBE95F0 /end MEASUREMENT
/begin MEASUREMENT sAutParkCtrl_FctCoCtrlState_xdu8 "return value of the FunctionCoordinator" UBYTE ZU0 1 100 0 99 FORMAT "%5.2" ECU_ADDRESS 0xFEBE993E /end MEASUREMENT
/begin MEASUREMENT sAutParkCtrl_FeatureState_xdu8 "internal feature state for FunctionCoordinator" UBYTE ZU0 1 100 0 5 FORMAT "%5.3" ECU_ADDRESS 0xFEBE993F /end MEASUREMENT
/begin MEASUREMENT sAutParkCtrl_MakeSafeState_xdu8 "Indicates whether the MakeSafe checks report OK (0), if they have detected a problem (1) or if HandsOn was detected (2)." UBYTE ZU0 1 100 0 2 FORMAT "%5.3" ECU_ADDRESS 0xFEBE9940 /end MEASUREMENT
/begin MEASUREMENT sBsdI_BlockedSteeringDetection_xdu8 "Status Blockiererkennung 0: nicht blockiert, 1: Verdacht einer Blockierung 2: blockiert" UBYTE ZU0 1 100 0 2 FORMAT "%5.3" ECU_ADDRESS 0xFEBE9941 /end MEASUREMENT
/begin MEASUREMENT sBsd_CtrlState_xdu8 "Return value of the FunctionCoordinator" UBYTE ZU0 1 100 0 99 FORMAT "%5.2" ECU_ADDRESS 0xFEBE9942 /end MEASUREMENT
/begin MEASUREMENT sBsd_CurrentInternalState_xdu8 "BSD: Internal state of state machine : 0=CHECK, 1=DetectionInactive, 2=Active, 3=BlockSuspicon,4=TorqueActive, 5=BlockDetected" UBYTE ZU0 1 100 0 6 FORMAT "%5.3" ECU_ADDRESS 0xFEBE9943 /end MEASUREMENT
/begin MEASUREMENT sBsd_FailureCause_xdu8 "Cause of failure (0= no failure, 1=requested MotorTorque too high,2=Arbitration Error,4=Rotpos and Torque not in sync)" UBYTE ZU0 1 100 0 4 FORMAT "%5.3" ECU_ADDRESS 0xFEBE9944 /end MEASUREMENT
/begin MEASUREMENT sBsd_FeatureState_xdu8 "Funktionskoordinator status fuer BlockedSteeringDetection" UBYTE ZU0 1 100 0 99 FORMAT "%5.2" ECU_ADDRESS 0xFEBE9945 /end MEASUREMENT
/begin MEASUREMENT sEpsInI_ADActiveReq_xdu8 "Hands Free Active Request:0x0=NoRequest;0x2=NOP Active Request" UBYTE ZU0 1 100 0 2 FORMAT "%5.3" ECU_ADDRESS 0xFEBE9986 /end MEASUREMENT
/begin MEASUREMENT sEpsInI_ADDeactiveReq_xdu8 "Hands Free Deactive Request" UBYTE ZU0 1 100 0 1 FORMAT "%5.3" ECU_ADDRESS 0xFEBE9987 /end MEASUREMENT
/begin MEASUREMENT sEpsInI_ADModeReq_xdu8 "Hands Free Mode Request:0x0=No AD;0x2=AD NOP" UBYTE ZU0 1 100 0 2 FORMAT "%5.3" ECU_ADDRESS 0xFEBE9988 /end MEASUREMENT
/begin MEASUREMENT sEpsIn_GearSt_xdu8 "Level identification state" UBYTE STATUS 1 100 0 4 FORMAT "%5.3" ECU_ADDRESS 0xFEBE9997 /end MEASUREMENT
/begin MEASUREMENT sHLIpcI_RemoteBoschASDiagnostics_xdu8 "RemoteBoschASDiagnostics" UBYTE ZU0 1 100 0 1 FORMAT "%5.3" ECU_ADDRESS 0xFEBE99A4 /end MEASUREMENT
/begin MEASUREMENT tAsm_StartTimeHealingsOscillation_xdu16 "Zeitstempel um einen oszillierenden Fehler zu erkennen." UWORD TIMMS 1 100 0 65535 FORMAT "%8.2" ECU_ADDRESS 0xFEBE960C /end MEASUREMENT
/begin MEASUREMENT tBatVolt_StartTimeStamp_xdu16 "Holen Sie sich die aktuelle Uhrzeit des Systems." UWORD TIMS 1 100 0 65535 FORMAT "%6.0" ECU_ADDRESS 0xFEBE960E /end MEASUREMENT
/begin MEASUREMENT tBatVolt_TimeElapsed_xdu32 "Zeitstempel zum Verstreichen des Batteriespannungswarnstatus." ULONG TIMS 1 100 0 4294967295 FORMAT "%6.0" ECU_ADDRESS 0xFEBE9120 /end MEASUREMENT
/begin MEASUREMENT vApplI_AbsRackSpeed_xdu16 "Abs. Zahnstangengeschwindigkeit [mm/s]" UWORD RACKSPEED128 1 100 0 250 FORMAT "%8.4" ECU_ADDRESS 0xFEBE9644 /end MEASUREMENT
/begin MEASUREMENT vApplI_AbsSafeNssVehicleSpeed_xdu16 "Abs. Fahrzeuggeschwindigkeit: Abgesichert im stillstandsnahen Bereich" UWORD VFZHIGH 1 100 0 500 FORMAT "%8.4" ECU_ADDRESS 0xFEBE9646 /end MEASUREMENT
/begin MEASUREMENT vApplI_AbsSafeVehicleSpeed_xdu16 "Abs. Fahrzeuggeschwindigkeit: Abgesichert ï¿½ber den kompletten Geschwindigkeitsbereich" UWORD VFZHIGH 1 100 0 500 FORMAT "%8.4" ECU_ADDRESS 0xFEBE4B00 /end MEASUREMENT
/begin MEASUREMENT vApplI_AbsSteeringAngleSpeed_xdu16 "Abs. Lenkwinkelgeschwindigkeit" UWORD SAS_8 1 100 0 1500 FORMAT "%8.3" ECU_ADDRESS 0xFEBE9648 /end MEASUREMENT
/begin MEASUREMENT vApplI_AbsVehicleSpeedFilt_xdu16 "Abs. Fahrzeuggeschwindigkeit: aufbereitet" UWORD VFZHIGH 1 100 0 500 FORMAT "%8.4" ECU_ADDRESS 0xFEBE964A /end MEASUREMENT
/begin MEASUREMENT vApplI_RackSpeed_xds16 "Zahnstangengeschwindigkeit [mm/s]" SWORD RACKSPEED128 1 100 -250 250 FORMAT "%8.4" ECU_ADDRESS 0xFEBE9654 /end MEASUREMENT
/begin MEASUREMENT vApplI_SteeringAngleSpeed_xds16 "Lenkwinkelgeschwindigkeit" SWORD SAS_8 1 100 -1500 1500 FORMAT "%8.3" ECU_ADDRESS 0xFEBE9658 /end MEASUREMENT
/begin MEASUREMENT vApplI_WindUpAdaption_xds32 "ï¿½nderungsrate der Kraft aus Zahnstangenkraft-Adaptionen" SLONG FRACK 1 100 -20000000 20000000 FORMAT "%13.4" ECU_ADDRESS 0xFEBE9178 /end MEASUREMENT
/begin MEASUREMENT vApplI_YawRateRaw_xds16 "Gierrate" SWORD VGIER 1 100 -150 150 FORMAT "%8.4" ECU_ADDRESS 0xFEBE965A /end MEASUREMENT
/begin MEASUREMENT vApplI_YawVelocity_xds16 "Gierrate" SWORD VGIER 1 100 -150 150 FORMAT "%8.4" ECU_ADDRESS 0xFEBE965C /end MEASUREMENT
/begin MEASUREMENT vAutParkCtrl_DesiredRackSpeed_xds16 "desired rack speed incl. feed-forward controlled part" SWORD RACKSPEED128 1 100 -250 250 FORMAT "%8.4" ECU_ADDRESS 0xFEBE965E /end MEASUREMENT
/begin MEASUREMENT vAutParkCtrl_LimitedDesiredRackSpeed_xds16 "gradient limited desired rack speed" SWORD RACKSPEED128 1 100 -250 250 FORMAT "%8.4" ECU_ADDRESS 0xFEBE9660 /end MEASUREMENT
/begin MEASUREMENT vazReqVehSpeed_xdu8 "Anzahl der Werte im Residuum" UBYTE ZU0 1 100 0 255 FORMAT "%5.1" ECU_ADDRESS 0xFEBE9A54 /end MEASUREMENT
/begin MEASUREMENT vYROC_compvalue_xdf32 "Gierrate" FLOAT32_IEEE ZU0 1 100 -150 150 FORMAT "%10.6" ECU_ADDRESS 0xFEBE91CC /end MEASUREMENT
/begin MEASUREMENT wApplI_AbsDynSteerAngle_xdu16 "Absoluter dyn Lenkwinkel (Summe aus Schwimmwinkel und Lenkradwinkel)" UWORD SA_10 1 100 0 1000 FORMAT "%8.3" ECU_ADDRESS 0xFEBE96AA /end MEASUREMENT
/begin MEASUREMENT wApplI_AbsPinionAngle_xdu16 "Absoluter Ritzel Winkel" UWORD SA_10 1 100 0 1000 FORMAT "%8.3" ECU_ADDRESS 0xFEBE96AC /end MEASUREMENT
/begin MEASUREMENT wApplI_AbsSteeringAngleSafe_xdu16 "Abs. sicherer korrigierter Lenkwinkel" UWORD SA_10 1 100 0 1000 FORMAT "%8.3" ECU_ADDRESS 0xFEBE96AE /end MEASUREMENT
/begin MEASUREMENT wApplI_AbsSteeringAngle_xdu16 "Abs. korrigierter Lenkwinkel" UWORD SA_10 1 100 0 1000 FORMAT "%8.3" ECU_ADDRESS 0xFEBE96B0 /end MEASUREMENT
/begin MEASUREMENT wApplI_ApxDesiredAngle_xds16 "APC: desired steering angle" SWORD SA_10 1 100 -1000 1000 FORMAT "%8.3" ECU_ADDRESS 0xFEBE96B2 /end MEASUREMENT
/begin MEASUREMENT wApplI_DynSteerAngle_xds16 "Dyn Lenkwinkel (Summe aus Schwimmwinkel und Lenkradwinkel)" SWORD SA_10 1 100 -1000 1000 FORMAT "%8.3" ECU_ADDRESS 0xFEBE96B4 /end MEASUREMENT
/begin MEASUREMENT wApplI_PinionAngle_xds16 "Ritzel Winkel" SWORD SA_10 1 100 -1000 1000 FORMAT "%8.3" ECU_ADDRESS 0xFEBE96BA /end MEASUREMENT
/begin MEASUREMENT wApplI_SteeringAngleLtCorr_xds16 "langzeitkorrigierter Lenkwinkel [ï¿½]" SWORD SA_10 1 100 -1000 1000 FORMAT "%8.3" ECU_ADDRESS 0xFEBE96BC /end MEASUREMENT
/begin MEASUREMENT wApplI_SteeringAngle_xds16 "korrigierter Lenkwinkel" SWORD SA_10 1 100 -1000 1000 FORMAT "%8.3" ECU_ADDRESS 0xFEBE96C0 /end MEASUREMENT
/begin MEASUREMENT wBsd_DeltaRotPosMakeSafe_xds32 "Delta Rotor position for BsdI_MakeSafe server" SLONG ROTPOS 1 100 -32000.0097656 32000.0097656 FORMAT "%13.7" ECU_ADDRESS 0xFEBE91D4 /end MEASUREMENT
/begin MEASUREMENT wBsd_DeltaRotPosMonitor_xds32 "Delta Rotor position for BsdI_MonitorSafe server" SLONG ROTPOS 1 100 -32000.0097656 32000.0097656 FORMAT "%13.7" ECU_ADDRESS 0xFEBE91D8 /end MEASUREMENT
/begin MEASUREMENT wBsd_DeltaRotPos_xds32 "Calculated Delta Rotor Position threshold" SLONG ROTPOS 1 100 -32000.0097656 32000.0097656 FORMAT "%13.7" ECU_ADDRESS 0xFEBE91DC /end MEASUREMENT
/begin MEASUREMENT wBsd_MaxRotPosMakeSafe_xds32 "Max Rotor Position for BsdI_MakeSafe server" SLONG ROTPOS 1 100 -32000.0097656 32000.0097656 FORMAT "%13.7" ECU_ADDRESS 0xFEBE91E0 /end MEASUREMENT
/begin MEASUREMENT wBsd_MaxRotPosMonitor_xds32 "Max Rotor Position for BsdI_MonitorSafe server" SLONG ROTPOS 1 100 -32000.0097656 32000.0097656 FORMAT "%13.7" ECU_ADDRESS 0xFEBE91E4 /end MEASUREMENT
/begin MEASUREMENT wBsd_MinRotPosMakeSafe_xds32 "Min Rotor Position for BsdI_MakeSafe server" SLONG ROTPOS 1 100 -32000.0097656 32000.0097656 FORMAT "%13.7" ECU_ADDRESS 0xFEBE91E8 /end MEASUREMENT
/begin MEASUREMENT wBsd_MinRotPosMonitor_xds32 "Min Rotor Position for BsdI_MonitorSafe server" SLONG ROTPOS 1 100 -32000.0097656 32000.0097656 FORMAT "%13.7" ECU_ADDRESS 0xFEBE91EC /end MEASUREMENT
/begin MEASUREMENT wBsd_RotPosMax_xds32 "Calculated Rotor Position Maximum threshold" SLONG ROTPOS 1 100 -32000.0097656 32000.0097656 FORMAT "%13.7" ECU_ADDRESS 0xFEBE91F0 /end MEASUREMENT
/begin MEASUREMENT wBsd_RotPosMin_xds32 "Calculated Rotor Position Minimum threshold" SLONG ROTPOS 1 100 -32000.0097656 32000.0097656 FORMAT "%13.7" ECU_ADDRESS 0xFEBE91F4 /end MEASUREMENT
/begin MEASUREMENT xApplI_ActCharFact_xdu16 "Faktor fï¿½r die Gewichtung des aktuellen Fahrprogramms" UWORD RIGHTSH13NP 1 100 0 1 FORMAT "%8.6" ECU_ADDRESS 0xFEBE9724 /end MEASUREMENT
/begin MEASUREMENT xApplI_DegreeOfOversteer_xdu16 "Grad des ï¿½bersteuerns" UWORD RIGHTSH10NP 1 100 0 1 FORMAT "%8.6" ECU_ADDRESS 0xFEBE9726 /end MEASUREMENT
/begin MEASUREMENT xApplI_DegreeOfUndersteer_xdu16 "Grad des Untersteuerns" UWORD RIGHTSH10NP 1 100 0 1 FORMAT "%8.6" ECU_ADDRESS 0xFEBE9728 /end MEASUREMENT
/begin MEASUREMENT xApplI_HLCharCurveBuckleFact_xdu16 "Gesamtfaktor der Kennlinienstauchung" UWORD RIGHTSH15NP 1 100 0 1 FORMAT "%8.6" ECU_ADDRESS 0xFEBE4B06 /end MEASUREMENT
/begin MEASUREMENT xApplI_HLReductionFactor_xdu16 "Der niedrigste von allen im HighLevel angeforderten Reduktionsfaktoren" UWORD RIGHTSH15NP 1 100 0 1 FORMAT "%8.6" ECU_ADDRESS 0xFEBE4B08 /end MEASUREMENT
/begin MEASUREMENT xApplI_NewCharFact_xdu16 "Faktor fï¿½r die Gewichtung des neuen Fahrprogramms" UWORD RIGHTSH13NP 1 100 0 1 FORMAT "%8.6" ECU_ADDRESS 0xFEBE972A /end MEASUREMENT
/begin MEASUREMENT xApplI_RatioD2C_xdu16 "Verhï¿½ltnis der gemergten Zahnstangekraft (1=100% Dynamic, 0=100% Comfort)" UWORD RIGHTSH10NP 1 100 0 1 FORMAT "%8.6" ECU_ADDRESS 0xFEBE972C /end MEASUREMENT
/begin MEASUREMENT xApplI_TotalMotTorLim_xdu16 "Gesamtreduktion des Torque Reduction Coordinators" UWORD RIGHTSH15NP 1 100 0 1 FORMAT "%8.6" ECU_ADDRESS 0xFEBE4B0A /end MEASUREMENT
/begin MEASUREMENT xApplI_VehDirection_xds8 "Vorzeichen Fahrzeuggeschwindigkeit vorwï¿½rts (1)/ rï¿½ckwï¿½rts (-1)" SBYTE ZU0 1 100 -1 1 FORMAT "%5.3" ECU_ADDRESS 0xFEBE9A55 /end MEASUREMENT
/begin MEASUREMENT xatActTorGradFact_xdu16 "aktuelle Gradientenbegrenzung Unterspannungsueberwachung" UWORD RSH15 1 100 0 100 FORMAT "%8.4" ECU_ADDRESS 0xFEBE9730 /end MEASUREMENT
/begin MEASUREMENT xatAssistanceGradMax_xdu16 "Maximaler Gradient der Unterstuetzungskennlinie" UWORD TORGAINHIGH 1 100 0 5 FORMAT "%8.6" ECU_ADDRESS 0xFEBE9732 /end MEASUREMENT
/begin MEASUREMENT xatAssistanceGrad_xau16 "Steigungen der aktuellen Unterstuetzungskennlinie" UWORD TORGAINHIGH 1 100 0 63.99902 FORMAT "%8.5" ECU_ADDRESS 0xFEBE9FB0 MATRIX_DIM 9 1 1 /end MEASUREMENT
/begin MEASUREMENT xatAssistanceGrad_xdu16 "aktuelle Steigung der Unterstuetzungskennlinie" UWORD TORGAINHIGH 1 100 0 10 FORMAT "%8.5" ECU_ADDRESS 0xFEBE9734 /end MEASUREMENT
/begin MEASUREMENT xatAssistFilterFrequ_xdu16 "aktuelle Filterzeitkonstante fuer PT1 Limitierung" UWORD RIGHTSH11NP 1 100 0.0004882813 0.1499023 FORMAT "%9.7" ECU_ADDRESS 0xFEBE9736 /end MEASUREMENT
/begin MEASUREMENT xatCurrentServoFactor_xdu8 "Aktueller Servofaktor" UBYTE RSH7 1 100 0 150 FORMAT "%5.1" ECU_ADDRESS 0xFEBE9A56 /end MEASUREMENT
/begin MEASUREMENT xatMaxGrad_xdu16 "aktuell berechneter maximaler Gradient fuer DAC" UWORD TORGAINHIGH 1 100 0 5 FORMAT "%8.6" ECU_ADDRESS 0xFEBE9738 /end MEASUREMENT
/begin MEASUREMENT xAutParkCtrlI_DesActRetFuncFact4Check_xdu16 "Desired ActiveReturn function factor of AutomaticParkingControl to be read by Check component only" UWORD RIGHTSH10NP 1 100 0 1 FORMAT "%8.6" ECU_ADDRESS 0xFEBE973A /end MEASUREMENT
/begin MEASUREMENT xAutParkCtrlI_DesActRetFuncFact_xdu16 "Desired ActiveReturn function factor of AutomaticParkingControl" UWORD RIGHTSH10NP 1 100 0 1 FORMAT "%8.6" ECU_ADDRESS 0xFEBE973C /end MEASUREMENT
/begin MEASUREMENT xAutParkCtrl_DesActRetFuncFactChecked_xdu16 "ActiveReturn function factor which has been subjected to the MakeSafe measures" UWORD RIGHTSH10NP 1 100 0 1 FORMAT "%8.6" ECU_ADDRESS 0xFEBE973E /end MEASUREMENT
/begin MEASUREMENT xEpsInI_VehDirection_xds8 "vehicle direction from EPS Input" SBYTE ZU0 1 100 -1 1 FORMAT "%5.3" ECU_ADDRESS 0xFEBE9A57 /end MEASUREMENT
/begin MEASUREMENT yApplI_ActCharacteristic_xdu8 "Aktuelles Fahrprogramm" UBYTE ZU0 1 100 0 2 FORMAT "%5.3" ECU_ADDRESS 0xFEBE9A5F /end MEASUREMENT
/begin MEASUREMENT yApplI_CharismaSelected_xdu8 "Charisma selected: 0-Normal Mode, 1-Comfort Mode, 2-Sport Mode, 3-Reserved1, 4-Reserved2, 255-Unavailable" UBYTE ZU0 1 100 0 4 FORMAT "%5.3" ECU_ADDRESS 0xFEBE9A61 /end MEASUREMENT
/begin MEASUREMENT yApplI_DMSActCharacteristic_xdu8 "Actual characteristic Selected through DMS: 0-Normal Mode, 1-Comfort Mode, 2-Sport Mode, 3-Reserved1, 4-Reserved2, 5-Special Mode" UBYTE ZU0 1 100 0 5 FORMAT "%5.3" ECU_ADDRESS 0xFEBE9A62 /end MEASUREMENT
/begin MEASUREMENT yApplI_EstimatedGear_xdu8 " " UBYTE ZU0 1 100 0 1 FORMAT "%5.3" ECU_ADDRESS 0xFEBE9A63 /end MEASUREMENT
/begin MEASUREMENT yApplI_HLMaxTorqueGradient_xdu16 "Der niedrigste von allen Momentengradienten" UWORD TORGRAD 1 100 0 12 FORMAT "%8.5" ECU_ADDRESS 0xFEBE4B12 /end MEASUREMENT
/begin MEASUREMENT yApplI_NewCharacteristic_xdu8 "Neues Fahrprogramm" UBYTE ZU0 1 100 0 2 FORMAT "%5.3" ECU_ADDRESS 0xFEBE9A67 /end MEASUREMENT
/begin MEASUREMENT yApplI_ReverseGearEngaged_xdu8 "Ist R?ckw?rtsgang eingelegt" UBYTE ZU0 1 100 0 3 FORMAT "%5.3" ECU_ADDRESS 0xFEBE9A6A /end MEASUREMENT
/begin MEASUREMENT yeeResetInfo_xdu32 "reset information" ULONG ZU0 1 100 0 4294967295 FORMAT "%13.2" ECU_ADDRESS 0xFEBE92AC /end MEASUREMENT
/begin MEASUREMENT zApplI_SlippingClutchActivations_xdu8 "Zï¿½hler fï¿½r Rutschkupplungsauslï¿½ser" UBYTE ZU0 1 100 0 255 FORMAT "%5.1" ECU_ADDRESS 0xFEBE9A84 /end MEASUREMENT
/begin MEASUREMENT zAsm_HealingsPerIgnition_xdu8 "Zähler der Heilungen innerhalb dieses Klemmenzyklus." UBYTE ZU0 1 100 0 255 FORMAT "%5.1" ECU_ADDRESS 0xFEBE9A85 /end MEASUREMENT
/begin MEASUREMENT zAsm_HealingsPerOscillation_xdu8 "Zähler der Heilungen innerhalb tAsmI_OscillationMeasureTime_XDU16." UBYTE ZU0 1 100 0 255 FORMAT "%5.1" ECU_ADDRESS 0xFEBE9A86 /end MEASUREMENT
/begin MEASUREMENT zAutParkCtrl_HandsOnCounter_xdu16 "Diverse stored counter value of HandsOnDetection" UWORD TIMMS 1 100 0 1000 FORMAT "%8.3" ECU_ADDRESS 0xFEBE9800 /end MEASUREMENT
/begin MEASUREMENT zBsd_BlockDetectedCnt_xdu16 "Bsd Counter when Blocked steering is detected" UWORD ZU0 1 100 0 65535 FORMAT "%8.2" ECU_ADDRESS 0xFEBE9802 /end MEASUREMENT
/begin MEASUREMENT zBsd_BlockSuspicionCnt_xdu16 "Bsd Counter when BSD enters SUSPICION state of statemachine" UWORD ZU0 1 100 0 65535 FORMAT "%8.2" ECU_ADDRESS 0xFEBE9804 /end MEASUREMENT
/begin MEASUREMENT zBsd_CycleCount_xdu8 "Internal Counter of Statemachine to generate the torque Cycles" UBYTE ZU0 1 100 0 3 FORMAT "%5.3" ECU_ADDRESS 0xFEBE9A89 /end MEASUREMENT
/begin COMPU_METHOD AFZ "" RAT_FUNC "%6.5" "m/s^2" COEFFS 0 1024 0 0 0 1 /end COMPU_METHOD
/begin COMPU_METHOD BIT "" RAT_FUNC "%6.2" "Bitanzeige" COEFFS 0 1 0 0 0 1 /end COMPU_METHOD
/begin COMPU_METHOD ECU_STATE "" TAB_VERB "%6.3" "Status" COMPU_TAB_REF ECU_STATE /end COMPU_METHOD
/begin COMPU_METHOD FRACK "" RAT_FUNC "%6.2" "N" COEFFS 0 1 0 0 0 1 /end COMPU_METHOD
/begin COMPU_METHOD FREQHZ "" RAT_FUNC "%6.3" "Hz" COEFFS 0 8 0 0 0 1 /end COMPU_METHOD
/begin COMPU_METHOD MDRVSHAFT "" RAT_FUNC "%6.2" "Nm" COEFFS 0 1 0 0 0 1 /end COMPU_METHOD
/begin COMPU_METHOD MMOT "" RAT_FUNC "%6.5" "Nm" COEFFS 0 1024 0 0 0 1 /end COMPU_METHOD
/begin COMPU_METHOD RACKPOS128 "" RAT_FUNC "%6.4" "mm" COEFFS 0 128 0 0 0 1 /end COMPU_METHOD
/begin COMPU_METHOD RACKSPEED128 "" RAT_FUNC "%6.4" "mm/s" COEFFS 0 128 0 0 0 1 /end COMPU_METHOD
/begin COMPU_METHOD RIGHTSH10NP "" RAT_FUNC "%6.5" "" COEFFS 0 1024 0 0 0 1 /end COMPU_METHOD
/begin COMPU_METHOD RIGHTSH11NP "" RAT_FUNC "%6.5" "" COEFFS 0 2048 0 0 0 1 /end COMPU_METHOD
/begin COMPU_METHOD RIGHTSH13NP "" RAT_FUNC "%6.5" "1" COEFFS 0 8192 0 0 0 1 /end COMPU_METHOD
/begin COMPU_METHOD RIGHTSH15NP "" RAT_FUNC "%7.6" "" COEFFS 0 32768 0 0 0 1 /end COMPU_METHOD
/begin COMPU_METHOD RIGHTSH5NP "" RAT_FUNC "%6.4" "" COEFFS 0 32 0 0 0 1 /end COMPU_METHOD
/begin COMPU_METHOD ROTACC "" RAT_FUNC "%6.4" "1/min/ms" COEFFS 0 64 0 0 0 1 /end COMPU_METHOD
/begin COMPU_METHOD ROTPOS "" RAT_FUNC "%6.3" "Â°" COEFFS 0 11.3777777778 0 0 0 1 /end COMPU_METHOD
/begin COMPU_METHOD RSH15 "" RAT_FUNC "%6.4" "%" COEFFS 0 327.68 0 0 0 1 /end COMPU_METHOD
/begin COMPU_METHOD RSH7 "" RAT_FUNC "%6.3" "%" COEFFS 0 1.28 0 0 0 1 /end COMPU_METHOD
/begin COMPU_METHOD SAS_8 "" RAT_FUNC "%6.3" "Â°/s" COEFFS 0 8 0 0 0 1 /end COMPU_METHOD
/begin COMPU_METHOD SA_10 "" RAT_FUNC "%6.3" "Â°" COEFFS 0 10 0 0 0 1 /end COMPU_METHOD
/begin COMPU_METHOD SM_I "" RAT_FUNC "%6.4" "A" COEFFS 0 16 0 0 0 1 /end COMPU_METHOD
/begin COMPU_METHOD STATUS "" RAT_FUNC "%6.2" "Status" COEFFS 0 1 0 0 0 1 /end COMPU_METHOD
/begin COMPU_METHOD TBTHIGH "" RAT_FUNC "%6.5" "Nm" COEFFS 0 1024 0 0 0 1 /end COMPU_METHOD
/begin COMPU_METHOD TIMMS "" RAT_FUNC "%6.2" "ms" COEFFS 0 1 0 0 0 1 /end COMPU_METHOD
/begin COMPU_METHOD TIMS "" RAT_FUNC "%6.2" "s" COEFFS 0 1 0 0 0 1 /end COMPU_METHOD
/begin COMPU_METHOD TMPOUTS "" RAT_FUNC "%6.2" "Â°C" COEFFS 0 1 70 0 0 1 /end COMPU_METHOD
/begin COMPU_METHOD TORGAINHIGH "" RAT_FUNC "%6.5" "Nm/Nm" COEFFS 0 1024 0 0 0 1 /end COMPU_METHOD
/begin COMPU_METHOD TORGRAD "" RAT_FUNC "%6.5" "Nm/ms" COEFFS 0 1024 0 0 0 1 /end COMPU_METHOD
/begin COMPU_METHOD U64V "" RAT_FUNC "%6.4" "V" COEFFS 0 64 0 0 0 1 /end COMPU_METHOD
/begin COMPU_METHOD VFZHIGH "" RAT_FUNC "%6.4" "km/h" COEFFS 0 64 0 0 0 1 /end COMPU_METHOD
/begin COMPU_METHOD VGIER "" RAT_FUNC "%6.4" "Â°/s" COEFFS 0 200 0 0 0 1 /end COMPU_METHOD
/begin COMPU_METHOD VROT "" RAT_FUNC "%3.1" "1/min" COEFFS 0 1 0 0 0 1 /end COMPU_METHOD
/begin COMPU_METHOD ZU0 "" RAT_FUNC "%6.2" "" COEFFS 0 1 0 0 0 1 /end COMPU_METHOD
/begin COMPU_VTAB ECU_STATE "" TAB_VERB 9 0 "undefined" 1 "EcuInit" 2 "ApplicationInit" 3 "Normal" 4 "Production" 5 "FailOp" 6 "PostRun" 7 "Error" 8 "ApplicationOff" /end COMPU_VTAB
/begin FUNCTION ApplicationInterfaceI "Applikations Schnittsstelle"
 /begin OUT_MEASUREMENT aApplI_AbsLatAccel_xdu16 aApplI_LateralAcceleration_xds16 aApplI_LongitudeAcceleration_xds16 aApplI_RotAccelerationFilt_xds16 aApplI_RotAcceleration_xds16 iApplI_AllowedBattCurr_xdu16 iApplI_MaxBattCurr_xdu16 kApplI_AbsRackForce_xdu16 kApplI_RackForceComfortRaw_xds16 kApplI_RackForceComfort_xds16 kApplI_RackForceMerge_xds16 kApplI_RackForceSimple_xds16 kApplI_RackForce_xds16 lApplI_AbsRackPosition_xdu16 lApplI_RackPositionLtCorr_xds16 lApplI_RackPosition_xds16 lApplI_VehCentRackPos_xds16 mApplI_AbsDriverTorque_xdu16 mApplI_DriverTorque_xds16 mApplI_MaxRequiredMotorTorque_xdu16 mApplI_NominalMotorTorque_xds16 mApplI_SSWarnTorque_xds16 nApplI_AbsGeneratoricRotorSpeed_xdu16 nApplI_AbsRotorSpeedFilt_xdu16 nApplI_RotorSpeedFilt_xds16 nApplI_RotorSpeed_xds16 qApplI_WheelFrequencyFL_xds16 qApplI_WheelFrequencyFR_xds16 qApplI_WheelFrequencyRL_xds16 qApplI_WheelFrequencyRR_xds16 sApplI_BoostModeRequest_xdu8 sApplI_CommBusTml50_xdu8 sApplI_DesVoltRedState_xdu8 sApplI_EcuState_xdu8 sApplI_EngineRunning_xdu8 sApplI_FootBrakeState_xdu8 sApplI_RackPosQualifier_xdu8 sApplI_SteeringAngleLinState_xdu8 sApplI_SteeringAngleState_xdu8 sApplI_VehicleRunning_xdu8 sApplI_VehicleSpeedState_xdu8 vApplI_AbsRackSpeed_xdu16 vApplI_AbsSafeNssVehicleSpeed_xdu16 vApplI_AbsSafeVehicleSpeed_xdu16 vApplI_AbsSteeringAngleSpeed_xdu16 vApplI_AbsVehicleSpeedFilt_xdu16 vApplI_RackSpeed_xds16 vApplI_SteeringAngleSpeed_xds16 vApplI_WindUpAdaption_xds32 vApplI_YawVelocity_xds16 wApplI_AbsDynSteerAngle_xdu16 wApplI_AbsPinionAngle_xdu16 wApplI_AbsSteeringAngleSafe_xdu16 wApplI_AbsSteeringAngle_xdu16 wApplI_DynSteerAngle_xds16 wApplI_PinionAngle_xds16 wApplI_SteeringAngleLtCorr_xds16 wApplI_SteeringAngle_xds16 xApplI_ActCharFact_xdu16 xApplI_DegreeOfOversteer_xdu16 xApplI_DegreeOfUndersteer_xdu16 xApplI_HLCharCurveBuckleFact_xdu16 xApplI_HLReductionFactor_xdu16 xApplI_NewCharFact_xdu16 xApplI_RatioD2C_xdu16 xApplI_TotalMotTorLim_xdu16 xApplI_VehDirection_xds8 yApplI_ActCharacteristic_xdu8 yApplI_HLMaxTorqueGradient_xdu16 yApplI_NewCharacteristic_xdu8 zApplI_SlippingClutchActivations_xdu8 /end OUT_MEASUREMENT
/end FUNCTION
/begin FUNCTION ApplicationInterfaceSuppI "ApplicationInterfaceSupp - interfaces"
 /begin OUT_MEASUREMENT fApplI_ImproperShutdown_xdb fApplI_LaErrorMode_xdb fApplI_LdwErrorMode_xdb fApplI_RscEpsFault_xdb mApplI_DriveShaftTorque_xds16 mApplI_LkaTorqueRequest_xds16 sApplI_ABSActive_xdu8 sApplI_ABSFailed_xdu8 sApplI_ApxState_xdu8 sApplI_ApxSysStatus_xdu8 sApplI_displayindicatorstate_xdu8 sApplI_EpsApcState_xdu8 sApplI_EpsApxState_xdu8 sApplI_EpsCharismaState_xdu8 sApplI_EssMode_xdu8 sApplI_HWAEnabled_xdu8 sApplI_LdwVibrationRequest_xdu8 sApplI_LkaActivationRequest_xdu8 sApplI_LkaActive_xdu8 sApplI_LkaEnabled_xdu8 sApplI_LkaMode_xdu8 sApplI_remotecontrolstate_xdu8 sApplI_RemoteSteerVehDirection_xdu16 sApplI_TjaEnabled_xdu8 sApplI_TjaMode_xdu8 sApplI_VSEActive_xdu8 sApplI_VSEStatus_xdu8 sAutParkCtrl_CancelState_xdu16 sEpsInI_ADActiveReq_xdu8 sEpsInI_ADDeactiveReq_xdu8 sEpsInI_ADModeReq_xdu8 sEpsIn_GearSt_xdu8 vApplI_YawRateRaw_xds16 vYROC_compvalue_xdf32 wApplI_ApxDesiredAngle_xds16 xEpsInI_VehDirection_xds8 yApplI_CharismaSelected_xdu8 yApplI_DMSActCharacteristic_xdu8 yApplI_EstimatedGear_xdu8 yApplI_ReverseGearEngaged_xdu8 /end OUT_MEASUREMENT
/end FUNCTION
/begin FUNCTION ApplicationStateMachine "Statusmaschine, die Ã¼ber den kompletten Klemmenzyklus arbeitet" /begin DEF_CHARACTERISTIC tAsmI_ApplicationInit_TimeOut_XDU16 /end DEF_CHARACTERISTIC /begin OUT_MEASUREMENT sAsmI_LocalUcSync_xdu8 sAsmI_RequestBswShutdown_xdb /end OUT_MEASUREMENT /end FUNCTION
/begin FUNCTION ApplicationStateMachinePlausi "ApplicationStateMachinePlausi" /begin OUT_MEASUREMENT sAsmPlausi_EcuState_xdu8 /end OUT_MEASUREMENT /end FUNCTION
/begin FUNCTION ApplicationStateMachinePlausiI "Applikation State Machine Verifikation" /begin OUT_MEASUREMENT sAsmI_ErrLvl_Red_xdu8 sAsmI_ErrLvl_xdu8 /end OUT_MEASUREMENT /end FUNCTION
/begin FUNCTION ApplicationStateMachineSupp "ApplicationStateMachineSupp" /begin OUT_MEASUREMENT yeeResetInfo_xdu32 /end OUT_MEASUREMENT /end FUNCTION
/begin FUNCTION ApplicationStateMachine_DetectionOscillation "Statusmaschine, die Ã¼ber den kompletten Klemmenzyklus arbeitet"
 /begin DEF_CHARACTERISTIC tAsmI_OscillationMeasureTime_XDU16 zAsmI_MaxHealingPerIgnitionCycle_XDU8 zAsmI_MaxHealingPerOscillation_XDU8 /end DEF_CHARACTERISTIC
 /begin OUT_MEASUREMENT fAsm_MaxHealingsReached_gdb sAsmI_MaxHealings_ErrLvl_Red_xdu8 sAsmI_MaxHealings_ErrLvl_xdu8 sAsm_StoredEcuState_xdu8 tAsm_StartTimeHealingsOscillation_xdu16 zAsm_HealingsPerIgnition_xdu8 zAsm_HealingsPerOscillation_xdu8 /end OUT_MEASUREMENT
/end FUNCTION
/begin FUNCTION ArModeManAbstraction ""
 /begin DEF_CHARACTERISTIC tArmI_ComSyncTimeout_XDU16 tArmI_HwLibFinishedTimeout_XDU16 tArmI_PollToOffTimeout_XDU16 tArmI_ProductionProcessingTimeout_XDU16 tArmI_ShutdownResyncTimeout_XDU16 tArmI_UartComSyncTimeout_XDU16 tArmI_WriteAllTimeout_XDU16 /end DEF_CHARACTERISTIC
 /begin OUT_MEASUREMENT sArmI_LocalShutdownSync_xdu8 sArmI_ShutdownMode_xdu8 /end OUT_MEASUREMENT
/end FUNCTION
/begin FUNCTION AssistanceController "Erweiterung für den Assistance Controller"
 /begin DEF_CHARACTERISTIC tAssCtrl_NoAssist_TimeOut_XDU16 yAssCtrl_RampDownGradient_XDU16 yAssCtrl_VehicleNotRunningGradient_XDU16 yAssCtrl_VehicleRunningGradient_XDU16 /end DEF_CHARACTERISTIC
 /begin OUT_MEASUREMENT sAssCtrlI_AssistMode_xdu8 sAssCtrl_InternalAssistState_xdu8 /end OUT_MEASUREMENT
/end FUNCTION
/begin FUNCTION AssistanceI "Interface Unterstuetzungsmoment"
 /begin OUT_MEASUREMENT matAssistantTorque_xds16 xatAssistanceGrad_xdu16 xatCurrentServoFactor_xdu8 /end OUT_MEASUREMENT
/end FUNCTION
/begin FUNCTION AssistanceV3 "Unterstuetzungsmoment V3"
 /begin DEF_CHARACTERISTIC fatAllowAssistReduction_XDB fatAllowMaxReqMMotReduction_XDB fatUseBandsperre_XDU8 xatAssistFilterFrequFast_XDU16 xatAssistFilterFrequ_XAU16 xatBandsperre_A2_XDF32 xatBandsperre_A3_XDF32 xatBandsperre_B2_XDF32 xatBandsperre_S1_XDF32 xatBSTMaxgrad_XDU16 xatMaxGradChatterActive_XAU16 xatMaxGradGradDown_XDU16 xatMaxGradGradUp_XDU16 xatMaxGradTorGrad_XAU16 xatMaxGradvVehicleReverse_XAU16 xatMaxGradvVehicle_XAU16_00__A xatMaxGradvVehicle_XAU16_01__A xatMaxGradvVehicle_XAU16_02__A xatMaxGradvVehicle_XAU16_03__A xatMaxGradvVehicle_XAU16_04__A xatMaxGradvVehicle_XAU16_05__A xatMaxGradvVehicle_XAU16_06__A xatMaxGradvVehicle_XAU16_07__A xatMaxGradvVehicle_XAU16_08__A xatMaxGradvVehicle_XAU16_09__A xatMaxGradvVehicle_XAU16_10__A xatMaxGradvVehicle_XAU16_11__A xatMaxGradvVehicle_XAU16_12__A xatMaxGradvVehicle_XAU16_13__A xatMaxGradvVehicle_XAU16_14__A xatMaxGradvVehicle_XAU16_15__A xatMaxGradvVehicle_XAU16_16__A xatMaxGradvVehicle_XAU16_17__A xatMaxGradvVehicle_XAU16_18__A xatMaxGradvVehicle_XAU16_19__A xatMaxGradvVehicle_XAU16_20__A xatMaxGradvVehicle_XAU16_21__A xatMaxGradvVehicle_XAU16_22__A xatMaxGradvVehicle_XAU16_23__A xatMaxGradvVehicle_XAU16_24__A xatMaxGradvVehicle_XAU16_25__A xatMaxGradvVehicle_XAU16_26__A xatMaxGradvVehicle_XAU16_27__A xatMaxGradvVehicle_XAU16_28__A xatMaxGradvVehicle_XAU16_29__A xatMaxGradvVehicle_XAU16_30__A xatMaxGradvVehicle_XAU16_31__A xatMaxGradvVehicle_XAU16_32__A xatMaxGradvVehicle_XAU16_33__A xatMaxGradvVehicle_XAU16_34__A xatMaxGradvVehicle_XAU16_35__A /end DEF_CHARACTERISTIC
 /begin IN_MEASUREMENT vApplI_AbsSafeNssVehicleSpeed_xdu16 /end IN_MEASUREMENT
 /begin OUT_MEASUREMENT matAbsTorsionBarTorque_xdu16 matAssistanceLimitedY_xau16 matAssistanceX_xau16 matAssistanceY_xau16 matFactRedAssistTrq_xds16 matLimitationDiff_xds16 matLimitation_xds16 matMaxXLimitedAssistance_xdu16 matPT1Offset_xds16 matTorsionBarTorque_xds16 matUnlimitedAssistantTorque_xds16 xatActTorGradFact_xdu16 xatAssistanceGradMax_xdu16 xatAssistanceGrad_xau16 xatAssistFilterFrequ_xdu16 xatMaxGrad_xdu16 /end OUT_MEASUREMENT
/end FUNCTION
/begin FUNCTION AutomaticParkingControl "AutomaticParkingControl"
 /begin DEF_CHARACTERISTIC fAutParkCtrl_EnableDesRackPosFilt_XDU8 fAutParkCtrl_EnableFeedForward_XDU8 mAutParkCtrl_DeadBandTBT_XDU16 tAutParkCtrl_CycleTimeController_XDU8 tAutParkCtrl_CycleTimeControlVariable_XDU8 vAutParkCtrl_DeadBandRackSpeed_XDU16 vAutParkCtrl_MaxGradRackSpeed_XDU16 vAutParkCtrl_MaxRackSpeed_XDU16 xAutParkCtrl_FeedForwardFiltFact_XDU16 xAutParkCtrl_PositionDPart_XDF32 xAutParkCtrl_PositionIMax_XDF32 xAutParkCtrl_PositionIPart_XDF32_0___A xAutParkCtrl_PositionIPart_XDF32_1___A xAutParkCtrl_PositionIPart_XDF32_2___A xAutParkCtrl_PositionIPart_XDF32_3___A xAutParkCtrl_PositionIPart_XDF32_4___A xAutParkCtrl_PositionIPart_XDF32_5___A xAutParkCtrl_PositionPPart_XDF32_0___A xAutParkCtrl_PositionPPart_XDF32_1___A xAutParkCtrl_PositionPPart_XDF32_2___A xAutParkCtrl_PositionPPart_XDF32_3___A xAutParkCtrl_PositionPPart_XDF32_4___A xAutParkCtrl_PositionPPart_XDF32_5___A xAutParkCtrl_RackSpeedDPart_XDF32 xAutParkCtrl_RackSpeedIMax_XDF32 xAutParkCtrl_RackSpeedIPart_XDF32_0___A xAutParkCtrl_RackSpeedIPart_XDF32_1___A xAutParkCtrl_RackSpeedIPart_XDF32_2___A xAutParkCtrl_RackSpeedIPart_XDF32_3___A xAutParkCtrl_RackSpeedIPart_XDF32_4___A xAutParkCtrl_RackSpeedIPart_XDF32_5___A xAutParkCtrl_RackSpeedPPart_XDF32_0___A xAutParkCtrl_RackSpeedPPart_XDF32_1___A xAutParkCtrl_RackSpeedPPart_XDF32_2___A xAutParkCtrl_RackSpeedPPart_XDF32_3___A xAutParkCtrl_RackSpeedPPart_XDF32_4___A xAutParkCtrl_RackSpeedPPart_XDF32_5___A /end DEF_CHARACTERISTIC
 /begin OUT_MEASUREMENT lAutParkCtrl_DesiredRackPosFilt_xds16 vAutParkCtrl_DesiredRackSpeed_xds16 vAutParkCtrl_LimitedDesiredRackSpeed_xds16 /end OUT_MEASUREMENT
/end FUNCTION
/begin FUNCTION AutomaticParkingControlCheck "AutomaticParkingControlCheck"
 /begin DEF_CHARACTERISTIC mAutParkCtrl_CheckHandsOnTorqLim_XDU16 tAutParkCtrl_CheckHandsOnSwOffTime_XDU16 vAutParkCtrl_SafetyLimitMaxVehicleSpeed_XDU16 /end DEF_CHARACTERISTIC
 /begin OUT_MEASUREMENT fAutParkCtrl_MonSafeOk_xdb mAutParkCtrl_DesMotTrqOffsetChecked_xds16 mAutParkCtrl_DesSteerTrqOffsetChecked_xds16 sAutParkCtrl_MakeSafeState_xdu8 xAutParkCtrl_DesActRetFuncFactChecked_xdu16 zAutParkCtrl_HandsOnCounter_xdu16 /end OUT_MEASUREMENT
/end FUNCTION
/begin FUNCTION AutomaticParkingControlCheckI "AutomaticParkingControlCheckI - interface"
 /begin OUT_MEASUREMENT mAutParkCtrlI_DesMotTrqOffset_xds16 mAutParkCtrlI_DesSteerTrqOffset_xds16 sAutParkCtrlI_MakeSafeAndMonState_xdu8 xAutParkCtrlI_DesActRetFuncFact_xdu16 /end OUT_MEASUREMENT
/end FUNCTION
/begin FUNCTION AutomaticParkingControlI "AutomaticParkingControlI - interface"
 /begin OUT_MEASUREMENT mAutParkCtrlI_DesMotTrqOffset4Check_xds16 mAutParkCtrlI_DesSteerTrqOffset4Check_xds16 xAutParkCtrlI_DesActRetFuncFact4Check_xdu16 /end OUT_MEASUREMENT
/end FUNCTION
/begin FUNCTION AutomaticParkingControlSupp "AutomaticParkingControlSupp"
 /begin DEF_CHARACTERISTIC fAPA_AngDeviationCheckOn_XDU8 fAutParkCtrl_APCalwaysOn_XDU8 fAutParkCtrl_LtStCorrActive_XDB mAutParkCtrl_ColumnTorqueLim_XDU16 mAutParkCtrl_HandsOffTorqLim_XDU16 mAutParkCtrl_HandsOnTorqLim_XDU16 mAutParkCtrl_HandsOnTrqLim2Active_XDU16 sAutParkCtrl_FctCoCtrlStateTest_XDU8 tAutParkCtrl_AngleDiffTooHighSwOTime_XDU16 tAutParkCtrl_CycleTime_XDU8 tAutParkCtrl_EpsMaxRespondTime_XDU16 tAutParkCtrl_HandsOffSwTime_XDU16 tAutParkCtrl_HandsOnSwTime2Active_XDU16 tAutParkCtrl_HandsOnSwTime_XDU16 tAutParkCtrl_OverAgGridCheckTime_XDU16 tAutParkCtrl_ReqStsTimeOut_XDU16 vAutParkCtrl_APAStandStillVehicleSpeed_XDU16 vAutParkCtrl_MaxAPAVehicleSpeed_XDU16 wAutParkCtrl_MaxAngleDiff_XDU16 wAutParkCtrl_MaxRequestAngle_XDU16 xAutParkCtrl_InterruptTorqueFactor_XDU16 xAutParkCtrl_MaxAngleGrad_XDU16 xAutParkCtrl_RecoverTorqueFactor_XDU16 xAutParkCtrl_RefuseTorqueFactor_XDU16 /end DEF_CHARACTERISTIC
 /begin OUT_MEASUREMENT sAutParkCtrl_FctCoCtrlState_xdu8 sAutParkCtrl_FeatureState_xdu8 /end OUT_MEASUREMENT
/end FUNCTION
/begin FUNCTION AutomaticParkingControlSuppI "AutomaticParkingControlSuppI - interface"
 /begin OUT_MEASUREMENT lAutParkCtrlI_DesiredRackPosition_xds16 sApplI_InterferDetdState_xdu8 sAutParkCtrlI_Activate_xdu8 /end OUT_MEASUREMENT
/end FUNCTION
/begin FUNCTION AutosarAbstractionInterface ""
 /begin OUT_MEASUREMENT fBswI_IsInitialized_gdb sHLIpcI_RemoteBoschASDiagnostics_xdu8 /end OUT_MEASUREMENT
/end FUNCTION
/begin FUNCTION AZG "AZG" /begin OUT_MEASUREMENT vazReqVehSpeed_xdu8 /end OUT_MEASUREMENT /end FUNCTION
/begin FUNCTION AZGSecurityAccess "AZGSecurityAccess"
 /begin DEF_CHARACTERISTIC AZG_SecurityAccessDeliveredPublicKey AZG_SecurityAccessDevelopmentPublicKey AZG_SecurityAccessProductionPublicKey /end DEF_CHARACTERISTIC
/end FUNCTION
/begin FUNCTION BasicSteerTorque "Basic Steering Torque" /begin DEF_CHARACTERISTIC xBST_PT1FilterFactor_XDU16 xBST_RackForceScaleFact_XDU16 /end DEF_CHARACTERISTIC /end FUNCTION
/begin FUNCTION BasicSteerTorqueI "Basislenkmoment" /begin OUT_MEASUREMENT mBSTI_NominalSteerTorque_xds16 /end OUT_MEASUREMENT /end FUNCTION
/begin FUNCTION BatteryVoltageMonitor_OemWarning "Warnung aufgrund nicht kritischer Batteriespannung"
 /begin DEF_CHARACTERISTIC tBatVoltMon_HighVoltageValueLeft_XDU16 tBatVoltMon_HighVoltageValueReached_XDU16 tBatVoltMon_LowVoltageValueLeft_XDU16 tBatVoltMon_LowVoltageValueReached_XDU16 tBatVoltMon_NormalVoltageThreshold_XDU16 uBatVoltMon_HighVoltageValueLeft_XDU16 uBatVoltMon_HighVoltageValueReached_XDU16 uBatVoltMon_LowVoltageValueLeft_XDU16 uBatVoltMon_LowVoltageValueReached_XDU16 /end DEF_CHARACTERISTIC
 /begin OUT_MEASUREMENT fBatVolt_StartTimer_gdb tBatVolt_StartTimeStamp_xdu16 tBatVolt_TimeElapsed_xdu32 /end OUT_MEASUREMENT
/end FUNCTION
/begin FUNCTION BlockedSteeringDetection "Mess- und Applikationsgrößen BlockedSteeringDetection"
 /begin DEF_CHARACTERISTIC cBsd_TempratureLimit_XDU8 mBsd_TBTDeadband_XDU16 mBsd_VibrationTorque_XDU16 tBsd_MaxTimeTorqueActive_XDU16 tBsd_StateCycletimer_XDU8 vBsd_LowVehSpeed_XDU16 vBsd_VehicleSpeedForBSDActivation_XDU16 wBsd_MinRotPosChange_XDU16 wBsd_SteeringAngleLimit_XDU16 zBsd_MaxRampUpCycles_XDU8 /end DEF_CHARACTERISTIC
 /begin OUT_MEASUREMENT fBsd_ActivateTorqueGen_xdb fBsd_EnableMonitoring_xdb fBsd_JobResultOK_xdb sBsd_CtrlState_xdu8 sBsd_CurrentInternalState_xdu8 sBsd_FeatureState_xdu8 wBsd_DeltaRotPos_xds32 wBsd_RotPosMax_xds32 wBsd_RotPosMin_xds32 zBsd_BlockDetectedCnt_xdu16 zBsd_BlockSuspicionCnt_xdu16 zBsd_CycleCount_xdu8 /end OUT_MEASUREMENT
/end FUNCTION
/begin FUNCTION BlockedSteeringDetectionCheck "Mess- und Applikationsgrößen BlockedSteeringDetectionCheck"
 /begin DEF_CHARACTERISTIC mBsd_MaxSafetyMotorTorq_XDU16 wBsd_MinSafetyRotPosChange_XDU16 /end DEF_CHARACTERISTIC
 /begin OUT_MEASUREMENT fBsd_FirstRunMonitorSafe_xdb mBsd_MotorTorqueSaturated_xds16 sBsd_FailureCause_xdu8 wBsd_DeltaRotPosMakeSafe_xds32 wBsd_DeltaRotPosMonitor_xds32 wBsd_MaxRotPosMakeSafe_xds32 wBsd_MaxRotPosMonitor_xds32 wBsd_MinRotPosMakeSafe_xds32 wBsd_MinRotPosMonitor_xds32 /end OUT_MEASUREMENT
/end FUNCTION
/begin FUNCTION BlockedSteeringDetectionCheckI "Interfacegrößen BlockedSteeringDetectionCheck" /begin OUT_MEASUREMENT fBsdI_MonSafeOk_xdb mBsdI_MotorTorqueOffset_xds16 /end OUT_MEASUREMENT /end FUNCTION
/begin FUNCTION BlockedSteeringDetectionI "Interfacegrößen BlockedSteeringDetection"
 /begin OUT_MEASUREMENT mBsdI_MotorTorque4Check_xds16 sBsdI_BlockedSteeringDetection_xdu8 /end OUT_MEASUREMENT
/end FUNCTION
/begin FUNCTION BoostCurveInterpolationI "Unterstuetzungskennlinien"
 /begin OUT_MEASUREMENT kBciI_BSTCurveRackForceXAxis_xau16 mBciI_AssistCurveMMotYAxis_xau16 mBciI_AssistCurveTBTXAxis_xau16 mBciI_BSTCurveSteerTorqueYAxis_xau16 /end OUT_MEASUREMENT
/end FUNCTION
/begin FUNCTION BoostCurveInterpolationInterpol "Unterstuetzungskennlinien (interpolate vehicle speed depended characteristic curves)"
 /begin DEF_CHARACTERISTIC mBci_V0BaseTorque_XAS16_00___A mBci_V0BaseTorque_XAS16_01___A mBci_V0BaseTorque_XAS16_02___A mBci_V0BaseTorque_XAS16_03___A mBci_V0BaseTorque_XAS16_04___A mBci_V0BaseTorque_XAS16_05___A mBci_V0BaseTorque_XAS16_06___A mBci_V0BaseTorque_XAS16_07___A mBci_V0BaseTorque_XAS16_08___A mBci_V0BaseTorque_XAS16_09___A mBci_V0BaseTorque_XAS16_10___A mBci_V0BaseTorque_XAS16_11___A mBci_V0BaseTorque_XAS16_12___A mBci_V0BaseTorque_XAS16_13___A mBci_V0BaseTorque_XAS16_14___A mBci_V0BaseTorque_XAS16_15___A mBci_V0BaseTorque_XAS16_16___A mBci_V0BaseTorque_XAS16_17___A mBci_V0BaseTorque_XAS16_18___A mBci_V0BaseTorque_XAS16_19___A mBci_V0BaseTorque_XAS16_20___A mBci_V0BaseTorque_XAS16_21___A mBci_V0BaseTorque_XAS16_22___A mBci_V0BaseTorque_XAS16_23___A mBci_V0BaseTorque_XAS16_24___A mBci_V0BaseTorque_XAS16_25___A mBci_V0BaseTorque_XAS16_26___A mBci_V0BaseTorque_XAS16_27___A mBci_V0BaseTorque_XAS16_28___A mBci_V0BaseTorque_XAS16_29___A mBci_V0BaseTorque_XAS16_30___A mBci_V0BaseTorque_XAS16_31___A mBci_V0BaseTorque_XAS16_32___A mBci_V0BaseTorque_XAS16_33___A mBci_V0BaseTorque_XAS16_34___A mBci_V0BaseTorque_XAS16_35___A mBci_V1BaseTorque_XAS16_00___A mBci_V1BaseTorque_XAS16_01___A mBci_V1BaseTorque_XAS16_02___A mBci_V1BaseTorque_XAS16_03___A mBci_V1BaseTorque_XAS16_04___A mBci_V1BaseTorque_XAS16_05___A mBci_V1BaseTorque_XAS16_06___A mBci_V1BaseTorque_XAS16_07___A mBci_V1BaseTorque_XAS16_08___A mBci_V1BaseTorque_XAS16_09___A mBci_V1BaseTorque_XAS16_10___A mBci_V1BaseTorque_XAS16_11___A mBci_V1BaseTorque_XAS16_12___A mBci_V1BaseTorque_XAS16_13___A mBci_V1BaseTorque_XAS16_14___A mBci_V1BaseTorque_XAS16_15___A mBci_V1BaseTorque_XAS16_16___A mBci_V1BaseTorque_XAS16_17___A mBci_V1BaseTorque_XAS16_18___A mBci_V1BaseTorque_XAS16_19___A mBci_V1BaseTorque_XAS16_20___A mBci_V1BaseTorque_XAS16_21___A mBci_V1BaseTorque_XAS16_22___A mBci_V1BaseTorque_XAS16_23___A mBci_V1BaseTorque_XAS16_24___A mBci_V1BaseTorque_XAS16_25___A mBci_V1BaseTorque_XAS16_26___A mBci_V1BaseTorque_XAS16_27___A mBci_V1BaseTorque_XAS16_28___A mBci_V1BaseTorque_XAS16_29___A mBci_V1BaseTorque_XAS16_30___A mBci_V1BaseTorque_XAS16_31___A mBci_V1BaseTorque_XAS16_32___A mBci_V1BaseTorque_XAS16_33___A mBci_V1BaseTorque_XAS16_34___A mBci_V1BaseTorque_XAS16_35___A mBci_V2BaseTorque_XAS16_00___A mBci_V2BaseTorque_XAS16_01___A mBci_V2BaseTorque_XAS16_02___A mBci_V2BaseTorque_XAS16_03___A mBci_V2BaseTorque_XAS16_04___A mBci_V2BaseTorque_XAS16_05___A mBci_V2BaseTorque_XAS16_06___A mBci_V2BaseTorque_XAS16_07___A mBci_V2BaseTorque_XAS16_08___A mBci_V2BaseTorque_XAS16_09___A mBci_V2BaseTorque_XAS16_10___A mBci_V2BaseTorque_XAS16_11___A mBci_V2BaseTorque_XAS16_12___A mBci_V2BaseTorque_XAS16_13___A mBci_V2BaseTorque_XAS16_14___A mBci_V2BaseTorque_XAS16_15___A mBci_V2BaseTorque_XAS16_16___A mBci_V2BaseTorque_XAS16_17___A mBci_V2BaseTorque_XAS16_18___A mBci_V2BaseTorque_XAS16_19___A mBci_V2BaseTorque_XAS16_20___A mBci_V2BaseTorque_XAS16_21___A mBci_V2BaseTorque_XAS16_22___A mBci_V2BaseTorque_XAS16_23___A mBci_V2BaseTorque_XAS16_24___A mBci_V2BaseTorque_XAS16_25___A mBci_V2BaseTorque_XAS16_26___A mBci_V2BaseTorque_XAS16_27___A mBci_V2BaseTorque_XAS16_28___A mBci_V2BaseTorque_XAS16_29___A mBci_V2BaseTorque_XAS16_30___A mBci_V2BaseTorque_XAS16_31___A mBci_V2BaseTorque_XAS16_32___A mBci_V2BaseTorque_XAS16_33___A mBci_V2BaseTorque_XAS16_34___A mBci_V2BaseTorque_XAS16_35___A mBci_V3BaseTorque_XAS16_00___A mBci_V3BaseTorque_XAS16_01___A mBci_V3BaseTorque_XAS16_02___A mBci_V3BaseTorque_XAS16_03___A mBci_V3BaseTorque_XAS16_04___A mBci_V3BaseTorque_XAS16_05___A mBci_V3BaseTorque_XAS16_06___A mBci_V3BaseTorque_XAS16_07___A mBci_V3BaseTorque_XAS16_08___A mBci_V3BaseTorque_XAS16_09___A mBci_V3BaseTorque_XAS16_10___A mBci_V3BaseTorque_XAS16_11___A mBci_V3BaseTorque_XAS16_12___A mBci_V3BaseTorque_XAS16_13___A mBci_V3BaseTorque_XAS16_14___A mBci_V3BaseTorque_XAS16_15___A mBci_V3BaseTorque_XAS16_16___A mBci_V3BaseTorque_XAS16_17___A mBci_V3BaseTorque_XAS16_18___A mBci_V3BaseTorque_XAS16_19___A mBci_V3BaseTorque_XAS16_20___A mBci_V3BaseTorque_XAS16_21___A mBci_V3BaseTorque_XAS16_22___A mBci_V3BaseTorque_XAS16_23___A mBci_V3BaseTorque_XAS16_24___A mBci_V3BaseTorque_XAS16_25___A mBci_V3BaseTorque_XAS16_26___A mBci_V3BaseTorque_XAS16_27___A mBci_V3BaseTorque_XAS16_28___A mBci_V3BaseTorque_XAS16_29___A mBci_V3BaseTorque_XAS16_30___A mBci_V3BaseTorque_XAS16_31___A mBci_V3BaseTorque_XAS16_32___A mBci_V3BaseTorque_XAS16_33___A mBci_V3BaseTorque_XAS16_34___A mBci_V3BaseTorque_XAS16_35___A mBci_V4BaseTorque_XAS16_00___A mBci_V4BaseTorque_XAS16_01___A mBci_V4BaseTorque_XAS16_02___A mBci_V4BaseTorque_XAS16_03___A mBci_V4BaseTorque_XAS16_04___A mBci_V4BaseTorque_XAS16_05___A mBci_V4BaseTorque_XAS16_06___A mBci_V4BaseTorque_XAS16_07___A mBci_V4BaseTorque_XAS16_08___A mBci_V4BaseTorque_XAS16_09___A mBci_V4BaseTorque_XAS16_10___A mBci_V4BaseTorque_XAS16_11___A mBci_V4BaseTorque_XAS16_12___A mBci_V4BaseTorque_XAS16_13___A mBci_V4BaseTorque_XAS16_14___A mBci_V4BaseTorque_XAS16_15___A mBci_V4BaseTorque_XAS16_16___A mBci_V4BaseTorque_XAS16_17___A mBci_V4BaseTorque_XAS16_18___A mBci_V4BaseTorque_XAS16_19___A mBci_V4BaseTorque_XAS16_20___A mBci_V4BaseTorque_XAS16_21___A mBci_V4BaseTorque_XAS16_22___A mBci_V4BaseTorque_XAS16_23___A mBci_V4BaseTorque_XAS16_24___A mBci_V4BaseTorque_XAS16_25___A mBci_V4BaseTorque_XAS16_26___A mBci_V4BaseTorque_XAS16_27___A mBci_V4BaseTorque_XAS16_28___A mBci_V4BaseTorque_XAS16_29___A mBci_V4BaseTorque_XAS16_30___A mBci_V4BaseTorque_XAS16_31___A mBci_V4BaseTorque_XAS16_32___A mBci_V4BaseTorque_XAS16_33___A mBci_V4BaseTorque_XAS16_34___A mBci_V4BaseTorque_XAS16_35___A mBci_V5BaseTorque_XAS16_00___A mBci_V5BaseTorque_XAS16_01___A mBci_V5BaseTorque_XAS16_02___A mBci_V5BaseTorque_XAS16_03___A mBci_V5BaseTorque_XAS16_04___A mBci_V5BaseTorque_XAS16_05___A mBci_V5BaseTorque_XAS16_06___A mBci_V5BaseTorque_XAS16_07___A mBci_V5BaseTorque_XAS16_08___A mBci_V5BaseTorque_XAS16_09___A mBci_V5BaseTorque_XAS16_10___A mBci_V5BaseTorque_XAS16_11___A mBci_V5BaseTorque_XAS16_12___A mBci_V5BaseTorque_XAS16_13___A mBci_V5BaseTorque_XAS16_14___A mBci_V5BaseTorque_XAS16_15___A mBci_V5BaseTorque_XAS16_16___A mBci_V5BaseTorque_XAS16_17___A mBci_V5BaseTorque_XAS16_18___A mBci_V5BaseTorque_XAS16_19___A mBci_V5BaseTorque_XAS16_20___A mBci_V5BaseTorque_XAS16_21___A mBci_V5BaseTorque_XAS16_22___A mBci_V5BaseTorque_XAS16_23___A mBci_V5BaseTorque_XAS16_24___A mBci_V5BaseTorque_XAS16_25___A mBci_V5BaseTorque_XAS16_26___A mBci_V5BaseTorque_XAS16_27___A mBci_V5BaseTorque_XAS16_28___A mBci_V5BaseTorque_XAS16_29___A mBci_V5BaseTorque_XAS16_30___A mBci_V5BaseTorque_XAS16_31___A mBci_V5BaseTorque_XAS16_32___A mBci_V5BaseTorque_XAS16_33___A mBci_V5BaseTorque_XAS16_34___A mBci_V5BaseTorque_XAS16_35___A mBci_V6BaseTorque_XAS16_00___A mBci_V6BaseTorque_XAS16_01___A mBci_V6BaseTorque_XAS16_02___A mBci_V6BaseTorque_XAS16_03___A mBci_V6BaseTorque_XAS16_04___A mBci_V6BaseTorque_XAS16_05___A mBci_V6BaseTorque_XAS16_06___A mBci_V6BaseTorque_XAS16_07___A mBci_V6BaseTorque_XAS16_08___A mBci_V6BaseTorque_XAS16_09___A mBci_V6BaseTorque_XAS16_10___A mBci_V6BaseTorque_XAS16_11___A mBci_V6BaseTorque_XAS16_12___A mBci_V6BaseTorque_XAS16_13___A mBci_V6BaseTorque_XAS16_14___A mBci_V6BaseTorque_XAS16_15___A mBci_V6BaseTorque_XAS16_16___A mBci_V6BaseTorque_XAS16_17___A mBci_V6BaseTorque_XAS16_18___A mBci_V6BaseTorque_XAS16_19___A mBci_V6BaseTorque_XAS16_20___A mBci_V6BaseTorque_XAS16_21___A mBci_V6BaseTorque_XAS16_22___A mBci_V6BaseTorque_XAS16_23___A mBci_V6BaseTorque_XAS16_24___A mBci_V6BaseTorque_XAS16_25___A mBci_V6BaseTorque_XAS16_26___A mBci_V6BaseTorque_XAS16_27___A mBci_V6BaseTorque_XAS16_28___A mBci_V6BaseTorque_XAS16_29___A mBci_V6BaseTorque_XAS16_30___A mBci_V6BaseTorque_XAS16_31___A mBci_V6BaseTorque_XAS16_32___A mBci_V6BaseTorque_XAS16_33___A mBci_V6BaseTorque_XAS16_34___A mBci_V6BaseTorque_XAS16_35___A zBci_BaseTorqueCharSelect_XAS16_00___A zBci_BaseTorqueCharSelect_XAS16_01___A zBci_BaseTorqueCharSelect_XAS16_02___A zBci_BaseTorqueCharSelect_XAS16_03___A zBci_BaseTorqueCharSelect_XAS16_04___A zBci_BaseTorqueCharSelect_XAS16_05___A zBci_BaseTorqueCharSelect_XAS16_06___A zBci_BaseTorqueCharSelect_XAS16_07___A zBci_BaseTorqueCharSelect_XAS16_08___A zBci_BaseTorqueCharSelect_XAS16_09___A zBci_BaseTorqueCharSelect_XAS16_10___A zBci_BaseTorqueCharSelect_XAS16_11___A zBci_BaseTorqueCharSelect_XAS16_12___A zBci_BaseTorqueCharSelect_XAS16_13___A zBci_BaseTorqueCharSelect_XAS16_14___A zBci_BaseTorqueCharSelect_XAS16_15___A zBci_BaseTorqueCharSelect_XAS16_16___A zBci_BaseTorqueCharSelect_XAS16_17___A zBci_BaseTorqueCharSelect_XAS16_18___A zBci_BaseTorqueCharSelect_XAS16_19___A zBci_BaseTorqueCharSelect_XAS16_20___A zBci_BaseTorqueCharSelect_XAS16_21___A zBci_BaseTorqueCharSelect_XAS16_22___A zBci_BaseTorqueCharSelect_XAS16_23___A zBci_BaseTorqueCharSelect_XAS16_24___A zBci_BaseTorqueCharSelect_XAS16_25___A zBci_BaseTorqueCharSelect_XAS16_26___A zBci_BaseTorqueCharSelect_XAS16_27___A zBci_BaseTorqueCharSelect_XAS16_28___A zBci_BaseTorqueCharSelect_XAS16_29___A zBci_BaseTorqueCharSelect_XAS16_30___A zBci_BaseTorqueCharSelect_XAS16_31___A zBci_BaseTorqueCharSelect_XAS16_32___A zBci_BaseTorqueCharSelect_XAS16_33___A zBci_BaseTorqueCharSelect_XAS16_34___A zBci_BaseTorqueCharSelect_XAS16_35___A /end DEF_CHARACTERISTIC
 /begin IN_MEASUREMENT kApplI_AbsRackForce_xdu16 /end IN_MEASUREMENT
 /begin OUT_MEASUREMENT kBci_BSTCurveRackForceXAxisRawL2_xaf32 kBci_BSTCurveRackForceXAxisRaw_xas16 mBci_BSTCurveSteerTorqueYAxisRawL2_xaf32 mBci_BSTCurveSteerTorqueYAxisRaw_xas16 /end OUT_MEASUREMENT
/end FUNCTION
/begin RECORD_LAYOUT AblGLKLsw FNC_VALUES 3 SWORD COLUMN_DIR DIRECT AXIS_PTS_X 2 SWORD INDEX_INCR DIRECT NO_AXIS_PTS_X 1 UWORD /end RECORD_LAYOUT
/begin RECORD_LAYOUT AblGLKLuw FNC_VALUES 3 UWORD COLUMN_DIR DIRECT AXIS_PTS_X 2 UWORD INDEX_INCR DIRECT NO_AXIS_PTS_X 1 UWORD /end RECORD_LAYOUT
/begin RECORD_LAYOUT AblGLKWBsw FNC_VALUES 1 SWORD COLUMN_DIR DIRECT /end RECORD_LAYOUT
/begin RECORD_LAYOUT AblGLKWBub FNC_VALUES 1 UBYTE COLUMN_DIR DIRECT /end RECORD_LAYOUT
/begin RECORD_LAYOUT AblGLKWfl4 FNC_VALUES 1 FLOAT32_IEEE COLUMN_DIR DIRECT /end RECORD_LAYOUT
/begin RECORD_LAYOUT AblGLKWub FNC_VALUES 1 UBYTE COLUMN_DIR DIRECT /end RECORD_LAYOUT
/begin RECORD_LAYOUT AblGLKWuw FNC_VALUES 1 UWORD COLUMN_DIR DIRECT /end RECORD_LAYOUT
/end MODULE
/end PROJECT
