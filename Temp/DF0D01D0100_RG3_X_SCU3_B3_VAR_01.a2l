ASAP2_VERSION 1 70
/begin PROJECT _DF0_D01 "SCU3_B3_VAR_01"
/begin HEADER "" VERSION "DF0_D01_D_01_00" PROJECT_NO _DF0_D01 /end HEADER
/begin MODULE XCP_EPS_ECU "CMP"
/begin MOD_COMMON "" BYTE_ORDER MSB_LAST ALIGNMENT_BYTE 1 ALIGNMENT_WORD 2 ALIGNMENT_LONG 4 ALIGNMENT_FLOAT32_IEEE 4 ALIGNMENT_FLOAT64_IEEE 8 /end MOD_COMMON
/begin CHARACTERISTIC aInCo_RotAccDeadZone_XDU16 "Totzone Rotor Beschleunigung" VALUE 0x150532 AblGLKWuw 500 ROTACC 0 500 FORMAT "%8.4" /end CHARACTERISTIC
/begin CHARACTERISTIC aLa_AbsChatterGrad_XDU16 "minimum rotor acceleration to activation the Chatter detection" VALUE 0x150534 AblGLKWuw 499 ROTACC 1 500 FORMAT "%8.4" /end CHARACTERISTIC
/begin CHARACTERISTIC aLa_InjectRotAccLim_XDS16 "Injected rotor acceleration" VALUE 0x150536 AblGLKWsw 1000 ROTACC -500 500 FORMAT "%8.4" /end CHARACTERISTIC
/begin CHARACTERISTIC aLa_MaxRackSpeedRampDownGradient_XDU16 "" VALUE 0x150538 AblGLKWuw 20 RACKSPEED128 0 20 FORMAT "%8.5" /end CHARACTERISTIC
/begin CHARACTERISTIC fApplI_TorsionBarTorqueInjectEnable_XDB "" VALUE 0x150A96 AblGLKWub 1 ZU0 0 1 FORMAT "%5.3" /end CHARACTERISTIC
/begin CHARACTERISTIC fFuncDispl_EnableVibration_XDU8 "FunctionDisplacer Modus 0=Displace ohne Vibration, 1=Displace mit Vibration" VALUE 0x150AAA AblGLKWub 1 ZU0 0 1 FORMAT "%5.3" /end CHARACTERISTIC
/begin CHARACTERISTIC fHystDect_ActivateHystDetection_XDB "flag for the activation of the HysterisisDetection " VALUE 0x150AAB AblGLKWub 1 ZU0 0 1 FORMAT "%5.3" /end CHARACTERISTIC
/begin CHARACTERISTIC fHystDect_ResetDataManually_XDB "reset learn values manually" VALUE 0x150AAC AblGLKWub 1 BIT 0 1 FORMAT "%5.3" /end CHARACTERISTIC
/begin CHARACTERISTIC fLa_ActRackPosActive_XDUB "Flag for using actual rackposition as desired average rackposition when LA inactive" VALUE 0x150AAD AblGLKWub 1 ZU0 0 1 FORMAT "%5.3" /end CHARACTERISTIC
/begin CHARACTERISTIC fLa_ChatterFunctActivated_XDU8 "ChatterDetect is active => not deactivated through a parameter " VALUE 0x150AAE AblGLKWub 1 ZU0 0 1 FORMAT "%5.3" /end CHARACTERISTIC
/begin CHARACTERISTIC fLa_CheckInjectEnable_XDB "" VALUE 0x150AAF AblGLKWub 1 ZU0 0 1 FORMAT "%5.3" /end CHARACTERISTIC
/begin CHARACTERISTIC fLa_DesSteeringTorqueOffsetEnable_XDB "" VALUE 0x150AB0 AblGLKWub 1 ZU0 0 1 FORMAT "%5.3" /end CHARACTERISTIC
/begin CHARACTERISTIC fLa_DesSteeringTrqOffsetDependOnDrvInLoopDisable_XDB "" VALUE 0x150AB1 AblGLKWub 1 ZU0 0 1 FORMAT "%5.3" /end CHARACTERISTIC
/begin CHARACTERISTIC fLa_EnableLaAvgFilter_XDUB "Flag for active LA Avg filter" VALUE 0x150AB2 AblGLKWub 1 ZU0 0 1 FORMAT "%5.3" /end CHARACTERISTIC
/begin CHARACTERISTIC fLa_FeedForwardEnable_XDU8 "" VALUE 0x150AB3 AblGLKWub 1 ZU0 0 1 FORMAT "%5.3" /end CHARACTERISTIC
/begin CHARACTERISTIC fLa_InjectArbitrationEnable_XDB "" VALUE 0x150AB4 AblGLKWub 1 ZU0 0 1 FORMAT "%5.3" /end CHARACTERISTIC
/begin CHARACTERISTIC fLa_InjectLAActiveEnable_XDB "Enable flag of inject LA active" VALUE 0x150AB5 AblGLKWub 1 ZU0 0 1 FORMAT "%5.3" /end CHARACTERISTIC
/begin CHARACTERISTIC fLa_InjectMMotEnable_XDB "" VALUE 0x150AB6 AblGLKWub 1 ZU0 0 1 FORMAT "%5.3" /end CHARACTERISTIC
/begin CHARACTERISTIC fLa_InjectRotAccEnable_XDU8 "Injected rotor acceleration is active => not deactivated through a parameter " VALUE 0x150AB7 AblGLKWub 1 ZU0 0 1 FORMAT "%5.3" /end CHARACTERISTIC
/begin CHARACTERISTIC fLa_InjectSmoothMMotEnable_XDB "" VALUE 0x150AB8 AblGLKWub 1 ZU0 0 1 FORMAT "%5.3" /end CHARACTERISTIC
/begin CHARACTERISTIC fLa_LaCtrlModSwEnable_XDB "" VALUE 0x150AB9 AblGLKWub 1 ZU0 0 1 FORMAT "%5.3" /end CHARACTERISTIC
/begin CHARACTERISTIC fLa_LaInjectHandsModeEnable_XDU8 "" VALUE 0x150ABA AblGLKWub 1 ZU0 0 1 FORMAT "%5.3" /end CHARACTERISTIC
/begin CHARACTERISTIC fLa_MMotOffsetFilter_Enable_XDB "Activation of filter the MMOT Offset" VALUE 0x150ABB AblGLKWub 1 ZU0 0 1 FORMAT "%5.3" /end CHARACTERISTIC
/begin CHARACTERISTIC fLa_MotorTorqueDriverFactorEnable_XDB "Enable the Factor depends on Driver" VALUE 0x150ABC AblGLKWub 1 ZU0 0 1 FORMAT "%5.3" /end CHARACTERISTIC
/begin CHARACTERISTIC fLa_PinionCorrActive_XDB "LT and ST correction of Steering angle 0=Disabled, 1=Enabled" VALUE 0x150ABD AblGLKWub 1 ZU0 0 1 FORMAT "%5.3" /end CHARACTERISTIC
/begin CHARACTERISTIC fLa_RackPositionInjectEnable_XDB "Flag of enable inject of rack position" VALUE 0x150ABE AblGLKWub 1 ZU0 0 1 FORMAT "%5.3" /end CHARACTERISTIC
/begin CHARACTERISTIC fLa_RackSpeedInjectEnable_XDB "Flag of enable inject of rack speed" VALUE 0x150ABF AblGLKWub 1 ZU0 0 1 FORMAT "%5.3" /end CHARACTERISTIC
/begin CHARACTERISTIC fLa_ReqStateHFInjectEnable_XDB "" VALUE 0x150AC0 AblGLKWub 1 ZU0 0 1 FORMAT "%5.3" /end CHARACTERISTIC
/begin CHARACTERISTIC fLa_TorqOverlayCoefntEnable_XDB "Enable flag of Coefficient on Torque overlay of LA function" VALUE 0x150AC1 AblGLKWub 1 ZU0 0 1 FORMAT "%5.3" /end CHARACTERISTIC
/begin CHARACTERISTIC fLa_UpLowLimEnable_XDB "Enable flag of Up limitation and low low limitation" VALUE 0x150AC2 AblGLKWub 1 ZU0 0 1 FORMAT "%5.3" /end CHARACTERISTIC
/begin CHARACTERISTIC fLdw_DisableNeutralCheck_XDB "" VALUE 0x150AC3 AblGLKWub 1 ZU0 0 1 FORMAT "%5.3" /end CHARACTERISTIC
/begin CHARACTERISTIC fLdw_FinishVibrationEnable_XDB "" VALUE 0x150AC4 AblGLKWub 1 ZU0 0 1 FORMAT "%5.3" /end CHARACTERISTIC
/begin CHARACTERISTIC fLdw_VibrationWaveform_XDU8 "" VALUE 0x150AC5 AblGLKWub 1 ZU0 0 1 FORMAT "%5.3" /end CHARACTERISTIC
/begin CHARACTERISTIC lLa_HFMaxDesRackPosition_XAU16 "" CURVE 0x150F44 AblGLKLuw 100 RACKPOS128 0 100 FORMAT "%8.4"
 /begin AXIS_DESCR STD_AXIS vVehSpI_AbsMaxSafeVehSpd_xdu16 VFZHIGH 9 0 500 FORMAT "%8.4" DEPOSIT ABSOLUTE /end AXIS_DESCR
/end CHARACTERISTIC
/begin CHARACTERISTIC lLa_HFMaxRackPosition_XAU16 "" CURVE 0x150F6C AblGLKLuw 100 RACKPOS128 0 100 FORMAT "%8.4"
 /begin AXIS_DESCR STD_AXIS vVehSpI_AbsMaxSafeVehSpd_xdu16 VFZHIGH 9 0 180 FORMAT "%8.4" DEPOSIT ABSOLUTE /end AXIS_DESCR
/end CHARACTERISTIC
/begin CHARACTERISTIC lLa_HOMaxDesRackPosition_XAU16 "" CURVE 0x150F94 AblGLKLuw 100 RACKPOS128 0 100 FORMAT "%8.4"
 /begin AXIS_DESCR STD_AXIS vVehSpI_AbsMaxSafeVehSpd_xdu16 VFZHIGH 9 0 500 FORMAT "%8.4" DEPOSIT ABSOLUTE /end AXIS_DESCR
/end CHARACTERISTIC
/begin CHARACTERISTIC lLa_HOMaxRackPosition_XAU16 "" CURVE 0x150FBC AblGLKLuw 100 RACKPOS128 0 100 FORMAT "%8.4"
 /begin AXIS_DESCR STD_AXIS vVehSpI_AbsMaxSafeVehSpd_xdu16 VFZHIGH 9 0 180 FORMAT "%8.4" DEPOSIT ABSOLUTE /end AXIS_DESCR
/end CHARACTERISTIC
/begin CHARACTERISTIC lLa_InjectDesiredRackPosition_XDS16 "Injected desired rack position for test(mm)" VALUE 0x15057E AblGLKWsw 400 RACKPOS128 -200 200 FORMAT "%8.4" /end CHARACTERISTIC
/begin CHARACTERISTIC lLa_InjectDesiredRackSpeed_XDS16 "Injected desired rack speed for test(mm/s)" VALUE 0x150580 AblGLKWsw 500 RACKSPEED128 -250 250 FORMAT "%8.4" /end CHARACTERISTIC
/begin CHARACTERISTIC lLa_MaxRackPositionIntegral_XAU16 "" CURVE 0x150FE4 AblGLKLuw 10 RACKPOS128 0 10 FORMAT "%8.5"
 /begin AXIS_DESCR STD_AXIS vVehSpI_AbsMaxSafeVehSpd_xdu16 VFZHIGH 9 0 180 FORMAT "%8.4" DEPOSIT ABSOLUTE /end AXIS_DESCR
/end CHARACTERISTIC
/begin CHARACTERISTIC mApplI_TorsionBarTorqueInjectValue_XDS16 "" VALUE 0x15058C AblGLKWsw 50 TBTHIGH -25 25 FORMAT "%8.5" /end CHARACTERISTIC
/begin CHARACTERISTIC mFriCo_FrictionCompFixValue_XDU16 "Fixer Kompensationswert bei ausgeschalteter Funktion (customer coding)" VALUE 0x1505F6 AblGLKWuw 0.490234 MMOT 0 0.4902344 FORMAT "%9.7" /end CHARACTERISTIC
/begin CHARACTERISTIC mFriCo_FrictionCompMax_XDU16 "Maximalwert, der kompensiert wird (bei eingeschalteter Funktion (customer coding))" VALUE 0x1505F8 AblGLKWuw 1 MMOT 0 1 FORMAT "%8.6" /end CHARACTERISTIC
/begin CHARACTERISTIC mFriCo_FrictionCompMin_XDU16 "Mindestwert, der immer kompensiert wird (bei eingeschalteter Funktion (customer coding))" VALUE 0x1505FA AblGLKWuw 0.490234 MMOT 0 0.4902344 FORMAT "%9.7" /end CHARACTERISTIC
/begin CHARACTERISTIC mFriCo_FrictionDeadZone_XDU16 "Totband auf gefiltertes Reibungsmoment" VALUE 0x1505FC AblGLKWuw 1 MMOT 0 1 FORMAT "%8.6" /end CHARACTERISTIC
/begin CHARACTERISTIC mFriCo_FrictionThreshold4Error_XDU16 "Schwelle für Fehlereintrag: hohe Reibung" VALUE 0x1505FE AblGLKWuw 2 MMOT 0 2 FORMAT "%8.6" /end CHARACTERISTIC
/begin CHARACTERISTIC mFriCo_MaxTorqueChange4Learn_XDU16 "Maximale Momentenänderung für Berechnung Reibungserkennung" VALUE 0x150600 AblGLKWuw 1 MMOT 0 1 FORMAT "%8.6" /end CHARACTERISTIC
/begin CHARACTERISTIC mFuncDispl_MaxAllowedVibrationTrq_XDU16 "Maximales Vibrationsmoment im EcuStatus FailOp" VALUE 0x150602 AblGLKWuw 0.5 MMOT 0 0.5 FORMAT "%9.7" /end CHARACTERISTIC
/begin CHARACTERISTIC mFuncDispl_MaxSafetyMotorTorq_XDU16 "Max. zul. Motormomentoffset fuer Vibration am Lenkrad (Sicherheit)" VALUE 0x150604 AblGLKWuw 0.5 MMOT 0 0.5 FORMAT "%9.7" /end CHARACTERISTIC
/begin CHARACTERISTIC mHndOff_FrictionSubst_XDU8 "substitute value of column friction since value is still not learned" VALUE 0x150AE1 AblGLKWub 2 TBT_RSH5 0 2 FORMAT "%5.3" /end CHARACTERISTIC
/begin CHARACTERISTIC mHndOff_GradIntegralLimit_XDU16 "Max TBT Integral 4 gradient monitoring" VALUE 0x150606 AblGLKWuw 25 TBTHIGH 0 25 FORMAT "%8.5" /end CHARACTERISTIC
/begin CHARACTERISTIC mHndOff_IncrLowerBorder_XDU16 "torque value to increase the opposite threshold when changed to hysteresis state" VALUE 0x150608 AblGLKWuw 2 TBTHIGH 0 2 FORMAT "%8.6" /end CHARACTERISTIC
/begin CHARACTERISTIC mHndOff_MaxTbtRange4Lka_XAU16 "maximum allowed torsion bar torque range/noise depending on column friction @ LDP" CURVE 0x1510BC AblGLKLuw 2 TBTHIGH 0 2 FORMAT "%8.6"
 /begin AXIS_DESCR STD_AXIS mHystDectI_ColumnFriction_xdu16 TBTHIGH 3 0 4 FORMAT "%8.6" DEPOSIT ABSOLUTE /end AXIS_DESCR
/end CHARACTERISTIC
/begin CHARACTERISTIC mHndOff_MaxTbtRange_XAU16 "maximum allowed torsion bar torque range/noise depending on column friction" CURVE 0x1510CC AblGLKLuw 2 TBTHIGH 0 2 FORMAT "%8.6"
 /begin AXIS_DESCR STD_AXIS mHystDectI_ColumnFriction_xdu16 TBTHIGH 3 0 4 FORMAT "%8.6" DEPOSIT ABSOLUTE /end AXIS_DESCR
/end CHARACTERISTIC
/begin CHARACTERISTIC mHndOff_TbtGradLimit_XDU16 "Max TBT Gradient avg 4 gradient monitoring" VALUE 0x15060A AblGLKWuw 25 TBTHIGH 0 25 FORMAT "%8.5" /end CHARACTERISTIC
/begin CHARACTERISTIC mHndOff_TbtOffsetSubst_XDU8 "substitute value of torsion bar torque offset since value is still not learned" VALUE 0x150AE2 AblGLKWub 1 TBT_RSH7 0 1 FORMAT "%5.3" /end CHARACTERISTIC
/begin CHARACTERISTIC mHwlWrapI_MaxMechAllowedTorque_XDF32 "Maximales Moment das der Motor stellen k?nnen darf. Hier?ber kann der Motor der Mechanik angepasst werden." VALUE 0x15040C AblGLKWfl4 19 ZU0 1 20 FORMAT "%10.7" /end CHARACTERISTIC
/begin CHARACTERISTIC mHwlWrapI_MaxSafeRampDownReqTorque_XDU16 "Motormomentenschwelle (requested torque) unter der die Sudden Loss of Assist Gradientenlimitierung deaktiviert wird." VALUE 0x15060C AblGLKWuw 1 MMOT 0 1 FORMAT "%8.6" /end CHARACTERISTIC
/begin CHARACTERISTIC mHwlWrapI_MaxSafeRampUpReqTorque_XDU16 "Motormomentenschwelle (requested torque) unter der die Sudden Assist Gradientenlimitierung deaktiviert wird." VALUE 0x15060E AblGLKWuw 1 MMOT 0 1 FORMAT "%8.6" /end CHARACTERISTIC
/begin CHARACTERISTIC mHystDect_MaxColumnFriction_XDU8 "maximum column friction torque of learning value" VALUE 0x150AE3 AblGLKWub 2 TBT_RSH5 0 2 FORMAT "%5.3" /end CHARACTERISTIC
/begin CHARACTERISTIC mHystDect_MaxTbtRange_XDU16 "torsion bar torque shall be within this stable range" VALUE 0x150610 AblGLKWuw 0.495117 TBTHIGH 0.004882813 0.5 FORMAT "%9.7" /end CHARACTERISTIC
/begin CHARACTERISTIC mHystDect_MaxTbt_XDU8 "maximum torsion bar torque to enable learning" VALUE 0x150AE4 AblGLKWub 3.938 TBT_RSH5 0.0625 4 FORMAT "%5.3" /end CHARACTERISTIC
/begin CHARACTERISTIC mHystDect_MaxTorqueGradient_XDU16 "maximum gradient of new hysteresis value" VALUE 0x150612 AblGLKWuw 0.200195 TBTHIGH 0 0.2001953 FORMAT "%9.7" /end CHARACTERISTIC
/begin CHARACTERISTIC mHystDect_MaxTorqueOffset_XDU8 "maximum torsion bar torque offset of learning value" VALUE 0x150AE5 AblGLKWub 1 TBT_RSH7 0 1 FORMAT "%5.3" /end CHARACTERISTIC
/begin CHARACTERISTIC mHystTor_MaxHystTor_XDU16 " Grenzwert für maximales Hysteresemoment" VALUE 0x150614 AblGLKWuw 2 TBTHIGH 0 2 FORMAT "%8.6" /end CHARACTERISTIC
/begin CHARACTERISTIC mInCo_InertiaCompLimit_XDS16 "max. zulässiges Trägheitskompensationsmoment" VALUE 0x14A04E AblGLKWsw 1 MMOT 0 1 FORMAT "%8.6" /end CHARACTERISTIC
/begin CHARACTERISTIC mLa_CheckDrvNoOverideTorqLim_XDU16 "" VALUE 0x150616 AblGLKWuw 8 TBTHIGH 0 8 FORMAT "%8.6" /end CHARACTERISTIC
/begin CHARACTERISTIC mLa_CheckDrvOverideTorqLim_XDU16 "" VALUE 0x150618 AblGLKWuw 8 MMOT 0 8 FORMAT "%8.6" /end CHARACTERISTIC
/begin CHARACTERISTIC mLa_DesSteeringTorqueOffsetLimit_XAS16 "" CURVE 0x1510DC AblGLKLsw 10 TBTHIGH 0 10 FORMAT "%8.5"
 /begin AXIS_DESCR STD_AXIS vVehSpI_AbsMaxSafeVehSpd_xdu16 VFZHIGH 6 0 250 FORMAT "%8.4" DEPOSIT ABSOLUTE /end AXIS_DESCR
/end CHARACTERISTIC
/begin CHARACTERISTIC mLa_DriInLoopLowerLimMinValue_XAS16 "" CURVE 0x1510F8 AblGLKLsw 20 TBTHIGH -20 0 FORMAT "%8.5"
 /begin AXIS_DESCR STD_AXIS vVehSpI_AbsMaxSafeVehSpd_xdu16 VFZHIGH 6 0 250 FORMAT "%8.4" DEPOSIT ABSOLUTE /end AXIS_DESCR
/end CHARACTERISTIC
/begin CHARACTERISTIC mLa_DriInLoopLowerLimRampDownGradient_XAS16 "" CURVE 0x151114 AblGLKLsw 20 TBTHIGH 0 20 FORMAT "%8.5"
 /begin AXIS_DESCR STD_AXIS vVehSpI_AbsMaxSafeVehSpd_xdu16 VFZHIGH 6 0 250 FORMAT "%8.4" DEPOSIT ABSOLUTE /end AXIS_DESCR
/end CHARACTERISTIC
/begin CHARACTERISTIC mLa_DriInLoopUpperLimMinValue_XAS16 "" CURVE 0x151130 AblGLKLsw 20 TBTHIGH 0 20 FORMAT "%8.5"
 /begin AXIS_DESCR STD_AXIS vVehSpI_AbsMaxSafeVehSpd_xdu16 VFZHIGH 6 0 250 FORMAT "%8.4" DEPOSIT ABSOLUTE /end AXIS_DESCR
/end CHARACTERISTIC
/begin CHARACTERISTIC mLa_DriInLoopUpperLimRampDownGradient_XAS16 "" CURVE 0x15114C AblGLKLsw 20 TBTHIGH 0 20 FORMAT "%8.5"
 /begin AXIS_DESCR STD_AXIS vVehSpI_AbsMaxSafeVehSpd_xdu16 VFZHIGH 6 0 250 FORMAT "%8.4" DEPOSIT ABSOLUTE /end AXIS_DESCR
/end CHARACTERISTIC
/begin CHARACTERISTIC mLa_DriNotInLoopLowerLimRampUpGradient_XAS16 "" CURVE 0x151168 AblGLKLsw 20 TBTHIGH 0 20 FORMAT "%8.5"
 /begin AXIS_DESCR STD_AXIS vVehSpI_AbsMaxSafeVehSpd_xdu16 VFZHIGH 6 0 250 FORMAT "%8.4" DEPOSIT ABSOLUTE /end AXIS_DESCR
/end CHARACTERISTIC
/begin CHARACTERISTIC mLa_DriNotInLoopUpperLimRampUpGradient_XAS16 "" CURVE 0x151184 AblGLKLsw 20 TBTHIGH 0 20 FORMAT "%8.5"
 /begin AXIS_DESCR STD_AXIS vVehSpI_AbsMaxSafeVehSpd_xdu16 VFZHIGH 6 0 250 FORMAT "%8.4" DEPOSIT ABSOLUTE /end AXIS_DESCR
/end CHARACTERISTIC
/begin CHARACTERISTIC mLa_DriverInLoopThrehold_XAU16 "" CURVE 0x1511A0 AblGLKLuw 20 TBTHIGH 0 20 FORMAT "%8.5"
 /begin AXIS_DESCR STD_AXIS vVehSpI_AbsMaxSafeVehSpd_xdu16 VFZHIGH 6 0 250 FORMAT "%8.4" DEPOSIT ABSOLUTE /end AXIS_DESCR
/end CHARACTERISTIC
/begin CHARACTERISTIC mLa_DriverNotInLoopThrehold_XAU16 "" CURVE 0x1511BC AblGLKLuw 20 TBTHIGH 0 20 FORMAT "%8.5"
 /begin AXIS_DESCR STD_AXIS vVehSpI_AbsMaxSafeVehSpd_xdu16 VFZHIGH 6 0 250 FORMAT "%8.4" DEPOSIT ABSOLUTE /end AXIS_DESCR
/end CHARACTERISTIC
/begin CHARACTERISTIC mLa_DrvOverideTorqLim_XDU16 "" VALUE 0x15061A AblGLKWuw 8 TBTHIGH 0 8 FORMAT "%8.6" /end CHARACTERISTIC
/begin CHARACTERISTIC mLa_HFMaxTrqHighDepOnVelocityController_XAU16 "" CURVE 0x1511D8 AblGLKLuw 8 MMOT 0 8 FORMAT "%8.6"
 /begin AXIS_DESCR STD_AXIS vVehSpI_AbsMaxSafeVehSpd_xdu16 VFZHIGH 9 0 250 FORMAT "%8.4" DEPOSIT ABSOLUTE /end AXIS_DESCR
/end CHARACTERISTIC
/begin CHARACTERISTIC mLa_HFMaxTrqHighDepOnVelocity_XAU16 "" CURVE 0x151200 AblGLKLuw 8 MMOT 0 8 FORMAT "%8.6"
 /begin AXIS_DESCR STD_AXIS vVehSpI_AbsMaxSafeVehSpd_xdu16 VFZHIGH 9 0 150 FORMAT "%8.4" DEPOSIT ABSOLUTE /end AXIS_DESCR
/end CHARACTERISTIC
/begin CHARACTERISTIC mLa_HOMaxTrqHighDepOnVelocityController_XAU16 "" CURVE 0x151228 AblGLKLuw 8 MMOT 0 8 FORMAT "%8.6"
 /begin AXIS_DESCR STD_AXIS vVehSpI_AbsMaxSafeVehSpd_xdu16 VFZHIGH 9 0 250 FORMAT "%8.4" DEPOSIT ABSOLUTE /end AXIS_DESCR
/end CHARACTERISTIC
/begin CHARACTERISTIC mLa_HOMaxTrqHighDepOnVelocity_XAU16 "" CURVE 0x151250 AblGLKLuw 8 MMOT 0 8 FORMAT "%8.6"
 /begin AXIS_DESCR STD_AXIS vVehSpI_AbsMaxSafeVehSpd_xdu16 VFZHIGH 9 0 150 FORMAT "%8.4" DEPOSIT ABSOLUTE /end AXIS_DESCR
/end CHARACTERISTIC
/begin CHARACTERISTIC mLa_LaInjectMMot_XDS16 "" VALUE 0x15061C AblGLKWsw 13 MMOT -6.5 6.5 FORMAT "%8.6" /end CHARACTERISTIC
/begin CHARACTERISTIC mLa_LowerLimMaxValue_XAS16 "" CURVE 0x151278 AblGLKLsw 20 TBTHIGH -20 0 FORMAT "%8.5"
 /begin AXIS_DESCR STD_AXIS vVehSpI_AbsMaxSafeVehSpd_xdu16 VFZHIGH 6 0 250 FORMAT "%8.4" DEPOSIT ABSOLUTE /end AXIS_DESCR
/end CHARACTERISTIC
/begin CHARACTERISTIC mLa_LowerLimSNAValue_XDS16 "" VALUE 0x15061E AblGLKWsw 20 TBTHIGH -10 10 FORMAT "%8.5" /end CHARACTERISTIC
/begin CHARACTERISTIC mLa_MaxMotTrqRampGradient_XDU16 "Rate limitation active torque threshold" VALUE 0x150620 AblGLKWuw 3 RAMPRATE 0 3 FORMAT "%8.6" /end CHARACTERISTIC
/begin CHARACTERISTIC mLa_MaxTrqHighDepOnVelocity_XAU16 "" CURVE 0x151294 AblGLKLuw 6.5 MMOT 0 6.5 FORMAT "%8.6"
 /begin AXIS_DESCR STD_AXIS vVehSpI_AbsMaxSafeVehSpd_xdu16 VFZHIGH 5 0 150 FORMAT "%8.4" DEPOSIT ABSOLUTE /end AXIS_DESCR
/end CHARACTERISTIC
/begin CHARACTERISTIC mLa_NormalRampOutRate_XDU16 "" VALUE 0x150622 AblGLKWuw 60 TBTHIGH 0 60 FORMAT "%8.5" /end CHARACTERISTIC
/begin CHARACTERISTIC mLa_SpeedIPartClearRampOutRate_XAF32 "Rack speed controller I part ramp out rate" CURVE 0x150C2C AblGLKLfl4 1600 ZU0 0 1600 FORMAT "%10.5"
 /begin AXIS_DESCR STD_AXIS vVehSpI_AbsMaxSafeVehSpd_xdf32 ZU0 6 0 180 FORMAT "%10.6" DEPOSIT ABSOLUTE /end AXIS_DESCR
/end CHARACTERISTIC
/begin CHARACTERISTIC mLa_TorsionBarTorqueDeadzone_XDS16 "" VALUE 0x150624 AblGLKWsw 20 TBTHIGH -10 10 FORMAT "%8.5" /end CHARACTERISTIC
/begin CHARACTERISTIC mLa_UpperLimMaxValue_XAS16 "" CURVE 0x151354 AblGLKLsw 10 TBTHIGH 0 10 FORMAT "%8.5"
 /begin AXIS_DESCR STD_AXIS vVehSpI_AbsMaxSafeVehSpd_xdu16 VFZHIGH 6 0 250 FORMAT "%8.4" DEPOSIT ABSOLUTE /end AXIS_DESCR
/end CHARACTERISTIC
/begin CHARACTERISTIC mLa_UpperLimSNAValue_XDS16 "" VALUE 0x150626 AblGLKWsw 20 TBTHIGH -10 10 FORMAT "%8.5" /end CHARACTERISTIC
/begin CHARACTERISTIC mLdw_ActTorsionBarTorqueLimit_XDU16 "" VALUE 0x150628 AblGLKWuw 8 TBTHIGH 0 8 FORMAT "%8.6" /end CHARACTERISTIC
/begin CHARACTERISTIC mLdw_DeactTorsionBarTorqueLimit_XDU16 "" VALUE 0x15062A AblGLKWuw 8 TBTHIGH 0 8 FORMAT "%8.6" /end CHARACTERISTIC
/begin CHARACTERISTIC mLdw_DriverOverrideTrq_XDU16 "" VALUE 0x15062C AblGLKWuw 8 TBTHIGH 0 8 FORMAT "%8.6" /end CHARACTERISTIC
/begin CHARACTERISTIC mLdw_MaxIntegratedTorque_XDU16 "Max. erlaubtes aufintegriertes Motormoment von Seiten Sicherheit [Nm*ms]" VALUE 0x15062E AblGLKWuw 49 MMOT 1 50 FORMAT "%8.5" /end CHARACTERISTIC
/begin CHARACTERISTIC mLdw_MaxSafetyDCMotorTorque_XDU16 "maximales erlaubtes Motormoment ohne erforderliche Integralüberwachung" VALUE 0x150630 AblGLKWuw 0.900391 MMOT 0.09960938 1 FORMAT "%8.6" /end CHARACTERISTIC
/begin CHARACTERISTIC mLdw_MaxSafetyMotorTorq_XDU16 "" VALUE 0x150632 AblGLKWuw 0.900391 MMOT 0.09960938 1 FORMAT "%8.6" /end CHARACTERISTIC
/begin CHARACTERISTIC mLdw_MaxTorque_XDU16_0___A "" VALUE 0x1580B8 AblGLKWuw 0.5 MMOT 0 0.5 FORMAT "%9.7" /end CHARACTERISTIC
/begin CHARACTERISTIC mLdw_MaxTorque_XDU16_1___A "" VALUE 0x1580BA AblGLKWuw 0.5 MMOT 0 0.5 FORMAT "%9.7" /end CHARACTERISTIC
/begin CHARACTERISTIC mLdw_MaxTorque_XDU16_2___A "" VALUE 0x1580BC AblGLKWuw 0.5 MMOT 0 0.5 FORMAT "%9.7" /end CHARACTERISTIC
/begin CHARACTERISTIC mLdw_MaxTorque_XDU16_3___A "" VALUE 0x1580BE AblGLKWuw 0.5 MMOT 0 0.5 FORMAT "%9.7" /end CHARACTERISTIC
/begin CHARACTERISTIC mLdw_MaxTorque_XDU16_4___A "" VALUE 0x1580C0 AblGLKWuw 0.5 MMOT 0 0.5 FORMAT "%9.7" /end CHARACTERISTIC
/begin CHARACTERISTIC mLdw_MaxTorque_XDU16_5___A "" VALUE 0x1580C2 AblGLKWuw 0.5 MMOT 0 0.5 FORMAT "%9.7" /end CHARACTERISTIC
/begin CHARACTERISTIC mLdw_NoOvrRidTrqLimit_XDU16 "" VALUE 0x150634 AblGLKWuw 8 TBTHIGH 0 8 FORMAT "%8.6" /end CHARACTERISTIC
/begin CHARACTERISTIC nFriCo_MaxRotorSpeed4Learn_XDU16 "maximale Rotordrehzahl für Berechnung Reibungserkennung" VALUE 0x1506C8 AblGLKWuw 3000 VROT 0 3000 FORMAT "%3.0" /end CHARACTERISTIC
/begin CHARACTERISTIC qLdw_Frequency_XDU8_00___A " Warnung der Frequenz " VALUE 0x15855C AblGLKWub 21 FREQ 10 31 FORMAT "%5.2" /end CHARACTERISTIC
/begin CHARACTERISTIC qLdw_Frequency_XDU8_01___A " Warnung der Frequenz " VALUE 0x15855D AblGLKWub 21 FREQ 10 31 FORMAT "%5.2" /end CHARACTERISTIC
/begin CHARACTERISTIC qLdw_Frequency_XDU8_02___A " Warnung der Frequenz " VALUE 0x15855E AblGLKWub 21 FREQ 10 31 FORMAT "%5.2" /end CHARACTERISTIC
/begin CHARACTERISTIC qLdw_Frequency_XDU8_03___A " Warnung der Frequenz " VALUE 0x15855F AblGLKWub 21 FREQ 10 31 FORMAT "%5.2" /end CHARACTERISTIC
/begin CHARACTERISTIC qLdw_Frequency_XDU8_04___A " Warnung der Frequenz " VALUE 0x158560 AblGLKWub 21 FREQ 10 31 FORMAT "%5.2" /end CHARACTERISTIC
/begin CHARACTERISTIC qLdw_Frequency_XDU8_05___A " Warnung der Frequenz " VALUE 0x158561 AblGLKWub 21 FREQ 10 31 FORMAT "%5.2" /end CHARACTERISTIC
/begin CHARACTERISTIC qLdw_Frequency_XDU8_06___A " Warnung der Frequenz " VALUE 0x158562 AblGLKWub 21 FREQ 10 31 FORMAT "%5.2" /end CHARACTERISTIC
/begin CHARACTERISTIC qLdw_Frequency_XDU8_07___A " Warnung der Frequenz " VALUE 0x158563 AblGLKWub 21 FREQ 10 31 FORMAT "%5.2" /end CHARACTERISTIC
/begin CHARACTERISTIC qLdw_Frequency_XDU8_08___A " Warnung der Frequenz " VALUE 0x158564 AblGLKWub 21 FREQ 10 31 FORMAT "%5.2" /end CHARACTERISTIC
/begin CHARACTERISTIC qLdw_Frequency_XDU8_09___A " Warnung der Frequenz " VALUE 0x158565 AblGLKWub 21 FREQ 10 31 FORMAT "%5.2" /end CHARACTERISTIC
/begin CHARACTERISTIC qLdw_Frequency_XDU8_10___A " Warnung der Frequenz " VALUE 0x158566 AblGLKWub 21 FREQ 10 31 FORMAT "%5.2" /end CHARACTERISTIC
/begin CHARACTERISTIC qLdw_Frequency_XDU8_11___A " Warnung der Frequenz " VALUE 0x158567 AblGLKWub 21 FREQ 10 31 FORMAT "%5.2" /end CHARACTERISTIC
/begin CHARACTERISTIC sFaInTI_EnableInjection_XDU8 "globale Freigabe für die Fehlerinjektion, 0 = Fehlerinjektion nicht aktiv (Default wert)" VALUE 0x150AEF AblGLKWub 255 ZU0 0 255 FORMAT "%5.1" /end CHARACTERISTIC
/begin CHARACTERISTIC sFaInTI_RPSL2Active_XDU8 "1 = Rotorlagesensor L2 aktiv (Default wert)" VALUE 0x150AF0 AblGLKWub 255 ZU0 0 255 FORMAT "%5.1" /end CHARACTERISTIC
/begin CHARACTERISTIC sFaInTI_RPSOffsetActive_XDU8 "Aufschaltung Rotorlagewinkeloffset freigeben, 0 = Rotorlagewinkeloffset Aufschaltung inaktiv (Default wert)" VALUE 0x150AF1 AblGLKWub 255 ZU0 0 255 FORMAT "%5.1" /end CHARACTERISTIC
/begin CHARACTERISTIC sFaInTI_TBTL2Active_XDU8 "1 = Momentensensor L2 aktiv (Default wert)" VALUE 0x150AF2 AblGLKWub 255 ZU0 0 255 FORMAT "%5.1" /end CHARACTERISTIC
/begin CHARACTERISTIC sFaInTI_TBTOffsetActive_XDU8 "Aufschaltung Handmomentenoffset freigeben, 0 = Handmomentenoffset Aufschaltung inaktiv (Default wert)" VALUE 0x150AF3 AblGLKWub 255 ZU0 0 255 FORMAT "%5.1" /end CHARACTERISTIC
/begin CHARACTERISTIC sFctCo_AllowedToActivate_XAU8 "Matrix zum Konfigurieren, welche Kanäle in Abhängigkeit aller anderen Kanäle aktiviert werden dürfen. Zeile -> anfragender Kanal, Spalte -> laufender Kanal" MAP 0x14A184 AblGLFKFub 1 ZU0 0 1 FORMAT "%5.3"
 /begin AXIS_DESCR FIX_AXIS yFctCo_Dummy_xdu8 AOC_FEATURES 22 0 21 FIX_AXIS_PAR 0 0 22 FORMAT "%13.10" /end AXIS_DESCR
 /begin AXIS_DESCR FIX_AXIS yFctCo_Dummy_xdu8 AOC_FEATURES 22 0 21 FIX_AXIS_PAR 0 0 22 FORMAT "%13.10" /end AXIS_DESCR
/end CHARACTERISTIC
/begin CHARACTERISTIC sFctCo_ChannelCategory_XAU8 "Kanal Kategorie zur Begrenzung der aktive Kanäle. 0->interner Kanal, 1->externer Kanal" VAL_BLK 0x14A128 AblGLKWBub 1 ZU0 0 1 NUMBER 22 FORMAT "%5.3" /end CHARACTERISTIC
/begin CHARACTERISTIC sFctCo_ContinueIfActive_XAU8 "Matrix zum Konfigurieren, welche Kanäle in Abhängigkeit aller anderen Kanäle weiterlaufen dürfen. Zeile -> anfragender Kanal, Spalte -> laufender Kanal" MAP 0x14A368 AblGLFKFub 1 ZU0 0 1 FORMAT "%5.3"
 /begin AXIS_DESCR FIX_AXIS yFctCo_Dummy_xdu8 AOC_FEATURES 22 0 21 FIX_AXIS_PAR 0 0 22 FORMAT "%13.10" /end AXIS_DESCR
 /begin AXIS_DESCR FIX_AXIS yFctCo_Dummy_xdu8 AOC_FEATURES 22 0 21 FIX_AXIS_PAR 0 0 22 FORMAT "%13.10" /end AXIS_DESCR
/end CHARACTERISTIC
/begin CHARACTERISTIC sFctCo_ParallelActingAllowed_XAU8 "Features die gleichzeitig Moment stellen dürfen (Continue | ParallelRamping)" MAP 0x14A54C AblGLFKFub 1 ZU0 0 1 FORMAT "%5.3"
 /begin AXIS_DESCR FIX_AXIS yFctCo_Dummy_xdu8 AOC_FEATURES 22 0 21 FIX_AXIS_PAR 0 0 22 FORMAT "%13.10" /end AXIS_DESCR
 /begin AXIS_DESCR FIX_AXIS yFctCo_Dummy_xdu8 AOC_FEATURES 22 0 21 FIX_AXIS_PAR 0 0 22 FORMAT "%13.10" /end AXIS_DESCR
/end CHARACTERISTIC
/begin CHARACTERISTIC sFctCo_ParallelRampingAllowed_XAU8 "Matrix zum Konfigurieren, welche Kanäle parallel rampen dürfen. Zeile -> anfragender Kanal, Spalte -> laufender Kanal" MAP 0x14A730 AblGLFKFub 1 ZU0 0 1 FORMAT "%5.3"
 /begin AXIS_DESCR FIX_AXIS yFctCo_Dummy_xdu8 AOC_FEATURES 22 0 21 FIX_AXIS_PAR 0 0 22 FORMAT "%13.10" /end AXIS_DESCR
 /begin AXIS_DESCR FIX_AXIS yFctCo_Dummy_xdu8 AOC_FEATURES 22 0 21 FIX_AXIS_PAR 0 0 22 FORMAT "%13.10" /end AXIS_DESCR
/end CHARACTERISTIC
/begin CHARACTERISTIC sLa_LaConfigFlag_XDU8 "" VALUE 0x150AF4 AblGLKWub 3 ZU0 0 3 FORMAT "%5.3" /end CHARACTERISTIC
/begin CHARACTERISTIC sLa_LaCtrlModInjectValue_XDU8 "" VALUE 0x150AF5 AblGLKWub 2 ZU0 0 2 FORMAT "%5.3" /end CHARACTERISTIC
/begin CHARACTERISTIC sLa_LaInjectHandsMode_XDU8 "/" VALUE 0x150AF6 AblGLKWub 1 ZU0 0 1 FORMAT "%5.3" /end CHARACTERISTIC
/begin CHARACTERISTIC sLa_ReqStateHFInjectValue_XDU8 "" VALUE 0x150AF7 AblGLKWub 5 ZU0 0 5 FORMAT "%5.3" /end CHARACTERISTIC
/begin CHARACTERISTIC sLdw_ConfigFlag_XDU8 "" VALUE 0x150AF8 AblGLKWub 31 ZU0 0 31 FORMAT "%5.2" /end CHARACTERISTIC
/begin CHARACTERISTIC tHndOff_CycleTimeHndOff_XDU16 "Zykluszeit von HoD / [ms]" VALUE 0x150750 AblGLKWuw 199.5 TIMMS_100US 0.5 200 FORMAT "%8.4" /end CHARACTERISTIC
/begin CHARACTERISTIC tHndOff_GradMinEntryTime_XDU8 "Min entry time 4 gradient monitoring" VALUE 0x150B11 AblGLKWub 2 TIMSEC_100 0 2 FORMAT "%5.3" /end CHARACTERISTIC
/begin CHARACTERISTIC tHndOff_TimeIncrLowerBorder_XDU8 "maximum time to increase the lower border to opposite direction when changed to hysteresis state" VALUE 0x150B12 AblGLKWub 2 TIMSEC_100 0 2 FORMAT "%5.3" /end CHARACTERISTIC
/begin CHARACTERISTIC tHwlWrapI_RampUpSuspensionTime_XDU16 "Die maximale Zeit die der Reduktionslevel auf 0% sein darf, innerhalb der eine Aufw?rtsrampe nicht gradientenbegrenzt wird. Nach Ablauf der Zeit ist die Begrenzung wieder aktiv." VALUE 0x150752 AblGLKWuw 500 TIMMS 0 500 FORMAT "%8.4" /end CHARACTERISTIC
/begin CHARACTERISTIC tHystDect_CycleTimeHystDectSigProcessing_XDU16 "Zykluszeit von HystDect Signal processing/ [ms]" VALUE 0x150754 AblGLKWuw 199.5 TIMMS_100US 0.5 200 FORMAT "%8.4" /end CHARACTERISTIC
/begin CHARACTERISTIC tHystDect_CycleTimeHystDect_XDU16 "Zykluszeit von HystDect / [ms]" VALUE 0x150756 AblGLKWuw 199.5 TIMMS_100US 0.5 200 FORMAT "%8.4" /end CHARACTERISTIC
/begin CHARACTERISTIC tHystDect_MinLearnTime_XDU8 "minimum seconds to learn hysteresis" VALUE 0x150B13 AblGLKWub 19.9 TIMSEC_10 0.1 20 FORMAT "%5.2" /end CHARACTERISTIC
/begin CHARACTERISTIC tHystDect_WarmUpPhase_XDU8 "minimum minutes after start up to enable learning: avoid too much learned friction due to cold environemnt" VALUE 0x150B14 AblGLKWub 60 TIMMIN 0 60 FORMAT "%5.2" /end CHARACTERISTIC
/begin CHARACTERISTIC tLa_ChatterDetectRecoverTime_XDU16 "minimum time after next half period of rotor acceleration can not be detected" VALUE 0x150758 AblGLKWuw 60000 TIMMS 0 60000 FORMAT "%8.2" /end CHARACTERISTIC
/begin CHARACTERISTIC tLa_ChatterDetectTime_XDU16 "maximum time until next half period of rotor acceleration must be detected" VALUE 0x15075A AblGLKWuw 60000 TIMMS 0 60000 FORMAT "%8.2" /end CHARACTERISTIC
/begin CHARACTERISTIC tLa_CheckDrvNoOverideTime_XDU16 "" VALUE 0x15075C AblGLKWuw 1000 TIMMS 0 1000 FORMAT "%8.3" /end CHARACTERISTIC
/begin CHARACTERISTIC tLa_CheckDrvOverideTime_XDU16 "" VALUE 0x15075E AblGLKWuw 999 TIMMS 1 1000 FORMAT "%8.3" /end CHARACTERISTIC
/begin CHARACTERISTIC tLa_CheckSpeedExceedTime_XDU16 "" VALUE 0x150760 AblGLKWuw 1000 TIMMS 0 1000 FORMAT "%8.3" /end CHARACTERISTIC
/begin CHARACTERISTIC tLa_CheckSpeedInTime_XDU16 "" VALUE 0x150762 AblGLKWuw 1000 TIMMS 0 1000 FORMAT "%8.3" /end CHARACTERISTIC
/begin CHARACTERISTIC tLa_CycleTime_XDU8 "LA Zykluszeit [ms] (für Hands-On-Überwachung)" VALUE 0x150B15 AblGLKWub 99 TIMMS 1 100 FORMAT "%5.1" /end CHARACTERISTIC
/begin CHARACTERISTIC tLa_DriverInLoopTimeThrehold_XDU16 "" VALUE 0x150764 AblGLKWuw 1000 TIMMS 0 1000 FORMAT "%8.3" /end CHARACTERISTIC
/begin CHARACTERISTIC tLa_DriverNotInLoopTimeThrehold_XDU16 "" VALUE 0x150766 AblGLKWuw 1000 TIMMS 0 1000 FORMAT "%8.3" /end CHARACTERISTIC
/begin CHARACTERISTIC tLa_DrvOverideTime_XDU16 "" VALUE 0x150768 AblGLKWuw 2000 TIMMS 0 2000 FORMAT "%8.3" /end CHARACTERISTIC
/begin CHARACTERISTIC tLa_InjectChatterContinueTime_XDU16 "Injected  Chatter Continue times" VALUE 0x15076A AblGLKWuw 50000 TIMMS 0 50000 FORMAT "%8.2" /end CHARACTERISTIC
/begin CHARACTERISTIC tLa_InjectRotAccCycleTimeLim_XDU16 "time timing upper limit of injected rotor acceleration cycle " VALUE 0x15076C AblGLKWuw 5000 TIMMS 0 5000 FORMAT "%8.3" /end CHARACTERISTIC
/begin CHARACTERISTIC tLa_InjectRotAccCycleTime_XDU16 "Injected rotor acceleration cycle time" VALUE 0x15076E AblGLKWuw 49 TIMMS 1 50 FORMAT "%8.5" /end CHARACTERISTIC
/begin CHARACTERISTIC tLa_LaCycleTime_XDU8 "[ms]" VALUE 0x150B16 AblGLKWub 99 TIMMS 1 100 FORMAT "%5.1" /end CHARACTERISTIC
/begin CHARACTERISTIC tLa_LaInjectTorqueTime_XDU16 "" VALUE 0x150770 AblGLKWuw 9990 TIMMS 10 10000 FORMAT "%8.2" /end CHARACTERISTIC
/begin CHARACTERISTIC tLa_LaSmoothCycleTime_XDU8 "" VALUE 0x150B17 AblGLKWub 99 TIMMS 1 100 FORMAT "%5.1" /end CHARACTERISTIC
/begin CHARACTERISTIC tLa_LaSmoothInjectTorqueTime_XDU16 "" VALUE 0x150772 AblGLKWuw 9990 TIMMS 10 10000 FORMAT "%8.2" /end CHARACTERISTIC
/begin CHARACTERISTIC tLa_RackPositionInjectTime_XDU16 "Inject rack position working time[ms]" VALUE 0x150774 AblGLKWuw 2000 TIMMS 0 2000 FORMAT "%8.3" /end CHARACTERISTIC
/begin CHARACTERISTIC tLa_RackSpeedInjectTime_XDU16 "Inject rack speed working time[ms]" VALUE 0x150776 AblGLKWuw 2000 TIMMS 0 2000 FORMAT "%8.3" /end CHARACTERISTIC
/begin CHARACTERISTIC tLa_ReqAngSpdTime_XDU16 "" VALUE 0x150778 AblGLKWuw 9999 TIMMS 1 10000 FORMAT "%8.2" /end CHARACTERISTIC
/begin CHARACTERISTIC tLa_ReqAngTime_XDU16 "" VALUE 0x15077A AblGLKWuw 9999 TIMMS 1 10000 FORMAT "%8.2" /end CHARACTERISTIC
/begin CHARACTERISTIC tLa_RequestErrorTime_XDU16 "" VALUE 0x15077C AblGLKWuw 4999 TIMMS 1 5000 FORMAT "%8.3" /end CHARACTERISTIC
/begin CHARACTERISTIC tLa_VehSpeedErrTime_XDU16 "" VALUE 0x15077E AblGLKWuw 9980 TIMMS 20 10000 FORMAT "%8.2" /end CHARACTERISTIC
/begin CHARACTERISTIC tLa_VSEABSActiveCheckTime_XDU16 "" VALUE 0x150780 AblGLKWuw 2000 TIMMS 0 2000 FORMAT "%8.3" /end CHARACTERISTIC
/begin CHARACTERISTIC tLa_VSEABSInactiveCheckTime_XDU16 "" VALUE 0x150782 AblGLKWuw 2000 TIMMS 0 2000 FORMAT "%8.3" /end CHARACTERISTIC
/begin CHARACTERISTIC tLdw_CheckCycleTime_XDU16 "" VALUE 0x150784 AblGLKWuw 0.099 TIMSEC_1000 0.001 0.1 FORMAT "%9.7" /end CHARACTERISTIC
/begin CHARACTERISTIC tLdw_DriverOverrideTime_XDU16 "" VALUE 0x150786 AblGLKWuw 2490 TIMMS 10 2500 FORMAT "%8.3" /end CHARACTERISTIC
/begin CHARACTERISTIC tLdw_MaxAllowedVibrDuration_XDU16 "" VALUE 0x150788 AblGLKWuw 4 TIMSEC_1000 0 4 FORMAT "%8.6" /end CHARACTERISTIC
/begin CHARACTERISTIC tLdw_MaxHalfVibrationCycle_XDU8 "" VALUE 0x15078A AblGLKWuw 0.025 TIMSEC_1000 0.025 0.05 FORMAT "%10.8" /end CHARACTERISTIC
/begin CHARACTERISTIC tLdw_NoOvrRidTimeLimit_XDU16 "" VALUE 0x15078C AblGLKWuw 2490 TIMMS 10 2500 FORMAT "%8.3" /end CHARACTERISTIC
/begin CHARACTERISTIC tLdw_PauseTime_XAU16 "" VAL_BLK 0x150C60 AblGLKWBuw 10 TIMSEC_1000 0 10 NUMBER 6 FORMAT "%8.5" /end CHARACTERISTIC
/begin CHARACTERISTIC tLdw_PulseDuration_XAU16 "Dauer des dritten Impuls" VAL_BLK 0x1514DC AblGLKWBuw 10 TIMSEC_1000 0 10 NUMBER 7 FORMAT "%8.5" /end CHARACTERISTIC
/begin CHARACTERISTIC tLdw_RampDownDuration_XAU8 "" VAL_BLK 0x1514EC AblGLKWBuw 2 TIMSEC 0 2 NUMBER 7 FORMAT "%8.6" /end CHARACTERISTIC
/begin CHARACTERISTIC tLdw_RampUpDuration_XAU8 "" VAL_BLK 0x1514FC AblGLKWBuw 2 TIMSEC 0 2 NUMBER 7 FORMAT "%8.6" /end CHARACTERISTIC
/begin CHARACTERISTIC tLdw_StateMcCycleTime_XDU16 "" VALUE 0x15078E AblGLKWuw 0.099 TIMSEC_1000 0.001 0.1 FORMAT "%9.7" /end CHARACTERISTIC
/begin CHARACTERISTIC tLdw_VibrationCycleTime_XDU16_0___A "" VALUE 0x158178 AblGLKWuw 0.099 TIMSEC_1000 0.001 0.1 FORMAT "%9.7" /end CHARACTERISTIC
/begin CHARACTERISTIC tLdw_VibrationCycleTime_XDU16_1___A "" VALUE 0x15817A AblGLKWuw 0.099 TIMSEC_1000 0.001 0.1 FORMAT "%9.7" /end CHARACTERISTIC
/begin CHARACTERISTIC tLdw_VibrationCycleTime_XDU16_2___A "" VALUE 0x15817C AblGLKWuw 0.099 TIMSEC_1000 0.001 0.1 FORMAT "%9.7" /end CHARACTERISTIC
/begin CHARACTERISTIC tLdw_VibrationCycleTime_XDU16_3___A "" VALUE 0x15817E AblGLKWuw 0.099 TIMSEC_1000 0.001 0.1 FORMAT "%9.7" /end CHARACTERISTIC
/begin CHARACTERISTIC tLdw_VibrationCycleTime_XDU16_4___A "" VALUE 0x158180 AblGLKWuw 0.099 TIMSEC_1000 0.001 0.1 FORMAT "%9.7" /end CHARACTERISTIC
/begin CHARACTERISTIC tLdw_VibrationCycleTime_XDU16_5___A "" VALUE 0x158182 AblGLKWuw 0.099 TIMSEC_1000 0.001 0.1 FORMAT "%9.7" /end CHARACTERISTIC
/begin CHARACTERISTIC vFriCo_MaxVehicleSpeed4Learn_XDU16 "maximale Fahrzeuggeschwindigkeit für Berechnung Reibungserkennung" VALUE 0x150850 AblGLKWuw 240 VFZHIGH 10 250 FORMAT "%8.4" /end CHARACTERISTIC
/begin CHARACTERISTIC vFriCo_MinVehicleSpeed4Learn_XDU16 "minimale Fahrzeuggeschwindigkeit für Berechnung Reibungserkennung" VALUE 0x150852 AblGLKWuw 250 VFZHIGH 0 250 FORMAT "%8.4" /end CHARACTERISTIC
/begin CHARACTERISTIC vHndOff_MaxVehicleSpeed_XDU16 "maximun vehicle speed to enable HoD" VALUE 0x150854 AblGLKWuw 449 VFZHIGH 51 500 FORMAT "%8.4" /end CHARACTERISTIC
/begin CHARACTERISTIC vHndOff_MinVehicleSpeed_XDU16 "minimum vehicle speed to enable HoD" VALUE 0x150856 AblGLKWuw 49 VFZHIGH 1 50 FORMAT "%8.5" /end CHARACTERISTIC
/begin CHARACTERISTIC vHndOff_MinVehicleSpeed_XDU8 "minimum vehicle speed to enable HoD" VALUE 0x150B2F AblGLKWub 49 VFZ 1 50 FORMAT "%5.2" /end CHARACTERISTIC
/begin CHARACTERISTIC vHystDect_MaxSteerAngleSpeed_XDU8 "maximum steering angle speed to enable learning" VALUE 0x150B30 AblGLKWub 996 SAS_FOURTH 4 1000 FORMAT "%5.0" /end CHARACTERISTIC
/begin CHARACTERISTIC vHystDect_MinVehSpeed_XDU8 "minimum vehicle speed to enable learning" VALUE 0x150B31 AblGLKWub 99 VFZ 1 100 FORMAT "%5.1" /end CHARACTERISTIC
/begin CHARACTERISTIC vLa_DeadBandRackSpeed_XDU16 "Totband Zahnstangengeschwindigkeit LA [mm/s]" VALUE 0x150858 AblGLKWuw 100 RACKSPEED128 0 100 FORMAT "%8.4" /end CHARACTERISTIC
/begin CHARACTERISTIC vLa_HFMaxDesRackSpeed_XAU16 "" CURVE 0x15151C AblGLKLuw 100 RACKSPEED128 0 100 FORMAT "%8.4"
 /begin AXIS_DESCR STD_AXIS vVehSpI_AbsMaxSafeVehSpd_xdu16 VFZHIGH 9 0 500 FORMAT "%8.4" DEPOSIT ABSOLUTE /end AXIS_DESCR
/end CHARACTERISTIC
/begin CHARACTERISTIC vLa_HFMaxRackSpeed_XAU16 "" CURVE 0x151544 AblGLKLuw 100 RACKSPEED128 0 100 FORMAT "%8.4"
 /begin AXIS_DESCR STD_AXIS vVehSpI_AbsMaxSafeVehSpd_xdu16 VFZHIGH 9 0 180 FORMAT "%8.4" DEPOSIT ABSOLUTE /end AXIS_DESCR
/end CHARACTERISTIC
/begin CHARACTERISTIC vLa_HOMaxDesRackSpeed_XAU16 "" CURVE 0x15156C AblGLKLuw 200 RACKSPEED128 0 200 FORMAT "%8.4"
 /begin AXIS_DESCR STD_AXIS vVehSpI_AbsMaxSafeVehSpd_xdu16 VFZHIGH 9 0 500 FORMAT "%8.4" DEPOSIT ABSOLUTE /end AXIS_DESCR
/end CHARACTERISTIC
/begin CHARACTERISTIC vLa_HOMaxRackSpeed_XAU16 "" CURVE 0x151594 AblGLKLuw 100 RACKSPEED128 0 100 FORMAT "%8.4"
 /begin AXIS_DESCR STD_AXIS vVehSpI_AbsMaxSafeVehSpd_xdu16 VFZHIGH 9 0 180 FORMAT "%8.4" DEPOSIT ABSOLUTE /end AXIS_DESCR
/end CHARACTERISTIC
/begin CHARACTERISTIC vLa_InjectRackPosRampRate_XDU16 "" VALUE 0x15085A AblGLKWuw 20 RACKSPEED128 0 20 FORMAT "%8.5" /end CHARACTERISTIC
/begin CHARACTERISTIC vLa_MaxGradRackSpeed_XDU16 "Gradientenbegrenzung Zahnstangengeschwindigkeit LA [mm/s / 10ms]" VALUE 0x15085C AblGLKWuw 100 RACKSPEED128 0 100 FORMAT "%8.4" /end CHARACTERISTIC
/begin CHARACTERISTIC vLa_MaxRackPositionRampDownGradient_XDU16 "" VALUE 0x15085E AblGLKWuw 80 RACKSPEED128 0 80 FORMAT "%8.5" /end CHARACTERISTIC
/begin CHARACTERISTIC vLa_MaxRackSpeedIntegral_XAU16 "" CURVE 0x1515BC AblGLKLuw 10 RACKSPEED128 0 10 FORMAT "%8.5"
 /begin AXIS_DESCR STD_AXIS vVehSpI_AbsMaxSafeVehSpd_xdu16 VFZHIGH 9 0 180 FORMAT "%8.4" DEPOSIT ABSOLUTE /end AXIS_DESCR
/end CHARACTERISTIC
/begin CHARACTERISTIC vLa_MaxRecoVehicleSpeed_XDU16 "" VALUE 0x150860 AblGLKWuw 80 VFZHIGH 120 200 FORMAT "%8.4" /end CHARACTERISTIC
/begin CHARACTERISTIC vLa_MaxVehicleSpeedInActive_XDU16 "" VALUE 0x150862 AblGLKWuw 140 VFZHIGH 60 200 FORMAT "%8.4" /end CHARACTERISTIC
/begin CHARACTERISTIC vLa_MaxVehicleSpeed_XDU16 "" VALUE 0x150864 AblGLKWuw 140 VFZHIGH 60 200 FORMAT "%8.4" /end CHARACTERISTIC
/begin CHARACTERISTIC vLa_MinVehicleSpeed_XDU16 "" VALUE 0x150866 AblGLKWuw 60 VFZHIGH 0 60 FORMAT "%8.5" /end CHARACTERISTIC
/begin CHARACTERISTIC vLdw_MaxAllowedVehicleSpeed_XDU16 "Maximale gültige Fahrzeuggeschwindigkeit für LaneDepartureWarning" VALUE 0x150868 AblGLKWuw 190 VFZHIGH 10 200 FORMAT "%8.4" /end CHARACTERISTIC
/begin CHARACTERISTIC vLdw_MinActVehicleSpeed_XDU16 "Minimale gültige Fahrzeuggeschwindigkeit für LaneDepartureWarning" VALUE 0x15086A AblGLKWuw 200 VFZHIGH 0 200 FORMAT "%8.4" /end CHARACTERISTIC
/begin CHARACTERISTIC vLdw_MinDeactVehicleSpeed_XDU16 "Minimale gültige Fahrzeuggeschwindigkeit für LaneDepartureWarning" VALUE 0x15086C AblGLKWuw 200 VFZHIGH 0 200 FORMAT "%8.4" /end CHARACTERISTIC
/begin CHARACTERISTIC wFriCo_MaxSteeringAngle4Learn_XDU16 "maximaler Lenkwinkel für Berechnung Reibungserkennung" VALUE 0x1508DA AblGLKWuw 100 SA_10 0 100 FORMAT "%8.4" /end CHARACTERISTIC
/begin CHARACTERISTIC wFriCo_SteeringAngleHysteresis_XDU16 "Breite der Hysterese für Lenkwinkel Hysteresefilter" VALUE 0x1508DC AblGLKWuw 10 SA_10 0 10 FORMAT "%8.5" /end CHARACTERISTIC
/begin CHARACTERISTIC wHndOff_MinRotPosChange4Entry_XDU16 "minimum movement of rotor position to enter the detection" VALUE 0x1508DE AblGLKWuw 200.039 ROTPOS 0 200.0391 FORMAT "%8.4" /end CHARACTERISTIC
/begin CHARACTERISTIC wHndOff_MinRotPosChange_XDU16 "minimum chaange of rotor position to detect a change of steering direction" VALUE 0x1508E0 AblGLKWuw 200.039 ROTPOS 0 200.0391 FORMAT "%8.4" /end CHARACTERISTIC
/begin CHARACTERISTIC wHndOff_RotPosGradLimit_XDU16 "Max rot pos grad limit 4 gradient monitoring" VALUE 0x1508E2 AblGLKWuw 1000.02 ROTPOS 0 1000.02 FORMAT "%8.3" /end CHARACTERISTIC
/begin CHARACTERISTIC wHystDect_MaxOppositeRotPos_XDU8 "maximum allowed rotor movement to oppsite direction" VALUE 0x150B34 AblGLKWub 20.04 ROTPOS 0 20.04 FORMAT "%5.2" /end CHARACTERISTIC
/begin CHARACTERISTIC wHystDect_MaxRotPosChange4RateLimExtender_XDU16 "rotor position at which the widening of the rate limiter stops" VALUE 0x1508E4 AblGLKWuw 499.043 ROTPOS 0.9667969 500.0098 FORMAT "%8.4" /end CHARACTERISTIC
/begin CHARACTERISTIC wHystDect_MaxSteerAngle_XDU8 "maximum steering angle to enable learning" VALUE 0x150B35 AblGLKWub 597 SA_THIRD 3 600 FORMAT "%5.1" /end CHARACTERISTIC
/begin CHARACTERISTIC wHystDect_MinRotPosChange_XDU16 "rotor position shall move this significant angle to allow learning" VALUE 0x1508E6 AblGLKWuw 499.043 ROTPOS 0.9667969 500.0098 FORMAT "%8.4" /end CHARACTERISTIC
/begin CHARACTERISTIC wLa_MaxStrgReqAngValDepOnVelocity_XAU16 "" CURVE 0x1515E4 AblGLKLuw 600 SA_10 0 600 FORMAT "%8.4"
 /begin AXIS_DESCR STD_AXIS vVehSpI_AbsMaxSafeVehSpd_xdu16 VFZHIGH 15 0 200 FORMAT "%8.4" DEPOSIT ABSOLUTE /end AXIS_DESCR
/end CHARACTERISTIC
/begin CHARACTERISTIC wLa_RateLimDepOnVelocity_XAU16 "" CURVE 0x151624 AblGLKLuw 600 SA_10 0 600 FORMAT "%8.4"
 /begin AXIS_DESCR STD_AXIS vVehSpI_AbsMaxSafeVehSpd_xdu16 VFZHIGH 15 0 200 FORMAT "%8.4" DEPOSIT ABSOLUTE /end AXIS_DESCR
/end CHARACTERISTIC
/begin CHARACTERISTIC wLdw_StartAngle_XDU16_0___A "" VALUE 0x1581A4 AblGLKWuw 360 ZU0 0 360 FORMAT "%8.4" /end CHARACTERISTIC
/begin CHARACTERISTIC wLdw_StartAngle_XDU16_1___A "" VALUE 0x1581A6 AblGLKWuw 360 ZU0 0 360 FORMAT "%8.4" /end CHARACTERISTIC
/begin CHARACTERISTIC wLdw_StartAngle_XDU16_2___A "" VALUE 0x1581A8 AblGLKWuw 360 ZU0 0 360 FORMAT "%8.4" /end CHARACTERISTIC
/begin CHARACTERISTIC wLdw_StartAngle_XDU16_3___A "" VALUE 0x1581AA AblGLKWuw 360 ZU0 0 360 FORMAT "%8.4" /end CHARACTERISTIC
/begin CHARACTERISTIC wLdw_StartAngle_XDU16_4___A "" VALUE 0x1581AC AblGLKWuw 360 ZU0 0 360 FORMAT "%8.4" /end CHARACTERISTIC
/begin CHARACTERISTIC wLdw_StartAngle_XDU16_5___A "" VALUE 0x1581AE AblGLKWuw 360 ZU0 0 360 FORMAT "%8.4" /end CHARACTERISTIC
/begin CHARACTERISTIC xFctCo_LockAtDeratingLimit_XAU16 "Array zum individuellen Sperren von Kanälen bei Leistungsreduzierung der EPS." VAL_BLK 0x14A0E8 AblGLKWBuw 1 RIGHTSH15NP 0 1 NUMBER 22 FORMAT "%8.6" /end CHARACTERISTIC
/begin CHARACTERISTIC xFriCo_CompensationTorqueFilter_XDU16 "Filterzeitkonstante für Reibunskompensationwert" VALUE 0x1509A8 AblGLKWuw 0.999023 RIGHTSH10NP 0.0009765625 1 FORMAT "%8.6" /end CHARACTERISTIC
/begin CHARACTERISTIC xFriCo_FilterConstantMotorTorqueFilter_XDU16 "Zeitkonstante Motormomentfilter " VALUE 0x1509AA AblGLKWuw 0.999023 RIGHTSH10NP 0.0009765625 1 FORMAT "%8.6" /end CHARACTERISTIC
/begin CHARACTERISTIC xFriCo_FrictionWeightFactor_XDU16 "Faktor auf gefiltertes Reibungsmoment" VALUE 0x1509AC AblGLKWuw 1.5 RIGHTSH10NP 0 1.5 FORMAT "%8.6" /end CHARACTERISTIC
/begin CHARACTERISTIC xFriCo_LongTermFrictionFilterConstant_XDU16 "Filterkonstante Langzeit Reibungserkennung" VALUE 0x1509AE AblGLKWuw 0.999908 RIGHTSH15NP 9.155273E-05 1 FORMAT "%8.6" /end CHARACTERISTIC
/begin CHARACTERISTIC xFriCo_ShortTermFrictionFilterConstantRampUp_XDU16 "Filterkonstante Kurzzeit Reibungserkennung gültig für die ersten Zyklen(zFriCo_UseFastShortTermFilterFactor_XDU8)" VALUE 0x1509B0 AblGLKWuw 0.999023 RIGHTSH10NP 0.0009765625 1 FORMAT "%8.6" /end CHARACTERISTIC
/begin CHARACTERISTIC xFriCo_ShortTermFrictionFilterConstant_XDU16 "Filterkonstante Kurzzeit Reibungserkennung" VALUE 0x1509B2 AblGLKWuw 0.199219 RIGHTSH10NP 0.0009765625 0.2001953 FORMAT "%9.7" /end CHARACTERISTIC
/begin CHARACTERISTIC xHndOff_ConfLevelThreshold_XDU16 "" VALUE 0x1509B4 AblGLKWuw 1 RIGHTSH15NP 0 1 FORMAT "%8.6" /end CHARACTERISTIC
/begin CHARACTERISTIC xHndOff_GradConfLevel_XAU16 "vehicle speed dependent gradient of confidence level" CURVE 0x151794 AblGLKLuw 0.0599995 RIGHTSH20NP 9.536743E-07 0.06000042 FORMAT "%10.8"
 /begin AXIS_DESCR STD_AXIS vVehSpI_AbsAvgVehSpd_xdu16 VFZHIGH 2 1 150 FORMAT "%8.4" DEPOSIT ABSOLUTE /end AXIS_DESCR
/end CHARACTERISTIC
/begin CHARACTERISTIC xHndOff_HndOffModeEnableTime_XDU16 "Mindestzeit zum Umschalten von einem anderen Status zum Aktivieren" VALUE 0x1509B6 AblGLKWuw 59999 ZU0 1 60000 FORMAT "%8.2" /end CHARACTERISTIC
/begin CHARACTERISTIC xHystDect_MaxTorqueGradientExtendeder_XDU16 "Max gradient extender for learning values." VALUE 0x1509B8 AblGLKWuw 1 RIGHTSH14NP 1 2 FORMAT "%8.6" /end CHARACTERISTIC
/begin CHARACTERISTIC xHystDect_TbtFilterFactor_XDU16 "PT1 filter factor for torsion bar torque" VALUE 0x1509BA AblGLKWuw 0.0150146 RIGHTSH15NP 0 0.01501465 FORMAT "%10.8" /end CHARACTERISTIC
/begin CHARACTERISTIC xHystDect_TbtLdwFilterFactor_XDU16 "PT1 filter factor for torsion bar torque when LDW is active" VALUE 0x1509BC AblGLKWuw 0.0150146 RIGHTSH15NP 0 0.01501465 FORMAT "%10.8" /end CHARACTERISTIC
/begin CHARACTERISTIC xHystTor_DeadZoneStSpeed_XDU16_00___A "Todband Lenkradgeschwindigkeit" VALUE 0x158258 AblGLKWuw 50 SAS_8 0 50 FORMAT "%8.5" /end CHARACTERISTIC
/begin CHARACTERISTIC xHystTor_DeadZoneStSpeed_XDU16_01___A "Todband Lenkradgeschwindigkeit" VALUE 0x15825A AblGLKWuw 50 SAS_8 0 50 FORMAT "%8.5" /end CHARACTERISTIC
/begin CHARACTERISTIC xHystTor_DeadZoneStSpeed_XDU16_02___A "Todband Lenkradgeschwindigkeit" VALUE 0x15825C AblGLKWuw 50 SAS_8 0 50 FORMAT "%8.5" /end CHARACTERISTIC
/begin CHARACTERISTIC xHystTor_DeadZoneStSpeed_XDU16_03___A "Todband Lenkradgeschwindigkeit" VALUE 0x15825E AblGLKWuw 50 SAS_8 0 50 FORMAT "%8.5" /end CHARACTERISTIC
/begin CHARACTERISTIC xHystTor_DeadZoneStSpeed_XDU16_04___A "Todband Lenkradgeschwindigkeit" VALUE 0x158260 AblGLKWuw 50 SAS_8 0 50 FORMAT "%8.5" /end CHARACTERISTIC
/begin CHARACTERISTIC xHystTor_DeadZoneStSpeed_XDU16_05___A "Todband Lenkradgeschwindigkeit" VALUE 0x158262 AblGLKWuw 50 SAS_8 0 50 FORMAT "%8.5" /end CHARACTERISTIC
/begin CHARACTERISTIC xHystTor_DeadZoneStSpeed_XDU16_06___A "Todband Lenkradgeschwindigkeit" VALUE 0x158264 AblGLKWuw 50 SAS_8 0 50 FORMAT "%8.5" /end CHARACTERISTIC
/begin CHARACTERISTIC xHystTor_DeadZoneStSpeed_XDU16_07___A "Todband Lenkradgeschwindigkeit" VALUE 0x158266 AblGLKWuw 50 SAS_8 0 50 FORMAT "%8.5" /end CHARACTERISTIC
/begin CHARACTERISTIC xHystTor_DeadZoneStSpeed_XDU16_08___A "Todband Lenkradgeschwindigkeit" VALUE 0x158268 AblGLKWuw 50 SAS_8 0 50 FORMAT "%8.5" /end CHARACTERISTIC
/begin CHARACTERISTIC xHystTor_DeadZoneStSpeed_XDU16_09___A "Todband Lenkradgeschwindigkeit" VALUE 0x15826A AblGLKWuw 50 SAS_8 0 50 FORMAT "%8.5" /end CHARACTERISTIC
/begin CHARACTERISTIC xHystTor_DeadZoneStSpeed_XDU16_10___A "Todband Lenkradgeschwindigkeit" VALUE 0x15826C AblGLKWuw 50 SAS_8 0 50 FORMAT "%8.5" /end CHARACTERISTIC
/begin CHARACTERISTIC xHystTor_DeadZoneStSpeed_XDU16_11___A "Todband Lenkradgeschwindigkeit" VALUE 0x15826E AblGLKWuw 50 SAS_8 0 50 FORMAT "%8.5" /end CHARACTERISTIC
/begin CHARACTERISTIC xHystTor_DeadZoneStSpeed_XDU16_12___A "Todband Lenkradgeschwindigkeit" VALUE 0x158270 AblGLKWuw 50 SAS_8 0 50 FORMAT "%8.5" /end CHARACTERISTIC
/begin CHARACTERISTIC xHystTor_DeadZoneStSpeed_XDU16_13___A "Todband Lenkradgeschwindigkeit" VALUE 0x158272 AblGLKWuw 50 SAS_8 0 50 FORMAT "%8.5" /end CHARACTERISTIC
/begin CHARACTERISTIC xHystTor_DeadZoneStSpeed_XDU16_14___A "Todband Lenkradgeschwindigkeit" VALUE 0x158274 AblGLKWuw 50 SAS_8 0 50 FORMAT "%8.5" /end CHARACTERISTIC
/begin CHARACTERISTIC xHystTor_DeadZoneStSpeed_XDU16_15___A "Todband Lenkradgeschwindigkeit" VALUE 0x158276 AblGLKWuw 50 SAS_8 0 50 FORMAT "%8.5" /end CHARACTERISTIC
/begin CHARACTERISTIC xHystTor_DeadZoneStSpeed_XDU16_16___A "Todband Lenkradgeschwindigkeit" VALUE 0x158278 AblGLKWuw 50 SAS_8 0 50 FORMAT "%8.5" /end CHARACTERISTIC
/begin CHARACTERISTIC xHystTor_DeadZoneStSpeed_XDU16_17___A "Todband Lenkradgeschwindigkeit" VALUE 0x15827A AblGLKWuw 50 SAS_8 0 50 FORMAT "%8.5" /end CHARACTERISTIC
/begin CHARACTERISTIC xHystTor_DeadZoneStSpeed_XDU16_18___A "Todband Lenkradgeschwindigkeit" VALUE 0x15827C AblGLKWuw 50 SAS_8 0 50 FORMAT "%8.5" /end CHARACTERISTIC
/begin CHARACTERISTIC xHystTor_DeadZoneStSpeed_XDU16_19___A "Todband Lenkradgeschwindigkeit" VALUE 0x15827E AblGLKWuw 50 SAS_8 0 50 FORMAT "%8.5" /end CHARACTERISTIC
/begin CHARACTERISTIC xHystTor_DeadZoneStSpeed_XDU16_20___A "Todband Lenkradgeschwindigkeit" VALUE 0x158280 AblGLKWuw 50 SAS_8 0 50 FORMAT "%8.5" /end CHARACTERISTIC
/begin CHARACTERISTIC xHystTor_DeadZoneStSpeed_XDU16_21___A "Todband Lenkradgeschwindigkeit" VALUE 0x158282 AblGLKWuw 50 SAS_8 0 50 FORMAT "%8.5" /end CHARACTERISTIC
/begin CHARACTERISTIC xHystTor_DeadZoneStSpeed_XDU16_22___A "Todband Lenkradgeschwindigkeit" VALUE 0x158284 AblGLKWuw 50 SAS_8 0 50 FORMAT "%8.5" /end CHARACTERISTIC
/begin CHARACTERISTIC xHystTor_DeadZoneStSpeed_XDU16_23___A "Todband Lenkradgeschwindigkeit" VALUE 0x158286 AblGLKWuw 50 SAS_8 0 50 FORMAT "%8.5" /end CHARACTERISTIC
/begin CHARACTERISTIC xHystTor_DeadZoneStSpeed_XDU16_24___A "Todband Lenkradgeschwindigkeit" VALUE 0x158288 AblGLKWuw 50 SAS_8 0 50 FORMAT "%8.5" /end CHARACTERISTIC
/begin CHARACTERISTIC xHystTor_DeadZoneStSpeed_XDU16_25___A "Todband Lenkradgeschwindigkeit" VALUE 0x15828A AblGLKWuw 50 SAS_8 0 50 FORMAT "%8.5" /end CHARACTERISTIC
/begin CHARACTERISTIC xHystTor_DeadZoneStSpeed_XDU16_26___A "Todband Lenkradgeschwindigkeit" VALUE 0x15828C AblGLKWuw 50 SAS_8 0 50 FORMAT "%8.5" /end CHARACTERISTIC
/begin CHARACTERISTIC xHystTor_DeadZoneStSpeed_XDU16_27___A "Todband Lenkradgeschwindigkeit" VALUE 0x15828E AblGLKWuw 50 SAS_8 0 50 FORMAT "%8.5" /end CHARACTERISTIC
/begin CHARACTERISTIC xHystTor_DeadZoneStSpeed_XDU16_28___A "Todband Lenkradgeschwindigkeit" VALUE 0x158290 AblGLKWuw 50 SAS_8 0 50 FORMAT "%8.5" /end CHARACTERISTIC
/begin CHARACTERISTIC xHystTor_DeadZoneStSpeed_XDU16_29___A "Todband Lenkradgeschwindigkeit" VALUE 0x158292 AblGLKWuw 50 SAS_8 0 50 FORMAT "%8.5" /end CHARACTERISTIC
/begin CHARACTERISTIC xHystTor_DeadZoneStSpeed_XDU16_30___A "Todband Lenkradgeschwindigkeit" VALUE 0x158294 AblGLKWuw 50 SAS_8 0 50 FORMAT "%8.5" /end CHARACTERISTIC
/begin CHARACTERISTIC xHystTor_DeadZoneStSpeed_XDU16_31___A "Todband Lenkradgeschwindigkeit" VALUE 0x158296 AblGLKWuw 50 SAS_8 0 50 FORMAT "%8.5" /end CHARACTERISTIC
/begin CHARACTERISTIC xHystTor_DeadZoneStSpeed_XDU16_32___A "Todband Lenkradgeschwindigkeit" VALUE 0x158298 AblGLKWuw 50 SAS_8 0 50 FORMAT "%8.5" /end CHARACTERISTIC
/begin CHARACTERISTIC xHystTor_DeadZoneStSpeed_XDU16_33___A "Todband Lenkradgeschwindigkeit" VALUE 0x15829A AblGLKWuw 50 SAS_8 0 50 FORMAT "%8.5" /end CHARACTERISTIC
/begin CHARACTERISTIC xHystTor_DeadZoneStSpeed_XDU16_34___A "Todband Lenkradgeschwindigkeit" VALUE 0x15829C AblGLKWuw 50 SAS_8 0 50 FORMAT "%8.5" /end CHARACTERISTIC
/begin CHARACTERISTIC xHystTor_DeadZoneStSpeed_XDU16_35___A "Todband Lenkradgeschwindigkeit" VALUE 0x15829E AblGLKWuw 50 SAS_8 0 50 FORMAT "%8.5" /end CHARACTERISTIC
/begin CHARACTERISTIC xHystTor_FactOfNominalTorque_XDS16 "Faktor für Sollhandmoment der Hysterese" VALUE 0x1509BE AblGLKWsw 2 RIGHTSH10NP -1 1 FORMAT "%8.6" /end CHARACTERISTIC
/begin CHARACTERISTIC xHystTor_HystTorFact_XDU16 "Faktor auf Kennlinie xHystTor_TBTFact_XAU16 für maximales Hysteresemoment " VALUE 0x1509C0 AblGLKWuw 2 RIGHTSH10NP 0 2 FORMAT "%8.6" /end CHARACTERISTIC
/begin CHARACTERISTIC xHystTor_LowPassFilterFact_XDU16 "Zeitkonstante Tiefpass Filter (Wert*1000 entspricht [Hz])" VALUE 0x1509C2 AblGLKWuw 0.999023 RIGHTSH10NP 0.0009765625 1 FORMAT "%8.6" /end CHARACTERISTIC
/begin CHARACTERISTIC xHystTor_StSpeed2TorFact_XDU16_00___A "Verstärkungsfaktor Hysterese [Nms/°]" VALUE 0x1582A0 AblGLKWuw 1 TORFACT 0 1 FORMAT "%8.6" /end CHARACTERISTIC
/begin CHARACTERISTIC xHystTor_StSpeed2TorFact_XDU16_01___A "Verstärkungsfaktor Hysterese [Nms/°]" VALUE 0x1582A2 AblGLKWuw 1 TORFACT 0 1 FORMAT "%8.6" /end CHARACTERISTIC
/begin CHARACTERISTIC xHystTor_StSpeed2TorFact_XDU16_02___A "Verstärkungsfaktor Hysterese [Nms/°]" VALUE 0x1582A4 AblGLKWuw 1 TORFACT 0 1 FORMAT "%8.6" /end CHARACTERISTIC
/begin CHARACTERISTIC xHystTor_StSpeed2TorFact_XDU16_03___A "Verstärkungsfaktor Hysterese [Nms/°]" VALUE 0x1582A6 AblGLKWuw 1 TORFACT 0 1 FORMAT "%8.6" /end CHARACTERISTIC
/begin CHARACTERISTIC xHystTor_StSpeed2TorFact_XDU16_04___A "Verstärkungsfaktor Hysterese [Nms/°]" VALUE 0x1582A8 AblGLKWuw 1 TORFACT 0 1 FORMAT "%8.6" /end CHARACTERISTIC
/begin CHARACTERISTIC xHystTor_StSpeed2TorFact_XDU16_05___A "Verstärkungsfaktor Hysterese [Nms/°]" VALUE 0x1582AA AblGLKWuw 1 TORFACT 0 1 FORMAT "%8.6" /end CHARACTERISTIC
/begin CHARACTERISTIC xHystTor_StSpeed2TorFact_XDU16_06___A "Verstärkungsfaktor Hysterese [Nms/°]" VALUE 0x1582AC AblGLKWuw 1 TORFACT 0 1 FORMAT "%8.6" /end CHARACTERISTIC
/begin CHARACTERISTIC xHystTor_StSpeed2TorFact_XDU16_07___A "Verstärkungsfaktor Hysterese [Nms/°]" VALUE 0x1582AE AblGLKWuw 1 TORFACT 0 1 FORMAT "%8.6" /end CHARACTERISTIC
/begin CHARACTERISTIC xHystTor_StSpeed2TorFact_XDU16_08___A "Verstärkungsfaktor Hysterese [Nms/°]" VALUE 0x1582B0 AblGLKWuw 1 TORFACT 0 1 FORMAT "%8.6" /end CHARACTERISTIC
/begin CHARACTERISTIC xHystTor_StSpeed2TorFact_XDU16_09___A "Verstärkungsfaktor Hysterese [Nms/°]" VALUE 0x1582B2 AblGLKWuw 1 TORFACT 0 1 FORMAT "%8.6" /end CHARACTERISTIC
/begin CHARACTERISTIC xHystTor_StSpeed2TorFact_XDU16_10___A "Verstärkungsfaktor Hysterese [Nms/°]" VALUE 0x1582B4 AblGLKWuw 1 TORFACT 0 1 FORMAT "%8.6" /end CHARACTERISTIC
/begin CHARACTERISTIC xHystTor_StSpeed2TorFact_XDU16_11___A "Verstärkungsfaktor Hysterese [Nms/°]" VALUE 0x1582B6 AblGLKWuw 1 TORFACT 0 1 FORMAT "%8.6" /end CHARACTERISTIC
/begin CHARACTERISTIC xHystTor_StSpeed2TorFact_XDU16_12___A "Verstärkungsfaktor Hysterese [Nms/°]" VALUE 0x1582B8 AblGLKWuw 1 TORFACT 0 1 FORMAT "%8.6" /end CHARACTERISTIC
/begin CHARACTERISTIC xHystTor_StSpeed2TorFact_XDU16_13___A "Verstärkungsfaktor Hysterese [Nms/°]" VALUE 0x1582BA AblGLKWuw 1 TORFACT 0 1 FORMAT "%8.6" /end CHARACTERISTIC
/begin CHARACTERISTIC xHystTor_StSpeed2TorFact_XDU16_14___A "Verstärkungsfaktor Hysterese [Nms/°]" VALUE 0x1582BC AblGLKWuw 1 TORFACT 0 1 FORMAT "%8.6" /end CHARACTERISTIC
/begin CHARACTERISTIC xHystTor_StSpeed2TorFact_XDU16_15___A "Verstärkungsfaktor Hysterese [Nms/°]" VALUE 0x1582BE AblGLKWuw 1 TORFACT 0 1 FORMAT "%8.6" /end CHARACTERISTIC
/begin CHARACTERISTIC xHystTor_StSpeed2TorFact_XDU16_16___A "Verstärkungsfaktor Hysterese [Nms/°]" VALUE 0x1582C0 AblGLKWuw 1 TORFACT 0 1 FORMAT "%8.6" /end CHARACTERISTIC
/begin CHARACTERISTIC xHystTor_StSpeed2TorFact_XDU16_17___A "Verstärkungsfaktor Hysterese [Nms/°]" VALUE 0x1582C2 AblGLKWuw 1 TORFACT 0 1 FORMAT "%8.6" /end CHARACTERISTIC
/begin CHARACTERISTIC xHystTor_StSpeed2TorFact_XDU16_18___A "Verstärkungsfaktor Hysterese [Nms/°]" VALUE 0x1582C4 AblGLKWuw 1 TORFACT 0 1 FORMAT "%8.6" /end CHARACTERISTIC
/begin CHARACTERISTIC xHystTor_StSpeed2TorFact_XDU16_19___A "Verstärkungsfaktor Hysterese [Nms/°]" VALUE 0x1582C6 AblGLKWuw 1 TORFACT 0 1 FORMAT "%8.6" /end CHARACTERISTIC
/begin CHARACTERISTIC xHystTor_StSpeed2TorFact_XDU16_20___A "Verstärkungsfaktor Hysterese [Nms/°]" VALUE 0x1582C8 AblGLKWuw 1 TORFACT 0 1 FORMAT "%8.6" /end CHARACTERISTIC
/begin CHARACTERISTIC xHystTor_StSpeed2TorFact_XDU16_21___A "Verstärkungsfaktor Hysterese [Nms/°]" VALUE 0x1582CA AblGLKWuw 1 TORFACT 0 1 FORMAT "%8.6" /end CHARACTERISTIC
/begin CHARACTERISTIC xHystTor_StSpeed2TorFact_XDU16_22___A "Verstärkungsfaktor Hysterese [Nms/°]" VALUE 0x1582CC AblGLKWuw 1 TORFACT 0 1 FORMAT "%8.6" /end CHARACTERISTIC
/begin CHARACTERISTIC xHystTor_StSpeed2TorFact_XDU16_23___A "Verstärkungsfaktor Hysterese [Nms/°]" VALUE 0x1582CE AblGLKWuw 1 TORFACT 0 1 FORMAT "%8.6" /end CHARACTERISTIC
/begin CHARACTERISTIC xHystTor_StSpeed2TorFact_XDU16_24___A "Verstärkungsfaktor Hysterese [Nms/°]" VALUE 0x1582D0 AblGLKWuw 1 TORFACT 0 1 FORMAT "%8.6" /end CHARACTERISTIC
/begin CHARACTERISTIC xHystTor_StSpeed2TorFact_XDU16_25___A "Verstärkungsfaktor Hysterese [Nms/°]" VALUE 0x1582D2 AblGLKWuw 1 TORFACT 0 1 FORMAT "%8.6" /end CHARACTERISTIC
/begin CHARACTERISTIC xHystTor_StSpeed2TorFact_XDU16_26___A "Verstärkungsfaktor Hysterese [Nms/°]" VALUE 0x1582D4 AblGLKWuw 1 TORFACT 0 1 FORMAT "%8.6" /end CHARACTERISTIC
/begin CHARACTERISTIC xHystTor_StSpeed2TorFact_XDU16_27___A "Verstärkungsfaktor Hysterese [Nms/°]" VALUE 0x1582D6 AblGLKWuw 1 TORFACT 0 1 FORMAT "%8.6" /end CHARACTERISTIC
/begin CHARACTERISTIC xHystTor_StSpeed2TorFact_XDU16_28___A "Verstärkungsfaktor Hysterese [Nms/°]" VALUE 0x1582D8 AblGLKWuw 1 TORFACT 0 1 FORMAT "%8.6" /end CHARACTERISTIC
/begin CHARACTERISTIC xHystTor_StSpeed2TorFact_XDU16_29___A "Verstärkungsfaktor Hysterese [Nms/°]" VALUE 0x1582DA AblGLKWuw 1 TORFACT 0 1 FORMAT "%8.6" /end CHARACTERISTIC
/begin CHARACTERISTIC xHystTor_StSpeed2TorFact_XDU16_30___A "Verstärkungsfaktor Hysterese [Nms/°]" VALUE 0x1582DC AblGLKWuw 1 TORFACT 0 1 FORMAT "%8.6" /end CHARACTERISTIC
/begin CHARACTERISTIC xHystTor_StSpeed2TorFact_XDU16_31___A "Verstärkungsfaktor Hysterese [Nms/°]" VALUE 0x1582DE AblGLKWuw 1 TORFACT 0 1 FORMAT "%8.6" /end CHARACTERISTIC
/begin CHARACTERISTIC xHystTor_StSpeed2TorFact_XDU16_32___A "Verstärkungsfaktor Hysterese [Nms/°]" VALUE 0x1582E0 AblGLKWuw 1 TORFACT 0 1 FORMAT "%8.6" /end CHARACTERISTIC
/begin CHARACTERISTIC xHystTor_StSpeed2TorFact_XDU16_33___A "Verstärkungsfaktor Hysterese [Nms/°]" VALUE 0x1582E2 AblGLKWuw 1 TORFACT 0 1 FORMAT "%8.6" /end CHARACTERISTIC
/begin CHARACTERISTIC xHystTor_StSpeed2TorFact_XDU16_34___A "Verstärkungsfaktor Hysterese [Nms/°]" VALUE 0x1582E4 AblGLKWuw 1 TORFACT 0 1 FORMAT "%8.6" /end CHARACTERISTIC
/begin CHARACTERISTIC xHystTor_StSpeed2TorFact_XDU16_35___A "Verstärkungsfaktor Hysterese [Nms/°]" VALUE 0x1582E6 AblGLKWuw 1 TORFACT 0 1 FORMAT "%8.6" /end CHARACTERISTIC
/begin CHARACTERISTIC xHystTor_TBTFact_XAU16_00___A "Faktor abhängig von Drehstabmoment für maximales Hysteresemoment" CURVE 0x15E01C AblGLKLuw 1 RIGHTSH10NP 0 1 FORMAT "%8.6"
 /begin AXIS_DESCR STD_AXIS mHystTor_TBTFilt_xdu16 TBTHIGH 8 0 25 FORMAT "%8.5" DEPOSIT ABSOLUTE /end AXIS_DESCR
/end CHARACTERISTIC
/begin CHARACTERISTIC xHystTor_TBTFact_XAU16_01___A "Faktor abhängig von Drehstabmoment für maximales Hysteresemoment" CURVE 0x15E040 AblGLKLuw 1 RIGHTSH10NP 0 1 FORMAT "%8.6"
 /begin AXIS_DESCR STD_AXIS mHystTor_TBTFilt_xdu16 TBTHIGH 8 0 25 FORMAT "%8.5" DEPOSIT ABSOLUTE /end AXIS_DESCR
/end CHARACTERISTIC
/begin CHARACTERISTIC xHystTor_TBTFact_XAU16_02___A "Faktor abhängig von Drehstabmoment für maximales Hysteresemoment" CURVE 0x15E064 AblGLKLuw 1 RIGHTSH10NP 0 1 FORMAT "%8.6"
 /begin AXIS_DESCR STD_AXIS mHystTor_TBTFilt_xdu16 TBTHIGH 8 0 25 FORMAT "%8.5" DEPOSIT ABSOLUTE /end AXIS_DESCR
/end CHARACTERISTIC
/begin CHARACTERISTIC xHystTor_TBTFact_XAU16_03___A "Faktor abhängig von Drehstabmoment für maximales Hysteresemoment" CURVE 0x15E088 AblGLKLuw 1 RIGHTSH10NP 0 1 FORMAT "%8.6"
 /begin AXIS_DESCR STD_AXIS mHystTor_TBTFilt_xdu16 TBTHIGH 8 0 25 FORMAT "%8.5" DEPOSIT ABSOLUTE /end AXIS_DESCR
/end CHARACTERISTIC
/begin CHARACTERISTIC xHystTor_TBTFact_XAU16_04___A "Faktor abhängig von Drehstabmoment für maximales Hysteresemoment" CURVE 0x15E0AC AblGLKLuw 1 RIGHTSH10NP 0 1 FORMAT "%8.6"
 /begin AXIS_DESCR STD_AXIS mHystTor_TBTFilt_xdu16 TBTHIGH 8 0 25 FORMAT "%8.5" DEPOSIT ABSOLUTE /end AXIS_DESCR
/end CHARACTERISTIC
/begin CHARACTERISTIC xHystTor_TBTFact_XAU16_05___A "Faktor abhängig von Drehstabmoment für maximales Hysteresemoment" CURVE 0x15E0D0 AblGLKLuw 1 RIGHTSH10NP 0 1 FORMAT "%8.6"
 /begin AXIS_DESCR STD_AXIS mHystTor_TBTFilt_xdu16 TBTHIGH 8 0 25 FORMAT "%8.5" DEPOSIT ABSOLUTE /end AXIS_DESCR
/end CHARACTERISTIC
/begin CHARACTERISTIC xHystTor_TBTFact_XAU16_06___A "Faktor abhängig von Drehstabmoment für maximales Hysteresemoment" CURVE 0x15E0F4 AblGLKLuw 1 RIGHTSH10NP 0 1 FORMAT "%8.6"
 /begin AXIS_DESCR STD_AXIS mHystTor_TBTFilt_xdu16 TBTHIGH 8 0 25 FORMAT "%8.5" DEPOSIT ABSOLUTE /end AXIS_DESCR
/end CHARACTERISTIC
/begin CHARACTERISTIC xHystTor_TBTFact_XAU16_07___A "Faktor abhängig von Drehstabmoment für maximales Hysteresemoment" CURVE 0x15E118 AblGLKLuw 1 RIGHTSH10NP 0 1 FORMAT "%8.6"
 /begin AXIS_DESCR STD_AXIS mHystTor_TBTFilt_xdu16 TBTHIGH 8 0 25 FORMAT "%8.5" DEPOSIT ABSOLUTE /end AXIS_DESCR
/end CHARACTERISTIC
/begin CHARACTERISTIC xHystTor_TBTFact_XAU16_08___A "Faktor abhängig von Drehstabmoment für maximales Hysteresemoment" CURVE 0x15E13C AblGLKLuw 1 RIGHTSH10NP 0 1 FORMAT "%8.6"
 /begin AXIS_DESCR STD_AXIS mHystTor_TBTFilt_xdu16 TBTHIGH 8 0 25 FORMAT "%8.5" DEPOSIT ABSOLUTE /end AXIS_DESCR
/end CHARACTERISTIC
/begin CHARACTERISTIC xHystTor_TBTFact_XAU16_09___A "Faktor abhängig von Drehstabmoment für maximales Hysteresemoment" CURVE 0x15E160 AblGLKLuw 1 RIGHTSH10NP 0 1 FORMAT "%8.6"
 /begin AXIS_DESCR STD_AXIS mHystTor_TBTFilt_xdu16 TBTHIGH 8 0 25 FORMAT "%8.5" DEPOSIT ABSOLUTE /end AXIS_DESCR
/end CHARACTERISTIC
/begin CHARACTERISTIC xHystTor_TBTFact_XAU16_10___A "Faktor abhängig von Drehstabmoment für maximales Hysteresemoment" CURVE 0x15E184 AblGLKLuw 1 RIGHTSH10NP 0 1 FORMAT "%8.6"
 /begin AXIS_DESCR STD_AXIS mHystTor_TBTFilt_xdu16 TBTHIGH 8 0 25 FORMAT "%8.5" DEPOSIT ABSOLUTE /end AXIS_DESCR
/end CHARACTERISTIC
/begin CHARACTERISTIC xHystTor_TBTFact_XAU16_11___A "Faktor abhängig von Drehstabmoment für maximales Hysteresemoment" CURVE 0x15E1A8 AblGLKLuw 1 RIGHTSH10NP 0 1 FORMAT "%8.6"
 /begin AXIS_DESCR STD_AXIS mHystTor_TBTFilt_xdu16 TBTHIGH 8 0 25 FORMAT "%8.5" DEPOSIT ABSOLUTE /end AXIS_DESCR
/end CHARACTERISTIC
/begin CHARACTERISTIC xHystTor_TBTFact_XAU16_12___A "Faktor abhängig von Drehstabmoment für maximales Hysteresemoment" CURVE 0x15E1CC AblGLKLuw 1 RIGHTSH10NP 0 1 FORMAT "%8.6"
 /begin AXIS_DESCR STD_AXIS mHystTor_TBTFilt_xdu16 TBTHIGH 8 0 25 FORMAT "%8.5" DEPOSIT ABSOLUTE /end AXIS_DESCR
/end CHARACTERISTIC
/begin CHARACTERISTIC xHystTor_TBTFact_XAU16_13___A "Faktor abhängig von Drehstabmoment für maximales Hysteresemoment" CURVE 0x15E1F0 AblGLKLuw 1 RIGHTSH10NP 0 1 FORMAT "%8.6"
 /begin AXIS_DESCR STD_AXIS mHystTor_TBTFilt_xdu16 TBTHIGH 8 0 25 FORMAT "%8.5" DEPOSIT ABSOLUTE /end AXIS_DESCR
/end CHARACTERISTIC
/begin CHARACTERISTIC xHystTor_TBTFact_XAU16_14___A "Faktor abhängig von Drehstabmoment für maximales Hysteresemoment" CURVE 0x15E214 AblGLKLuw 1 RIGHTSH10NP 0 1 FORMAT "%8.6"
 /begin AXIS_DESCR STD_AXIS mHystTor_TBTFilt_xdu16 TBTHIGH 8 0 25 FORMAT "%8.5" DEPOSIT ABSOLUTE /end AXIS_DESCR
/end CHARACTERISTIC
/begin CHARACTERISTIC xHystTor_TBTFact_XAU16_15___A "Faktor abhängig von Drehstabmoment für maximales Hysteresemoment" CURVE 0x15E238 AblGLKLuw 1 RIGHTSH10NP 0 1 FORMAT "%8.6"
 /begin AXIS_DESCR STD_AXIS mHystTor_TBTFilt_xdu16 TBTHIGH 8 0 25 FORMAT "%8.5" DEPOSIT ABSOLUTE /end AXIS_DESCR
/end CHARACTERISTIC
/begin CHARACTERISTIC xHystTor_TBTFact_XAU16_16___A "Faktor abhängig von Drehstabmoment für maximales Hysteresemoment" CURVE 0x15E25C AblGLKLuw 1 RIGHTSH10NP 0 1 FORMAT "%8.6"
 /begin AXIS_DESCR STD_AXIS mHystTor_TBTFilt_xdu16 TBTHIGH 8 0 25 FORMAT "%8.5" DEPOSIT ABSOLUTE /end AXIS_DESCR
/end CHARACTERISTIC
/begin CHARACTERISTIC xHystTor_TBTFact_XAU16_17___A "Faktor abhängig von Drehstabmoment für maximales Hysteresemoment" CURVE 0x15E280 AblGLKLuw 1 RIGHTSH10NP 0 1 FORMAT "%8.6"
 /begin AXIS_DESCR STD_AXIS mHystTor_TBTFilt_xdu16 TBTHIGH 8 0 25 FORMAT "%8.5" DEPOSIT ABSOLUTE /end AXIS_DESCR
/end CHARACTERISTIC
/begin CHARACTERISTIC xHystTor_TBTFact_XAU16_18___A "Faktor abhängig von Drehstabmoment für maximales Hysteresemoment" CURVE 0x15E2A4 AblGLKLuw 1 RIGHTSH10NP 0 1 FORMAT "%8.6"
 /begin AXIS_DESCR STD_AXIS mHystTor_TBTFilt_xdu16 TBTHIGH 8 0 25 FORMAT "%8.5" DEPOSIT ABSOLUTE /end AXIS_DESCR
/end CHARACTERISTIC
/begin CHARACTERISTIC xHystTor_TBTFact_XAU16_19___A "Faktor abhängig von Drehstabmoment für maximales Hysteresemoment" CURVE 0x15E2C8 AblGLKLuw 1 RIGHTSH10NP 0 1 FORMAT "%8.6"
 /begin AXIS_DESCR STD_AXIS mHystTor_TBTFilt_xdu16 TBTHIGH 8 0 25 FORMAT "%8.5" DEPOSIT ABSOLUTE /end AXIS_DESCR
/end CHARACTERISTIC
/begin CHARACTERISTIC xHystTor_TBTFact_XAU16_20___A "Faktor abhängig von Drehstabmoment für maximales Hysteresemoment" CURVE 0x15E2EC AblGLKLuw 1 RIGHTSH10NP 0 1 FORMAT "%8.6"
 /begin AXIS_DESCR STD_AXIS mHystTor_TBTFilt_xdu16 TBTHIGH 8 0 25 FORMAT "%8.5" DEPOSIT ABSOLUTE /end AXIS_DESCR
/end CHARACTERISTIC
/begin CHARACTERISTIC xHystTor_TBTFact_XAU16_21___A "Faktor abhängig von Drehstabmoment für maximales Hysteresemoment" CURVE 0x15E310 AblGLKLuw 1 RIGHTSH10NP 0 1 FORMAT "%8.6"
 /begin AXIS_DESCR STD_AXIS mHystTor_TBTFilt_xdu16 TBTHIGH 8 0 25 FORMAT "%8.5" DEPOSIT ABSOLUTE /end AXIS_DESCR
/end CHARACTERISTIC
/begin CHARACTERISTIC xHystTor_TBTFact_XAU16_22___A "Faktor abhängig von Drehstabmoment für maximales Hysteresemoment" CURVE 0x15E334 AblGLKLuw 1 RIGHTSH10NP 0 1 FORMAT "%8.6"
 /begin AXIS_DESCR STD_AXIS mHystTor_TBTFilt_xdu16 TBTHIGH 8 0 25 FORMAT "%8.5" DEPOSIT ABSOLUTE /end AXIS_DESCR
/end CHARACTERISTIC
/begin CHARACTERISTIC xHystTor_TBTFact_XAU16_23___A "Faktor abhängig von Drehstabmoment für maximales Hysteresemoment" CURVE 0x15E358 AblGLKLuw 1 RIGHTSH10NP 0 1 FORMAT "%8.6"
 /begin AXIS_DESCR STD_AXIS mHystTor_TBTFilt_xdu16 TBTHIGH 8 0 25 FORMAT "%8.5" DEPOSIT ABSOLUTE /end AXIS_DESCR
/end CHARACTERISTIC
/begin CHARACTERISTIC xHystTor_TBTFact_XAU16_24___A "Faktor abhängig von Drehstabmoment für maximales Hysteresemoment" CURVE 0x15E37C AblGLKLuw 1 RIGHTSH10NP 0 1 FORMAT "%8.6"
 /begin AXIS_DESCR STD_AXIS mHystTor_TBTFilt_xdu16 TBTHIGH 8 0 25 FORMAT "%8.5" DEPOSIT ABSOLUTE /end AXIS_DESCR
/end CHARACTERISTIC
/begin CHARACTERISTIC xHystTor_TBTFact_XAU16_25___A "Faktor abhängig von Drehstabmoment für maximales Hysteresemoment" CURVE 0x15E3A0 AblGLKLuw 1 RIGHTSH10NP 0 1 FORMAT "%8.6"
 /begin AXIS_DESCR STD_AXIS mHystTor_TBTFilt_xdu16 TBTHIGH 8 0 25 FORMAT "%8.5" DEPOSIT ABSOLUTE /end AXIS_DESCR
/end CHARACTERISTIC
/begin CHARACTERISTIC xHystTor_TBTFact_XAU16_26___A "Faktor abhängig von Drehstabmoment für maximales Hysteresemoment" CURVE 0x15E3C4 AblGLKLuw 1 RIGHTSH10NP 0 1 FORMAT "%8.6"
 /begin AXIS_DESCR STD_AXIS mHystTor_TBTFilt_xdu16 TBTHIGH 8 0 25 FORMAT "%8.5" DEPOSIT ABSOLUTE /end AXIS_DESCR
/end CHARACTERISTIC
/begin CHARACTERISTIC xHystTor_TBTFact_XAU16_27___A "Faktor abhängig von Drehstabmoment für maximales Hysteresemoment" CURVE 0x15E3E8 AblGLKLuw 1 RIGHTSH10NP 0 1 FORMAT "%8.6"
 /begin AXIS_DESCR STD_AXIS mHystTor_TBTFilt_xdu16 TBTHIGH 8 0 25 FORMAT "%8.5" DEPOSIT ABSOLUTE /end AXIS_DESCR
/end CHARACTERISTIC
/begin CHARACTERISTIC xHystTor_TBTFact_XAU16_28___A "Faktor abhängig von Drehstabmoment für maximales Hysteresemoment" CURVE 0x15E40C AblGLKLuw 1 RIGHTSH10NP 0 1 FORMAT "%8.6"
 /begin AXIS_DESCR STD_AXIS mHystTor_TBTFilt_xdu16 TBTHIGH 8 0 25 FORMAT "%8.5" DEPOSIT ABSOLUTE /end AXIS_DESCR
/end CHARACTERISTIC
/begin CHARACTERISTIC xHystTor_TBTFact_XAU16_29___A "Faktor abhängig von Drehstabmoment für maximales Hysteresemoment" CURVE 0x15E430 AblGLKLuw 1 RIGHTSH10NP 0 1 FORMAT "%8.6"
 /begin AXIS_DESCR STD_AXIS mHystTor_TBTFilt_xdu16 TBTHIGH 8 0 25 FORMAT "%8.5" DEPOSIT ABSOLUTE /end AXIS_DESCR
/end CHARACTERISTIC
/begin CHARACTERISTIC xHystTor_TBTFact_XAU16_30___A "Faktor abhängig von Drehstabmoment für maximales Hysteresemoment" CURVE 0x15E454 AblGLKLuw 1 RIGHTSH10NP 0 1 FORMAT "%8.6"
 /begin AXIS_DESCR STD_AXIS mHystTor_TBTFilt_xdu16 TBTHIGH 8 0 25 FORMAT "%8.5" DEPOSIT ABSOLUTE /end AXIS_DESCR
/end CHARACTERISTIC
/begin CHARACTERISTIC xHystTor_TBTFact_XAU16_31___A "Faktor abhängig von Drehstabmoment für maximales Hysteresemoment" CURVE 0x15E478 AblGLKLuw 1 RIGHTSH10NP 0 1 FORMAT "%8.6"
 /begin AXIS_DESCR STD_AXIS mHystTor_TBTFilt_xdu16 TBTHIGH 8 0 25 FORMAT "%8.5" DEPOSIT ABSOLUTE /end AXIS_DESCR
/end CHARACTERISTIC
/begin CHARACTERISTIC xHystTor_TBTFact_XAU16_32___A "Faktor abhängig von Drehstabmoment für maximales Hysteresemoment" CURVE 0x15E49C AblGLKLuw 1 RIGHTSH10NP 0 1 FORMAT "%8.6"
 /begin AXIS_DESCR STD_AXIS mHystTor_TBTFilt_xdu16 TBTHIGH 8 0 25 FORMAT "%8.5" DEPOSIT ABSOLUTE /end AXIS_DESCR
/end CHARACTERISTIC
/begin CHARACTERISTIC xHystTor_TBTFact_XAU16_33___A "Faktor abhängig von Drehstabmoment für maximales Hysteresemoment" CURVE 0x15E4C0 AblGLKLuw 1 RIGHTSH10NP 0 1 FORMAT "%8.6"
 /begin AXIS_DESCR STD_AXIS mHystTor_TBTFilt_xdu16 TBTHIGH 8 0 25 FORMAT "%8.5" DEPOSIT ABSOLUTE /end AXIS_DESCR
/end CHARACTERISTIC
/begin CHARACTERISTIC xHystTor_TBTFact_XAU16_34___A "Faktor abhängig von Drehstabmoment für maximales Hysteresemoment" CURVE 0x15E4E4 AblGLKLuw 1 RIGHTSH10NP 0 1 FORMAT "%8.6"
 /begin AXIS_DESCR STD_AXIS mHystTor_TBTFilt_xdu16 TBTHIGH 8 0 25 FORMAT "%8.5" DEPOSIT ABSOLUTE /end AXIS_DESCR
/end CHARACTERISTIC
/begin CHARACTERISTIC xHystTor_TBTFact_XAU16_35___A "Faktor abhängig von Drehstabmoment für maximales Hysteresemoment" CURVE 0x15E508 AblGLKLuw 1 RIGHTSH10NP 0 1 FORMAT "%8.6"
 /begin AXIS_DESCR STD_AXIS mHystTor_TBTFilt_xdu16 TBTHIGH 8 0 25 FORMAT "%8.5" DEPOSIT ABSOLUTE /end AXIS_DESCR
/end CHARACTERISTIC
/begin CHARACTERISTIC xHystTor_TBTFilterFact_XDU16 "Filterfaktor für das Drehstabmoment" VALUE 0x1509C4 AblGLKWuw 0.998993 RIGHTSH15NP 0.00100708 1 FORMAT "%8.6" /end CHARACTERISTIC
/begin CHARACTERISTIC xHystTor_VehicleFact_XAU16_00___A "Faktor abhängig von Fahrzeuggeschwindigkeit für Hysteresemoment" CURVE 0x15E52C AblGLKLuw 1.20019 TBTHIGH 0 1.200195 FORMAT "%8.6"
 /begin AXIS_DESCR STD_AXIS vApplI_AbsVehicleSpeedFilt_xdu16 VFZHIGH 6 0 500 FORMAT "%8.4" DEPOSIT ABSOLUTE /end AXIS_DESCR
/end CHARACTERISTIC
/begin CHARACTERISTIC xHystTor_VehicleFact_XAU16_01___A "Faktor abhängig von Fahrzeuggeschwindigkeit für Hysteresemoment" CURVE 0x15E548 AblGLKLuw 1.20019 TBTHIGH 0 1.200195 FORMAT "%8.6"
 /begin AXIS_DESCR STD_AXIS vApplI_AbsVehicleSpeedFilt_xdu16 VFZHIGH 6 0 500 FORMAT "%8.4" DEPOSIT ABSOLUTE /end AXIS_DESCR
/end CHARACTERISTIC
/begin CHARACTERISTIC xHystTor_VehicleFact_XAU16_02___A "Faktor abhängig von Fahrzeuggeschwindigkeit für Hysteresemoment" CURVE 0x15E564 AblGLKLuw 1.20019 TBTHIGH 0 1.200195 FORMAT "%8.6"
 /begin AXIS_DESCR STD_AXIS vApplI_AbsVehicleSpeedFilt_xdu16 VFZHIGH 6 0 500 FORMAT "%8.4" DEPOSIT ABSOLUTE /end AXIS_DESCR
/end CHARACTERISTIC
/begin CHARACTERISTIC xHystTor_VehicleFact_XAU16_03___A "Faktor abhängig von Fahrzeuggeschwindigkeit für Hysteresemoment" CURVE 0x15E580 AblGLKLuw 1.20019 TBTHIGH 0 1.200195 FORMAT "%8.6"
 /begin AXIS_DESCR STD_AXIS vApplI_AbsVehicleSpeedFilt_xdu16 VFZHIGH 6 0 500 FORMAT "%8.4" DEPOSIT ABSOLUTE /end AXIS_DESCR
/end CHARACTERISTIC
/begin CHARACTERISTIC xHystTor_VehicleFact_XAU16_04___A "Faktor abhängig von Fahrzeuggeschwindigkeit für Hysteresemoment" CURVE 0x15E59C AblGLKLuw 1.20019 TBTHIGH 0 1.200195 FORMAT "%8.6"
 /begin AXIS_DESCR STD_AXIS vApplI_AbsVehicleSpeedFilt_xdu16 VFZHIGH 6 0 500 FORMAT "%8.4" DEPOSIT ABSOLUTE /end AXIS_DESCR
/end CHARACTERISTIC
/begin CHARACTERISTIC xHystTor_VehicleFact_XAU16_05___A "Faktor abhängig von Fahrzeuggeschwindigkeit für Hysteresemoment" CURVE 0x15E5B8 AblGLKLuw 1.20019 TBTHIGH 0 1.200195 FORMAT "%8.6"
 /begin AXIS_DESCR STD_AXIS vApplI_AbsVehicleSpeedFilt_xdu16 VFZHIGH 6 0 500 FORMAT "%8.4" DEPOSIT ABSOLUTE /end AXIS_DESCR
/end CHARACTERISTIC
/begin CHARACTERISTIC xHystTor_VehicleFact_XAU16_06___A "Faktor abhängig von Fahrzeuggeschwindigkeit für Hysteresemoment" CURVE 0x15E5D4 AblGLKLuw 1.20019 TBTHIGH 0 1.200195 FORMAT "%8.6"
 /begin AXIS_DESCR STD_AXIS vApplI_AbsVehicleSpeedFilt_xdu16 VFZHIGH 6 0 500 FORMAT "%8.4" DEPOSIT ABSOLUTE /end AXIS_DESCR
/end CHARACTERISTIC
/begin CHARACTERISTIC xHystTor_VehicleFact_XAU16_07___A "Faktor abhängig von Fahrzeuggeschwindigkeit für Hysteresemoment" CURVE 0x15E5F0 AblGLKLuw 1.20019 TBTHIGH 0 1.200195 FORMAT "%8.6"
 /begin AXIS_DESCR STD_AXIS vApplI_AbsVehicleSpeedFilt_xdu16 VFZHIGH 6 0 500 FORMAT "%8.4" DEPOSIT ABSOLUTE /end AXIS_DESCR
/end CHARACTERISTIC
/begin CHARACTERISTIC xHystTor_VehicleFact_XAU16_08___A "Faktor abhängig von Fahrzeuggeschwindigkeit für Hysteresemoment" CURVE 0x15E60C AblGLKLuw 1.20019 TBTHIGH 0 1.200195 FORMAT "%8.6"
 /begin AXIS_DESCR STD_AXIS vApplI_AbsVehicleSpeedFilt_xdu16 VFZHIGH 6 0 500 FORMAT "%8.4" DEPOSIT ABSOLUTE /end AXIS_DESCR
/end CHARACTERISTIC
/begin CHARACTERISTIC xHystTor_VehicleFact_XAU16_09___A "Faktor abhängig von Fahrzeuggeschwindigkeit für Hysteresemoment" CURVE 0x15E628 AblGLKLuw 1.20019 TBTHIGH 0 1.200195 FORMAT "%8.6"
 /begin AXIS_DESCR STD_AXIS vApplI_AbsVehicleSpeedFilt_xdu16 VFZHIGH 6 0 500 FORMAT "%8.4" DEPOSIT ABSOLUTE /end AXIS_DESCR
/end CHARACTERISTIC
/begin CHARACTERISTIC xHystTor_VehicleFact_XAU16_10___A "Faktor abhängig von Fahrzeuggeschwindigkeit für Hysteresemoment" CURVE 0x15E644 AblGLKLuw 1.20019 TBTHIGH 0 1.200195 FORMAT "%8.6"
 /begin AXIS_DESCR STD_AXIS vApplI_AbsVehicleSpeedFilt_xdu16 VFZHIGH 6 0 500 FORMAT "%8.4" DEPOSIT ABSOLUTE /end AXIS_DESCR
/end CHARACTERISTIC
/begin CHARACTERISTIC xHystTor_VehicleFact_XAU16_11___A "Faktor abhängig von Fahrzeuggeschwindigkeit für Hysteresemoment" CURVE 0x15E660 AblGLKLuw 1.20019 TBTHIGH 0 1.200195 FORMAT "%8.6"
 /begin AXIS_DESCR STD_AXIS vApplI_AbsVehicleSpeedFilt_xdu16 VFZHIGH 6 0 500 FORMAT "%8.4" DEPOSIT ABSOLUTE /end AXIS_DESCR
/end CHARACTERISTIC
/begin CHARACTERISTIC xHystTor_VehicleFact_XAU16_12___A "Faktor abhängig von Fahrzeuggeschwindigkeit für Hysteresemoment" CURVE 0x15E67C AblGLKLuw 1.20019 TBTHIGH 0 1.200195 FORMAT "%8.6"
 /begin AXIS_DESCR STD_AXIS vApplI_AbsVehicleSpeedFilt_xdu16 VFZHIGH 6 0 500 FORMAT "%8.4" DEPOSIT ABSOLUTE /end AXIS_DESCR
/end CHARACTERISTIC
/begin CHARACTERISTIC xHystTor_VehicleFact_XAU16_13___A "Faktor abhängig von Fahrzeuggeschwindigkeit für Hysteresemoment" CURVE 0x15E698 AblGLKLuw 1.20019 TBTHIGH 0 1.200195 FORMAT "%8.6"
 /begin AXIS_DESCR STD_AXIS vApplI_AbsVehicleSpeedFilt_xdu16 VFZHIGH 6 0 500 FORMAT "%8.4" DEPOSIT ABSOLUTE /end AXIS_DESCR
/end CHARACTERISTIC
/begin CHARACTERISTIC xHystTor_VehicleFact_XAU16_14___A "Faktor abhängig von Fahrzeuggeschwindigkeit für Hysteresemoment" CURVE 0x15E6B4 AblGLKLuw 1.20019 TBTHIGH 0 1.200195 FORMAT "%8.6"
 /begin AXIS_DESCR STD_AXIS vApplI_AbsVehicleSpeedFilt_xdu16 VFZHIGH 6 0 500 FORMAT "%8.4" DEPOSIT ABSOLUTE /end AXIS_DESCR
/end CHARACTERISTIC
/begin CHARACTERISTIC xHystTor_VehicleFact_XAU16_15___A "Faktor abhängig von Fahrzeuggeschwindigkeit für Hysteresemoment" CURVE 0x15E6D0 AblGLKLuw 1.20019 TBTHIGH 0 1.200195 FORMAT "%8.6"
 /begin AXIS_DESCR STD_AXIS vApplI_AbsVehicleSpeedFilt_xdu16 VFZHIGH 6 0 500 FORMAT "%8.4" DEPOSIT ABSOLUTE /end AXIS_DESCR
/end CHARACTERISTIC
/begin CHARACTERISTIC xHystTor_VehicleFact_XAU16_16___A "Faktor abhängig von Fahrzeuggeschwindigkeit für Hysteresemoment" CURVE 0x15E6EC AblGLKLuw 1.20019 TBTHIGH 0 1.200195 FORMAT "%8.6"
 /begin AXIS_DESCR STD_AXIS vApplI_AbsVehicleSpeedFilt_xdu16 VFZHIGH 6 0 500 FORMAT "%8.4" DEPOSIT ABSOLUTE /end AXIS_DESCR
/end CHARACTERISTIC
/begin CHARACTERISTIC xHystTor_VehicleFact_XAU16_17___A "Faktor abhängig von Fahrzeuggeschwindigkeit für Hysteresemoment" CURVE 0x15E708 AblGLKLuw 1.20019 TBTHIGH 0 1.200195 FORMAT "%8.6"
 /begin AXIS_DESCR STD_AXIS vApplI_AbsVehicleSpeedFilt_xdu16 VFZHIGH 6 0 500 FORMAT "%8.4" DEPOSIT ABSOLUTE /end AXIS_DESCR
/end CHARACTERISTIC
/begin CHARACTERISTIC xHystTor_VehicleFact_XAU16_18___A "Faktor abhängig von Fahrzeuggeschwindigkeit für Hysteresemoment" CURVE 0x15E724 AblGLKLuw 1.20019 TBTHIGH 0 1.200195 FORMAT "%8.6"
 /begin AXIS_DESCR STD_AXIS vApplI_AbsVehicleSpeedFilt_xdu16 VFZHIGH 6 0 500 FORMAT "%8.4" DEPOSIT ABSOLUTE /end AXIS_DESCR
/end CHARACTERISTIC
/begin CHARACTERISTIC xHystTor_VehicleFact_XAU16_19___A "Faktor abhängig von Fahrzeuggeschwindigkeit für Hysteresemoment" CURVE 0x15E740 AblGLKLuw 1.20019 TBTHIGH 0 1.200195 FORMAT "%8.6"
 /begin AXIS_DESCR STD_AXIS vApplI_AbsVehicleSpeedFilt_xdu16 VFZHIGH 6 0 500 FORMAT "%8.4" DEPOSIT ABSOLUTE /end AXIS_DESCR
/end CHARACTERISTIC
/begin CHARACTERISTIC xHystTor_VehicleFact_XAU16_20___A "Faktor abhängig von Fahrzeuggeschwindigkeit für Hysteresemoment" CURVE 0x15E75C AblGLKLuw 1.20019 TBTHIGH 0 1.200195 FORMAT "%8.6"
 /begin AXIS_DESCR STD_AXIS vApplI_AbsVehicleSpeedFilt_xdu16 VFZHIGH 6 0 500 FORMAT "%8.4" DEPOSIT ABSOLUTE /end AXIS_DESCR
/end CHARACTERISTIC
/begin CHARACTERISTIC xHystTor_VehicleFact_XAU16_21___A "Faktor abhängig von Fahrzeuggeschwindigkeit für Hysteresemoment" CURVE 0x15E778 AblGLKLuw 1.20019 TBTHIGH 0 1.200195 FORMAT "%8.6"
 /begin AXIS_DESCR STD_AXIS vApplI_AbsVehicleSpeedFilt_xdu16 VFZHIGH 6 0 500 FORMAT "%8.4" DEPOSIT ABSOLUTE /end AXIS_DESCR
/end CHARACTERISTIC
/begin CHARACTERISTIC xHystTor_VehicleFact_XAU16_22___A "Faktor abhängig von Fahrzeuggeschwindigkeit für Hysteresemoment" CURVE 0x15E794 AblGLKLuw 1.20019 TBTHIGH 0 1.200195 FORMAT "%8.6"
 /begin AXIS_DESCR STD_AXIS vApplI_AbsVehicleSpeedFilt_xdu16 VFZHIGH 6 0 500 FORMAT "%8.4" DEPOSIT ABSOLUTE /end AXIS_DESCR
/end CHARACTERISTIC
/begin CHARACTERISTIC xHystTor_VehicleFact_XAU16_23___A "Faktor abhängig von Fahrzeuggeschwindigkeit für Hysteresemoment" CURVE 0x15E7B0 AblGLKLuw 1.20019 TBTHIGH 0 1.200195 FORMAT "%8.6"
 /begin AXIS_DESCR STD_AXIS vApplI_AbsVehicleSpeedFilt_xdu16 VFZHIGH 6 0 500 FORMAT "%8.4" DEPOSIT ABSOLUTE /end AXIS_DESCR
/end CHARACTERISTIC
/begin CHARACTERISTIC xHystTor_VehicleFact_XAU16_24___A "Faktor abhängig von Fahrzeuggeschwindigkeit für Hysteresemoment" CURVE 0x15E7CC AblGLKLuw 1.20019 TBTHIGH 0 1.200195 FORMAT "%8.6"
 /begin AXIS_DESCR STD_AXIS vApplI_AbsVehicleSpeedFilt_xdu16 VFZHIGH 6 0 500 FORMAT "%8.4" DEPOSIT ABSOLUTE /end AXIS_DESCR
/end CHARACTERISTIC
/begin CHARACTERISTIC xHystTor_VehicleFact_XAU16_25___A "Faktor abhängig von Fahrzeuggeschwindigkeit für Hysteresemoment" CURVE 0x15E7E8 AblGLKLuw 1.20019 TBTHIGH 0 1.200195 FORMAT "%8.6"
 /begin AXIS_DESCR STD_AXIS vApplI_AbsVehicleSpeedFilt_xdu16 VFZHIGH 6 0 500 FORMAT "%8.4" DEPOSIT ABSOLUTE /end AXIS_DESCR
/end CHARACTERISTIC
/begin CHARACTERISTIC xHystTor_VehicleFact_XAU16_26___A "Faktor abhängig von Fahrzeuggeschwindigkeit für Hysteresemoment" CURVE 0x15E804 AblGLKLuw 1.20019 TBTHIGH 0 1.200195 FORMAT "%8.6"
 /begin AXIS_DESCR STD_AXIS vApplI_AbsVehicleSpeedFilt_xdu16 VFZHIGH 6 0 500 FORMAT "%8.4" DEPOSIT ABSOLUTE /end AXIS_DESCR
/end CHARACTERISTIC
/begin CHARACTERISTIC xHystTor_VehicleFact_XAU16_27___A "Faktor abhängig von Fahrzeuggeschwindigkeit für Hysteresemoment" CURVE 0x15E820 AblGLKLuw 1.20019 TBTHIGH 0 1.200195 FORMAT "%8.6"
 /begin AXIS_DESCR STD_AXIS vApplI_AbsVehicleSpeedFilt_xdu16 VFZHIGH 6 0 500 FORMAT "%8.4" DEPOSIT ABSOLUTE /end AXIS_DESCR
/end CHARACTERISTIC
/begin CHARACTERISTIC xHystTor_VehicleFact_XAU16_28___A "Faktor abhängig von Fahrzeuggeschwindigkeit für Hysteresemoment" CURVE 0x15E83C AblGLKLuw 1.20019 TBTHIGH 0 1.200195 FORMAT "%8.6"
 /begin AXIS_DESCR STD_AXIS vApplI_AbsVehicleSpeedFilt_xdu16 VFZHIGH 6 0 500 FORMAT "%8.4" DEPOSIT ABSOLUTE /end AXIS_DESCR
/end CHARACTERISTIC
/begin CHARACTERISTIC xHystTor_VehicleFact_XAU16_29___A "Faktor abhängig von Fahrzeuggeschwindigkeit für Hysteresemoment" CURVE 0x15E858 AblGLKLuw 1.20019 TBTHIGH 0 1.200195 FORMAT "%8.6"
 /begin AXIS_DESCR STD_AXIS vApplI_AbsVehicleSpeedFilt_xdu16 VFZHIGH 6 0 500 FORMAT "%8.4" DEPOSIT ABSOLUTE /end AXIS_DESCR
/end CHARACTERISTIC
/begin CHARACTERISTIC xHystTor_VehicleFact_XAU16_30___A "Faktor abhängig von Fahrzeuggeschwindigkeit für Hysteresemoment" CURVE 0x15E874 AblGLKLuw 1.20019 TBTHIGH 0 1.200195 FORMAT "%8.6"
 /begin AXIS_DESCR STD_AXIS vApplI_AbsVehicleSpeedFilt_xdu16 VFZHIGH 6 0 500 FORMAT "%8.4" DEPOSIT ABSOLUTE /end AXIS_DESCR
/end CHARACTERISTIC
/begin CHARACTERISTIC xHystTor_VehicleFact_XAU16_31___A "Faktor abhängig von Fahrzeuggeschwindigkeit für Hysteresemoment" CURVE 0x15E890 AblGLKLuw 1.20019 TBTHIGH 0 1.200195 FORMAT "%8.6"
 /begin AXIS_DESCR STD_AXIS vApplI_AbsVehicleSpeedFilt_xdu16 VFZHIGH 6 0 500 FORMAT "%8.4" DEPOSIT ABSOLUTE /end AXIS_DESCR
/end CHARACTERISTIC
/begin CHARACTERISTIC xHystTor_VehicleFact_XAU16_32___A "Faktor abhängig von Fahrzeuggeschwindigkeit für Hysteresemoment" CURVE 0x15E8AC AblGLKLuw 1.20019 TBTHIGH 0 1.200195 FORMAT "%8.6"
 /begin AXIS_DESCR STD_AXIS vApplI_AbsVehicleSpeedFilt_xdu16 VFZHIGH 6 0 500 FORMAT "%8.4" DEPOSIT ABSOLUTE /end AXIS_DESCR
/end CHARACTERISTIC
/begin CHARACTERISTIC xHystTor_VehicleFact_XAU16_33___A "Faktor abhängig von Fahrzeuggeschwindigkeit für Hysteresemoment" CURVE 0x15E8C8 AblGLKLuw 1.20019 TBTHIGH 0 1.200195 FORMAT "%8.6"
 /begin AXIS_DESCR STD_AXIS vApplI_AbsVehicleSpeedFilt_xdu16 VFZHIGH 6 0 500 FORMAT "%8.4" DEPOSIT ABSOLUTE /end AXIS_DESCR
/end CHARACTERISTIC
/begin CHARACTERISTIC xHystTor_VehicleFact_XAU16_34___A "Faktor abhängig von Fahrzeuggeschwindigkeit für Hysteresemoment" CURVE 0x15E8E4 AblGLKLuw 1.20019 TBTHIGH 0 1.200195 FORMAT "%8.6"
 /begin AXIS_DESCR STD_AXIS vApplI_AbsVehicleSpeedFilt_xdu16 VFZHIGH 6 0 500 FORMAT "%8.4" DEPOSIT ABSOLUTE /end AXIS_DESCR
/end CHARACTERISTIC
/begin CHARACTERISTIC xHystTor_VehicleFact_XAU16_35___A "Faktor abhängig von Fahrzeuggeschwindigkeit für Hysteresemoment" CURVE 0x15E900 AblGLKLuw 1.20019 TBTHIGH 0 1.200195 FORMAT "%8.6"
 /begin AXIS_DESCR STD_AXIS vApplI_AbsVehicleSpeedFilt_xdu16 VFZHIGH 6 0 500 FORMAT "%8.4" DEPOSIT ABSOLUTE /end AXIS_DESCR
/end CHARACTERISTIC
/begin CHARACTERISTIC xInCo_ChatterRotAccFactor_XAS16 "Trägheitsmomentfaktor abhängig von der Fahrzeuggeschwindigkeit, wenn Umschaltgrenze -zInCo_ChatterCountLimitInertia_XDU8- ueberschritten" CURVE 0x1517A0 AblGLKLsw 3.99994 INERTOR_HIGH -2 1.999939 FORMAT "%8.6"
 /begin AXIS_DESCR STD_AXIS vInCo_AbsAvgVehSpd_xdu16 VFZHIGH 5 0 500 FORMAT "%8.4" DEPOSIT ABSOLUTE /end AXIS_DESCR
/end CHARACTERISTIC
/begin CHARACTERISTIC xInCo_InvalidInputSigRotAccFactor_XDS16 "Traegheitsmomentfaktor, wenn Eingangssignale ungueltig" VALUE 0x1509C6 AblGLKWsw 3.99994 INERTOR_HIGH -2 1.999939 FORMAT "%8.6" /end CHARACTERISTIC
/begin CHARACTERISTIC xInCo_RotAccFactor_XAS16_00___A "Trägheitsmomentfaktor abhängig von der Fahrzeuggeschwindigkeit" CURVE 0x15E91C AblGLKLsw 3.99994 INERTOR_HIGH -2 1.999939 FORMAT "%8.6"
 /begin AXIS_DESCR STD_AXIS vInCo_AbsAvgVehSpd_xdu16 VFZHIGH 5 0 500 FORMAT "%8.4" DEPOSIT ABSOLUTE /end AXIS_DESCR
/end CHARACTERISTIC
/begin CHARACTERISTIC xInCo_RotAccFactor_XAS16_01___A "Trägheitsmomentfaktor abhängig von der Fahrzeuggeschwindigkeit" CURVE 0x15E934 AblGLKLsw 3.99994 INERTOR_HIGH -2 1.999939 FORMAT "%8.6"
 /begin AXIS_DESCR STD_AXIS vInCo_AbsAvgVehSpd_xdu16 VFZHIGH 5 0 500 FORMAT "%8.4" DEPOSIT ABSOLUTE /end AXIS_DESCR
/end CHARACTERISTIC
/begin CHARACTERISTIC xInCo_RotAccFactor_XAS16_02___A "Trägheitsmomentfaktor abhängig von der Fahrzeuggeschwindigkeit" CURVE 0x15E94C AblGLKLsw 3.99994 INERTOR_HIGH -2 1.999939 FORMAT "%8.6"
 /begin AXIS_DESCR STD_AXIS vInCo_AbsAvgVehSpd_xdu16 VFZHIGH 5 0 500 FORMAT "%8.4" DEPOSIT ABSOLUTE /end AXIS_DESCR
/end CHARACTERISTIC
/begin CHARACTERISTIC xInCo_RotAccFactor_XAS16_03___A "Trägheitsmomentfaktor abhängig von der Fahrzeuggeschwindigkeit" CURVE 0x15E964 AblGLKLsw 3.99994 INERTOR_HIGH -2 1.999939 FORMAT "%8.6"
 /begin AXIS_DESCR STD_AXIS vInCo_AbsAvgVehSpd_xdu16 VFZHIGH 5 0 500 FORMAT "%8.4" DEPOSIT ABSOLUTE /end AXIS_DESCR
/end CHARACTERISTIC
/begin CHARACTERISTIC xInCo_RotAccFactor_XAS16_04___A "Trägheitsmomentfaktor abhängig von der Fahrzeuggeschwindigkeit" CURVE 0x15E97C AblGLKLsw 3.99994 INERTOR_HIGH -2 1.999939 FORMAT "%8.6"
 /begin AXIS_DESCR STD_AXIS vInCo_AbsAvgVehSpd_xdu16 VFZHIGH 5 0 500 FORMAT "%8.4" DEPOSIT ABSOLUTE /end AXIS_DESCR
/end CHARACTERISTIC
/begin CHARACTERISTIC xInCo_RotAccFactor_XAS16_05___A "Trägheitsmomentfaktor abhängig von der Fahrzeuggeschwindigkeit" CURVE 0x15E994 AblGLKLsw 3.99994 INERTOR_HIGH -2 1.999939 FORMAT "%8.6"
 /begin AXIS_DESCR STD_AXIS vInCo_AbsAvgVehSpd_xdu16 VFZHIGH 5 0 500 FORMAT "%8.4" DEPOSIT ABSOLUTE /end AXIS_DESCR
/end CHARACTERISTIC
/begin CHARACTERISTIC xInCo_RotAccFactor_XAS16_06___A "Trägheitsmomentfaktor abhängig von der Fahrzeuggeschwindigkeit" CURVE 0x15E9AC AblGLKLsw 3.99994 INERTOR_HIGH -2 1.999939 FORMAT "%8.6"
 /begin AXIS_DESCR STD_AXIS vInCo_AbsAvgVehSpd_xdu16 VFZHIGH 5 0 500 FORMAT "%8.4" DEPOSIT ABSOLUTE /end AXIS_DESCR
/end CHARACTERISTIC
/begin CHARACTERISTIC xInCo_RotAccFactor_XAS16_07___A "Trägheitsmomentfaktor abhängig von der Fahrzeuggeschwindigkeit" CURVE 0x15E9C4 AblGLKLsw 3.99994 INERTOR_HIGH -2 1.999939 FORMAT "%8.6"
 /begin AXIS_DESCR STD_AXIS vInCo_AbsAvgVehSpd_xdu16 VFZHIGH 5 0 500 FORMAT "%8.4" DEPOSIT ABSOLUTE /end AXIS_DESCR
/end CHARACTERISTIC
/begin CHARACTERISTIC xInCo_RotAccFactor_XAS16_08___A "Trägheitsmomentfaktor abhängig von der Fahrzeuggeschwindigkeit" CURVE 0x15E9DC AblGLKLsw 3.99994 INERTOR_HIGH -2 1.999939 FORMAT "%8.6"
 /begin AXIS_DESCR STD_AXIS vInCo_AbsAvgVehSpd_xdu16 VFZHIGH 5 0 500 FORMAT "%8.4" DEPOSIT ABSOLUTE /end AXIS_DESCR
/end CHARACTERISTIC
/begin CHARACTERISTIC xInCo_RotAccFactor_XAS16_09___A "Trägheitsmomentfaktor abhängig von der Fahrzeuggeschwindigkeit" CURVE 0x15E9F4 AblGLKLsw 3.99994 INERTOR_HIGH -2 1.999939 FORMAT "%8.6"
 /begin AXIS_DESCR STD_AXIS vInCo_AbsAvgVehSpd_xdu16 VFZHIGH 5 0 500 FORMAT "%8.4" DEPOSIT ABSOLUTE /end AXIS_DESCR
/end CHARACTERISTIC
/begin CHARACTERISTIC xInCo_RotAccFactor_XAS16_10___A "Trägheitsmomentfaktor abhängig von der Fahrzeuggeschwindigkeit" CURVE 0x15EA0C AblGLKLsw 3.99994 INERTOR_HIGH -2 1.999939 FORMAT "%8.6"
 /begin AXIS_DESCR STD_AXIS vInCo_AbsAvgVehSpd_xdu16 VFZHIGH 5 0 500 FORMAT "%8.4" DEPOSIT ABSOLUTE /end AXIS_DESCR
/end CHARACTERISTIC
/begin CHARACTERISTIC xInCo_RotAccFactor_XAS16_11___A "Trägheitsmomentfaktor abhängig von der Fahrzeuggeschwindigkeit" CURVE 0x15EA24 AblGLKLsw 3.99994 INERTOR_HIGH -2 1.999939 FORMAT "%8.6"
 /begin AXIS_DESCR STD_AXIS vInCo_AbsAvgVehSpd_xdu16 VFZHIGH 5 0 500 FORMAT "%8.4" DEPOSIT ABSOLUTE /end AXIS_DESCR
/end CHARACTERISTIC
/begin CHARACTERISTIC xInCo_RotAccFactor_XAS16_12___A "Trägheitsmomentfaktor abhängig von der Fahrzeuggeschwindigkeit" CURVE 0x15EA3C AblGLKLsw 3.99994 INERTOR_HIGH -2 1.999939 FORMAT "%8.6"
 /begin AXIS_DESCR STD_AXIS vInCo_AbsAvgVehSpd_xdu16 VFZHIGH 5 0 500 FORMAT "%8.4" DEPOSIT ABSOLUTE /end AXIS_DESCR
/end CHARACTERISTIC
/begin CHARACTERISTIC xInCo_RotAccFactor_XAS16_13___A "Trägheitsmomentfaktor abhängig von der Fahrzeuggeschwindigkeit" CURVE 0x15EA54 AblGLKLsw 3.99994 INERTOR_HIGH -2 1.999939 FORMAT "%8.6"
 /begin AXIS_DESCR STD_AXIS vInCo_AbsAvgVehSpd_xdu16 VFZHIGH 5 0 500 FORMAT "%8.4" DEPOSIT ABSOLUTE /end AXIS_DESCR
/end CHARACTERISTIC
/begin CHARACTERISTIC xInCo_RotAccFactor_XAS16_14___A "Trägheitsmomentfaktor abhängig von der Fahrzeuggeschwindigkeit" CURVE 0x15EA6C AblGLKLsw 3.99994 INERTOR_HIGH -2 1.999939 FORMAT "%8.6"
 /begin AXIS_DESCR STD_AXIS vInCo_AbsAvgVehSpd_xdu16 VFZHIGH 5 0 500 FORMAT "%8.4" DEPOSIT ABSOLUTE /end AXIS_DESCR
/end CHARACTERISTIC
/begin CHARACTERISTIC xInCo_RotAccFactor_XAS16_15___A "Trägheitsmomentfaktor abhängig von der Fahrzeuggeschwindigkeit" CURVE 0x15EA84 AblGLKLsw 3.99994 INERTOR_HIGH -2 1.999939 FORMAT "%8.6"
 /begin AXIS_DESCR STD_AXIS vInCo_AbsAvgVehSpd_xdu16 VFZHIGH 5 0 500 FORMAT "%8.4" DEPOSIT ABSOLUTE /end AXIS_DESCR
/end CHARACTERISTIC
/begin CHARACTERISTIC xInCo_RotAccFactor_XAS16_16___A "Trägheitsmomentfaktor abhängig von der Fahrzeuggeschwindigkeit" CURVE 0x15EA9C AblGLKLsw 3.99994 INERTOR_HIGH -2 1.999939 FORMAT "%8.6"
 /begin AXIS_DESCR STD_AXIS vInCo_AbsAvgVehSpd_xdu16 VFZHIGH 5 0 500 FORMAT "%8.4" DEPOSIT ABSOLUTE /end AXIS_DESCR
/end CHARACTERISTIC
/begin CHARACTERISTIC xInCo_RotAccFactor_XAS16_17___A "Trägheitsmomentfaktor abhängig von der Fahrzeuggeschwindigkeit" CURVE 0x15EAB4 AblGLKLsw 3.99994 INERTOR_HIGH -2 1.999939 FORMAT "%8.6"
 /begin AXIS_DESCR STD_AXIS vInCo_AbsAvgVehSpd_xdu16 VFZHIGH 5 0 500 FORMAT "%8.4" DEPOSIT ABSOLUTE /end AXIS_DESCR
/end CHARACTERISTIC
/begin CHARACTERISTIC xInCo_RotAccFactor_XAS16_18___A "Trägheitsmomentfaktor abhängig von der Fahrzeuggeschwindigkeit" CURVE 0x15EACC AblGLKLsw 3.99994 INERTOR_HIGH -2 1.999939 FORMAT "%8.6"
 /begin AXIS_DESCR STD_AXIS vInCo_AbsAvgVehSpd_xdu16 VFZHIGH 5 0 500 FORMAT "%8.4" DEPOSIT ABSOLUTE /end AXIS_DESCR
/end CHARACTERISTIC
/begin CHARACTERISTIC xInCo_RotAccFactor_XAS16_19___A "Trägheitsmomentfaktor abhängig von der Fahrzeuggeschwindigkeit" CURVE 0x15EAE4 AblGLKLsw 3.99994 INERTOR_HIGH -2 1.999939 FORMAT "%8.6"
 /begin AXIS_DESCR STD_AXIS vInCo_AbsAvgVehSpd_xdu16 VFZHIGH 5 0 500 FORMAT "%8.4" DEPOSIT ABSOLUTE /end AXIS_DESCR
/end CHARACTERISTIC
/begin CHARACTERISTIC xInCo_RotAccFactor_XAS16_20___A "Trägheitsmomentfaktor abhängig von der Fahrzeuggeschwindigkeit" CURVE 0x15EAFC AblGLKLsw 3.99994 INERTOR_HIGH -2 1.999939 FORMAT "%8.6"
 /begin AXIS_DESCR STD_AXIS vInCo_AbsAvgVehSpd_xdu16 VFZHIGH 5 0 500 FORMAT "%8.4" DEPOSIT ABSOLUTE /end AXIS_DESCR
/end CHARACTERISTIC
/begin CHARACTERISTIC xInCo_RotAccFactor_XAS16_21___A "Trägheitsmomentfaktor abhängig von der Fahrzeuggeschwindigkeit" CURVE 0x15EB14 AblGLKLsw 3.99994 INERTOR_HIGH -2 1.999939 FORMAT "%8.6"
 /begin AXIS_DESCR STD_AXIS vInCo_AbsAvgVehSpd_xdu16 VFZHIGH 5 0 500 FORMAT "%8.4" DEPOSIT ABSOLUTE /end AXIS_DESCR
/end CHARACTERISTIC
/begin CHARACTERISTIC xInCo_RotAccFactor_XAS16_22___A "Trägheitsmomentfaktor abhängig von der Fahrzeuggeschwindigkeit" CURVE 0x15EB2C AblGLKLsw 3.99994 INERTOR_HIGH -2 1.999939 FORMAT "%8.6"
 /begin AXIS_DESCR STD_AXIS vInCo_AbsAvgVehSpd_xdu16 VFZHIGH 5 0 500 FORMAT "%8.4" DEPOSIT ABSOLUTE /end AXIS_DESCR
/end CHARACTERISTIC
/begin CHARACTERISTIC xInCo_RotAccFactor_XAS16_23___A "Trägheitsmomentfaktor abhängig von der Fahrzeuggeschwindigkeit" CURVE 0x15EB44 AblGLKLsw 3.99994 INERTOR_HIGH -2 1.999939 FORMAT "%8.6"
 /begin AXIS_DESCR STD_AXIS vInCo_AbsAvgVehSpd_xdu16 VFZHIGH 5 0 500 FORMAT "%8.4" DEPOSIT ABSOLUTE /end AXIS_DESCR
/end CHARACTERISTIC
/begin CHARACTERISTIC xInCo_RotAccFactor_XAS16_24___A "Trägheitsmomentfaktor abhängig von der Fahrzeuggeschwindigkeit" CURVE 0x15EB5C AblGLKLsw 3.99994 INERTOR_HIGH -2 1.999939 FORMAT "%8.6"
 /begin AXIS_DESCR STD_AXIS vInCo_AbsAvgVehSpd_xdu16 VFZHIGH 5 0 500 FORMAT "%8.4" DEPOSIT ABSOLUTE /end AXIS_DESCR
/end CHARACTERISTIC
/begin CHARACTERISTIC xInCo_RotAccFactor_XAS16_25___A "Trägheitsmomentfaktor abhängig von der Fahrzeuggeschwindigkeit" CURVE 0x15EB74 AblGLKLsw 3.99994 INERTOR_HIGH -2 1.999939 FORMAT "%8.6"
 /begin AXIS_DESCR STD_AXIS vInCo_AbsAvgVehSpd_xdu16 VFZHIGH 5 0 500 FORMAT "%8.4" DEPOSIT ABSOLUTE /end AXIS_DESCR
/end CHARACTERISTIC
/begin CHARACTERISTIC xInCo_RotAccFactor_XAS16_26___A "Trägheitsmomentfaktor abhängig von der Fahrzeuggeschwindigkeit" CURVE 0x15EB8C AblGLKLsw 3.99994 INERTOR_HIGH -2 1.999939 FORMAT "%8.6"
 /begin AXIS_DESCR STD_AXIS vInCo_AbsAvgVehSpd_xdu16 VFZHIGH 5 0 500 FORMAT "%8.4" DEPOSIT ABSOLUTE /end AXIS_DESCR
/end CHARACTERISTIC
/begin CHARACTERISTIC xInCo_RotAccFactor_XAS16_27___A "Trägheitsmomentfaktor abhängig von der Fahrzeuggeschwindigkeit" CURVE 0x15EBA4 AblGLKLsw 3.99994 INERTOR_HIGH -2 1.999939 FORMAT "%8.6"
 /begin AXIS_DESCR STD_AXIS vInCo_AbsAvgVehSpd_xdu16 VFZHIGH 5 0 500 FORMAT "%8.4" DEPOSIT ABSOLUTE /end AXIS_DESCR
/end CHARACTERISTIC
/begin CHARACTERISTIC xInCo_RotAccFactor_XAS16_28___A "Trägheitsmomentfaktor abhängig von der Fahrzeuggeschwindigkeit" CURVE 0x15EBBC AblGLKLsw 3.99994 INERTOR_HIGH -2 1.999939 FORMAT "%8.6"
 /begin AXIS_DESCR STD_AXIS vInCo_AbsAvgVehSpd_xdu16 VFZHIGH 5 0 500 FORMAT "%8.4" DEPOSIT ABSOLUTE /end AXIS_DESCR
/end CHARACTERISTIC
/begin CHARACTERISTIC xInCo_RotAccFactor_XAS16_29___A "Trägheitsmomentfaktor abhängig von der Fahrzeuggeschwindigkeit" CURVE 0x15EBD4 AblGLKLsw 3.99994 INERTOR_HIGH -2 1.999939 FORMAT "%8.6"
 /begin AXIS_DESCR STD_AXIS vInCo_AbsAvgVehSpd_xdu16 VFZHIGH 5 0 500 FORMAT "%8.4" DEPOSIT ABSOLUTE /end AXIS_DESCR
/end CHARACTERISTIC
/begin CHARACTERISTIC xInCo_RotAccFactor_XAS16_30___A "Trägheitsmomentfaktor abhängig von der Fahrzeuggeschwindigkeit" CURVE 0x15EBEC AblGLKLsw 3.99994 INERTOR_HIGH -2 1.999939 FORMAT "%8.6"
 /begin AXIS_DESCR STD_AXIS vInCo_AbsAvgVehSpd_xdu16 VFZHIGH 5 0 500 FORMAT "%8.4" DEPOSIT ABSOLUTE /end AXIS_DESCR
/end CHARACTERISTIC
/begin CHARACTERISTIC xInCo_RotAccFactor_XAS16_31___A "Trägheitsmomentfaktor abhängig von der Fahrzeuggeschwindigkeit" CURVE 0x15EC04 AblGLKLsw 3.99994 INERTOR_HIGH -2 1.999939 FORMAT "%8.6"
 /begin AXIS_DESCR STD_AXIS vInCo_AbsAvgVehSpd_xdu16 VFZHIGH 5 0 500 FORMAT "%8.4" DEPOSIT ABSOLUTE /end AXIS_DESCR
/end CHARACTERISTIC
/begin CHARACTERISTIC xInCo_RotAccFactor_XAS16_32___A "Trägheitsmomentfaktor abhängig von der Fahrzeuggeschwindigkeit" CURVE 0x15EC1C AblGLKLsw 3.99994 INERTOR_HIGH -2 1.999939 FORMAT "%8.6"
 /begin AXIS_DESCR STD_AXIS vInCo_AbsAvgVehSpd_xdu16 VFZHIGH 5 0 500 FORMAT "%8.4" DEPOSIT ABSOLUTE /end AXIS_DESCR
/end CHARACTERISTIC
/begin CHARACTERISTIC xInCo_RotAccFactor_XAS16_33___A "Trägheitsmomentfaktor abhängig von der Fahrzeuggeschwindigkeit" CURVE 0x15EC34 AblGLKLsw 3.99994 INERTOR_HIGH -2 1.999939 FORMAT "%8.6"
 /begin AXIS_DESCR STD_AXIS vInCo_AbsAvgVehSpd_xdu16 VFZHIGH 5 0 500 FORMAT "%8.4" DEPOSIT ABSOLUTE /end AXIS_DESCR
/end CHARACTERISTIC
/begin CHARACTERISTIC xInCo_RotAccFactor_XAS16_34___A "Trägheitsmomentfaktor abhängig von der Fahrzeuggeschwindigkeit" CURVE 0x15EC4C AblGLKLsw 3.99994 INERTOR_HIGH -2 1.999939 FORMAT "%8.6"
 /begin AXIS_DESCR STD_AXIS vInCo_AbsAvgVehSpd_xdu16 VFZHIGH 5 0 500 FORMAT "%8.4" DEPOSIT ABSOLUTE /end AXIS_DESCR
/end CHARACTERISTIC
/begin CHARACTERISTIC xInCo_RotAccFactor_XAS16_35___A "Trägheitsmomentfaktor abhängig von der Fahrzeuggeschwindigkeit" CURVE 0x15EC64 AblGLKLsw 3.99994 INERTOR_HIGH -2 1.999939 FORMAT "%8.6"
 /begin AXIS_DESCR STD_AXIS vInCo_AbsAvgVehSpd_xdu16 VFZHIGH 5 0 500 FORMAT "%8.4" DEPOSIT ABSOLUTE /end AXIS_DESCR
/end CHARACTERISTIC
/begin CHARACTERISTIC xLa_ActReturnFuncFactLA_XDU16 "" VALUE 0x1509C8 AblGLKWuw 1 RIGHTSH10NP 0 1 FORMAT "%8.6" /end CHARACTERISTIC
/begin CHARACTERISTIC xLa_AngleCtrl_ddt_filt_fac_XDF32 "" VALUE 0x1504D4 AblGLKWfl4 1 ZU0 0 1 FORMAT "%10.8" /end CHARACTERISTIC
/begin CHARACTERISTIC xLa_BoostFactor_XDU8 "" VALUE 0x150B3B AblGLKWub 100 ZU0 0 100 FORMAT "%5.1" /end CHARACTERISTIC
/begin CHARACTERISTIC xLa_IpartClearMode_XDU8 " 1- Ipart clear when uplowlim changes n times, 0- Ipart clear when uplim increases n times or lowlim decreases n times " VALUE 0x150B3C AblGLKWub 1 ZU0 0 1 FORMAT "%5.3" /end CHARACTERISTIC
/begin CHARACTERISTIC xLa_LowerRiseLimfactor_XDU16 "" VALUE 0x1509CA AblGLKWuw 1 RIGHTSH10NP 0 1 FORMAT "%8.6" /end CHARACTERISTIC
/begin CHARACTERISTIC xLa_MMotOffset_filt_fac_XDF32 "Filter factor for MMOT Offset" VALUE 0x1504D8 AblGLKWfl4 1 ZU0 0 1 FORMAT "%10.8" /end CHARACTERISTIC
/begin CHARACTERISTIC xLa_MotorTorqueFactDepOnDriverV0_XAU16 "torque factor of lane assist depending on driver torque at V0" CURVE 0x1517B8 AblGLKLuw 1 RIGHTSH14NP 0 1 FORMAT "%8.6"
 /begin AXIS_DESCR STD_AXIS mApplI_AbsDriverTorque_xdu16 TBTHIGH 6 0.5 8 FORMAT "%8.6" DEPOSIT ABSOLUTE /end AXIS_DESCR
/end CHARACTERISTIC
/begin CHARACTERISTIC xLa_MotorTorqueFactDepOnDriverV1_XAU16 "torque factor of lane assist depending on driver torque at V1" CURVE 0x1517D4 AblGLKLuw 1 RIGHTSH14NP 0 1 FORMAT "%8.6"
 /begin AXIS_DESCR STD_AXIS mApplI_AbsDriverTorque_xdu16 TBTHIGH 6 0.5 8 FORMAT "%8.6" DEPOSIT ABSOLUTE /end AXIS_DESCR
/end CHARACTERISTIC
/begin CHARACTERISTIC xLa_MotorTorqueFactDepOnDriverV2_XAU16 "torque factor of lane assist depending on driver torque at V2" CURVE 0x1517F0 AblGLKLuw 1 RIGHTSH14NP 0 1 FORMAT "%8.6"
 /begin AXIS_DESCR STD_AXIS mApplI_AbsDriverTorque_xdu16 TBTHIGH 6 0.5 8 FORMAT "%8.6" DEPOSIT ABSOLUTE /end AXIS_DESCR
/end CHARACTERISTIC
/begin CHARACTERISTIC xLa_MotorTorqueFactDepOnDriverV3_XAU16 "torque factor of lane assist depending on driver torque at V3" CURVE 0x15180C AblGLKLuw 1 RIGHTSH14NP 0 1 FORMAT "%8.6"
 /begin AXIS_DESCR STD_AXIS mApplI_AbsDriverTorque_xdu16 TBTHIGH 6 0.5 8 FORMAT "%8.6" DEPOSIT ABSOLUTE /end AXIS_DESCR
/end CHARACTERISTIC
/begin CHARACTERISTIC xLa_MotorTorqueFactDepOnDriverV4_XAU16 "factor of lane keep assist torque depending on driver torque at V4" CURVE 0x151828 AblGLKLuw 1 RIGHTSH14NP 0 1 FORMAT "%8.6"
 /begin AXIS_DESCR STD_AXIS mApplI_AbsDriverTorque_xdu16 TBTHIGH 6 0.5 8 FORMAT "%8.6" DEPOSIT ABSOLUTE /end AXIS_DESCR
/end CHARACTERISTIC
/begin CHARACTERISTIC xLa_MotorTorqueFactDepOnDriverV5_XAU16 "factor of lane keep assist torque depending on driver torque at V5" CURVE 0x151844 AblGLKLuw 1 RIGHTSH14NP 0 1 FORMAT "%8.6"
 /begin AXIS_DESCR STD_AXIS mApplI_AbsDriverTorque_xdu16 TBTHIGH 6 0.5 8 FORMAT "%8.6" DEPOSIT ABSOLUTE /end AXIS_DESCR
/end CHARACTERISTIC
/begin CHARACTERISTIC xLa_MulFactorVehicleSpeed_XDU16 "" VALUE 0x1509CC AblGLKWuw 0.75 RIGHTSH10NP 0.5 1.25 FORMAT "%8.6" /end CHARACTERISTIC
/begin CHARACTERISTIC xLa_PositionIMax_XDF32 "saturation i-part positioncontroller LA" VALUE 0x1504DC AblGLKWfl4 2000 ZU0 0 2000 FORMAT "%10.5" /end CHARACTERISTIC
/begin CHARACTERISTIC xLa_PositionIPart_XAF32 "Position control I Fact depend on vehicle speed" CURVE 0x150D2C AblGLKLfl4 100 ZU0 0 100 FORMAT "%10.6"
 /begin AXIS_DESCR STD_AXIS vVehSpI_AbsMaxSafeVehSpd_xdf32 ZU0 6 0 180 FORMAT "%10.6" DEPOSIT ABSOLUTE /end AXIS_DESCR
/end CHARACTERISTIC
/begin CHARACTERISTIC xLa_PositionPPartDepOnChatter_XAF32 "Position control P Fact depend on chatter count" CURVE 0x150D60 AblGLKLfl4 1 ZU0 0 1 FORMAT "%10.8"
 /begin AXIS_DESCR STD_AXIS zLa_ChatterDetectCount_xdf32 ZU0 4 0 50 FORMAT "%10.7" DEPOSIT ABSOLUTE /end AXIS_DESCR
/end CHARACTERISTIC
/begin CHARACTERISTIC xLa_PositionPPart_XAF32 "Position control P Fact depend on vehicle speed" CURVE 0x150D84 AblGLKLfl4 2000 ZU0 0 2000 FORMAT "%10.5"
 /begin AXIS_DESCR STD_AXIS vVehSpI_AbsMaxSafeVehSpd_xdf32 ZU0 6 0 180 FORMAT "%10.6" DEPOSIT ABSOLUTE /end AXIS_DESCR
/end CHARACTERISTIC
/begin CHARACTERISTIC xLa_RackPosPTFiltFactor_XDU16 "filter factor rack position" VALUE 0x1509CE AblGLKWuw 0.599609 RIGHTSH10NP 0.4003906 1 FORMAT "%8.6" /end CHARACTERISTIC
/begin CHARACTERISTIC xLa_RackSpeedDPart_XDF32 "D-Anteil Geschwindigkeitssregler lane assist" VALUE 0x1504E0 AblGLKWfl4 2 ZU0 0 2 FORMAT "%10.8" /end CHARACTERISTIC
/begin CHARACTERISTIC xLa_RackSpeedIMax_XDF32 "Begrenzung I-Anteil Geschwindigkeitssregler LA" VALUE 0x1504E4 AblGLKWfl4 8 ZU0 0 8 FORMAT "%10.8" /end CHARACTERISTIC
/begin CHARACTERISTIC xLa_RackSpeedIPartDepOnChatter_XAF32 "Rack speed control I Fact depend on chatter count" CURVE 0x150DB8 AblGLKLfl4 1 ZU0 0 1 FORMAT "%10.8"
 /begin AXIS_DESCR STD_AXIS zLa_ChatterDetectCount_xdf32 ZU0 4 0 50 FORMAT "%10.7" DEPOSIT ABSOLUTE /end AXIS_DESCR
/end CHARACTERISTIC
/begin CHARACTERISTIC xLa_RackSpeedIPart_XAF32 "Rack Speed control I Fact depend on vehicle speed" CURVE 0x150DDC AblGLKLfl4 1 ZU0 0 1 FORMAT "%10.8"
 /begin AXIS_DESCR STD_AXIS vVehSpI_AbsMaxSafeVehSpd_xdf32 ZU0 6 0 180 FORMAT "%10.6" DEPOSIT ABSOLUTE /end AXIS_DESCR
/end CHARACTERISTIC
/begin CHARACTERISTIC xLa_RackSpeedPPartDepOnChatter_XAF32 "Rack speed control P Fact depend on chatter count" CURVE 0x150E10 AblGLKLfl4 1 ZU0 0 1 FORMAT "%10.8"
 /begin AXIS_DESCR STD_AXIS zLa_ChatterDetectCount_xdf32 ZU0 4 0 50 FORMAT "%10.7" DEPOSIT ABSOLUTE /end AXIS_DESCR
/end CHARACTERISTIC
/begin CHARACTERISTIC xLa_RackSpeedPPart_XAF32 "Rack speed control P Fact depend on vehicle speed" CURVE 0x150E34 AblGLKLfl4 2 ZU0 0 2 FORMAT "%10.8"
 /begin AXIS_DESCR STD_AXIS vVehSpI_AbsMaxSafeVehSpd_xdf32 ZU0 6 0 180 FORMAT "%10.6" DEPOSIT ABSOLUTE /end AXIS_DESCR
/end CHARACTERISTIC
/begin CHARACTERISTIC xLa_UpperRiseLimfactor_XDU16 "" VALUE 0x1509D0 AblGLKWuw 1 RIGHTSH10NP 0 1 FORMAT "%8.6" /end CHARACTERISTIC
/begin CHARACTERISTIC xLdw_HandsOnTrqFiltGain_XDU16 "" VALUE 0x1509E4 AblGLKWuw 0.499023 RIGHTSH10NP 0.0009765625 0.5 FORMAT "%9.7" /end CHARACTERISTIC
/begin CHARACTERISTIC xLdw_MulFactorVehicleSpeed_XDU16 "" VALUE 0x1509E6 AblGLKWuw 0.75 RIGHTSH10NP 0.5 1.25 FORMAT "%8.6" /end CHARACTERISTIC
/begin CHARACTERISTIC xLdw_PulseAmplitudeFactor_XAU16_00___A "" VAL_BLK 0x15EC7C AblGLKWBuw 1 MMOT 0 1 NUMBER 7 FORMAT "%8.6" /end CHARACTERISTIC
/begin CHARACTERISTIC xLdw_PulseAmplitudeFactor_XAU16_01___A "" VAL_BLK 0x15EC8C AblGLKWBuw 1 MMOT 0 1 NUMBER 7 FORMAT "%8.6" /end CHARACTERISTIC
/begin CHARACTERISTIC xLdw_PulseAmplitudeFactor_XAU16_02___A "" VAL_BLK 0x15EC9C AblGLKWBuw 1 MMOT 0 1 NUMBER 7 FORMAT "%8.6" /end CHARACTERISTIC
/begin CHARACTERISTIC xLdw_PulseAmplitudeFactor_XAU16_03___A "" VAL_BLK 0x15ECAC AblGLKWBuw 1 MMOT 0 1 NUMBER 7 FORMAT "%8.6" /end CHARACTERISTIC
/begin CHARACTERISTIC xLdw_PulseAmplitudeFactor_XAU16_04___A "" VAL_BLK 0x15ECBC AblGLKWBuw 1 MMOT 0 1 NUMBER 7 FORMAT "%8.6" /end CHARACTERISTIC
/begin CHARACTERISTIC xLdw_PulseAmplitudeFactor_XAU16_05___A "" VAL_BLK 0x15ECCC AblGLKWBuw 1 MMOT 0 1 NUMBER 7 FORMAT "%8.6" /end CHARACTERISTIC
/begin CHARACTERISTIC xLdw_PulseAmplitudeFactor_XAU16_06___A "" VAL_BLK 0x15ECDC AblGLKWBuw 1 MMOT 0 1 NUMBER 7 FORMAT "%8.6" /end CHARACTERISTIC
/begin CHARACTERISTIC xLdw_PulseAmplitudeFactor_XAU16_07___A "" VAL_BLK 0x15ECEC AblGLKWBuw 1 MMOT 0 1 NUMBER 7 FORMAT "%8.6" /end CHARACTERISTIC
/begin CHARACTERISTIC xLdw_PulseAmplitudeFactor_XAU16_08___A "" VAL_BLK 0x15ECFC AblGLKWBuw 1 MMOT 0 1 NUMBER 7 FORMAT "%8.6" /end CHARACTERISTIC
/begin CHARACTERISTIC xLdw_PulseAmplitudeFactor_XAU16_09___A "" VAL_BLK 0x15ED0C AblGLKWBuw 1 MMOT 0 1 NUMBER 7 FORMAT "%8.6" /end CHARACTERISTIC
/begin CHARACTERISTIC xLdw_PulseAmplitudeFactor_XAU16_10___A "" VAL_BLK 0x15ED1C AblGLKWBuw 1 MMOT 0 1 NUMBER 7 FORMAT "%8.6" /end CHARACTERISTIC
/begin CHARACTERISTIC xLdw_PulseAmplitudeFactor_XAU16_11___A "" VAL_BLK 0x15ED2C AblGLKWBuw 1 MMOT 0 1 NUMBER 7 FORMAT "%8.6" /end CHARACTERISTIC
/begin CHARACTERISTIC yHndOff_ConfLevelGradTarget_XDU32 "Target conf level for gradient monitoring" VALUE 0x15050C AblGLKWul 1 RIGHTSH20NP 0 1 FORMAT "%13.11" /end CHARACTERISTIC
/begin CHARACTERISTIC yHwlWrapI_InternalSasWakeUpBemfThd_XDU8 "Back-EMF threshold for ASIC wake up in standby mode for updating the ASIC steering angle counters." VALUE 0x150A7A AblGLKWuw 7 ZU0 0 7 FORMAT "%8.6" /end CHARACTERISTIC
/begin CHARACTERISTIC yHwlWrapI_InternalSasWakeUpPeriod_XDU8 "Period time of ASIC wake up in standby mode for updating the ASIC steering angle counters." VALUE 0x150A7C AblGLKWuw 255 ZU0 0 255 FORMAT "%8.4" /end CHARACTERISTIC
/begin CHARACTERISTIC yHwlWrapI_MaxRampUpGradient_XDU16 "Maximal erlaubter Gradient bei Aufw?rtsrampen f?r die Limitierung in der HwLib. Die Limitierung kann in bestimmten Umst?nden inaktiv sein (siehe MaxSafeRampUpReqTorque)" VALUE 0x150A7E AblGLKWuw 197.998 RSH15_GRAD1S 1.000977 198.999 FORMAT "%8.4" /end CHARACTERISTIC
/begin CHARACTERISTIC yHwlWrapI_SafetyRampGradient_XDU16 "Maximal erlaubter Gradient bei Abw?rtsrampen f?r die Limitierung in der HwLib. Die Limitierung kann in bestimmten Umst?nden inaktiv sein (siehe MaxSafeRampDownReqTorque)" VALUE 0x150A80 AblGLKWuw 198.999 RSH15_GRAD1S 0 198.999 FORMAT "%8.4" /end CHARACTERISTIC
/begin CHARACTERISTIC yHwlWrapI_SafetyRampLevel_XDU16 "Sicheres Unterst?tzungslevel von welchem ein Sturz auf 0% nicht mehr als Sudden Loss of Assist gilt." VALUE 0x150A82 AblGLKWuw 100 RSH15 0 100 FORMAT "%8.4" /end CHARACTERISTIC
/begin CHARACTERISTIC yHwlWrapI_SafetyRampTime_XDU32 "Geht das System in FailOp oder Error und verpasst die High Level SW zu reduzieren (siehe SafetyRampLevel), sorgt die HwLib innerhalb dieser Zeit f?r eine Notfallreduktion." VALUE 0x150510 AblGLKWul 60 TIMS 0 60 FORMAT "%6.3" /end CHARACTERISTIC
/begin CHARACTERISTIC yLa_MaxIntegralValue_XDU16 "" VALUE 0x150A84 AblGLKWuw 200 RACKPOS128 300 500 FORMAT "%8.4" /end CHARACTERISTIC
/begin CHARACTERISTIC zFctCo_MaxNumOfCat1Channel_XDU8 "Maximale Anzahl aktiver Kanäle der Kanalkategorie 1 " VALUE 0x150B52 AblGLKWub 3 ZU0 0 3 FORMAT "%5.3" /end CHARACTERISTIC
/begin CHARACTERISTIC zFriCo_UseFastShortTermFilterFactor_XDU8 "Anzahl Lernschritte, bei denen der schnelle (xFriCo_ShortTermFrictionFilterConstantRampUp_XDU16) Kurzzeitfilterfaktor verwendet wird" VALUE 0x150B53 AblGLKWub 254 ZU0 0 254 FORMAT "%5.1" /end CHARACTERISTIC
/begin CHARACTERISTIC zInCo_ChatterCountLimitInertia_XDU8 "Grenzewert Anzahl Ratterzyklen für Umschaltung auf Traegheitsmomentfaktor xInCo_ChatterRotAccFactor_XDS16" VALUE 0x150B54 AblGLKWub 255 ZU0 0 255 FORMAT "%5.1" /end CHARACTERISTIC
/begin CHARACTERISTIC zLa_CounterForAverage_XDU8 "counter for average of rack position num" VALUE 0x150B55 AblGLKWub 8 ZU0 0 8 FORMAT "%5.3" /end CHARACTERISTIC
/begin CHARACTERISTIC zLa_LaSmoothStep_XDU8 "" VALUE 0x150B56 AblGLKWub 99 ZU0 1 100 FORMAT "%5.1" /end CHARACTERISTIC
/begin CHARACTERISTIC zLa_MaxChatterPeriodsCount_XDU8 "minimum chatter cycle counter during holing time (after chatter detection finished)" VALUE 0x150B57 AblGLKWub 30 ZU0 0 30 FORMAT "%5.2" /end CHARACTERISTIC
/begin CHARACTERISTIC zLa_UpLowerRiseCount_XDU8 "" VALUE 0x150B58 AblGLKWub 5 ZU0 0 5 FORMAT "%5.3" /end CHARACTERISTIC
/begin CHARACTERISTIC zLdw_PulseSelection_XDU8 "" VALUE 0x150B5A AblGLKWub 6 ZU0 1 7 FORMAT "%5.3" /end CHARACTERISTIC
/begin CHARACTERISTIC zVDriverFactorCartSelect_XAU8 "Speed dependent selection of Driver Factor characteristics" VAL_BLK 0x150EB0 AblGLKWBuw 150 ZU0 0 150 NUMBER 6 FORMAT "%8.4" /end CHARACTERISTIC
/begin MEASUREMENT aHwlWrapI_RotorAcceleration_xdf32 "Gefilterte Rotorbeschleunigung" FLOAT32_IEEE ZU0 1 100 -52360 52360 FORMAT "%10.4" ECU_ADDRESS 0xFEBE4A7C /end MEASUREMENT
/begin MEASUREMENT cApplI_InternTempFilt_xdu8 "HW LIB: Gefilterte Temperatur Intern (Leiterplatte)" UBYTE TMPOUTS 1 100 -70 184 FORMAT "%5.1" ECU_ADDRESS 0xFEBE4B10 /end MEASUREMENT
/begin MEASUREMENT cApplI_OutstageTempFilt_xdu8 "HW LIB: Gefilterte Temperatur Endstufe (DBC)" UBYTE TMPOUTS 1 100 -70 184 FORMAT "%5.1" ECU_ADDRESS 0xFEBE4B11 /end MEASUREMENT
/begin MEASUREMENT cHwlWrapI_UcTempFilt_xdu8 "HW LIB: Uc Temperature" UBYTE TMPOUTS 1 100 -70 184 FORMAT "%5.1" ECU_ADDRESS 0xFEBE4B12 /end MEASUREMENT
/begin MEASUREMENT fcuOffsetUpdateRunning_xdu8 "Zeigt an, ob Offset Nachf?hrung l?uft (1=ja; 0=nein)" UBYTE ZU0 1 100 0 255 FORMAT "%5.1" ECU_ADDRESS 0xFEBE4B13 /end MEASUREMENT
/begin MEASUREMENT fFctCo_MaxActCat1ChannelsAchieved_xdb "Maximale Anzahl aktiver Kanalkategorie 1 Kanäle erreicht" UWORD ZU0 1 100 0 1 BIT_MASK 0x1 FORMAT "%5.3" ECU_ADDRESS 0xFEBE9465 /end MEASUREMENT
/begin MEASUREMENT fFriCo_JobResultOK_xdu8 " " UWORD ZU0 1 100 0 1 BIT_MASK 0x1 FORMAT "%5.3" ECU_ADDRESS 0xFEBE9466 /end MEASUREMENT
/begin MEASUREMENT fFriCo_MeasureHysteresisAllowed_xdb "Lernbedingungen erfuellt" UWORD ZU0 1 100 0 1 BIT_MASK 0x1 FORMAT "%5.3" ECU_ADDRESS 0xFEBE9467 /end MEASUREMENT
/begin MEASUREMENT fFuncDisplI_MonSafeOk_xdb "Indicates whether MonitorSafe checks report OK (1) or if they have detected a problem (0)" UWORD ZU0 1 100 0 1 BIT_MASK 0x1 FORMAT "%5.3" ECU_ADDRESS 0xFEBE9468 /end MEASUREMENT
/begin MEASUREMENT fFuncDispl_Activate_xdb "Indicates whether Function Displacer shall actively calculate and request a torque." UWORD ZU0 1 100 0 1 BIT_MASK 0x1 FORMAT "%5.3" ECU_ADDRESS 0xFEBE9469 /end MEASUREMENT
/begin MEASUREMENT fHwlI_Kl15State_xdu8 "KL15 ein Bit 0 CanWU Bit1" UBYTE ZU0 1 100 0 3 FORMAT "%5.3" ECU_ADDRESS 0xFEBE4B14 /end MEASUREMENT
/begin MEASUREMENT fHystDectI_Activate_xdb "Indicates whether HysteresisDetection (TbtOverRotPos) shall be activated." UWORD ZU0 1 100 0 1 BIT_MASK 0x1 FORMAT "%5.3" ECU_ADDRESS 0xFEBE946A /end MEASUREMENT
/begin MEASUREMENT fHystDect_ImmediateNvMWrite_xdb "Flag is set when NvM Immediate Write is Triggered" UBYTE BIT 1 100 0 1 BIT_MASK 0x1 FORMAT "%5.3" ECU_ADDRESS 0xFEBE946B /end MEASUREMENT
/begin MEASUREMENT fHystDect_NvMStatus_xdb "Flag is set when NvM Write is done" UBYTE BIT 1 100 0 1 BIT_MASK 0x1 FORMAT "%5.3" ECU_ADDRESS 0xFEBE946C /end MEASUREMENT
/begin MEASUREMENT fHystDect_NvMWriteError_xdb "Shows write error has detected" UBYTE BIT 1 100 0 1 BIT_MASK 0x1 FORMAT "%5.3" ECU_ADDRESS 0xFEBE946D /end MEASUREMENT
/begin MEASUREMENT fLaI_ChatterActive_xdu8 "" UBYTE ZU0 1 100 0 1 FORMAT "%5.3" ECU_ADDRESS 0xFEBE946E /end MEASUREMENT
/begin MEASUREMENT fLaI_DriverOverrideDetected_xdb "DriverOverrideDetection flag" UBYTE BIT 1 100 0 1 BIT_MASK 0x1 FORMAT "%5.3" ECU_ADDRESS 0xFEBE946F /end MEASUREMENT
/begin MEASUREMENT fLaI_ExtFctLowerLimActive_xdu8 "" UBYTE ZU0 1 100 0 1 FORMAT "%5.3" ECU_ADDRESS 0xFEBE9470 /end MEASUREMENT
/begin MEASUREMENT fLaI_ExtFctUpperLimActive_xdu8 "" UBYTE ZU0 1 100 0 1 FORMAT "%5.3" ECU_ADDRESS 0xFEBE9471 /end MEASUREMENT
/begin MEASUREMENT fLaI_ExtRateLimActive_xdu8 "" UBYTE ZU0 1 100 0 1 FORMAT "%5.3" ECU_ADDRESS 0xFEBE9472 /end MEASUREMENT
/begin MEASUREMENT fLaI_ExtSafeLimActive_xdu8 "" UBYTE ZU0 1 100 0 1 FORMAT "%5.3" ECU_ADDRESS 0xFEBE9473 /end MEASUREMENT
/begin MEASUREMENT fLaI_RackPosition2HighDetected_xdb "" UBYTE BIT 1 100 0 1 BIT_MASK 0x1 FORMAT "%5.3" ECU_ADDRESS 0xFEBE9474 /end MEASUREMENT
/begin MEASUREMENT fLaI_RackSpeed2HighDetected_xdb "" UBYTE BIT 1 100 0 1 BIT_MASK 0x1 FORMAT "%5.3" ECU_ADDRESS 0xFEBE9475 /end MEASUREMENT
/begin MEASUREMENT fLa_AngleReqOverRange_xdu8 "" UBYTE ZU0 1 100 0 1 FORMAT "%5.3" ECU_ADDRESS 0xFEBE9476 /end MEASUREMENT
/begin MEASUREMENT fLa_AngleSpeedReqOverRange_xdu8 "" UBYTE ZU0 1 100 0 1 FORMAT "%5.3" ECU_ADDRESS 0xFEBE9477 /end MEASUREMENT
/begin MEASUREMENT fLa_LastLaArbitrationResultPassive_xdb "Indicates whether the LaArbitrationResult is Passive and the TbtOffset is 0 in previous cycle or not for La arbitration valid" UWORD ZU0 1 100 0 1 BIT_MASK 0x1 FORMAT "%5.3" ECU_ADDRESS 0xFEBE9478 /end MEASUREMENT
/begin MEASUREMENT fLa_LastNopArbitrationResultPassive_xdb "Indicates whether the NopArbitrationResult is Passive and the TbtOffset is 0 in previous cycle or not for Nop arbitration valid" UWORD ZU0 1 100 0 1 BIT_MASK 0x1 FORMAT "%5.3" ECU_ADDRESS 0xFEBE9479 /end MEASUREMENT
/begin MEASUREMENT fLa_MonSafeOk_xdb "Indicates whether the MonitorSafe checks report OK (1) or if they have detected a problem (0)" UWORD ZU0 1 100 0 1 BIT_MASK 0x1 FORMAT "%5.3" ECU_ADDRESS 0xFEBE947A /end MEASUREMENT
/begin MEASUREMENT fLdwI_DriverIntervention_xdb "" UWORD ZU0 1 100 0 1 BIT_MASK 0x1 FORMAT "%5.3" ECU_ADDRESS 0xFEBE9486 /end MEASUREMENT
/begin MEASUREMENT fLdwI_InputValid_xdb "" UWORD ZU0 1 100 0 1 BIT_MASK 0x1 FORMAT "%5.3" ECU_ADDRESS 0xFEBE9487 /end MEASUREMENT
/begin MEASUREMENT fLdwI_MonSafeOk_xdb "Indicates whether MonitorSafe checks report OK (1) or if they have detected a problem (0)" UWORD ZU0 1 100 0 1 BIT_MASK 0x1 FORMAT "%5.3" ECU_ADDRESS 0xFEBE9488 /end MEASUREMENT
/begin MEASUREMENT fLdw_LastLdwArbitrationResultPassive_xdb "Indicates whether the LdwArbitrationResult is Passive and the TbtOffset is 0 in previous cycle or not for Ldw arbitration valid" UWORD ZU0 1 100 0 1 BIT_MASK 0x1 FORMAT "%5.3" ECU_ADDRESS 0xFEBE9489 /end MEASUREMENT
/begin MEASUREMENT fShimmyI_DebouncingDetectedErrorDelay_xdb "Indicates the delayed value of debouncing detected error" UWORD ZU0 1 100 0 1 BIT_MASK 0x1 FORMAT "%5.3" ECU_ADDRESS 0xFEBE94BC /end MEASUREMENT
/begin MEASUREMENT fShimmyI_MonSafeOk_xdb "Indicates whether the Monitor checks report OK (1) or if they have detected a problem (0)" UWORD ZU0 1 100 0 1 BIT_MASK 0x1 FORMAT "%5.3" ECU_ADDRESS 0xFEBE94BD /end MEASUREMENT
/begin MEASUREMENT fTscI_DisAvgBackUpMonFail_xdb " " UWORD ZU0 1 100 0 1 BIT_MASK 0x1 FORMAT "%5.3" ECU_ADDRESS 0xFEBE94C8 /end MEASUREMENT
/begin MEASUREMENT f_IntegralDisable_xdb "" UBYTE BIT 1 100 0 1 BIT_MASK 0x1 FORMAT "%5.3" ECU_ADDRESS 0xFEBE94D5 /end MEASUREMENT
/begin MEASUREMENT iApplI_BatteryCurrent_xds16 "HW LIB: Batterie Strom ohne Prozessor Strom" SWORD SM_I 1 100 -150 150 FORMAT "%8.4" ECU_ADDRESS 0xFEBE4AB4 /end MEASUREMENT
/begin MEASUREMENT iApplI_MaxBattCurrGeneratoric_xdu16 "maximal erlaubter generatorischer Batteriestrom " UWORD SM_I 1 100 0 200 FORMAT "%8.4" ECU_ADDRESS 0xFEBE4AB6 /end MEASUREMENT
/begin MEASUREMENT lLaI_DesiredRackPositionFilt_xds16 "Rack position filt" SWORD RACKPOS128 1 100 -200 200 FORMAT "%8.4" ECU_ADDRESS 0xFEBE8FE0 /end MEASUREMENT
/begin MEASUREMENT lLaI_DesiredRackPosition_xds16 "" SWORD RACKPOS128 1 100 -200 200 FORMAT "%8.4" ECU_ADDRESS 0xFEBE8FE2 /end MEASUREMENT
/begin MEASUREMENT lLa_RackPosition2HighIntegral_xds32 "" SLONG RACKPOS128 1 100 -33554431.9922 33554431.9922 FORMAT "%13.2" ECU_ADDRESS 0xFEBE8C64 /end MEASUREMENT
/begin MEASUREMENT lLa_RackpositionSim_xds16 "" SWORD RACKPOS128 1 100 -200 200 FORMAT "%8.4" ECU_ADDRESS 0xFEBE8FE4 /end MEASUREMENT
/begin MEASUREMENT mApplI_ActMaxMotorTorqueGeneratoric_xdu16 "HW LIB: Aktuelles max. Motormomnet im generatorischen Betrieb" UWORD MMOT 1 100 0 10 FORMAT "%8.5" ECU_ADDRESS 0xFEBE4ABA /end MEASUREMENT
/begin MEASUREMENT mApplI_ActMaxMotorTorque_xdu16 "HW LIB: Aktuelles max. Motormomnet" UWORD MMOT 1 100 0 10 FORMAT "%8.5" ECU_ADDRESS 0xFEBE4ABC /end MEASUREMENT
/begin MEASUREMENT mApplI_HWLMaxUsableTorque_xdf32 "MaxUsableTorque" FLOAT32_IEEE ZU0 1 100 0 12 FORMAT "%10.7" ECU_ADDRESS 0xFEBE4A80 /end MEASUREMENT
/begin MEASUREMENT mApplI_LimitedMotorTorque_xds16 "Begrenztes Motormoment durch Momentenkoordinator" SWORD MMOT 1 100 -12 12 FORMAT "%8.5" ECU_ADDRESS 0xFEBE4ABE /end MEASUREMENT
/begin MEASUREMENT mApplI_RequestedMotorTorque_xds16 "Angefordertes Motormoment" SWORD MMOT 1 100 -12 12 FORMAT "%8.5" ECU_ADDRESS 0xFEBE4AC0 /end MEASUREMENT
/begin MEASUREMENT mFriCoI_CompensationTorque_xds16 "Reibungskompensationsmoment" SWORD MMOT 1 100 -1 1 FORMAT "%8.6" ECU_ADDRESS 0xFEBE907A /end MEASUREMENT
/begin MEASUREMENT mFriCoI_LTFriction_xdu32 "stored friction of last ignition cycle" ULONG FRICFILT 1 100 0 3.99999999907 FORMAT "%13.11" ECU_ADDRESS 0xFEBE8C8C /end MEASUREMENT
/begin MEASUREMENT mFriCo_EffectiveTorque_xds16 "Wirkmoment aus Motor- und Handmoment" SWORD MMOT 1 100 -20 20 FORMAT "%8.5" ECU_ADDRESS 0xFEBE907C /end MEASUREMENT
/begin MEASUREMENT mFriCo_FrictionFilt_xdu16 "Summe aus kurz- und langzeitgefilterten Reibungsmoments" UWORD MMOT 1 100 0 3 FORMAT "%8.6" ECU_ADDRESS 0xFEBE907E /end MEASUREMENT
/begin MEASUREMENT mFriCo_LimitedFrictionTorque_xdu16 "Begrenztes Reibungsmoment (Eingang für Kompensation)" UWORD MMOT 1 100 0 3 FORMAT "%8.6" ECU_ADDRESS 0xFEBE9080 /end MEASUREMENT
/begin MEASUREMENT mFriCo_ShortTermFrictionFilt_xds32 "Reibungsmoment Kurzzeitlernen" SLONG RIGHTSH20NP 1 100 -3 3 FORMAT "%13.11" ECU_ADDRESS 0xFEBE8C90 /end MEASUREMENT
/begin MEASUREMENT mFriCo_TorqueHysteresis_xdu16 "berechntetes Hysteresemoment" UWORD MMOT 1 100 0 4 FORMAT "%8.6" ECU_ADDRESS 0xFEBE9082 /end MEASUREMENT
/begin MEASUREMENT mFuncDisplI_MotorTorque4Check_xds16 "Vibrations Motormoment im EcuStatus FailOp" SWORD MMOT 1 100 -0.5 0.5 FORMAT "%9.7" ECU_ADDRESS 0xFEBE9084 /end MEASUREMENT
/begin MEASUREMENT mFuncDisplI_MotorTorqueOffset_xds16 "Endgültiges Motormomentoffset fuer Vibration am Lenkrad im EcuStatus FailOp" SWORD MMOT 1 100 -0.5 0.5 FORMAT "%9.7" ECU_ADDRESS 0xFEBE9086 /end MEASUREMENT
/begin MEASUREMENT mFuncDispl_MtrTrqSaturated_xds16 "Durchtrankt Motormomentoffset fuer Vibration am Lenkrad im EcuStatus FailOp" SWORD MMOT 1 100 -8 8 FORMAT "%8.6" ECU_ADDRESS 0xFEBE9088 /end MEASUREMENT
/begin MEASUREMENT mHndOff_AbsFCLTorqGrad_xdu16 "Torque gradient of FCL component." UWORD TORGRAD 1 100 0 60 FORMAT "%8.5" ECU_ADDRESS 0xFEBE908A /end MEASUREMENT
/begin MEASUREMENT mHndOff_StoredTbt_xds16 "Stored TBT 4 Grad monitoring" SWORD TBTHIGH 1 100 -25 25 FORMAT "%8.5" ECU_ADDRESS 0xFEBE908C /end MEASUREMENT
/begin MEASUREMENT mHndOff_TbtGradAveragingArray_xau16 "TBT Grad averaging array." UWORD TBTHIGH 1 100 0 60 FORMAT "%8.5" ECU_ADDRESS 0xFEBE9AEC MATRIX_DIM 5 1 1 /end MEASUREMENT
/begin MEASUREMENT mHndOff_TbtIntegral_xds16 "Integral 4 Grad monitoring" SWORD TBTHIGH 1 100 -25 25 FORMAT "%8.5" ECU_ADDRESS 0xFEBE908E /end MEASUREMENT
/begin MEASUREMENT mHwlWrapI_MaxUsableTorqueGen_xdf32 "Maximal nutzbares Motordrehmoment generisch" FLOAT32_IEEE ZU0 1 100 0 12 FORMAT "%10.7" ECU_ADDRESS 0xFEBE4A84 /end MEASUREMENT
/begin MEASUREMENT mHwlWrapI_ProvidedMotorTorque_xdf32 "HwLib Provided Motor Torque" FLOAT32_IEEE ZU0 1 100 -12 12 FORMAT "%10.7" ECU_ADDRESS 0xFEBE4A88 /end MEASUREMENT
/begin MEASUREMENT mHwlWrapI_TorsionBarTorqueRed_xds16 "Pasive TBT sensor TorsionBarTorque" SWORD TBTHIGH 1 100 -25 25 FORMAT "%8.5" ECU_ADDRESS 0xFEBE4AC6 /end MEASUREMENT
/begin MEASUREMENT mHwlWrapI_TorsionBarTorque_xds16 "HwLib TorsionBarTorque" SWORD TBTHIGH 1 100 -25 25 FORMAT "%8.5" ECU_ADDRESS 0xFEBE4AC8 /end MEASUREMENT
/begin MEASUREMENT mHystDectI_ColumnFriction_xdu16 "driver has to apply this torque to get over the friction in steering column" UWORD TBTHIGH 1 100 0 2 FORMAT "%8.6" ECU_ADDRESS 0xFEBE9090 /end MEASUREMENT
/begin MEASUREMENT mHystDectI_TorqueOffset_xds16 "torsion bar torque offset due to sensor offset" SWORD TBTHIGH 1 100 -1 1 FORMAT "%8.6" ECU_ADDRESS 0xFEBE9092 /end MEASUREMENT
/begin MEASUREMENT mHystDectI_TorsionBarTorqueFilt_xds16 "filtered torsion bar torque" SWORD TBTHIGH 1 100 -25 25 FORMAT "%8.5" ECU_ADDRESS 0xFEBE9094 /end MEASUREMENT
/begin MEASUREMENT mHystDect_NegativeHyst_xds16 "negative hysteresis value" SWORD TBTHIGH 1 100 -3 3 FORMAT "%8.6" ECU_ADDRESS 0xFEBE9096 /end MEASUREMENT
/begin MEASUREMENT mHystDect_PositiveHyst_xds16 "positive hysteresis value" SWORD TBTHIGH 1 100 -3 3 FORMAT "%8.6" ECU_ADDRESS 0xFEBE9098 /end MEASUREMENT
/begin MEASUREMENT mHystTorI_NominalSteerTorque_xds16 "Sollhandmoment der Hysterese" SWORD TBTHIGH 1 100 -10 10 FORMAT "%8.5" ECU_ADDRESS 0xFEBE909A /end MEASUREMENT
/begin MEASUREMENT mHystTor_TBTFilt_xdu16 "Gefiltertes Drehstabmoment für Kennlinie" UWORD TBTHIGH 1 100 -25 25 FORMAT "%8.5" ECU_ADDRESS 0xFEBE909C /end MEASUREMENT
/begin MEASUREMENT mInCoI_InertiaComp_xds16 "Motormomentenoffset von Trägheitskompensation" SWORD MMOT 1 100 -1 1 FORMAT "%8.6" ECU_ADDRESS 0xFEBE909E /end MEASUREMENT
/begin MEASUREMENT mLaI_AgCtrlTqLowrLim_xds16 "" SWORD TBTHIGH 1 100 -30 30 FORMAT "%8.5" ECU_ADDRESS 0xFEBE90A0 /end MEASUREMENT
/begin MEASUREMENT mLaI_AgCtrlTqUpprLim_xds16 "" SWORD TBTHIGH 1 100 -30 30 FORMAT "%8.5" ECU_ADDRESS 0xFEBE90A2 /end MEASUREMENT
/begin MEASUREMENT mLaI_CheckedMotTrqOffset_xds16 "Lane Assist Checked MMOT Offset" SWORD MMOT 1 100 -25 25 FORMAT "%8.5" ECU_ADDRESS 0xFEBE90A4 /end MEASUREMENT
/begin MEASUREMENT mLaI_DesMotTrqOffset_xds16 "Handmomentenoffset Lane Assist" SWORD MMOT 1 100 -25 25 FORMAT "%8.5" ECU_ADDRESS 0xFEBE90A6 /end MEASUREMENT
/begin MEASUREMENT mLaI_DesSteeringTorqueOffset_xds16 "" SWORD TBTHIGH 1 100 -30 30 FORMAT "%8.5" ECU_ADDRESS 0xFEBE90A8 /end MEASUREMENT
/begin MEASUREMENT mLaI_LowerLimNoMap_xds16 "" SWORD TBTHIGH 1 100 -30 30 FORMAT "%8.5" ECU_ADDRESS 0xFEBE90AA /end MEASUREMENT
/begin MEASUREMENT mLaI_LowerLimTBT_xds16 "" SWORD TBTHIGH 1 100 -30 30 FORMAT "%8.5" ECU_ADDRESS 0xFEBE90AC /end MEASUREMENT
/begin MEASUREMENT mLaI_MaxSafetyLimitMotorTorque_xds16 "" SWORD MMOT 1 100 -6.5 6.5 FORMAT "%8.6" ECU_ADDRESS 0xFEBE90AE /end MEASUREMENT
/begin MEASUREMENT mLaI_MinSafetyLimitMotorTorque_xds16 "" SWORD MMOT 1 100 -6.5 6.5 FORMAT "%8.6" ECU_ADDRESS 0xFEBE90B0 /end MEASUREMENT
/begin MEASUREMENT mLaI_MMOTOffset_xds16 "Lane Assist MMOT Offset" SWORD MMOT 1 100 -8 8 FORMAT "%8.6" ECU_ADDRESS 0xFEBE90B2 /end MEASUREMENT
/begin MEASUREMENT mLaI_RampOutRate_xdu16 "" UWORD TBTHIGH 1 100 0 60 FORMAT "%8.5" ECU_ADDRESS 0xFEBE90B4 /end MEASUREMENT
/begin MEASUREMENT mLaI_UpperLimNoMap_xds16 "" SWORD TBTHIGH 1 100 -30 30 FORMAT "%8.5" ECU_ADDRESS 0xFEBE90B6 /end MEASUREMENT
/begin MEASUREMENT mLaI_UpperLimTBT_xds16 "" SWORD TBTHIGH 1 100 -30 30 FORMAT "%8.5" ECU_ADDRESS 0xFEBE90B8 /end MEASUREMENT
/begin MEASUREMENT mLa_AssistAct_xds16 "Lane Assist MMOT Offset before UpperLowerLimit" SWORD MMOT 1 100 -25 25 FORMAT "%8.5" ECU_ADDRESS 0xFEBE90BA /end MEASUREMENT
/begin MEASUREMENT mLa_CheckedMMotOffset_xds16 "Motormomentenoffset Lane Assist" SWORD MMOT 1 100 -25 25 FORMAT "%8.5" ECU_ADDRESS 0xFEBE90BC /end MEASUREMENT
/begin MEASUREMENT mLa_DriverFactorX_xau16 "X-Values of the interpolated Driver factor characteristic" UWORD TBTHIGH 1 100 0 63.99902 FORMAT "%8.5" ECU_ADDRESS 0xFEBE9958 MATRIX_DIM 6 1 1 /end MEASUREMENT
/begin MEASUREMENT mLa_InjectMMOTOffset_xds16 "Inject MMOTOffset" SWORD MMOT 1 100 -25 25 FORMAT "%8.5" ECU_ADDRESS 0xFEBE90BE /end MEASUREMENT
/begin MEASUREMENT mLa_MaxAllowedMMot_xds16 "" SWORD MMOT 1 100 -6.5 6.5 FORMAT "%8.6" ECU_ADDRESS 0xFEBE90C0 /end MEASUREMENT
/begin MEASUREMENT mLa_MMotRequestChecked_xds16 "" SWORD MMOT 1 100 -6.5 6.5 FORMAT "%8.6" ECU_ADDRESS 0xFEBE90C2 /end MEASUREMENT
/begin MEASUREMENT mLa_MonitorMaxTrqHighDepOnVelocity_Curve_xdu16 "/" UWORD MMOT 1 100 0 6.5 FORMAT "%8.6" ECU_ADDRESS 0xFEBE90C4 /end MEASUREMENT
/begin MEASUREMENT mLa_RackSpeedControllerDpart_xds16 "" SWORD MMOT 1 100 -8 8 FORMAT "%8.6" ECU_ADDRESS 0xFEBE90C6 /end MEASUREMENT
/begin MEASUREMENT mLa_RackSpeedControllerIpart_xds16 "" SWORD MMOT 1 100 -8 8 FORMAT "%8.6" ECU_ADDRESS 0xFEBE90C8 /end MEASUREMENT
/begin MEASUREMENT mLa_RackSpeedControllerPpart_xds16 "" SWORD MMOT 1 100 -8 8 FORMAT "%8.6" ECU_ADDRESS 0xFEBE90CA /end MEASUREMENT
/begin MEASUREMENT mLa_RackSpeedIFactorX_xau16 "X1-Values of the interpolated Driver factor characteristic" UWORD TBTHIGH 1 100 0 63.99902 FORMAT "%8.5" ECU_ADDRESS 0xFEBE9964 MATRIX_DIM 6 1 1 /end MEASUREMENT
/begin MEASUREMENT mLa_SatMMotOffset_xds16 "" SWORD MMOT 1 100 -8 8 FORMAT "%8.6" ECU_ADDRESS 0xFEBE90CC /end MEASUREMENT
/begin MEASUREMENT mLa_SmoothedMotTrqOffset_xds16 "Handmomentenoffset Lane Assist" SWORD MMOT 1 100 -25 25 FORMAT "%8.5" ECU_ADDRESS 0xFEBE90CE /end MEASUREMENT
/begin MEASUREMENT mLdwI_MotorTorque4Check_xds16 "Motormomentoffset aus LaneDepartureWarning zur Absicherung" SWORD MMOT 1 100 -4 4 FORMAT "%8.6" ECU_ADDRESS 0xFEBE90EE /end MEASUREMENT
/begin MEASUREMENT mLdwI_MotorTorqueOffset_xds16 "Abgesichertes Motormomentoffset LDW" SWORD MMOT 1 100 -0.5 0.5 FORMAT "%9.7" ECU_ADDRESS 0xFEBE90F0 /end MEASUREMENT
/begin MEASUREMENT mLdw_IntegratedTorque_xdf32 "L2 aufintegriertes Motormoment LaneDepartureWarning" FLOAT32_IEEE ZU0 1 100 -100 100 FORMAT "%10.6" ECU_ADDRESS 0xFEBE8CAC /end MEASUREMENT
/begin MEASUREMENT mLdw_IntegratedTorque_xds32 "aufintegriertes Motormoment LaneDepartureWarning" SLONG MMOT 1 100 -104 104 FORMAT "%13.9" ECU_ADDRESS 0xFEBE8CB0 /end MEASUREMENT
/begin MEASUREMENT mLdw_MotorTorqueSaturated_xds16 "Abgesichertes Motormoment LaneDepartureWarning" SWORD MMOT 1 100 -4 4 FORMAT "%8.6" ECU_ADDRESS 0xFEBE90F2 /end MEASUREMENT
/begin MEASUREMENT mShimmyI_DesMotTrqOffset_xds16 "Shimmy Compensation angeforderter Motormoment Offset" SWORD MMOT 1 100 -0.5 0.5 FORMAT "%9.7" ECU_ADDRESS 0xFEBE9152 /end MEASUREMENT
/begin MEASUREMENT mShimmyI_MotorTorque4Check_xds16 "Motormoment Shimmy Compensation zur Absicherung" SWORD MMOT 1 100 -1 1 FORMAT "%8.6" ECU_ADDRESS 0xFEBE9154 /end MEASUREMENT
/begin MEASUREMENT nEpsInI_EngineSpeed_xdu16 "Fahrzeug Motor Drehzahl" UWORD VROT 1 100 0 16382 FORMAT "%3.0" ECU_ADDRESS 0xFEBE91A8 /end MEASUREMENT
/begin MEASUREMENT nHwlWrapI_AbsRotSpeedVoltWeight_xdf32 "Spannungsgewichtete Rotordrehzahl" FLOAT32_IEEE ZU0 1 100 0 15000 FORMAT "%10.4" ECU_ADDRESS 0xFEBE4A8C /end MEASUREMENT
/begin MEASUREMENT nHwlWrapI_RotorSpeedFilt_xdf32 "Gefilterte Rotordrehzahl" FLOAT32_IEEE ZU0 1 100 -1047 1047 FORMAT "%10.5" ECU_ADDRESS 0xFEBE4A90 /end MEASUREMENT
/begin MEASUREMENT nrsI_IntRotorSpeed_xds16 "Kopie der im Interrupt berechneten Rotorgeschwindigkeit" SWORD VROT 1 100 -13000 13000 FORMAT "%3.0" ECU_ADDRESS 0xFEBE4ACC /end MEASUREMENT
/begin MEASUREMENT sApplI_IndexSignal_xdu8 "HW LIB: Indexsensor auf Lenksaeule: 0-nicht auf Index, 1-auf Index, sonst-SNA/ung?ltig" UBYTE ZU0 1 100 0 1 FORMAT "%5.3" ECU_ADDRESS 0xFEBE4B16 /end MEASUREMENT
/begin MEASUREMENT sApplI_LaSpecialModeActive_xdu8 "" UBYTE ZU0 1 100 0 1 FORMAT "%5.3" ECU_ADDRESS 0xFEBE94F5 /end MEASUREMENT
/begin MEASUREMENT sApplI_LaSpecialModeReq_xdu8 "" UBYTE ZU0 1 100 0 1 FORMAT "%5.3" ECU_ADDRESS 0xFEBE94F6 /end MEASUREMENT
/begin MEASUREMENT sApplI_LkaSta_D_Req_xdu8 "LKA intervention request from LKA Controller" UBYTE ZU0 1 100 0 15 FORMAT "%5.2" ECU_ADDRESS 0xFEBE94FC /end MEASUREMENT
/begin MEASUREMENT sEpsInI_CommBusTml15_xdu8 "Status Klemme 15" UBYTE ZU0 1 100 0 1 FORMAT "%5.3" ECU_ADDRESS 0xFEBE955A /end MEASUREMENT
/begin MEASUREMENT sEpsInI_HybridVehicle_xdu8 "Kennung für Hybrid-Fahrzeug" UBYTE ZU0 1 100 0 254 FORMAT "%5.1" ECU_ADDRESS 0xFEBE955D /end MEASUREMENT
/begin MEASUREMENT sFctCoI_ArbitrationIsValid_xau8 "is arbitration valid for this channel?" UBYTE ZU0 1 100 0 1 FORMAT "%5.3" ECU_ADDRESS 0xFEBE9AF8 MATRIX_DIM 22 1 1 /end MEASUREMENT
/begin MEASUREMENT sFctCoI_ArbitrationResult_xau8 "Vermittlungsstatus der KanÃ¤le:0= Arbitration Not OK; 1= Arbitration OK, Channel Active; 2= Arbitration OK, Channel Passive" UBYTE ZU0 1 100 0 2 FORMAT "%5.3" ECU_ADDRESS 0xFEBE9B10 MATRIX_DIM 22 1 1 /end MEASUREMENT
/begin MEASUREMENT sFctCoI_ChannelLockedByError_xau8 "array of channel error state; 0=channel unlocked; 1=channel locked due to internal error [obsolete: use DesignPattern]" UBYTE ZU0 1 100 0 1 FORMAT "%5.3" ECU_ADDRESS 0xFEBE9568 /end MEASUREMENT
/begin MEASUREMENT sFctCoI_ChannelStateArray_xau8 "Array fÃ¼r den aktuellen Status der KanÃ¤le" UBYTE AOC_FEAT_STATE 1 100 0 5 FORMAT "%13.11" ECU_ADDRESS 0xFEBE9B28 MATRIX_DIM 22 1 1 /end MEASUREMENT
/begin MEASUREMENT sFctCo_DeratingStateArray_xau8 "Array für den aktuellen Status der Kanäle bei Leistungsreduzierung 0-> Off, 1-> ON" UBYTE ZU0 1 100 0 1 FORMAT "%5.3" ECU_ADDRESS 0xFEBE9B40 MATRIX_DIM 22 1 1 /end MEASUREMENT
/begin MEASUREMENT sFuncDispl_FctCoCtrlState_xdu8 "Rueckgabewert des Function Coordinators" UBYTE ZU0 1 100 0 99 FORMAT "%5.2" ECU_ADDRESS 0xFEBE956A /end MEASUREMENT
/begin MEASUREMENT sFuncDispl_FeatureState_xdu8 "Funktionskoordinator status fuer FunctionDisplacer" UBYTE ZU0 1 100 0 99 FORMAT "%5.2" ECU_ADDRESS 0xFEBE956B /end MEASUREMENT
/begin MEASUREMENT sFuncDispl_PreStoreData_xdu16 "Indicates whether  MonitorSafe checks report OK (0) or if torque exceeds limit (1) or if invalid arbitration was detected (2) or if both the errors are present (3)." UBYTE ZU0 1 100 0 3 FORMAT "%5.3" ECU_ADDRESS 0xFEBE956C /end MEASUREMENT
/begin MEASUREMENT sHndOffI_HandsOffDetected_xdu8 "Status: Haende sind nicht am Lenkrad (0 == undef, 1 == HandsOn, 2 == HandsOff)" UBYTE ZU0 1 100 0 2 FORMAT "%5.3" ECU_ADDRESS 0xFEBE956E /end MEASUREMENT
/begin MEASUREMENT sHndOffI_HandsOffEnabled_xdu8 "Status: hands-off mode (0 == Disable, 1 == Enable, 255 == Failed)" UBYTE ZU0 1 100 0 1 FORMAT "%5.3" ECU_ADDRESS 0xFEBE956F /end MEASUREMENT
/begin MEASUREMENT sHndOff_State_xds8 "detection state: 0=HandsOn/deactivated, -1/1=LowGradients, -2/2=SupposedHyst, -3/3=Hysteresis, -4/4=SupposedTurningPoint" SBYTE ZU0 1 100 -4 4 FORMAT "%5.3" ECU_ADDRESS 0xFEBE9570 /end MEASUREMENT
/begin MEASUREMENT sHwlWrapI_AbsRotbasedAngleDetails_xdu32 "AbsRotbased Angle Details" ULONG ZU0 1 100 0 65535 FORMAT "%13.7" ECU_ADDRESS 0xFEBE4A94 /end MEASUREMENT
/begin MEASUREMENT sHwlWrapI_AbsRotbasedAngleState_xde "HwLib AbsRotbased Angle State" UWORD ZU0 1 100 0 32768 FORMAT "%8.2" ECU_ADDRESS 0xFEBE4ACE /end MEASUREMENT
/begin MEASUREMENT sHwlWrapI_ActuatorState_xde "HwLib Actuator State" UWORD ZU0 1 100 0 1024 FORMAT "%8.3" ECU_ADDRESS 0xFEBE4AD0 /end MEASUREMENT
/begin MEASUREMENT sHwlWrapI_BatteryCurrentState_xde "G?ltigkeitszustand des Batteriestroms" UWORD ZU0 1 100 0 32770 FORMAT "%8.2" ECU_ADDRESS 0xFEBE4AD2 /end MEASUREMENT
/begin MEASUREMENT sHwlWrapI_BoardTempState_xde "HwLib Board Temp State" UWORD ZU0 1 100 0 32768 FORMAT "%8.2" ECU_ADDRESS 0xFEBE4AD4 /end MEASUREMENT
/begin MEASUREMENT sHwlWrapI_ChipsetSafetyFault_xde "HwLib Chipset SafetyFault State" UBYTE ZU0 1 100 0 7 FORMAT "%5.3" ECU_ADDRESS 0xFEBE4B19 /end MEASUREMENT
/begin MEASUREMENT sHwlWrapI_CurrRecalibState_xde "Aktueller Offset-Neukalibrierungsstatus" UBYTE ZU0 1 100 0 2 FORMAT "%5.3" ECU_ADDRESS 0xFEBE4B1A /end MEASUREMENT
/begin MEASUREMENT sHwlWrapI_EcuIntConnState_xde "HwLib EcuIntConn State" UWORD ZU0 1 100 0 3 FORMAT "%8.6" ECU_ADDRESS 0xFEBE4AD6 /end MEASUREMENT
/begin MEASUREMENT sHwlWrapI_EsbState_xde "HwLib ESB State Wrapper" UBYTE ZU0 1 100 0 1 FORMAT "%5.3" ECU_ADDRESS 0xFEBE4B1B /end MEASUREMENT
/begin MEASUREMENT sHwlWrapI_GuardStatusInfo_xde "Status der GuardStatusInfo" UBYTE ZU0 1 100 0 15 FORMAT "%5.2" ECU_ADDRESS 0xFEBE4B1C /end MEASUREMENT
/begin MEASUREMENT sHwlWrapI_IndexSensSignalState_xde "HwLib IndexSensSignal State" UWORD ZU0 1 100 0 32768 FORMAT "%8.2" ECU_ADDRESS 0xFEBE4AD8 /end MEASUREMENT
/begin MEASUREMENT sHwlWrapI_LimitedMotorTorqueState_xde "G?ltigkeitszustand des begrenzten Motordrehmoments" UWORD ZU0 1 100 0 32795 FORMAT "%8.2" ECU_ADDRESS 0xFEBE4ADA /end MEASUREMENT
/begin MEASUREMENT sHwlWrapI_PhaseCurrentState_xde "Status der Phasenstrommessung" UWORD ZU0 1 100 0 32770 FORMAT "%8.2" ECU_ADDRESS 0xFEBE4ADC /end MEASUREMENT
/begin MEASUREMENT sHwlWrapI_PowerOnSteeringAngleState_xde "Status der PowerOnLenkungswinkelStatus" UWORD ZU0 1 100 0 32768 FORMAT "%8.2" ECU_ADDRESS 0xFEBE4ADE /end MEASUREMENT
/begin MEASUREMENT sHwlWrapI_RotorAccelerationState_xde "G?ltigkeitszustand der Rotorbeschleunigung" UWORD ZU0 1 100 0 32772 FORMAT "%8.2" ECU_ADDRESS 0xFEBE4AE0 /end MEASUREMENT
/begin MEASUREMENT sHwlWrapI_RotorPositionState_xde "HwLib Rotor Position State" UWORD ZU0 1 100 0 32776 FORMAT "%8.2" ECU_ADDRESS 0xFEBE4AE2 /end MEASUREMENT
/begin MEASUREMENT sHwlWrapI_RotorSpeedState_xde "G?ltigkeitszustand der Rotordrehzahl" UWORD ZU0 1 100 0 32772 FORMAT "%8.2" ECU_ADDRESS 0xFEBE4AE4 /end MEASUREMENT
/begin MEASUREMENT sHwlWrapI_SafeState_xde "HwLib SafeState wrapper" UBYTE ZU0 1 100 0 7 FORMAT "%5.3" ECU_ADDRESS 0xFEBE4B1D /end MEASUREMENT
/begin MEASUREMENT sHwlWrapI_SafetyRampControl_xdu8 "HW LIB" UBYTE ZU0 1 100 0 3 FORMAT "%5.3" ECU_ADDRESS 0xFEBE4B1E /end MEASUREMENT
/begin MEASUREMENT sHwlWrapI_SystemVoltageState_xde "HwLib System Voltage State" UWORD ZU0 1 100 0 32780 FORMAT "%8.2" ECU_ADDRESS 0xFEBE4AE6 /end MEASUREMENT
/begin MEASUREMENT sHwlWrapI_TorqueClipLevelsState_xde "Begrenzungsfaktoren f?r den G?ltigkeitszustand von HwLib-Reduktionskan?len" UWORD ZU0 1 100 0 1024 FORMAT "%8.3" ECU_ADDRESS 0xFEBE4AE8 /end MEASUREMENT
/begin MEASUREMENT sHwlWrapI_TorqueRedLevelsState_xde "G?ltigkeitszustand der Reduktionsfaktoren" UWORD ZU0 1 100 0 1024 FORMAT "%8.3" ECU_ADDRESS 0xFEBE4AEA /end MEASUREMENT
/begin MEASUREMENT sHwlWrapI_TorsionBarTorqueState_xde "HwLib TorsionBar Torque State" UWORD ZU0 1 100 0 32895 FORMAT "%8.2" ECU_ADDRESS 0xFEBE4AEC /end MEASUREMENT
/begin MEASUREMENT sHwlWrapI_UcTempState_xde "HwLib Uc Temp State" UWORD ZU0 1 100 0 32768 FORMAT "%8.2" ECU_ADDRESS 0xFEBE4AEE /end MEASUREMENT
/begin MEASUREMENT sHwlWrapI_VehPowerSupplyTestResult_xde "Testergebnisschnittstelle f?r die ?berpr?fung des Netzteils" SBYTE ZU0 1 100 0 4 FORMAT "%5.3" ECU_ADDRESS 0xFEBE4B1F /end MEASUREMENT
/begin MEASUREMENT sHwlWrapI_WakeUpCondition_xde "HwLib WakeUpCondition" UBYTE ZU0 1 100 0 4 FORMAT "%5.3" ECU_ADDRESS 0xFEBE4B20 /end MEASUREMENT
/begin MEASUREMENT sHystDect_JobResultOk_xdu8 " To check status of JobResult and Service ID of Hysteresis Detection NvM Operations" UBYTE ZU0 1 100 0 2 FORMAT "%5.3" ECU_ADDRESS 0xFEBE9571 /end MEASUREMENT
/begin MEASUREMENT sHystDect_NvWriteState_xdu8 "State of Write chart (0-Ready;1-Request is pushed ; 2- Error shall be locked)" UBYTE ZU0 1 100 0 3 FORMAT "%5.3" ECU_ADDRESS 0xFEBE9572 /end MEASUREMENT
/begin MEASUREMENT sHystDect_ResetData_xdu8 "indicates whether data flash data shall be reset (1), reset is acknowledged (2), manually reset is done (3) or no reset request is present (0)" UBYTE ZU0 1 100 0 3 FORMAT "%5.3" ECU_ADDRESS 0xFEBE9573 /end MEASUREMENT
/begin MEASUREMENT sHystDect_State_xds8 "learning state: 99=WarmUp, 0=Deactivated, -1/1=Hysteresis, -2/2=SetNewHystValue" SBYTE ZU0 1 100 -2 99 FORMAT "%5.2" ECU_ADDRESS 0xFEBE9574 /end MEASUREMENT
/begin MEASUREMENT sIgniI_IgnitionEnabled_xdu8 "Status IgnitionEnable" UBYTE ZU0 1 100 0 1 FORMAT "%5.3" ECU_ADDRESS 0xFEBE9575 /end MEASUREMENT
/begin MEASUREMENT sLaI_DesMotTrqOffsetValid_xdu8 "" UBYTE ZU0 1 100 0 1 FORMAT "%5.3" ECU_ADDRESS 0xFEBE9576 /end MEASUREMENT
/begin MEASUREMENT sLaI_DriverInLoopState_xdu8 "" UBYTE ZU0 1 100 0 2 FORMAT "%5.3" ECU_ADDRESS 0xFEBE9577 /end MEASUREMENT
/begin MEASUREMENT sLaI_EpsLaState_xdu8 "" UBYTE ZU0 1 100 0 5 FORMAT "%5.3" ECU_ADDRESS 0xFEBE9578 /end MEASUREMENT
/begin MEASUREMENT sLaI_ErrorCode_xdu8 "" UBYTE ZU0 1 100 0 255 FORMAT "%5.1" ECU_ADDRESS 0xFEBE9579 /end MEASUREMENT
/begin MEASUREMENT sLaI_FctCoCtrlState_xdu8 "return value of the FunctionCoordinator" UBYTE ZU0 1 100 0 99 FORMAT "%5.2" ECU_ADDRESS 0xFEBE957A /end MEASUREMENT
/begin MEASUREMENT sLaI_FeatureState_xdu8 "internal feature state for FunctionCoordinator" UBYTE ZU0 1 100 0 5 FORMAT "%5.3" ECU_ADDRESS 0xFEBE957B /end MEASUREMENT
/begin MEASUREMENT sLaI_LaCtrlMod_xdu8 "" UBYTE ZU0 1 100 0 3 FORMAT "%5.3" ECU_ADDRESS 0xFEBE957C /end MEASUREMENT
/begin MEASUREMENT sLaI_MakeSafeAndMonState_xdu8 "Indicates whether the MakeSafe and MonitorSafe checks report OK (0) or if they have detected a problem (1) or if HandsOn was detected (2) or if invalid arbitration was detected (3)." UBYTE ZU0 1 100 0 3 FORMAT "%5.3" ECU_ADDRESS 0xFEBE957D /end MEASUREMENT
/begin MEASUREMENT sLaI_ReqStateHF_xdu8 "" UBYTE ZU0 1 100 0 1 FORMAT "%5.3" ECU_ADDRESS 0xFEBE957E /end MEASUREMENT
/begin MEASUREMENT sLaI_ReqState_xdu8 "" UBYTE ZU0 1 100 0 2 FORMAT "%5.3" ECU_ADDRESS 0xFEBE957F /end MEASUREMENT
/begin MEASUREMENT sLa_ChatterDetectionState_xdu8 "state of the chatter detection (0=Init, 1=PositiveAcceleration, 2=NegativeAcceleration)" UBYTE ZU0 1 100 0 2 FORMAT "%5.3" ECU_ADDRESS 0xFEBE9414 /end MEASUREMENT
/begin MEASUREMENT sLa_HandsModeInject_xdu8 "Indicates checked hands-on/hands-free mode" UBYTE ZU0 1 100 0 3 FORMAT "%5.3" ECU_ADDRESS 0xFEBE9580 /end MEASUREMENT
/begin MEASUREMENT sLa_LdwState_xdu8 "LDW Status (0=Inactive,1=active)" UBYTE STATUS 1 100 0 2 FORMAT "%5.3" ECU_ADDRESS 0xFEBE9581 /end MEASUREMENT
/begin MEASUREMENT sLdwI_ActivateFctCo_xdu8 "Flag für den ActivationRequest des FunctionCoordinators" UBYTE ZU0 1 100 0 1 FORMAT "%5.3" ECU_ADDRESS 0xFEBE9588 /end MEASUREMENT
/begin MEASUREMENT sLdwI_LdwState_xdu8 "" UBYTE ZU0 1 100 0 6 FORMAT "%5.3" ECU_ADDRESS 0xFEBE9589 /end MEASUREMENT
/begin MEASUREMENT sLdw_ActivationRequest_xdb "Flag für den ActivationRequest des FunctionCoordinators" UWORD BIT 1 100 0 1 BIT_MASK 0x1 FORMAT "%5.3" ECU_ADDRESS 0xFEBE958A /end MEASUREMENT
/begin MEASUREMENT sLdw_CtrlState_xdu8 "Rückgabewert des Function Coordinators" UBYTE ZU0 1 100 0 99 FORMAT "%5.2" ECU_ADDRESS 0xFEBE958B /end MEASUREMENT
/begin MEASUREMENT sLdw_FailureCause_xdu8 "Grund der Fehlererkennung" UBYTE ZU0 1 100 0 255 FORMAT "%5.1" ECU_ADDRESS 0xFEBE958C /end MEASUREMENT
/begin MEASUREMENT sLdw_FeatureState_xdu8 "LaneDepartureWarning interner Mode Manager Status" UBYTE ZU0 1 100 0 5 FORMAT "%5.3" ECU_ADDRESS 0xFEBE958D /end MEASUREMENT
/begin MEASUREMENT sLdw_TorqueNotOK_xdu8 "" UBYTE ZU0 1 100 0 2 FORMAT "%5.3" ECU_ADDRESS 0xFEBE958E /end MEASUREMENT
/begin MEASUREMENT tEpsInI_DiagInfo1_xau8 "Diagnose Informationspacket" UBYTE ZU0 1 100 0 255 FORMAT "%5.1" ECU_ADDRESS 0xFEBE967C MATRIX_DIM 7 1 1 /end MEASUREMENT
/begin MEASUREMENT tHwlWrapI_TaskActSysTime_xdu16 "Task Activation Time" UWORD TIMUS 1 100 0 65535 FORMAT "%8.2" ECU_ADDRESS 0xFEBE4AF0 /end MEASUREMENT
/begin MEASUREMENT tHwlWrapI_TorsionBarTorqueSampleTimeRed_xdu16 "Passive Torsion Bar Torque Sample Time " UWORD TIMUS 1 100 0 65535 FORMAT "%8.2" ECU_ADDRESS 0xFEBE4AF2 /end MEASUREMENT
/begin MEASUREMENT tHwlWrapI_TorsionBarTorqueSampleTime_xdu16 "Torsion Bar Torque Sample Time" UWORD TIMUS 1 100 0 65535 FORMAT "%8.2" ECU_ADDRESS 0xFEBE4AF4 /end MEASUREMENT
/begin MEASUREMENT tLa_ChatterTime_xdu16 "time since last torque gradient has occurred" UWORD TIMMS 1 100 0 60000 FORMAT "%8.2" ECU_ADDRESS 0xFEBE8F78 /end MEASUREMENT
/begin MEASUREMENT uApplI_SupplyVoltage_xdu16 "SupplyVoltage" UWORD U64V 1 100 0 33 FORMAT "%8.5" ECU_ADDRESS 0xFEBE4AF6 /end MEASUREMENT
/begin MEASUREMENT uHwlWrapI_IgnitionFilt_xdf32 "Hw Klemme 15 Spannung" FLOAT32_IEEE ZU0 1 100 0 33 FORMAT "%10.7" ECU_ADDRESS 0xFEBE4A98 /end MEASUREMENT
/begin MEASUREMENT uHwlWrapI_SupplyVoltageUnfilt_xdf32 "Ungefilterte Batteriespannung" FLOAT32_IEEE ZU0 1 100 0 33 FORMAT "%10.7" ECU_ADDRESS 0xFEBE4A9C /end MEASUREMENT
/begin MEASUREMENT vApplWrapI_AbsSafeVehicleSpeed_xdu16 "Anwendungsumbruch f?r das Signal vApplWrapI_AbsSafeVehicleSpeed_xdu16 aus Konsistenzgr?nden f?r Multicore" UWORD VFZHIGH 1 100 0 500 FORMAT "%8.4" ECU_ADDRESS 0xFEBE4AFA /end MEASUREMENT
/begin MEASUREMENT vEpsInI_VehicleSpeedRaw_xds16 "Fahrzeug Geschwindigkeit Rohwert" SWORD VFZHIGH 1 100 -100 500 FORMAT "%8.4" ECU_ADDRESS 0xFEBE924A /end MEASUREMENT
/begin MEASUREMENT vEpsInI_WheelSpeedFLDiv_xds16 "Diverse Rad Geschwindigkeit vorne links" SWORD VFZHIGH 1 100 -100 500 FORMAT "%8.4" ECU_ADDRESS 0xFEBE924C /end MEASUREMENT
/begin MEASUREMENT vEpsInI_WheelSpeedFL_xds16 "Rad Geschwindigkeit vorne links" SWORD VFZHIGH 1 100 -100 500 FORMAT "%8.4" ECU_ADDRESS 0xFEBE924E /end MEASUREMENT
/begin MEASUREMENT vEpsInI_WheelSpeedFRDiv_xds16 "Diverse Rad Geschwindigkeit vorne rechts" SWORD VFZHIGH 1 100 -100 500 FORMAT "%8.4" ECU_ADDRESS 0xFEBE9250 /end MEASUREMENT
/begin MEASUREMENT vEpsInI_WheelSpeedFR_xds16 "Rad Geschwindigkeit vorne rechts" SWORD VFZHIGH 1 100 -100 500 FORMAT "%8.4" ECU_ADDRESS 0xFEBE9252 /end MEASUREMENT
/begin MEASUREMENT vEpsInI_WheelSpeedRLDiv_xds16 "Diverse Rad Geschwindigkeit hinten links" SWORD VFZHIGH 1 100 -100 500 FORMAT "%8.4" ECU_ADDRESS 0xFEBE9254 /end MEASUREMENT
/begin MEASUREMENT vEpsInI_WheelSpeedRL_xds16 "Rad Geschwindigkeit hinten link" SWORD VFZHIGH 1 100 -100 500 FORMAT "%8.4" ECU_ADDRESS 0xFEBE9256 /end MEASUREMENT
/begin MEASUREMENT vEpsInI_WheelSpeedRRDiv_xds16 "Diverse Rad Geschwindigkeit hinten rechts" SWORD VFZHIGH 1 100 -100 500 FORMAT "%8.4" ECU_ADDRESS 0xFEBE9258 /end MEASUREMENT
/begin MEASUREMENT vEpsInI_WheelSpeedRR_xds16 "Rad Geschwindigkeit hinten rechts" SWORD VFZHIGH 1 100 -100 500 FORMAT "%8.4" ECU_ADDRESS 0xFEBE925A /end MEASUREMENT
/begin MEASUREMENT vInCo_AbsAvgVehSpd_xdu16 "" UWORD VFZHIGH 1 100 0 500 FORMAT "%8.4" ECU_ADDRESS 0xFEBE925C /end MEASUREMENT
/begin MEASUREMENT vLaI_RackSpeed_xds16 "Zahnstangengeschwindigkeit [mm/s]" SWORD RACKSPEED128 1 100 -250 250 FORMAT "%8.4" ECU_ADDRESS 0xFEBE925E /end MEASUREMENT
/begin MEASUREMENT vLa_LimitedDesiredRackSpeed_xds16 "begrenzte, erechnete Zahnstangengeschwindigkeit" SWORD RACKSPEED128 1 100 -250 250 FORMAT "%8.4" ECU_ADDRESS 0xFEBE9260 /end MEASUREMENT
/begin MEASUREMENT vLa_RackSpeed2HighIntegral_xds32 "" SLONG RACKSPEED128 1 100 -33554431.9922 33554431.9922 FORMAT "%13.2" ECU_ADDRESS 0xFEBE8D94 /end MEASUREMENT
/begin MEASUREMENT vLa_RackSpeedSim_xds16 "Inject rackspeed[mm/s]" SWORD RACKSPEED128 1 100 -250 250 FORMAT "%8.4" ECU_ADDRESS 0xFEBE9262 /end MEASUREMENT
/begin MEASUREMENT vVehSpI_AbsMaxSafeVehSpd_xdf32 "" FLOAT32_IEEE ZU0 1 100 0 500 FORMAT "%10.6" ECU_ADDRESS 0xFEBE8DAC /end MEASUREMENT
/begin MEASUREMENT wApplI_MaxStrgReqAngVal_xds16 "Max LKA: Request steering angle" SWORD SA_10 1 100 -780 780 FORMAT "%8.4" ECU_ADDRESS 0xFEBE9294 /end MEASUREMENT
/begin MEASUREMENT wApplI_MinStrgReqAngVal_xds16 "Min LKA: Request steering angle" SWORD SA_10 1 100 -780 780 FORMAT "%8.4" ECU_ADDRESS 0xFEBE9296 /end MEASUREMENT
/begin MEASUREMENT wApplI_RelRotorPosition_xdu16 "HW LIB: Winkelwert Rotorlage +/-90 Grad" UWORD ROTPOS 1 100 0 360 FORMAT "%8.4" ECU_ADDRESS 0xFEBE4AFC /end MEASUREMENT
/begin MEASUREMENT wApplI_RotorPosition_xds32 "HW LIB: aufintegrierter, sprungkompensierter Rotorlagewinkel" SLONG ROTPOS 1 100 -32000.0097656 32000.0097656 FORMAT "%13.7" ECU_ADDRESS 0xFEBE4AA0 /end MEASUREMENT
/begin MEASUREMENT wEpsInI_SteeringAngleExtern_xds16 "Unkorrigierter Lenkradwinkel vom CAN-Bus" SWORD SA_10 1 100 -2048 2048 FORMAT "%8.3" ECU_ADDRESS 0xFEBE92A2 /end MEASUREMENT
/begin MEASUREMENT wFriCo_SteeringAngleHystFilt_xds16 "Hysteresegefilterter Lenkwinkel" SWORD SA_10 1 100 -1000 1000 FORMAT "%8.3" ECU_ADDRESS 0xFEBE92A4 /end MEASUREMENT
/begin MEASUREMENT wHndOff_MaxRotPos_xds32 "maximum rotor postion of hysteresis (positive or negative maximum)" SLONG ROTPOS 1 100 -32000.0097656 32000.0097656 FORMAT "%13.7" ECU_ADDRESS 0xFEBE8DE8 /end MEASUREMENT
/begin MEASUREMENT wHndOff_RotPosGradAveragingArray_xau32 "RotPosGradient averaging array." ULONG ROTPOS 1 100 0 23000.0097656 FORMAT "%13.7" ECU_ADDRESS 0xFEBE9988 MATRIX_DIM 5 1 1 /end MEASUREMENT
/begin MEASUREMENT wHndOff_StoredRotPos_xds32 "stored rotor postion of hysteresis" SLONG ROTPOS 1 100 -32000.0097656 32000.0097656 FORMAT "%13.7" ECU_ADDRESS 0xFEBE8DEC /end MEASUREMENT
/begin MEASUREMENT wHwlWrapI_PowerOnSteeringAngle_xdf32 "Status der PowerOnLenkungswinkel" FLOAT32_IEEE ZU0 1 100 0 45.582 FORMAT "%10.7" ECU_ADDRESS 0xFEBE4AA4 /end MEASUREMENT
/begin MEASUREMENT wHwlWrapI_TorsionBarTwist_xdf32 "Drehwinkel des Torsionsstabs" FLOAT32_IEEE ZU0 1 100 -0.55 0.55 FORMAT "%11.9" ECU_ADDRESS 0xFEBE4AA8 /end MEASUREMENT
/begin MEASUREMENT wLaI_SteeringAngleReq_xds16 "LKA: Request steering angle" SWORD SA_10 1 100 -780 780 FORMAT "%8.4" ECU_ADDRESS 0xFEBE92A6 /end MEASUREMENT
/begin MEASUREMENT wLa_LimitedSteerAngReq_xds16 "LKA: Limited steering angle Req" SWORD SA_10 1 100 -780 780 FORMAT "%8.4" ECU_ADDRESS 0xFEBE92A8 /end MEASUREMENT
/begin MEASUREMENT xApplI_GearSign_xds8 "Vorzeichen Lenkgetriebe positiv (1)/ negativ (-1) im EEPROM" SBYTE ZU0 1 100 -1 1 FORMAT "%5.3" ECU_ADDRESS 0xFEBE4B24 /end MEASUREMENT
/begin MEASUREMENT xFctCoI_AssistPostscaler_xdu16 "Faktor auf das angeforderte Moment nach Assist/BST" UWORD RIGHTSH10NP 1 100 0.2001953 5 FORMAT "%8.6" ECU_ADDRESS 0xFEBE933A /end MEASUREMENT
/begin MEASUREMENT xFctCoI_AssistPrescaler_xdu16 "Faktor auf die Zahnstangenkraft vor Assist/BST" UWORD RIGHTSH10NP 1 100 0.2001953 5 FORMAT "%8.6" ECU_ADDRESS 0xFEBE933C /end MEASUREMENT
/begin MEASUREMENT xHwlWrapI_CurrentLowestReductionLevel_xdu16 "Aktuell niedrigstes Reduktionslevel aus dem Array xHwlI_TorqueRedLevels_gau16[]" UWORD RIGHTSH15NP 1 100 0 1 FORMAT "%8.6" ECU_ADDRESS 0xFEBE4B04 /end MEASUREMENT
/begin MEASUREMENT xHwlWrapI_FadeOutDampingRatio_xdf32 "Fadeout Damping ratio" FLOAT32_IEEE ZU0 1 100 0 100 FORMAT "%10.6" ECU_ADDRESS 0xFEBE4AAC /end MEASUREMENT
/begin MEASUREMENT xHwlWrapI_MinRedLevel_xdu16 "Aktueller minimaler Reduktionsfaktor" UWORD RIGHTSH15NP 1 100 0 1 FORMAT "%8.6" ECU_ADDRESS 0xFEBE4B06 /end MEASUREMENT
/begin MEASUREMENT xHwlWrapI_RedPreWarnLevels_gau16 "Torque Red level" UWORD ZU0 1 100 0 100 FORMAT "%8.4" ECU_ADDRESS 0xFEBE4B2C MATRIX_DIM 10 1 1 /end MEASUREMENT
/begin MEASUREMENT xHwlWrapI_TorqueClipLevels_xau16 "Reduktionskan?le f?r Drehmomentbegrenzung" UWORD ZU0 1 100 0 100 FORMAT "%8.4" ECU_ADDRESS 0xFEBE4AB0 MATRIX_DIM 2 1 1 /end MEASUREMENT
/begin MEASUREMENT xHwlWrapI_TorqueRedLevels_xau16 "Torque Red level" UWORD ZU0 1 100 0 100 FORMAT "%8.4" ECU_ADDRESS 0xFEBE4B40 MATRIX_DIM 10 1 1 /end MEASUREMENT
/begin MEASUREMENT xLaI_ActiveReturnFuncFactor_xdu16 "" UWORD RIGHTSH10NP 1 100 0 1 FORMAT "%8.6" ECU_ADDRESS 0xFEBE933E /end MEASUREMENT
/begin MEASUREMENT xLaI_CheckedActiveRetFuncFact_xdu16 "" UWORD RIGHTSH10NP 1 100 0 1 FORMAT "%8.6" ECU_ADDRESS 0xFEBE9340 /end MEASUREMENT
/begin MEASUREMENT xLaI_DesActiveRetDampFact_xdu16 "" UWORD RIGHTSH10NP 1 100 0 1 FORMAT "%8.6" ECU_ADDRESS 0xFEBE9342 /end MEASUREMENT
/begin MEASUREMENT xLaI_DesActiveRetFuncFact_xdu16 "" UWORD RIGHTSH10NP 1 100 0 1 FORMAT "%8.6" ECU_ADDRESS 0xFEBE9344 /end MEASUREMENT
/begin MEASUREMENT xLaI_DesActiveRetSpFact_xdu16 "" UWORD RIGHTSH10NP 1 100 0 1 FORMAT "%8.6" ECU_ADDRESS 0xFEBE9346 /end MEASUREMENT
/begin MEASUREMENT xLaI_TorqOverlayCoefnt_xdu16 "Coefficient on Torque overlay of LA function" UWORD RIGHTSH10NP 1 100 0 1 FORMAT "%8.6" ECU_ADDRESS 0xFEBE9348 /end MEASUREMENT
/begin MEASUREMENT xLa_ActiveRetSpFactChecked_xdu16 "" UWORD RIGHTSH10NP 1 100 0 63.99902 FORMAT "%8.5" ECU_ADDRESS 0xFEBE934A /end MEASUREMENT
/begin MEASUREMENT xLa_ActReturnFuncFactInject_xdu16 "" UWORD RIGHTSH10NP 1 100 0 63.99902 FORMAT "%8.5" ECU_ADDRESS 0xFEBE934C /end MEASUREMENT
/begin MEASUREMENT xLa_DriverFactorY_xau16 "Y-Values of the interpolated Driver factor characteristic" UWORD RIGHTSH14NP 1 100 0 3.999939 FORMAT "%8.6" ECU_ADDRESS 0xFEBE9A98 MATRIX_DIM 6 1 1 /end MEASUREMENT
/begin MEASUREMENT xLa_InjectReturnFuncFactor_xdu16 "" UWORD RIGHTSH10NP 1 100 0 63.99902 FORMAT "%8.5" ECU_ADDRESS 0xFEBE934E /end MEASUREMENT
/begin MEASUREMENT xLa_RackSpeedIFactorY_xau16 "Y1-Values of the interpolated Driver factor characteristic" UWORD RIGHTSH14NP 1 100 0 3.999939 FORMAT "%8.6" ECU_ADDRESS 0xFEBE9AA4 MATRIX_DIM 6 1 1 /end MEASUREMENT
/begin MEASUREMENT xLdw_AmplitudeFactor_xdu16 "" UWORD MMOT 1 100 0 100 FORMAT "%8.4" ECU_ADDRESS 0xFEBE9354 /end MEASUREMENT
/begin MEASUREMENT xtcLimMotTorFactor_xdu16 "Faktor zur Begrenzung des Motormoments" UWORD RSH15 1 100 0 100 FORMAT "%8.4" ECU_ADDRESS 0xFEBE4B08 /end MEASUREMENT
/begin MEASUREMENT yeeRackType_xdu8 "Lenkungstyp" UBYTE ZU0 1 100 0 255 FORMAT "%5.1" ECU_ADDRESS 0xFEBE4B25 /end MEASUREMENT
/begin MEASUREMENT yEpsInI_CharismaSelected_xdu8 "Sport-Umschaltung" UBYTE ZU0 1 100 0 15 FORMAT "%5.2" ECU_ADDRESS 0xFEBE9627 /end MEASUREMENT
/begin MEASUREMENT yEpsInI_VehicleCoding_xdu8 "Berechnete EPS Varianten-Codierung" UBYTE ZU0 1 100 0 139 FORMAT "%5.1" ECU_ADDRESS 0xFEBE9628 /end MEASUREMENT
/begin MEASUREMENT yFctCo_Dummy_xdu8 "Dummy zum Anlegen von Festkennfeldern" UBYTE AOC_FEATURES 1 100 0 15 FORMAT "%13.10" ECU_ADDRESS 0xFEBE9629 /end MEASUREMENT
/begin MEASUREMENT yHndOffI_ConfidenceLevel_xdu16 "confidence level (0=low, 1=high, SNA=DetectionImpossible)" UWORD RIGHTSH15NP 1 100 0 1 FORMAT "%8.6" ECU_ADDRESS 0xFEBE93BC /end MEASUREMENT
/begin MEASUREMENT yHndOff_ConfLevel_xdu32 "internal confidence level" ULONG RIGHTSH20NP 1 100 0 1 FORMAT "%13.11" ECU_ADDRESS 0xFEBE8EA0 /end MEASUREMENT
/begin MEASUREMENT yHwlWrapI_FocDataSelector_xdu8 "FOC data selector value from NvShare" UBYTE ZU0 1 100 0 255 FORMAT "%5.1" ECU_ADDRESS 0xFEBE4B26 /end MEASUREMENT
/begin MEASUREMENT yHwlWrapI_LocalHwLibStdSyncData_xau8 "HwLib-Daten f?r Synchronisationsnachrichten ?ber SPI und CAN" UBYTE ZU0 1 100 0 255 FORMAT "%5.1" ECU_ADDRESS 0xFEBE4B0C MATRIX_DIM 2 1 1 /end MEASUREMENT
/begin MEASUREMENT yHwlWrapI_TorqueSensorVariant_xde "HwLib Torque Sensor Variant" UBYTE ZU0 1 100 0 5 FORMAT "%5.3" ECU_ADDRESS 0xFEBE4B27 /end MEASUREMENT
/begin MEASUREMENT yHwlWrapI_TorsionBarStiffness_xdu16 "Torsion Bar Stiffness" UWORD TBTSTIFFHIGH 1 100 0 4 FORMAT "%8.6" ECU_ADDRESS 0xFEBE4B0E /end MEASUREMENT
/begin MEASUREMENT zEpsInI_UnlearnCounter_xdu8 "Diagnose Verlernzähler" UBYTE ZU0 1 100 0 254 FORMAT "%5.1" ECU_ADDRESS 0xFEBE9647 /end MEASUREMENT
/begin MEASUREMENT zFriCo_FrictionTorqueFilterCalled_xdu8 "Zahl der Aufrufe von HysteresisTorqueFilter im aktuellen Klemmenzyklus" UBYTE ZU0 1 100 0 254 FORMAT "%5.1" ECU_ADDRESS 0xFEBE9648 /end MEASUREMENT
/begin MEASUREMENT zHystDect_JobcallCounter_xdu16 "Jobcallback Counter" UWORD ZU0 1 100 0 65535 FORMAT "%8.2" ECU_ADDRESS 0xFEBE93EA /end MEASUREMENT
/begin MEASUREMENT zLaI_ChatterDetectCount_xdu8 "counter of the delay chatter detection" UBYTE ZU0 1 100 0 50 FORMAT "%5.2" ECU_ADDRESS 0xFEBE9419 /end MEASUREMENT
/begin MEASUREMENT zLa_ChatterDetectCount_xdf32 "" FLOAT32_IEEE ZU0 1 100 0 50 FORMAT "%10.7" ECU_ADDRESS 0xFEBE8EF0 /end MEASUREMENT
/begin COMPU_METHOD AOC_FEATURES "" TAB_VERB "%6.3" "Feature" COMPU_TAB_REF AOC_FEATURES /end COMPU_METHOD
/begin COMPU_METHOD AOC_FEAT_STATE "" TAB_VERB "%6.3" "Status" COMPU_TAB_REF AOC_FEAT_STATE /end COMPU_METHOD
/begin COMPU_METHOD BIT "" RAT_FUNC "%6.2" "Bitanzeige" COEFFS 0 1 0 0 0 1 /end COMPU_METHOD
/begin COMPU_METHOD FREQ "" RAT_FUNC "%6.2" "Hz" COEFFS 0 1 0 0 0 1 /end COMPU_METHOD
/begin COMPU_METHOD FRICFILT "" RAT_FUNC "%12.11" "Nm" COEFFS 0 1073741824 0 0 0 1 /end COMPU_METHOD
/begin COMPU_METHOD INERTOR_HIGH "" RAT_FUNC "%7.6" "g * mÂ²" COEFFS 0 16384 0 0 0 1 /end COMPU_METHOD
/begin COMPU_METHOD MMOT "" RAT_FUNC "%6.5" "Nm" COEFFS 0 1024 0 0 0 1 /end COMPU_METHOD
/begin COMPU_METHOD RACKPOS128 "" RAT_FUNC "%6.4" "mm" COEFFS 0 128 0 0 0 1 /end COMPU_METHOD
/begin COMPU_METHOD RACKSPEED128 "" RAT_FUNC "%6.4" "mm/s" COEFFS 0 128 0 0 0 1 /end COMPU_METHOD
/begin COMPU_METHOD RAMPRATE "" RAT_FUNC "%6.5" "Nm/s" COEFFS 0 1024 0 0 0 1 /end COMPU_METHOD
/begin COMPU_METHOD RIGHTSH10NP "" RAT_FUNC "%6.5" "" COEFFS 0 1024 0 0 0 1 /end COMPU_METHOD
/begin COMPU_METHOD RIGHTSH14NP "" RAT_FUNC "%7.6" "" COEFFS 0 16384 0 0 0 1 /end COMPU_METHOD
/begin COMPU_METHOD RIGHTSH15NP "" RAT_FUNC "%7.6" "" COEFFS 0 32768 0 0 0 1 /end COMPU_METHOD
/begin COMPU_METHOD RIGHTSH20NP "" RAT_FUNC "%9.8" "" COEFFS 0 1048576 0 0 0 1 /end COMPU_METHOD
/begin COMPU_METHOD ROTACC "" RAT_FUNC "%6.4" "1/min/ms" COEFFS 0 64 0 0 0 1 /end COMPU_METHOD
/begin COMPU_METHOD ROTPOS "" RAT_FUNC "%6.3" "Â°" COEFFS 0 11.3777777778 0 0 0 1 /end COMPU_METHOD
/begin COMPU_METHOD RSH15 "" RAT_FUNC "%6.4" "%" COEFFS 0 327.68 0 0 0 1 /end COMPU_METHOD
/begin COMPU_METHOD RSH15_GRAD1S "" RAT_FUNC "%6.4" "% / s" COEFFS 0 327.68 0 0 0 1 /end COMPU_METHOD
/begin COMPU_METHOD SAS_8 "" RAT_FUNC "%6.3" "Â°/s" COEFFS 0 8 0 0 0 1 /end COMPU_METHOD
/begin COMPU_METHOD SAS_FOURTH "" RAT_FUNC "%6.2" "Â°/s" COEFFS 0 0.25 0 0 0 1 /end COMPU_METHOD
/begin COMPU_METHOD SA_10 "" RAT_FUNC "%6.3" "Â°" COEFFS 0 10 0 0 0 1 /end COMPU_METHOD
/begin COMPU_METHOD SA_THIRD "" RAT_FUNC "%6.2" "Â°" COEFFS 0 0.333333333333 0 0 0 1 /end COMPU_METHOD
/begin COMPU_METHOD SM_I "" RAT_FUNC "%6.4" "A" COEFFS 0 16 0 0 0 1 /end COMPU_METHOD
/begin COMPU_METHOD STATUS "" RAT_FUNC "%6.2" "Status" COEFFS 0 1 0 0 0 1 /end COMPU_METHOD
/begin COMPU_METHOD TBTHIGH "" RAT_FUNC "%6.5" "Nm" COEFFS 0 1024 0 0 0 1 /end COMPU_METHOD
/begin COMPU_METHOD TBTSTIFFHIGH "" RAT_FUNC "%6.5" "NM / Â°" COEFFS 0 1024 0 0 0 1 /end COMPU_METHOD
/begin COMPU_METHOD TBT_RSH5 "" RAT_FUNC "%6.4" "Nm" COEFFS 0 32 0 0 0 1 /end COMPU_METHOD
/begin COMPU_METHOD TBT_RSH7 "" RAT_FUNC "%6.4" "Nm" COEFFS 0 128 0 0 0 1 /end COMPU_METHOD
/begin COMPU_METHOD TIMMIN "" RAT_FUNC "%6.2" "min" COEFFS 0 1 0 0 0 1 /end COMPU_METHOD
/begin COMPU_METHOD TIMMS "" RAT_FUNC "%6.2" "ms" COEFFS 0 1 0 0 0 1 /end COMPU_METHOD
/begin COMPU_METHOD TIMMS_100US "" RAT_FUNC "%6.3" "ms" COEFFS 0 10 0 0 0 1 /end COMPU_METHOD
/begin COMPU_METHOD TIMS "" RAT_FUNC "%6.2" "s" COEFFS 0 1 0 0 0 1 /end COMPU_METHOD
/begin COMPU_METHOD TIMSEC "" RAT_FUNC "%6.4" "SEC" COEFFS 0 100 0 0 0 1 /end COMPU_METHOD
/begin COMPU_METHOD TIMSEC_10 "" RAT_FUNC "%6.3" "s" COEFFS 0 10 0 0 0 1 /end COMPU_METHOD
/begin COMPU_METHOD TIMSEC_100 "" RAT_FUNC "%6.4" "s" COEFFS 0 100 0 0 0 1 /end COMPU_METHOD
/begin COMPU_METHOD TIMSEC_1000 "" RAT_FUNC "%6.5" "s" COEFFS 0 1000 0 0 0 1 /end COMPU_METHOD
/begin COMPU_METHOD TIMUS "" RAT_FUNC "%6.2" "us" COEFFS 0 1 0 0 0 1 /end COMPU_METHOD
/begin COMPU_METHOD TMPOUTS "" RAT_FUNC "%6.2" "Â°C" COEFFS 0 1 70 0 0 1 /end COMPU_METHOD
/begin COMPU_METHOD TORFACT "" RAT_FUNC "%7.6" "Nms/Â°" COEFFS 0 32768 0 0 0 1 /end COMPU_METHOD
/begin COMPU_METHOD TORGRAD "" RAT_FUNC "%6.5" "Nm/ms" COEFFS 0 1024 0 0 0 1 /end COMPU_METHOD
/begin COMPU_METHOD U64V "" RAT_FUNC "%6.4" "V" COEFFS 0 64 0 0 0 1 /end COMPU_METHOD
/begin COMPU_METHOD VFZ "" RAT_FUNC "%6.2" "km/h" COEFFS 0 1 0 0 0 1 /end COMPU_METHOD
/begin COMPU_METHOD VFZHIGH "" RAT_FUNC "%6.4" "km/h" COEFFS 0 64 0 0 0 1 /end COMPU_METHOD
/begin COMPU_METHOD VROT "" RAT_FUNC "%3.1" "1/min" COEFFS 0 1 0 0 0 1 /end COMPU_METHOD
/begin COMPU_METHOD ZU0 "" RAT_FUNC "%6.2" "" COEFFS 0 1 0 0 0 1 /end COMPU_METHOD
/begin COMPU_VTAB AOC_FEATURES "" TAB_VERB 16 0 "PDC" 1 "PDC_Estimator" 2 "ANC" 3 "EAC" 4 "LXA" 5 "LDW" 6 "TSC" 7 "TSC_Estimator" 8 "DSR" 9 "DSR_Estimator" 10 "tbd_1" 11 "tbd_1_Estimator" 12 "tbd_2" 13 "tbd_2_Estimator" 14 "tbd_3" 15 "tbd_3_Estimator" DEFAULT_VALUE "undefined" /end COMPU_VTAB
/begin COMPU_VTAB AOC_FEAT_STATE "" TAB_VERB 6 0 "StatePassive" 1 "StateReqForActivation" 2 "StateRampIn" 3 "StateActive" 4 "StateRampOut" 5 "StateLocked" DEFAULT_VALUE "undefined" /end COMPU_VTAB
/begin FUNCTION FrictionCompensation "Reibungskompensation"
 /begin DEF_CHARACTERISTIC mFriCo_FrictionCompFixValue_XDU16 mFriCo_FrictionCompMax_XDU16 mFriCo_FrictionCompMin_XDU16 mFriCo_FrictionDeadZone_XDU16 mFriCo_FrictionThreshold4Error_XDU16 mFriCo_MaxTorqueChange4Learn_XDU16 nFriCo_MaxRotorSpeed4Learn_XDU16 vFriCo_MaxVehicleSpeed4Learn_XDU16 vFriCo_MinVehicleSpeed4Learn_XDU16 wFriCo_MaxSteeringAngle4Learn_XDU16 wFriCo_SteeringAngleHysteresis_XDU16 xFriCo_CompensationTorqueFilter_XDU16 xFriCo_FilterConstantMotorTorqueFilter_XDU16 xFriCo_FrictionWeightFactor_XDU16 xFriCo_LongTermFrictionFilterConstant_XDU16 xFriCo_ShortTermFrictionFilterConstantRampUp_XDU16 xFriCo_ShortTermFrictionFilterConstant_XDU16 zFriCo_UseFastShortTermFilterFactor_XDU8 /end DEF_CHARACTERISTIC
 /begin OUT_MEASUREMENT fFriCo_JobResultOK_xdu8 fFriCo_MeasureHysteresisAllowed_xdb mFriCo_EffectiveTorque_xds16 mFriCo_FrictionFilt_xdu16 mFriCo_LimitedFrictionTorque_xdu16 mFriCo_ShortTermFrictionFilt_xds32 mFriCo_TorqueHysteresis_xdu16 wFriCo_SteeringAngleHystFilt_xds16 zFriCo_FrictionTorqueFilterCalled_xdu8 /end OUT_MEASUREMENT
/end FUNCTION
/begin FUNCTION FunctionCoordinator "FunctionCoordinator" /begin DEF_CHARACTERISTIC zFctCo_MaxNumOfCat1Channel_XDU8 /end DEF_CHARACTERISTIC
 /begin OUT_MEASUREMENT fFctCo_MaxActCat1ChannelsAchieved_xdb sFctCo_DeratingStateArray_xau8 /end OUT_MEASUREMENT
/end FUNCTION
/begin FUNCTION FunctionCoordinatorCheck "FunctionCoordinatorCheck" /end FUNCTION
/begin FUNCTION FunctionCoordinatorCheckI "FunctionCoordinatorCheckI"
 /begin OUT_MEASUREMENT sFctCoI_ArbitrationIsValid_xau8 sFctCoI_ArbitrationResult_xau8 /end OUT_MEASUREMENT
/end FUNCTION
/begin FUNCTION FunctionCoordinatorConf "FunctionCoordinatorConf"
 /begin DEF_CHARACTERISTIC sFctCo_AllowedToActivate_XAU8 sFctCo_ChannelCategory_XAU8 sFctCo_ContinueIfActive_XAU8 sFctCo_ParallelRampingAllowed_XAU8 xFctCo_LockAtDeratingLimit_XAU16 /end DEF_CHARACTERISTIC
 /begin OUT_MEASUREMENT yFctCo_Dummy_xdu8 /end OUT_MEASUREMENT
/end FUNCTION
/begin FUNCTION FunctionCoordinatorConfPlausi "FunctionCoordinatorConfPlausi" /begin DEF_CHARACTERISTIC sFctCo_ParallelActingAllowed_XAU8 /end DEF_CHARACTERISTIC /begin IN_MEASUREMENT yFctCo_Dummy_xdu8 /end IN_MEASUREMENT /end FUNCTION
/begin FUNCTION FunctionCoordinatorI "FunctionCoordinatorI"
 /begin OUT_MEASUREMENT sFctCoI_ChannelLockedByError_xau8 sFctCoI_ChannelStateArray_xau8 /end OUT_MEASUREMENT
/end FUNCTION
/begin FUNCTION FunctionCoordinatorSuppI "FunctionCoordinatorSuppI"
 /begin OUT_MEASUREMENT xFctCoI_AssistPostscaler_xdu16 xFctCoI_AssistPrescaler_xdu16 /end OUT_MEASUREMENT
/end FUNCTION
/begin FUNCTION FunctionDisplacer "Mess- und Applikationsgrößen FunctionDisplacer"
 /begin DEF_CHARACTERISTIC fFuncDispl_EnableVibration_XDU8 mFuncDispl_MaxAllowedVibrationTrq_XDU16 /end DEF_CHARACTERISTIC
 /begin OUT_MEASUREMENT fFuncDispl_Activate_xdb sFuncDispl_FctCoCtrlState_xdu8 sFuncDispl_FeatureState_xdu8 /end OUT_MEASUREMENT
/end FUNCTION
/begin FUNCTION FunctionDisplacerCheck "Interfacegrößen FunctionDisplacerCheck" /begin DEF_CHARACTERISTIC mFuncDispl_MaxSafetyMotorTorq_XDU16 /end DEF_CHARACTERISTIC
 /begin OUT_MEASUREMENT mFuncDispl_MtrTrqSaturated_xds16 sFuncDispl_PreStoreData_xdu16 /end OUT_MEASUREMENT
/end FUNCTION
/begin FUNCTION FunctionDisplacerCheckI "Interfacegrößen FunctionDisplacerCheck"
 /begin OUT_MEASUREMENT fFuncDisplI_MonSafeOk_xdb mFuncDisplI_MotorTorqueOffset_xds16 /end OUT_MEASUREMENT
/end FUNCTION
/begin FUNCTION FunctionDisplacerI "Interfacegrößen FunctionDisplacer" /begin OUT_MEASUREMENT mFuncDisplI_MotorTorque4Check_xds16 /end OUT_MEASUREMENT /end FUNCTION
/begin FUNCTION HndOff_DectHysteresisV5 "HndOff_DectHysteresisV5"
 /begin DEF_CHARACTERISTIC mHndOff_FrictionSubst_XDU8 mHndOff_GradIntegralLimit_XDU16 mHndOff_IncrLowerBorder_XDU16 mHndOff_MaxTbtRange4Lka_XAU16 mHndOff_MaxTbtRange_XAU16 mHndOff_TbtGradLimit_XDU16 mHndOff_TbtOffsetSubst_XDU8 tHndOff_CycleTimeHndOff_XDU16 tHndOff_GradMinEntryTime_XDU8 tHndOff_TimeIncrLowerBorder_XDU8 vHndOff_MinVehicleSpeed_XDU16 vHndOff_MinVehicleSpeed_XDU8 wHndOff_MinRotPosChange4Entry_XDU16 wHndOff_MinRotPosChange_XDU16 wHndOff_RotPosGradLimit_XDU16 xHndOff_GradConfLevel_XAU16 yHndOff_ConfLevelGradTarget_XDU32 /end DEF_CHARACTERISTIC
 /begin IN_MEASUREMENT mHystDectI_ColumnFriction_xdu16 vVehSpI_AbsAvgVehSpd_xdu16 /end IN_MEASUREMENT
 /begin OUT_MEASUREMENT mHndOff_AbsFCLTorqGrad_xdu16 mHndOff_StoredTbt_xds16 mHndOff_TbtGradAveragingArray_xau16 mHndOff_TbtIntegral_xds16 sHndOff_State_xds8 wHndOff_MaxRotPos_xds32 wHndOff_RotPosGradAveragingArray_xau32 wHndOff_StoredRotPos_xds32 yHndOff_ConfLevel_xdu32 /end OUT_MEASUREMENT
/end FUNCTION
/begin FUNCTION HndOff_DectHysteresisV5I "HndOff_DectHysteresisV5I" /begin OUT_MEASUREMENT yHndOffI_ConfidenceLevel_xdu16 /end OUT_MEASUREMENT /end FUNCTION
/begin FUNCTION HndOff_SignalMapping "HndOff_SignalMapping"
 /begin DEF_CHARACTERISTIC vHndOff_MaxVehicleSpeed_XDU16 xHndOff_ConfLevelThreshold_XDU16 xHndOff_HndOffModeEnableTime_XDU16 /end DEF_CHARACTERISTIC
/end FUNCTION
/begin FUNCTION HndOff_SignalMappingI "HndOff_SignalMappingI"
 /begin OUT_MEASUREMENT sHndOffI_HandsOffDetected_xdu8 sHndOffI_HandsOffEnabled_xdu8 /end OUT_MEASUREMENT
/end FUNCTION
/begin FUNCTION HWLibDamosInterface "Interfaces der Hardware lib used in ROM Kennlinie in the SDK"
 /begin DEF_CHARACTERISTIC mHwlWrapI_MaxMechAllowedTorque_XDF32 mHwlWrapI_MaxSafeRampDownReqTorque_XDU16 mHwlWrapI_MaxSafeRampUpReqTorque_XDU16 tHwlWrapI_RampUpSuspensionTime_XDU16 yHwlWrapI_InternalSasWakeUpBemfThd_XDU8 yHwlWrapI_InternalSasWakeUpPeriod_XDU8 yHwlWrapI_MaxRampUpGradient_XDU16 yHwlWrapI_SafetyRampGradient_XDU16 yHwlWrapI_SafetyRampLevel_XDU16 yHwlWrapI_SafetyRampTime_XDU32 /end DEF_CHARACTERISTIC
 /begin OUT_MEASUREMENT aHwlWrapI_RotorAcceleration_xdf32 cApplI_InternTempFilt_xdu8 cApplI_OutstageTempFilt_xdu8 cHwlWrapI_UcTempFilt_xdu8 fcuOffsetUpdateRunning_xdu8 fHwlI_Kl15State_xdu8 iApplI_BatteryCurrent_xds16 iApplI_MaxBattCurrGeneratoric_xdu16 mApplI_ActMaxMotorTorqueGeneratoric_xdu16 mApplI_ActMaxMotorTorque_xdu16 mApplI_HWLMaxUsableTorque_xdf32 mApplI_LimitedMotorTorque_xds16 mApplI_RequestedMotorTorque_xds16 mHwlWrapI_MaxUsableTorqueGen_xdf32 mHwlWrapI_ProvidedMotorTorque_xdf32 mHwlWrapI_TorsionBarTorqueRed_xds16 mHwlWrapI_TorsionBarTorque_xds16 nHwlWrapI_AbsRotSpeedVoltWeight_xdf32 nHwlWrapI_RotorSpeedFilt_xdf32 nrsI_IntRotorSpeed_xds16 sApplI_IndexSignal_xdu8 sHwlWrapI_AbsRotbasedAngleDetails_xdu32 sHwlWrapI_AbsRotbasedAngleState_xde sHwlWrapI_ActuatorState_xde sHwlWrapI_BatteryCurrentState_xde sHwlWrapI_BoardTempState_xde sHwlWrapI_ChipsetSafetyFault_xde sHwlWrapI_CurrRecalibState_xde sHwlWrapI_EcuIntConnState_xde sHwlWrapI_EsbState_xde sHwlWrapI_GuardStatusInfo_xde sHwlWrapI_IndexSensSignalState_xde sHwlWrapI_LimitedMotorTorqueState_xde sHwlWrapI_PhaseCurrentState_xde sHwlWrapI_PowerOnSteeringAngleState_xde sHwlWrapI_RotorAccelerationState_xde sHwlWrapI_RotorPositionState_xde sHwlWrapI_RotorSpeedState_xde sHwlWrapI_SafeState_xde sHwlWrapI_SafetyRampControl_xdu8 sHwlWrapI_SystemVoltageState_xde sHwlWrapI_TorqueClipLevelsState_xde sHwlWrapI_TorqueRedLevelsState_xde sHwlWrapI_TorsionBarTorqueState_xde sHwlWrapI_UcTempState_xde sHwlWrapI_VehPowerSupplyTestResult_xde sHwlWrapI_WakeUpCondition_xde tHwlWrapI_TaskActSysTime_xdu16 tHwlWrapI_TorsionBarTorqueSampleTimeRed_xdu16 tHwlWrapI_TorsionBarTorqueSampleTime_xdu16 uApplI_SupplyVoltage_xdu16 uHwlWrapI_IgnitionFilt_xdf32 uHwlWrapI_SupplyVoltageUnfilt_xdf32 vApplWrapI_AbsSafeVehicleSpeed_xdu16 wApplI_RelRotorPosition_xdu16 wApplI_RotorPosition_xds32 wHwlWrapI_PowerOnSteeringAngle_xdf32 wHwlWrapI_TorsionBarTwist_xdf32 xApplI_GearSign_xds8 xHwlWrapI_CurrentLowestReductionLevel_xdu16 xHwlWrapI_FadeOutDampingRatio_xdf32 xHwlWrapI_MinRedLevel_xdu16 xHwlWrapI_RedPreWarnLevels_gau16 xHwlWrapI_TorqueClipLevels_xau16 xHwlWrapI_TorqueRedLevels_xau16 xtcLimMotTorFactor_xdu16 yeeRackType_xdu8 yHwlWrapI_FocDataSelector_xdu8 yHwlWrapI_LocalHwLibStdSyncData_xau8 yHwlWrapI_TorqueSensorVariant_xde yHwlWrapI_TorsionBarStiffness_xdu16 /end OUT_MEASUREMENT
/end FUNCTION
/begin FUNCTION HystDect_Activation "HystDect_Activation" /begin DEF_CHARACTERISTIC fHystDect_ActivateHystDetection_XDB /end DEF_CHARACTERISTIC /end FUNCTION
/begin FUNCTION HystDect_ActivationI "HystDect_ActivationI" /begin OUT_MEASUREMENT fHystDectI_Activate_xdb /end OUT_MEASUREMENT /end FUNCTION
/begin FUNCTION HystDect_TbtOverRotPos "HystDect_TbtOverRotPos"
 /begin DEF_CHARACTERISTIC fHystDect_ResetDataManually_XDB mHystDect_MaxColumnFriction_XDU8 mHystDect_MaxTbtRange_XDU16 mHystDect_MaxTbt_XDU8 mHystDect_MaxTorqueGradient_XDU16 mHystDect_MaxTorqueOffset_XDU8 tHystDect_CycleTimeHystDectSigProcessing_XDU16 tHystDect_CycleTimeHystDect_XDU16 tHystDect_MinLearnTime_XDU8 tHystDect_WarmUpPhase_XDU8 vHystDect_MaxSteerAngleSpeed_XDU8 vHystDect_MinVehSpeed_XDU8 wHystDect_MaxOppositeRotPos_XDU8 wHystDect_MaxRotPosChange4RateLimExtender_XDU16 wHystDect_MaxSteerAngle_XDU8 wHystDect_MinRotPosChange_XDU16 xHystDect_MaxTorqueGradientExtendeder_XDU16 xHystDect_TbtFilterFactor_XDU16 xHystDect_TbtLdwFilterFactor_XDU16 /end DEF_CHARACTERISTIC
 /begin OUT_MEASUREMENT fHystDect_ImmediateNvMWrite_xdb fHystDect_NvMStatus_xdb fHystDect_NvMWriteError_xdb mHystDect_NegativeHyst_xds16 mHystDect_PositiveHyst_xds16 sHystDect_JobResultOk_xdu8 sHystDect_NvWriteState_xdu8 sHystDect_ResetData_xdu8 sHystDect_State_xds8 zHystDect_JobcallCounter_xdu16 /end OUT_MEASUREMENT
/end FUNCTION
/begin FUNCTION HystDect_TbtOverRotPosI "HystDect_TbtOverRotPosI"
 /begin OUT_MEASUREMENT mHystDectI_ColumnFriction_xdu16 mHystDectI_TorqueOffset_xds16 mHystDectI_TorsionBarTorqueFilt_xds16 /end OUT_MEASUREMENT
/end FUNCTION
/begin FUNCTION HysteresisTorque "Hysterese"
 /begin DEF_CHARACTERISTIC mHystTor_MaxHystTor_XDU16 xHystTor_DeadZoneStSpeed_XDU16_00___A xHystTor_DeadZoneStSpeed_XDU16_01___A xHystTor_DeadZoneStSpeed_XDU16_02___A xHystTor_DeadZoneStSpeed_XDU16_03___A xHystTor_DeadZoneStSpeed_XDU16_04___A xHystTor_DeadZoneStSpeed_XDU16_05___A xHystTor_DeadZoneStSpeed_XDU16_06___A xHystTor_DeadZoneStSpeed_XDU16_07___A xHystTor_DeadZoneStSpeed_XDU16_08___A xHystTor_DeadZoneStSpeed_XDU16_09___A xHystTor_DeadZoneStSpeed_XDU16_10___A xHystTor_DeadZoneStSpeed_XDU16_11___A xHystTor_DeadZoneStSpeed_XDU16_12___A xHystTor_DeadZoneStSpeed_XDU16_13___A xHystTor_DeadZoneStSpeed_XDU16_14___A xHystTor_DeadZoneStSpeed_XDU16_15___A xHystTor_DeadZoneStSpeed_XDU16_16___A xHystTor_DeadZoneStSpeed_XDU16_17___A xHystTor_DeadZoneStSpeed_XDU16_18___A xHystTor_DeadZoneStSpeed_XDU16_19___A xHystTor_DeadZoneStSpeed_XDU16_20___A xHystTor_DeadZoneStSpeed_XDU16_21___A xHystTor_DeadZoneStSpeed_XDU16_22___A xHystTor_DeadZoneStSpeed_XDU16_23___A xHystTor_DeadZoneStSpeed_XDU16_24___A xHystTor_DeadZoneStSpeed_XDU16_25___A xHystTor_DeadZoneStSpeed_XDU16_26___A xHystTor_DeadZoneStSpeed_XDU16_27___A xHystTor_DeadZoneStSpeed_XDU16_28___A xHystTor_DeadZoneStSpeed_XDU16_29___A xHystTor_DeadZoneStSpeed_XDU16_30___A xHystTor_DeadZoneStSpeed_XDU16_31___A xHystTor_DeadZoneStSpeed_XDU16_32___A xHystTor_DeadZoneStSpeed_XDU16_33___A xHystTor_DeadZoneStSpeed_XDU16_34___A xHystTor_DeadZoneStSpeed_XDU16_35___A xHystTor_FactOfNominalTorque_XDS16 xHystTor_HystTorFact_XDU16 xHystTor_LowPassFilterFact_XDU16 xHystTor_StSpeed2TorFact_XDU16_00___A xHystTor_StSpeed2TorFact_XDU16_01___A xHystTor_StSpeed2TorFact_XDU16_02___A xHystTor_StSpeed2TorFact_XDU16_03___A xHystTor_StSpeed2TorFact_XDU16_04___A xHystTor_StSpeed2TorFact_XDU16_05___A xHystTor_StSpeed2TorFact_XDU16_06___A xHystTor_StSpeed2TorFact_XDU16_07___A xHystTor_StSpeed2TorFact_XDU16_08___A xHystTor_StSpeed2TorFact_XDU16_09___A xHystTor_StSpeed2TorFact_XDU16_10___A xHystTor_StSpeed2TorFact_XDU16_11___A xHystTor_StSpeed2TorFact_XDU16_12___A xHystTor_StSpeed2TorFact_XDU16_13___A xHystTor_StSpeed2TorFact_XDU16_14___A xHystTor_StSpeed2TorFact_XDU16_15___A xHystTor_StSpeed2TorFact_XDU16_16___A xHystTor_StSpeed2TorFact_XDU16_17___A xHystTor_StSpeed2TorFact_XDU16_18___A xHystTor_StSpeed2TorFact_XDU16_19___A xHystTor_StSpeed2TorFact_XDU16_20___A xHystTor_StSpeed2TorFact_XDU16_21___A xHystTor_StSpeed2TorFact_XDU16_22___A xHystTor_StSpeed2TorFact_XDU16_23___A xHystTor_StSpeed2TorFact_XDU16_24___A xHystTor_StSpeed2TorFact_XDU16_25___A xHystTor_StSpeed2TorFact_XDU16_26___A xHystTor_StSpeed2TorFact_XDU16_27___A xHystTor_StSpeed2TorFact_XDU16_28___A xHystTor_StSpeed2TorFact_XDU16_29___A xHystTor_StSpeed2TorFact_XDU16_30___A xHystTor_StSpeed2TorFact_XDU16_31___A xHystTor_StSpeed2TorFact_XDU16_32___A xHystTor_StSpeed2TorFact_XDU16_33___A xHystTor_StSpeed2TorFact_XDU16_34___A xHystTor_StSpeed2TorFact_XDU16_35___A xHystTor_TBTFact_XAU16_00___A xHystTor_TBTFact_XAU16_01___A xHystTor_TBTFact_XAU16_02___A xHystTor_TBTFact_XAU16_03___A xHystTor_TBTFact_XAU16_04___A xHystTor_TBTFact_XAU16_05___A xHystTor_TBTFact_XAU16_06___A xHystTor_TBTFact_XAU16_07___A xHystTor_TBTFact_XAU16_08___A xHystTor_TBTFact_XAU16_09___A xHystTor_TBTFact_XAU16_10___A xHystTor_TBTFact_XAU16_11___A xHystTor_TBTFact_XAU16_12___A xHystTor_TBTFact_XAU16_13___A xHystTor_TBTFact_XAU16_14___A xHystTor_TBTFact_XAU16_15___A xHystTor_TBTFact_XAU16_16___A xHystTor_TBTFact_XAU16_17___A xHystTor_TBTFact_XAU16_18___A xHystTor_TBTFact_XAU16_19___A xHystTor_TBTFact_XAU16_20___A xHystTor_TBTFact_XAU16_21___A xHystTor_TBTFact_XAU16_22___A xHystTor_TBTFact_XAU16_23___A xHystTor_TBTFact_XAU16_24___A xHystTor_TBTFact_XAU16_25___A xHystTor_TBTFact_XAU16_26___A xHystTor_TBTFact_XAU16_27___A xHystTor_TBTFact_XAU16_28___A xHystTor_TBTFact_XAU16_29___A xHystTor_TBTFact_XAU16_30___A xHystTor_TBTFact_XAU16_31___A xHystTor_TBTFact_XAU16_32___A xHystTor_TBTFact_XAU16_33___A xHystTor_TBTFact_XAU16_34___A xHystTor_TBTFact_XAU16_35___A xHystTor_TBTFilterFact_XDU16 xHystTor_VehicleFact_XAU16_00___A xHystTor_VehicleFact_XAU16_01___A xHystTor_VehicleFact_XAU16_02___A xHystTor_VehicleFact_XAU16_03___A xHystTor_VehicleFact_XAU16_04___A xHystTor_VehicleFact_XAU16_05___A xHystTor_VehicleFact_XAU16_06___A xHystTor_VehicleFact_XAU16_07___A xHystTor_VehicleFact_XAU16_08___A xHystTor_VehicleFact_XAU16_09___A xHystTor_VehicleFact_XAU16_10___A xHystTor_VehicleFact_XAU16_11___A xHystTor_VehicleFact_XAU16_12___A xHystTor_VehicleFact_XAU16_13___A xHystTor_VehicleFact_XAU16_14___A xHystTor_VehicleFact_XAU16_15___A xHystTor_VehicleFact_XAU16_16___A xHystTor_VehicleFact_XAU16_17___A xHystTor_VehicleFact_XAU16_18___A xHystTor_VehicleFact_XAU16_19___A xHystTor_VehicleFact_XAU16_20___A xHystTor_VehicleFact_XAU16_21___A xHystTor_VehicleFact_XAU16_22___A xHystTor_VehicleFact_XAU16_23___A xHystTor_VehicleFact_XAU16_24___A xHystTor_VehicleFact_XAU16_25___A xHystTor_VehicleFact_XAU16_26___A xHystTor_VehicleFact_XAU16_27___A xHystTor_VehicleFact_XAU16_28___A xHystTor_VehicleFact_XAU16_29___A xHystTor_VehicleFact_XAU16_30___A xHystTor_VehicleFact_XAU16_31___A xHystTor_VehicleFact_XAU16_32___A xHystTor_VehicleFact_XAU16_33___A xHystTor_VehicleFact_XAU16_34___A xHystTor_VehicleFact_XAU16_35___A /end DEF_CHARACTERISTIC
 /begin IN_MEASUREMENT vApplI_AbsVehicleSpeedFilt_xdu16 /end IN_MEASUREMENT
 /begin OUT_MEASUREMENT mHystTor_TBTFilt_xdu16 /end OUT_MEASUREMENT
/end FUNCTION
/begin FUNCTION HysteresisTorqueI "Hysterese" /begin OUT_MEASUREMENT mHystTorI_NominalSteerTorque_xds16 /end OUT_MEASUREMENT /end FUNCTION
/begin FUNCTION IEpsInput "Interfacegrößen der Komponente EpsInput"
 /begin OUT_MEASUREMENT nEpsInI_EngineSpeed_xdu16 sEpsInI_CommBusTml15_xdu8 sEpsInI_HybridVehicle_xdu8 tEpsInI_DiagInfo1_xau8 vEpsInI_VehicleSpeedRaw_xds16 vEpsInI_WheelSpeedFLDiv_xds16 vEpsInI_WheelSpeedFL_xds16 vEpsInI_WheelSpeedFRDiv_xds16 vEpsInI_WheelSpeedFR_xds16 vEpsInI_WheelSpeedRLDiv_xds16 vEpsInI_WheelSpeedRL_xds16 vEpsInI_WheelSpeedRRDiv_xds16 vEpsInI_WheelSpeedRR_xds16 wEpsInI_SteeringAngleExtern_xds16 yEpsInI_CharismaSelected_xdu8 yEpsInI_VehicleCoding_xdu8 zEpsInI_UnlearnCounter_xdu8 /end OUT_MEASUREMENT
/end FUNCTION
/begin FUNCTION IFailureInjection "Interfacegrößen für Fehleraufschaltung"
 /begin DEF_CHARACTERISTIC sFaInTI_EnableInjection_XDU8 sFaInTI_RPSL2Active_XDU8 sFaInTI_RPSOffsetActive_XDU8 sFaInTI_TBTL2Active_XDU8 sFaInTI_TBTOffsetActive_XDU8 /end DEF_CHARACTERISTIC
/end FUNCTION
/begin FUNCTION IFrictionCompensation "Schnittstellen Reibungskompensation" /begin OUT_MEASUREMENT mFriCoI_CompensationTorque_xds16 mFriCoI_LTFriction_xdu32 /end OUT_MEASUREMENT /end FUNCTION
/begin FUNCTION Ignition "Ignition calculation" /begin OUT_MEASUREMENT sIgniI_IgnitionEnabled_xdu8 /end OUT_MEASUREMENT /end FUNCTION
/begin FUNCTION IInertiaModification "Trägheitskompensation - Interfacegrößen" /begin OUT_MEASUREMENT mInCoI_InertiaComp_xds16 /end OUT_MEASUREMENT /end FUNCTION
/begin FUNCTION ILaneAssistChatterDetect "LaneAssistChatterDetect - interface" /begin OUT_MEASUREMENT zLaI_ChatterDetectCount_xdu8 /end OUT_MEASUREMENT /end FUNCTION
/begin FUNCTION InertiaModification "Trägheitskompensation - Mess- und Applikationsgrößen"
 /begin DEF_CHARACTERISTIC aInCo_RotAccDeadZone_XDU16 mInCo_InertiaCompLimit_XDS16 xInCo_ChatterRotAccFactor_XAS16 xInCo_InvalidInputSigRotAccFactor_XDS16 xInCo_RotAccFactor_XAS16_00___A xInCo_RotAccFactor_XAS16_01___A xInCo_RotAccFactor_XAS16_02___A xInCo_RotAccFactor_XAS16_03___A xInCo_RotAccFactor_XAS16_04___A xInCo_RotAccFactor_XAS16_05___A xInCo_RotAccFactor_XAS16_06___A xInCo_RotAccFactor_XAS16_07___A xInCo_RotAccFactor_XAS16_08___A xInCo_RotAccFactor_XAS16_09___A xInCo_RotAccFactor_XAS16_10___A xInCo_RotAccFactor_XAS16_11___A xInCo_RotAccFactor_XAS16_12___A xInCo_RotAccFactor_XAS16_13___A xInCo_RotAccFactor_XAS16_14___A xInCo_RotAccFactor_XAS16_15___A xInCo_RotAccFactor_XAS16_16___A xInCo_RotAccFactor_XAS16_17___A xInCo_RotAccFactor_XAS16_18___A xInCo_RotAccFactor_XAS16_19___A xInCo_RotAccFactor_XAS16_20___A xInCo_RotAccFactor_XAS16_21___A xInCo_RotAccFactor_XAS16_22___A xInCo_RotAccFactor_XAS16_23___A xInCo_RotAccFactor_XAS16_24___A xInCo_RotAccFactor_XAS16_25___A xInCo_RotAccFactor_XAS16_26___A xInCo_RotAccFactor_XAS16_27___A xInCo_RotAccFactor_XAS16_28___A xInCo_RotAccFactor_XAS16_29___A xInCo_RotAccFactor_XAS16_30___A xInCo_RotAccFactor_XAS16_31___A xInCo_RotAccFactor_XAS16_32___A xInCo_RotAccFactor_XAS16_33___A xInCo_RotAccFactor_XAS16_34___A xInCo_RotAccFactor_XAS16_35___A zInCo_ChatterCountLimitInertia_XDU8 /end DEF_CHARACTERISTIC
 /begin OUT_MEASUREMENT vInCo_AbsAvgVehSpd_xdu16 /end OUT_MEASUREMENT
/end FUNCTION
/begin FUNCTION IShimmy "Shimmy Compensation" /begin OUT_MEASUREMENT mShimmyI_MotorTorque4Check_xds16 /end OUT_MEASUREMENT /end FUNCTION
/begin FUNCTION IShimmyCheck "Shimmy Compensation Check"
 /begin OUT_MEASUREMENT fShimmyI_DebouncingDetectedErrorDelay_xdb fShimmyI_MonSafeOk_xdb mShimmyI_DesMotTrqOffset_xds16 /end OUT_MEASUREMENT
/end FUNCTION
/begin FUNCTION ITorqueSignalConditioningplausi "Interfaces der TorqueSignalConditioningPlausi SDK" /begin OUT_MEASUREMENT fTscI_DisAvgBackUpMonFail_xdb /end OUT_MEASUREMENT /end FUNCTION
/begin FUNCTION LaI_RackPosFilter "LaI_RackPosFilter"
 /begin DEF_CHARACTERISTIC fLa_ActRackPosActive_XDUB fLa_EnableLaAvgFilter_XDUB xLa_RackPosPTFiltFactor_XDU16 zLa_CounterForAverage_XDU8 /end DEF_CHARACTERISTIC
/end FUNCTION
/begin FUNCTION LaI_RackPosFilterI "LaI_RackPosFilter - interface" /begin OUT_MEASUREMENT lLaI_DesiredRackPositionFilt_xds16 /end OUT_MEASUREMENT /end FUNCTION
/begin FUNCTION LaneAssistChatterDetect "LaneAssist ChatterDetect"
 /begin DEF_CHARACTERISTIC aLa_AbsChatterGrad_XDU16 aLa_InjectRotAccLim_XDS16 fLa_ChatterFunctActivated_XDU8 fLa_InjectRotAccEnable_XDU8 tLa_ChatterDetectRecoverTime_XDU16 tLa_ChatterDetectTime_XDU16 tLa_InjectChatterContinueTime_XDU16 tLa_InjectRotAccCycleTimeLim_XDU16 tLa_InjectRotAccCycleTime_XDU16 zLa_MaxChatterPeriodsCount_XDU8 /end DEF_CHARACTERISTIC
 /begin OUT_MEASUREMENT sLa_ChatterDetectionState_xdu8 sLa_LdwState_xdu8 tLa_ChatterTime_xdu16 /end OUT_MEASUREMENT
/end FUNCTION
/begin FUNCTION LaneAssistCheck ""
 /begin DEF_CHARACTERISTIC aLa_MaxRackSpeedRampDownGradient_XDU16 fLa_CheckInjectEnable_XDB lLa_HFMaxRackPosition_XAU16 lLa_HOMaxRackPosition_XAU16 lLa_MaxRackPositionIntegral_XAU16 mLa_CheckDrvOverideTorqLim_XDU16 mLa_MaxTrqHighDepOnVelocity_XAU16 tLa_CheckDrvOverideTime_XDU16 tLa_LaCycleTime_XDU8 vLa_HFMaxRackSpeed_XAU16 vLa_HOMaxRackSpeed_XAU16 vLa_MaxRackPositionRampDownGradient_XDU16 vLa_MaxRackSpeedIntegral_XAU16 yLa_MaxIntegralValue_XDU16 /end DEF_CHARACTERISTIC
 /begin IN_MEASUREMENT vVehSpI_AbsMaxSafeVehSpd_xdu16 /end IN_MEASUREMENT
 /begin OUT_MEASUREMENT f_IntegralDisable_xdb lLa_RackPosition2HighIntegral_xds32 mLa_InjectMMOTOffset_xds16 mLa_MaxAllowedMMot_xds16 vLa_RackSpeed2HighIntegral_xds32 xLa_ActiveRetSpFactChecked_xdu16 xLa_InjectReturnFuncFactor_xdu16 /end OUT_MEASUREMENT
/end FUNCTION
/begin FUNCTION LaneAssistCheckI ""
 /begin OUT_MEASUREMENT fLaI_DriverOverrideDetected_xdb fLaI_ExtRateLimActive_xdu8 fLaI_RackPosition2HighDetected_xdb fLaI_RackSpeed2HighDetected_xdb mLaI_CheckedMotTrqOffset_xds16 xLaI_CheckedActiveRetFuncFact_xdu16 xLaI_DesActiveRetSpFact_xdu16 /end OUT_MEASUREMENT
/end FUNCTION
/begin FUNCTION LaneAssistController "LaneAssistController Regler"
 /begin DEF_CHARACTERISTIC fLa_FeedForwardEnable_XDU8 fLa_InjectLAActiveEnable_XDB fLa_LaInjectHandsModeEnable_XDU8 fLa_MMotOffsetFilter_Enable_XDB fLa_MotorTorqueDriverFactorEnable_XDB fLa_RackPositionInjectEnable_XDB fLa_RackSpeedInjectEnable_XDB fLa_TorqOverlayCoefntEnable_XDB fLa_UpLowLimEnable_XDB lLa_HFMaxDesRackPosition_XAU16 lLa_HOMaxDesRackPosition_XAU16 lLa_InjectDesiredRackPosition_XDS16 lLa_InjectDesiredRackSpeed_XDS16 mLa_HFMaxTrqHighDepOnVelocityController_XAU16 mLa_HOMaxTrqHighDepOnVelocityController_XAU16 mLa_SpeedIPartClearRampOutRate_XAF32 sLa_LaInjectHandsMode_XDU8 tLa_RackPositionInjectTime_XDU16 tLa_RackSpeedInjectTime_XDU16 vLa_DeadBandRackSpeed_XDU16 vLa_HFMaxDesRackSpeed_XAU16 vLa_HOMaxDesRackSpeed_XAU16 vLa_InjectRackPosRampRate_XDU16 vLa_MaxGradRackSpeed_XDU16 xLa_AngleCtrl_ddt_filt_fac_XDF32 xLa_BoostFactor_XDU8 xLa_IpartClearMode_XDU8 xLa_LowerRiseLimfactor_XDU16 xLa_MMotOffset_filt_fac_XDF32 xLa_MotorTorqueFactDepOnDriverV0_XAU16 xLa_MotorTorqueFactDepOnDriverV1_XAU16 xLa_MotorTorqueFactDepOnDriverV2_XAU16 xLa_MotorTorqueFactDepOnDriverV3_XAU16 xLa_MotorTorqueFactDepOnDriverV4_XAU16 xLa_MotorTorqueFactDepOnDriverV5_XAU16 xLa_PositionIMax_XDF32 xLa_PositionIPart_XAF32 xLa_PositionPPartDepOnChatter_XAF32 xLa_PositionPPart_XAF32 xLa_RackSpeedDPart_XDF32 xLa_RackSpeedIMax_XDF32 xLa_RackSpeedIPartDepOnChatter_XAF32 xLa_RackSpeedIPart_XAF32 xLa_RackSpeedPPartDepOnChatter_XAF32 xLa_RackSpeedPPart_XAF32 xLa_UpperRiseLimfactor_XDU16 zLa_UpLowerRiseCount_XDU8 zVDriverFactorCartSelect_XAU8 /end DEF_CHARACTERISTIC
 /begin IN_MEASUREMENT mApplI_AbsDriverTorque_xdu16 vVehSpI_AbsMaxSafeVehSpd_xdu16 /end IN_MEASUREMENT
 /begin OUT_MEASUREMENT lLa_RackpositionSim_xds16 mLaI_MMOTOffset_xds16 mLa_AssistAct_xds16 mLa_DriverFactorX_xau16 mLa_RackSpeedControllerDpart_xds16 mLa_RackSpeedControllerIpart_xds16 mLa_RackSpeedControllerPpart_xds16 mLa_RackSpeedIFactorX_xau16 mLa_SatMMotOffset_xds16 vLa_LimitedDesiredRackSpeed_xds16 vLa_RackSpeedSim_xds16 vVehSpI_AbsMaxSafeVehSpd_xdf32 xLa_DriverFactorY_xau16 xLa_RackSpeedIFactorY_xau16 zLa_ChatterDetectCount_xdf32 /end OUT_MEASUREMENT
/end FUNCTION
/begin FUNCTION LaneAssistControllerI "LaneAssistController Regler"
 /begin OUT_MEASUREMENT fLaI_ChatterActive_xdu8 fLaI_ExtFctLowerLimActive_xdu8 fLaI_ExtFctUpperLimActive_xdu8 mLaI_AgCtrlTqLowrLim_xds16 mLaI_AgCtrlTqUpprLim_xds16 xLaI_TorqOverlayCoefnt_xdu16 /end OUT_MEASUREMENT
/end FUNCTION
/begin FUNCTION LaneAssistDriverInLoop "LaneAssistDriverInLoop Regler"
 /begin DEF_CHARACTERISTIC fApplI_TorsionBarTorqueInjectEnable_XDB fLa_DesSteeringTorqueOffsetEnable_XDB fLa_DesSteeringTrqOffsetDependOnDrvInLoopDisable_XDB fLa_LaCtrlModSwEnable_XDB fLa_ReqStateHFInjectEnable_XDB mApplI_TorsionBarTorqueInjectValue_XDS16 mLa_DesSteeringTorqueOffsetLimit_XAS16 mLa_DriInLoopLowerLimMinValue_XAS16 mLa_DriInLoopLowerLimRampDownGradient_XAS16 mLa_DriInLoopUpperLimMinValue_XAS16 mLa_DriInLoopUpperLimRampDownGradient_XAS16 mLa_DriNotInLoopLowerLimRampUpGradient_XAS16 mLa_DriNotInLoopUpperLimRampUpGradient_XAS16 mLa_DriverInLoopThrehold_XAU16 mLa_DriverNotInLoopThrehold_XAU16 mLa_LowerLimMaxValue_XAS16 mLa_LowerLimSNAValue_XDS16 mLa_TorsionBarTorqueDeadzone_XDS16 mLa_UpperLimMaxValue_XAS16 mLa_UpperLimSNAValue_XDS16 sLa_LaCtrlModInjectValue_XDU8 sLa_ReqStateHFInjectValue_XDU8 tLa_DriverInLoopTimeThrehold_XDU16 tLa_DriverNotInLoopTimeThrehold_XDU16 /end DEF_CHARACTERISTIC
 /begin IN_MEASUREMENT vVehSpI_AbsMaxSafeVehSpd_xdu16 /end IN_MEASUREMENT
/end FUNCTION
/begin FUNCTION LaneAssistDriverInLoopI "LaneAssistDriverInLoop Regler"
 /begin OUT_MEASUREMENT mLaI_DesSteeringTorqueOffset_xds16 mLaI_LowerLimNoMap_xds16 mLaI_LowerLimTBT_xds16 mLaI_UpperLimNoMap_xds16 mLaI_UpperLimTBT_xds16 sLaI_DriverInLoopState_xdu8 /end OUT_MEASUREMENT
/end FUNCTION
/begin FUNCTION LaneAssistI ""
 /begin OUT_MEASUREMENT fLa_AngleReqOverRange_xdu8 fLa_AngleSpeedReqOverRange_xdu8 lLaI_DesiredRackPosition_xds16 mLaI_RampOutRate_xdu16 sApplI_LaSpecialModeActive_xdu8 sApplI_LaSpecialModeReq_xdu8 sApplI_LkaSta_D_Req_xdu8 sLaI_DesMotTrqOffsetValid_xdu8 sLaI_EpsLaState_xdu8 sLaI_FctCoCtrlState_xdu8 sLaI_FeatureState_xdu8 sLaI_LaCtrlMod_xdu8 sLaI_ReqStateHF_xdu8 sLaI_ReqState_xdu8 wApplI_MaxStrgReqAngVal_xds16 wApplI_MinStrgReqAngVal_xds16 wLaI_SteeringAngleReq_xds16 wLa_LimitedSteerAngReq_xds16 xLaI_ActiveReturnFuncFactor_xdu16 /end OUT_MEASUREMENT
/end FUNCTION
/begin FUNCTION LaneAssistMotorTorqueSmooth ""
 /begin DEF_CHARACTERISTIC fLa_InjectArbitrationEnable_XDB fLa_InjectMMotEnable_XDB fLa_InjectSmoothMMotEnable_XDB mLa_HFMaxTrqHighDepOnVelocity_XAU16 mLa_HOMaxTrqHighDepOnVelocity_XAU16 mLa_LaInjectMMot_XDS16 mLa_MaxMotTrqRampGradient_XDU16 sLa_LaConfigFlag_XDU8 tLa_LaInjectTorqueTime_XDU16 tLa_LaSmoothCycleTime_XDU8 tLa_LaSmoothInjectTorqueTime_XDU16 tLa_VehSpeedErrTime_XDU16 zLa_LaSmoothStep_XDU8 /end DEF_CHARACTERISTIC
 /begin IN_MEASUREMENT vVehSpI_AbsMaxSafeVehSpd_xdu16 /end IN_MEASUREMENT
 /begin OUT_MEASUREMENT fLa_LastLaArbitrationResultPassive_xdb fLa_LastNopArbitrationResultPassive_xdb fLa_MonSafeOk_xdb mLa_CheckedMMotOffset_xds16 mLa_MMotRequestChecked_xds16 mLa_MonitorMaxTrqHighDepOnVelocity_Curve_xdu16 mLa_SmoothedMotTrqOffset_xds16 sLa_HandsModeInject_xdu8 xLa_ActReturnFuncFactInject_xdu16 /end OUT_MEASUREMENT
/end FUNCTION
/begin FUNCTION LaneAssistMotorTorqueSmoothI ""
 /begin OUT_MEASUREMENT fLaI_ExtSafeLimActive_xdu8 mLaI_DesMotTrqOffset_xds16 mLaI_MaxSafetyLimitMotorTorque_xds16 mLaI_MinSafetyLimitMotorTorque_xds16 sLaI_MakeSafeAndMonState_xdu8 /end OUT_MEASUREMENT
/end FUNCTION
/begin FUNCTION LaneAssistMotorTorqueSmoothI_CMP ""
 /begin OUT_MEASUREMENT xLaI_DesActiveRetDampFact_xdu16 xLaI_DesActiveRetFuncFact_xdu16 /end OUT_MEASUREMENT
/end FUNCTION
/begin FUNCTION LaneAssistRackSpeedCalculationI "" /begin OUT_MEASUREMENT vLaI_RackSpeed_xds16 /end OUT_MEASUREMENT /end FUNCTION
/begin FUNCTION LaneAssistSupp ""
 /begin DEF_CHARACTERISTIC fLa_PinionCorrActive_XDB mLa_CheckDrvNoOverideTorqLim_XDU16 mLa_DrvOverideTorqLim_XDU16 mLa_NormalRampOutRate_XDU16 tLa_CheckDrvNoOverideTime_XDU16 tLa_CheckSpeedExceedTime_XDU16 tLa_CheckSpeedInTime_XDU16 tLa_CycleTime_XDU8 tLa_DrvOverideTime_XDU16 tLa_ReqAngSpdTime_XDU16 tLa_ReqAngTime_XDU16 tLa_RequestErrorTime_XDU16 tLa_VSEABSActiveCheckTime_XDU16 tLa_VSEABSInactiveCheckTime_XDU16 vLa_MaxRecoVehicleSpeed_XDU16 vLa_MaxVehicleSpeedInActive_XDU16 vLa_MaxVehicleSpeed_XDU16 vLa_MinVehicleSpeed_XDU16 wLa_MaxStrgReqAngValDepOnVelocity_XAU16 wLa_RateLimDepOnVelocity_XAU16 xLa_ActReturnFuncFactLA_XDU16 xLa_MulFactorVehicleSpeed_XDU16 /end DEF_CHARACTERISTIC
 /begin IN_MEASUREMENT vVehSpI_AbsMaxSafeVehSpd_xdu16 /end IN_MEASUREMENT
 /begin OUT_MEASUREMENT sLaI_ErrorCode_xdu8 /end OUT_MEASUREMENT
/end FUNCTION
/begin FUNCTION LaneDepartureWarning "LaneDepartureWarning - Interface"
 /begin DEF_CHARACTERISTIC fLdw_FinishVibrationEnable_XDB tLdw_PauseTime_XAU16 tLdw_PulseDuration_XAU16 tLdw_RampDownDuration_XAU8 tLdw_RampUpDuration_XAU8 xLdw_PulseAmplitudeFactor_XAU16_00___A xLdw_PulseAmplitudeFactor_XAU16_01___A xLdw_PulseAmplitudeFactor_XAU16_02___A xLdw_PulseAmplitudeFactor_XAU16_03___A xLdw_PulseAmplitudeFactor_XAU16_04___A xLdw_PulseAmplitudeFactor_XAU16_05___A xLdw_PulseAmplitudeFactor_XAU16_06___A xLdw_PulseAmplitudeFactor_XAU16_07___A xLdw_PulseAmplitudeFactor_XAU16_08___A xLdw_PulseAmplitudeFactor_XAU16_09___A xLdw_PulseAmplitudeFactor_XAU16_10___A xLdw_PulseAmplitudeFactor_XAU16_11___A zLdw_PulseSelection_XDU8 /end DEF_CHARACTERISTIC
 /begin OUT_MEASUREMENT xLdw_AmplitudeFactor_xdu16 /end OUT_MEASUREMENT
/end FUNCTION
/begin FUNCTION LaneDepartureWarningCheck "LaneDepartureWarningCheck"
 /begin DEF_CHARACTERISTIC fLdw_DisableNeutralCheck_XDB mLdw_MaxIntegratedTorque_XDU16 mLdw_MaxSafetyDCMotorTorque_XDU16 mLdw_MaxSafetyMotorTorq_XDU16 tLdw_CheckCycleTime_XDU16 tLdw_MaxHalfVibrationCycle_XDU8 /end DEF_CHARACTERISTIC
 /begin OUT_MEASUREMENT mLdw_IntegratedTorque_xdf32 mLdw_IntegratedTorque_xds32 mLdw_MotorTorqueSaturated_xds16 sLdw_ActivationRequest_xdb sLdw_CtrlState_xdu8 sLdw_FailureCause_xdu8 sLdw_FeatureState_xdu8 sLdw_TorqueNotOK_xdu8 /end OUT_MEASUREMENT
/end FUNCTION
/begin FUNCTION LaneDepartureWarningCheckInterface "Lane Departure Warning Check Interface"
 /begin OUT_MEASUREMENT fLdwI_MonSafeOk_xdb fLdw_LastLdwArbitrationResultPassive_xdb mLdwI_MotorTorqueOffset_xds16 /end OUT_MEASUREMENT
/end FUNCTION
/begin FUNCTION LaneDepartureWarningI "LaneDepartureWarning - Interface"
 /begin OUT_MEASUREMENT fLdwI_DriverIntervention_xdb fLdwI_InputValid_xdb mLdwI_MotorTorque4Check_xds16 sLdwI_ActivateFctCo_xdu8 /end OUT_MEASUREMENT
/end FUNCTION
/begin FUNCTION LaneDepartureWarningStatemachine "LaneDepartureWarning - Statemachine"
 /begin DEF_CHARACTERISTIC mLdw_ActTorsionBarTorqueLimit_XDU16 mLdw_DeactTorsionBarTorqueLimit_XDU16 mLdw_DriverOverrideTrq_XDU16 mLdw_NoOvrRidTrqLimit_XDU16 sLdw_ConfigFlag_XDU8 tLdw_DriverOverrideTime_XDU16 tLdw_NoOvrRidTimeLimit_XDU16 tLdw_StateMcCycleTime_XDU16 vLdw_MaxAllowedVehicleSpeed_XDU16 vLdw_MinActVehicleSpeed_XDU16 vLdw_MinDeactVehicleSpeed_XDU16 xLdw_HandsOnTrqFiltGain_XDU16 /end DEF_CHARACTERISTIC
 /begin OUT_MEASUREMENT sLdwI_LdwState_xdu8 /end OUT_MEASUREMENT
/end FUNCTION
/begin FUNCTION LaneDepartureWarningVibration "LaneDepartureWarning - Vibration"
 /begin DEF_CHARACTERISTIC fLdw_VibrationWaveform_XDU8 mLdw_MaxTorque_XDU16_0___A mLdw_MaxTorque_XDU16_1___A mLdw_MaxTorque_XDU16_2___A mLdw_MaxTorque_XDU16_3___A mLdw_MaxTorque_XDU16_4___A mLdw_MaxTorque_XDU16_5___A qLdw_Frequency_XDU8_00___A qLdw_Frequency_XDU8_01___A qLdw_Frequency_XDU8_02___A qLdw_Frequency_XDU8_03___A qLdw_Frequency_XDU8_04___A qLdw_Frequency_XDU8_05___A qLdw_Frequency_XDU8_06___A qLdw_Frequency_XDU8_07___A qLdw_Frequency_XDU8_08___A qLdw_Frequency_XDU8_09___A qLdw_Frequency_XDU8_10___A qLdw_Frequency_XDU8_11___A tLdw_MaxAllowedVibrDuration_XDU16 tLdw_VibrationCycleTime_XDU16_0___A tLdw_VibrationCycleTime_XDU16_1___A tLdw_VibrationCycleTime_XDU16_2___A tLdw_VibrationCycleTime_XDU16_3___A tLdw_VibrationCycleTime_XDU16_4___A tLdw_VibrationCycleTime_XDU16_5___A wLdw_StartAngle_XDU16_0___A wLdw_StartAngle_XDU16_1___A wLdw_StartAngle_XDU16_2___A wLdw_StartAngle_XDU16_3___A wLdw_StartAngle_XDU16_4___A wLdw_StartAngle_XDU16_5___A xLdw_MulFactorVehicleSpeed_XDU16 /end DEF_CHARACTERISTIC
/end FUNCTION
/begin RECORD_LAYOUT AblGLFKFub FNC_VALUES 1 UBYTE ROW_DIR DIRECT /end RECORD_LAYOUT
/begin RECORD_LAYOUT AblGLKLfl4 FNC_VALUES 3 FLOAT32_IEEE COLUMN_DIR DIRECT AXIS_PTS_X 2 FLOAT32_IEEE INDEX_INCR DIRECT NO_AXIS_PTS_X 1 ULONG /end RECORD_LAYOUT
/begin RECORD_LAYOUT AblGLKLsw FNC_VALUES 3 SWORD COLUMN_DIR DIRECT AXIS_PTS_X 2 SWORD INDEX_INCR DIRECT NO_AXIS_PTS_X 1 UWORD /end RECORD_LAYOUT
/begin RECORD_LAYOUT AblGLKLuw FNC_VALUES 3 UWORD COLUMN_DIR DIRECT AXIS_PTS_X 2 UWORD INDEX_INCR DIRECT NO_AXIS_PTS_X 1 UWORD /end RECORD_LAYOUT
/begin RECORD_LAYOUT AblGLKWBub FNC_VALUES 1 UBYTE COLUMN_DIR DIRECT /end RECORD_LAYOUT
/begin RECORD_LAYOUT AblGLKWBuw FNC_VALUES 1 UWORD COLUMN_DIR DIRECT /end RECORD_LAYOUT
/begin RECORD_LAYOUT AblGLKWfl4 FNC_VALUES 1 FLOAT32_IEEE COLUMN_DIR DIRECT /end RECORD_LAYOUT
/begin RECORD_LAYOUT AblGLKWsw FNC_VALUES 1 SWORD COLUMN_DIR DIRECT /end RECORD_LAYOUT
/begin RECORD_LAYOUT AblGLKWub FNC_VALUES 1 UBYTE COLUMN_DIR DIRECT /end RECORD_LAYOUT
/begin RECORD_LAYOUT AblGLKWul FNC_VALUES 1 ULONG COLUMN_DIR DIRECT /end RECORD_LAYOUT
/begin RECORD_LAYOUT AblGLKWuw FNC_VALUES 1 UWORD COLUMN_DIR DIRECT /end RECORD_LAYOUT
/end MODULE
/end PROJECT
