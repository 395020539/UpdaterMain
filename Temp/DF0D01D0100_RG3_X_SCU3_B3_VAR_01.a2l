/*
© by ASAM e.V., 2017
AML for the protocol layer specific parameters
Any use is limited to the scope described in the ASAM license terms.
This file is distributable in accordance with the ASAM license terms.
See www.asam.net/license.html for further details.
*/
ASAP2_VERSION 1 70
/begin PROJECT _DF0_D01 "SCU3_B3_VAR_01"
/begin HEADER "" VERSION "DF0_D01_D_01_00" PROJECT_NO _DF0_D01 /end HEADER
/begin MODULE XCP_EPS_ECU "CMP"
/begin MOD_COMMON "" BYTE_ORDER MSB_LAST ALIGNMENT_BYTE 1 ALIGNMENT_WORD 2 ALIGNMENT_LONG 4 ALIGNMENT_FLOAT32_IEEE 4 ALIGNMENT_FLOAT64_IEEE 8 /end MOD_COMMON
/begin CHARACTERISTIC aShimmy_VehDecelTh_XDS16 "Fahrzeug Verzögerung Grenze" VALUE 0x14A03E AblGLKWsw 32 RIGHTSH7NP -32 0 FORMAT "%8.5" /end CHARACTERISTIC
/begin CHARACTERISTIC fRemoteSteerCtrl_EnableDesRackPosFilt_XDU8 "enable filtering of the desired rack position due to an interpolation between the steps (macros shall be configured)" VALUE 0x150ACA AblGLKWub 1 ZU0 0 1 FORMAT "%5.3" /end CHARACTERISTIC
/begin CHARACTERISTIC fRemoteSteerCtrl_EnableFeedForward_XDU8 "enable feed-forward controlled nominal rack position (formerly known as bypass)" VALUE 0x150ACB AblGLKWub 1 ZU0 0 1 FORMAT "%5.3" /end CHARACTERISTIC
/begin CHARACTERISTIC fRpSync_StartKalibrieren_XDU8 "Kalibrierung iLWS: 1-CalAllo15, 2-CalAllo90, 3-CalAlloKD, 4-EOL_CalibZero, 5-EOL_CalibValue, 6-EOL_CalibKD, 7-InitReset, 8-CalibReset" VALUE 0x150ACD AblGLKWub 200 ZU0 0 200 FORMAT "%5.1" /end CHARACTERISTIC
/begin CHARACTERISTIC fSafCtrl_EnableLimitation_XDU8 "" VALUE 0x150ACE AblGLKWub 1 ZU0 0 1 FORMAT "%5.3" /end CHARACTERISTIC
/begin CHARACTERISTIC fStStp_FailopActive_XDB "Start Stop Funktion aktivieren 0=Aus, 1=Ein" VALUE 0x150AD1 AblGLKWub 1 ZU0 0 1 FORMAT "%5.3" /end CHARACTERISTIC
/begin CHARACTERISTIC fStStp_FuncActive_XDB "Start Stop Funktion aktivieren 0=Aus, 1=Ein" VALUE 0x150AD2 AblGLKWub 1 ZU0 0 1 FORMAT "%5.3" /end CHARACTERISTIC
/begin CHARACTERISTIC IRackPo_RackPositionArray_XAS16 "Kennlinie fuer Zahnstangenposition an bestimmten Positionen wg. variabler Ueberstetzung" VAL_BLK 0x150BA0 AblGLKWBsw 200 RACKPOS128 0 200 NUMBER 10 FORMAT "%8.4" /end CHARACTERISTIC
/begin CHARACTERISTIC lRackPo_RackPositionMax_XDU16 "maximaler gueltiger Zahnstangenhub bei Plausi" VALUE 0x150582 AblGLKWuw 200 RACKPOS128 0 200 FORMAT "%8.4" /end CHARACTERISTIC
/begin CHARACTERISTIC lRackPo_RackPosRangeAhead_XDU16 "zulässiger RackPoswert wenn Ahead erkannt wurde fuer Plausi " VALUE 0x150584 AblGLKWuw 200 RACKPOS128 0 200 FORMAT "%8.4" /end CHARACTERISTIC
/begin CHARACTERISTIC lRemoteSteerCtrl_MaxRackPosDiff_XDU16 "maximum allowed rack position difference of desired to real value" VALUE 0x150586 AblGLKWuw 400 RACKPOS128 0 400 FORMAT "%8.4" /end CHARACTERISTIC
/begin CHARACTERISTIC lRemoteSteerCtrl_MaxRackPosGrad_XDU16 "maximum allowed gradient of desired rack position" VALUE 0x150588 AblGLKWuw 400 RACKPOS128 0 400 FORMAT "%8.4" /end CHARACTERISTIC
/begin CHARACTERISTIC lRWCon_RackPosition_XAU16 "rack position array" VAL_BLK 0x150BF0 AblGLKWBuw 150 RACKPOS128 0 150 NUMBER 10 FORMAT "%8.4" /end CHARACTERISTIC
/begin CHARACTERISTIC mRackProt_LimitRedMotorTorque_XDU16 "Grenzwert Motormoment fuer Reduktion Rackprotection" VALUE 0x150666 AblGLKWuw 10 MMOT 0 10 FORMAT "%8.5" /end CHARACTERISTIC
/begin CHARACTERISTIC mRackProt_MaxAbsTorsionBarTorqueRampUp_XDU16 "maximales Drehstabmoment für RampUp" VALUE 0x150668 AblGLKWuw 10 MMOT 0 10 FORMAT "%8.5" /end CHARACTERISTIC
/begin CHARACTERISTIC mRackProt_MinAbsTorsionBarTorqueRampDown_XDU16 "minimales Drehstabmoment für RampDown" VALUE 0x15066A AblGLKWuw 10 MMOT 0 10 FORMAT "%8.5" /end CHARACTERISTIC
/begin CHARACTERISTIC mRemoteSteerCtrl_CheckHandsOnTorqLim_XDU16 "threshold of driver's steering torque to detect HandsOn" VALUE 0x15066C AblGLKWuw 6.5 TBTHIGH 0.5 7 FORMAT "%8.6" /end CHARACTERISTIC
/begin CHARACTERISTIC mRemoteSteerCtrl_DeadBandTBT_XDU16 "maximum allowed steering torque offset (formerly known as dead band)" VALUE 0x15066E AblGLKWuw 6.5 TBTHIGH 0 6.5 FORMAT "%8.6" /end CHARACTERISTIC
/begin CHARACTERISTIC mRemoteSteerCtrl_HandsOnTorqLim_XDU16 "threshold of driver's steering torque to detect HandsOn when RSC is Active" VALUE 0x150670 AblGLKWuw 6.5 TBTHIGH 0.5 7 FORMAT "%8.6" /end CHARACTERISTIC
/begin CHARACTERISTIC mRpCorr_LTATBT_XDU16 "Max.Handmoment Langzeitkorrektur" VALUE 0x150672 AblGLKWuw 8 TBTHIGH 0 8 FORMAT "%8.6" /end CHARACTERISTIC
/begin CHARACTERISTIC mRpCorr_LTMaxMotTorq_XDU16 "Max. Motormoment fuer Geradeauserkennung in Langzeitkorrektur" VALUE 0x150674 AblGLKWuw 8 TBTHIGH 0 8 FORMAT "%8.6" /end CHARACTERISTIC
/begin CHARACTERISTIC mRpCorr_STMaxMotTorq_XDU16 "Max. Motormoment fuer Geradeauserkennung in Kurzzeitkorrektur" VALUE 0x150676 AblGLKWuw 8 TBTHIGH 0 8 FORMAT "%8.6" /end CHARACTERISTIC
/begin CHARACTERISTIC mRpCorr_STMaxTBT_XDU16 "Max.Handmoment Kurzzeitkorrektur" VALUE 0x150678 AblGLKWuw 8 TBTHIGH 0 8 FORMAT "%8.6" /end CHARACTERISTIC
/begin CHARACTERISTIC mRpSync_MaxCalibTBTorq_XDU16 "Maximales Lenkmoment beim Kalibrieren des Lenkwinkels" VALUE 0x15067A AblGLKWuw 8 TBTHIGH 0 8 FORMAT "%8.6" /end CHARACTERISTIC
/begin CHARACTERISTIC mRpSync_MaxMMotLowDyn_XDU16 "Maximales Motormoment bis zu dem von niedriger Lenkdynamik ausgegangen wird." VALUE 0x15067C AblGLKWuw 20 MMOT 0 20 FORMAT "%8.5" /end CHARACTERISTIC
/begin CHARACTERISTIC mRpSync_MaxTBTGradForIdxSearch_XDU16 "Maximum tbt gard, unterhalb dessen die Flanken erkannt wÃ¼rden" VALUE 0x15067E AblGLKWuw 25 TORGRAD 0 25 FORMAT "%8.5" /end CHARACTERISTIC
/begin CHARACTERISTIC mRpSync_MaxTBTLowDyn_XDU16 "Maximales Drehstabmoment bis zu dem von niedriger Lenkdynamik ausgegangen wird." VALUE 0x150680 AblGLKWuw 20 MMOT 0 20 FORMAT "%8.5" /end CHARACTERISTIC
/begin CHARACTERISTIC mSafCtrlI_MaxSafCtrlMotorTorque_XAU16 "Max. SafetyController Motormoment abhängig vom abs. Handmoment" CURVE 0x1513B8 AblGLKLuw 4 MMOT 0 4 FORMAT "%8.6"
 /begin AXIS_DESCR STD_AXIS mApplI_AbsTorsionBarTorque_xdu16 TBTHIGH 4 0 25 FORMAT "%8.5" DEPOSIT ABSOLUTE /end AXIS_DESCR
/end CHARACTERISTIC
/begin CHARACTERISTIC mSafCtrl_DesiredTorsionBarTor_XDU16 "desired TorsionBarTorque" VALUE 0x150682 AblGLKWuw 25 TBTHIGH 0 25 FORMAT "%8.5" /end CHARACTERISTIC
/begin CHARACTERISTIC mSafCtrl_MaxTorsionBarTor_XDU16 "Max. TorsionBarTorque" VALUE 0x150684 AblGLKWuw 25 TBTHIGH 0 25 FORMAT "%8.5" /end CHARACTERISTIC
/begin CHARACTERISTIC mShimmy_AmpTBTMax_XDU16 "Maximal erlaubtes Shimmy-Drehstabmoment, bei dem Shimmy aktiv sein darf" VALUE 0x14A072 AblGLKWuw 5 RIGHTSH10NP 0 5 FORMAT "%8.6" /end CHARACTERISTIC
/begin CHARACTERISTIC mShimmy_MaxMotorTorq_XDU16 "Max. Motormoment" VALUE 0x14A074 AblGLKWuw 0.5 MMOT 0 0.5 FORMAT "%9.7" /end CHARACTERISTIC
/begin CHARACTERISTIC mShimmy_MaxSafetyMotorTorq_XDU16 "Max. Motormoment aus Sicherheitssicht." VALUE 0x14A076 AblGLKWuw 0.5 MMOT 0 0.5 FORMAT "%9.7" /end CHARACTERISTIC
/begin CHARACTERISTIC mShutPermI_NoSteeringTorqueBorder_XDU16 "Grenzwert unter der die TBT liegen muss um als Shutdown Permission zu gelten." VALUE 0x150686 AblGLKWuw 0.5 TBTHIGH 0 0.5 FORMAT "%9.7" /end CHARACTERISTIC
/begin CHARACTERISTIC mShutPermI_ShutdownVehSpeedBorder_XDU16_0___A "Grenzwert bei welcher VFzg abschalten erlaubt ist." VALUE 0x15816C AblGLKWuw 10 VFZHIGH 0 10 FORMAT "%8.5" /end CHARACTERISTIC
/begin CHARACTERISTIC mShutPermI_ShutdownVehSpeedBorder_XDU16_1___A "Grenzwert bei welcher VFzg abschalten erlaubt ist." VALUE 0x15816E AblGLKWuw 10 VFZHIGH 0 10 FORMAT "%8.5" /end CHARACTERISTIC
/begin CHARACTERISTIC mShutPermI_ShutdownVehSpeedBorder_XDU16_2___A "Grenzwert bei welcher VFzg abschalten erlaubt ist." VALUE 0x158170 AblGLKWuw 10 VFZHIGH 0 10 FORMAT "%8.5" /end CHARACTERISTIC
/begin CHARACTERISTIC mShutPermI_ShutdownVehSpeedBorder_XDU16_3___A "Grenzwert bei welcher VFzg abschalten erlaubt ist." VALUE 0x158172 AblGLKWuw 10 VFZHIGH 0 10 FORMAT "%8.5" /end CHARACTERISTIC
/begin CHARACTERISTIC mShutPermI_ShutdownVehSpeedBorder_XDU16_4___A "Grenzwert bei welcher VFzg abschalten erlaubt ist." VALUE 0x158174 AblGLKWuw 10 VFZHIGH 0 10 FORMAT "%8.5" /end CHARACTERISTIC
/begin CHARACTERISTIC mShutPermI_ShutdownVehSpeedBorder_XDU16_5___A "Grenzwert bei welcher VFzg abschalten erlaubt ist." VALUE 0x158176 AblGLKWuw 10 VFZHIGH 0 10 FORMAT "%8.5" /end CHARACTERISTIC
/begin CHARACTERISTIC mSrcI_MaxSafeRampDownReqTorque_XDU16 "Motormomentenschwelle (requested torque) unter der die Sudden Loss of Assist Gradientenlimitierung deaktiviert wird." VALUE 0x150688 AblGLKWuw 1 MMOT 0 1 FORMAT "%8.6" /end CHARACTERISTIC
/begin CHARACTERISTIC mSrcI_MaxSafeRampUpReqTorque_XDU16 "Motormomentenschwelle (requested torque) unter der die Sudden Assist Gradientenlimitierung deaktiviert wird." VALUE 0x15068A AblGLKWuw 1 MMOT 0 1 FORMAT "%8.6" /end CHARACTERISTIC
/begin CHARACTERISTIC mSSDet_MaxTorqueOffset_XDU16 "Wert (Maximales Motordrehmoment + Drehmomentversatz) für die Rutschkupplung" VALUE 0x15068C AblGLKWuw 400 RIGHTSH6NP 0 400 FORMAT "%8.4" /end CHARACTERISTIC
/begin CHARACTERISTIC mSSWarn_DeltaEffectiveTorque_XDU16 "Notwendiger Momenteneinbruch" VALUE 0x15068E AblGLKWuw 10 MMOT 0 10 FORMAT "%8.5" /end CHARACTERISTIC
/begin CHARACTERISTIC mSSWarn_EffTrqHigh_XDU16 "SSW_M3" VALUE 0x150690 AblGLKWuw 6 MMOT 0 6 FORMAT "%8.6" /end CHARACTERISTIC
/begin CHARACTERISTIC mSSWarn_EffTrqLow_XDU16 "SSW_M1" VALUE 0x150692 AblGLKWuw 6 MMOT 0 6 FORMAT "%8.6" /end CHARACTERISTIC
/begin CHARACTERISTIC mSSWarn_MaxFeedbackTorqueDT_XDF32 "Zulässiges Fehlerintegral des Wackelmoments (Nm * ms)" VALUE 0x150410 AblGLKWfl4 100 ZU0 0 100 FORMAT "%10.6" /end CHARACTERISTIC
/begin CHARACTERISTIC mSSWarn_MaxFeedbackTorque_XDF32 "Zulässiges Wackelmoment, ab dem Fehler aufintegriert wird" VALUE 0x150414 AblGLKWfl4 2 ZU0 0 2 FORMAT "%10.8" /end CHARACTERISTIC
/begin CHARACTERISTIC mSSWarn_SSFeedbackTorque_XDU16 "Anti-Stick-Slip Feedback-Moment" VALUE 0x150694 AblGLKWuw 6 MMOT 0 6 FORMAT "%8.6" /end CHARACTERISTIC
/begin CHARACTERISTIC mStStp_ToBarTorqueLowRedDownToHiRed_XDU16 "StartStop Absolutes Drehmoment für Statuswechsel LOW_RED_DOWN -> HI_RED and LOW_RED_UP -> HI RED" VALUE 0x150698 AblGLKWuw 10 TBTHIGH 0 10 FORMAT "%8.5" /end CHARACTERISTIC
/begin CHARACTERISTIC nRackPo_MaxRotorSpeedRackSpeedPlausi_XDU16 "Rotordrehzahl ueber der RackSpeedPlausi deaktiviert ist" VALUE 0x1506CC AblGLKWuw 30000 VROT 0 30000 FORMAT "%3.0" /end CHARACTERISTIC
/begin CHARACTERISTIC nRpSync_MaxRotSpdLowDyn_XDU16 "Maximale Rotorgeschwindigkeit bis zu der von niedriger Lenkdynamik ausgegangen wird." VALUE 0x1506CE AblGLKWuw 13000 VROT 0 13000 FORMAT "%3.0" /end CHARACTERISTIC
/begin CHARACTERISTIC nRpSync_MinRotSpdForIdxSearch_XDU16 "Mindest Rotorgeschwindigkeit ab der nach Index Flanken gesucht wird." VALUE 0x1506D0 AblGLKWuw 200 VROT 0 200 FORMAT "%3.0" /end CHARACTERISTIC
/begin CHARACTERISTIC nSsm_ShortCircuit_RotorSpeedLimit_XDU16 "RotorSpeed Grenzwert für die Mosfet SC Abschaltstrategie. Bei RotorSpeed > Limit wird abgeschaltet." VALUE 0x1506D2 AblGLKWuw 20000 VROT 0 20000 FORMAT "%3.0" /end CHARACTERISTIC
/begin CHARACTERISTIC nSSWarn_RotSpeedHigh_XDU16 "obere Schwelle für Rotordrehzahl" VALUE 0x1506D4 AblGLKWuw 1000 VROT 0 1000 FORMAT "%3.0" /end CHARACTERISTIC
/begin CHARACTERISTIC nSSWarn_RotSpeedLow_XDU16 "untere Schwelle für Rotordrehzahl" VALUE 0x1506D6 AblGLKWuw 70 VROT 0 70 FORMAT "%3.0" /end CHARACTERISTIC
/begin CHARACTERISTIC nStStp_EngineSpeedToHighGoImmediateToFull_XDU16 "StartStop Motordrehzahl zu hoch: sofortiger Wechsel in Zustand Full" VALUE 0x1506D8 AblGLKWuw 5000 VROT 0 5000 FORMAT "%3.0" /end CHARACTERISTIC
/begin CHARACTERISTIC nStStp_SpeedEngFullToLowRedDown_XDU16 "StartStop Drehzahl für Statuswechsel FULL -> LOW_RED_DOWN" VALUE 0x1506DA AblGLKWuw 2000 VROT 0 2000 FORMAT "%3.0" /end CHARACTERISTIC
/begin CHARACTERISTIC nStStp_SpeedEngLowRedDownToFull_XDU16 "StartStop Drehzahl für Statuswechsel LOW_RED_DOWN -> FULL" VALUE 0x1506DC AblGLKWuw 2000 VROT 0 2000 FORMAT "%3.0" /end CHARACTERISTIC
/begin CHARACTERISTIC qShimmy_FrequencyMax_XDU8 "Deaktivierungs Frequenz für Shimmy" VALUE 0x14A0DD AblGLKWub 15 FREQHZ 10 25 FORMAT "%5.2" /end CHARACTERISTIC
/begin CHARACTERISTIC qShimmy_FrequencyMin_XDU8 "Aktivierungs Frequenz für Shimmy" VALUE 0x14A0DE AblGLKWub 7 FREQHZ 8 15 FORMAT "%5.2" /end CHARACTERISTIC
/begin CHARACTERISTIC sRackPo_ConfigFlagsMainPlausiActivErr_XDU16 " Belegung siehe TL oder ...; einzelne Fehler aktiv / aus setzen " VALUE 0x1506E6 AblGLKWuw 65535 ZU0 0 65535 FORMAT "%8.2" /end CHARACTERISTIC
/begin CHARACTERISTIC sRackPo_ConfigFlagsMainPlausiReactErr_XDU16 " Belegung siehe TL oder ...; Reaktion auf einzelne Fehler: perm / rev. error " VALUE 0x1506E8 AblGLKWuw 65535 ZU0 0 65535 FORMAT "%8.2" /end CHARACTERISTIC
/begin CHARACTERISTIC sRackPo_ConfigFlagsMain_XDU16 "Konfiguration der Komponente; Details siehe UnitDesign" VALUE 0x1506EA AblGLKWuw 65535 ZU0 0 65535 FORMAT "%8.2" /end CHARACTERISTIC
/begin CHARACTERISTIC sRpCorr_ConfigFlagsCorr_XDU8 "Configflags Lenkwinkelkorrektur (bitcodiert): 0-inaktiv, 1-LTCorr aktivierbar, 2-STCorr aktivierbar, 4-TB Verdrehung in DynSteerAng, 8-CheckCalibCntr NVR" VALUE 0x150B04 AblGLKWub 255 ZU0 0 255 FORMAT "%5.1" /end CHARACTERISTIC
/begin CHARACTERISTIC sRpSync_CalibControl_XDU8 "Kalibrierung iLWS: 0->3:CheckCalibAllowed, 0->6:CalibZeroPos, 0->7:ResetInit, 0->8:ResetCalib" VALUE 0x150B05 AblGLKWub 8 ZU0 0 8 FORMAT "%5.3" /end CHARACTERISTIC
/begin CHARACTERISTIC sRpSync_ConfigFlagsIdx2_XDU16 "Weitere Konfiguration der Komponente; Details siehe UnitDesign" VALUE 0x1506EC AblGLKWuw 65535 ZU0 0 65535 FORMAT "%8.2" /end CHARACTERISTIC
/begin CHARACTERISTIC sRpSync_ConfigFlagsIdx_XDU16 "Konfiguration der Komponente; Details siehe UnitDesign" VALUE 0x1506EE AblGLKWuw 65535 ZU0 0 65535 FORMAT "%8.2" /end CHARACTERISTIC
/begin CHARACTERISTIC sRpSync_ConfigFlagsSyncPlausiActivErr_XDU16 " Belegung siehe TL oder ...; einzelne Fehler aktiv / aus setzen " VALUE 0x1506F0 AblGLKWuw 65535 ZU0 0 65535 FORMAT "%8.2" /end CHARACTERISTIC
/begin CHARACTERISTIC sRpSync_ConfigFlagsSyncPlausiReactErr_XDU16 " Belegung siehe TL oder ...; Reaktion auf einzelne Fehler: perm / rev. error " VALUE 0x1506F2 AblGLKWuw 65535 ZU0 0 65535 FORMAT "%8.2" /end CHARACTERISTIC
/begin CHARACTERISTIC tRackPo_ErrorFilterAheadTimeout_XDU16 "interne Fehlerfilterzeit RackPo_Plausi fuer Ahead-Fehler" VALUE 0x1507AC AblGLKWuw 30000 TIMMS 0 30000 FORMAT "%8.2" /end CHARACTERISTIC
/begin CHARACTERISTIC tRackPo_ErrorFilterTimeout_XDU16 "max. Filterzeit fuer redundante Filterung von allg. RackPos-Fehler" VALUE 0x1507AE AblGLKWuw 100 TIMMS 0 100 FORMAT "%8.4" /end CHARACTERISTIC
/begin CHARACTERISTIC tRackProt_TimeRedRampDown_XDU16 "Wartezeit bis runter gerampt wird" VALUE 0x1507B0 AblGLKWuw 10 TIMSEC 0 10 FORMAT "%8.5" /end CHARACTERISTIC
/begin CHARACTERISTIC tRackProt_TimeRedRampUp_XDU16 "Wartezeit bis hoch gerampt wird" VALUE 0x1507B2 AblGLKWuw 10 TIMSEC 0 10 FORMAT "%8.5" /end CHARACTERISTIC
/begin CHARACTERISTIC tRemoteSteerCtrl_CheckHandsOnSwOffTime_XDU16 "detection time for HandsOn" VALUE 0x1507B4 AblGLKWuw 980 TIMMS 20 1000 FORMAT "%8.3" /end CHARACTERISTIC
/begin CHARACTERISTIC tRemoteSteerCtrl_CycleTimeController_XDU8 "Cycle time of controller function call" VALUE 0x150B1D AblGLKWub 9 TIMMS 1 10 FORMAT "%5.2" /end CHARACTERISTIC
/begin CHARACTERISTIC tRemoteSteerCtrl_CycleTimeControlVariable_XDU8 "Cycle time of updating control variable (from bus) (shall be greater or equal than tRemoteSteerCtrl_CycleTimeController_XDU8)" VALUE 0x150B1E AblGLKWub 240 TIMMS 10 250 FORMAT "%5.1" /end CHARACTERISTIC
/begin CHARACTERISTIC tRemoteSteerCtrl_CycleTime_XDU8 "RSC Zykluszeit [ms] (for OverSpeed time detection in ACTIVE)" VALUE 0x150B1F AblGLKWub 99 TIMMS 1 100 FORMAT "%5.1" /end CHARACTERISTIC
/begin CHARACTERISTIC tRemoteSteerCtrl_DrivingCmdDelayTime_XDU32 "detection time for delay in remote command" VALUE 0x150430 AblGLKWul 654999 TIMMS 1 655000 FORMAT "%13.6" /end CHARACTERISTIC
/begin CHARACTERISTIC tRemoteSteerCtrl_HandsOnSwOffTime_XDU16 "detection time for HandsOn in Active state and move to failure" VALUE 0x1507B6 AblGLKWuw 980 TIMMS 20 1000 FORMAT "%8.3" /end CHARACTERISTIC
/begin CHARACTERISTIC tRpCorr_CycleTimeRpCorr_XDU8 "Taskzeit fuer Lenkwinkelkorrektur" VALUE 0x150B20 AblGLKWub 1 TIMSEC_10 0 1 FORMAT "%5.3" /end CHARACTERISTIC
/begin CHARACTERISTIC tRpCorr_DetectionTimerLT_XDU8 "Erkennungszeit fuer Geradeaus in Langzeitkorrektur" VALUE 0x150B21 AblGLKWub 20 TIMSEC_10 0 20 FORMAT "%5.2" /end CHARACTERISTIC
/begin CHARACTERISTIC tRpCorr_DetectionTimerST_XDU8 "Erkennungszeit fuer Geradeaus in Kurzzeitkorrektur" VALUE 0x150B22 AblGLKWub 20 TIMSEC_10 0 20 FORMAT "%5.2" /end CHARACTERISTIC
/begin CHARACTERISTIC tRpCorr_LTimeIntegTime_XDU8 "Nachlaufzeit fuer Langzeitkorrektur beim Verlassen des Lernbereichs" VALUE 0x150B23 AblGLKWub 19 TIMSEC_10 1 20 FORMAT "%5.2" /end CHARACTERISTIC
/begin CHARACTERISTIC tRpSync_ErrorFilterIdxPosTimeout_XDU16 "max. Filterzeit fuer Filterung von sync. RackPos-Fehler bzgl Indexposition" VALUE 0x1507B8 AblGLKWuw 100 TIMMS 0 100 FORMAT "%8.4" /end CHARACTERISTIC
/begin CHARACTERISTIC tRpSync_ErrorFilterIdxVldTimeout_XDU16 "max. Filterzeit fuer Filterung von sync. RackPos-Fehler bzgl Index Gültigkeit" VALUE 0x1507BA AblGLKWuw 65000 TIMMS 0 65000 FORMAT "%8.2" /end CHARACTERISTIC
/begin CHARACTERISTIC tRpSync_InitTimeStraight_XDU16 "Initzeit fuer Init aus AheadDetection (Index-high-Filter, Ahead-Filter)" VALUE 0x1507BC AblGLKWuw 10 TIMSEC_100 0 10 FORMAT "%8.5" /end CHARACTERISTIC
/begin CHARACTERISTIC tShimmy_CountMaxAmp_XDU16 "Verzögerungszeit zur Abschaltung der Kompensation, wenn das TBT größer ist als AmpTBTMax" VALUE 0x14A07C AblGLKWuw 5 TIMSEC_1000 0 5 FORMAT "%8.6" /end CHARACTERISTIC
/begin CHARACTERISTIC tShimmy_Time_XDU16 "Tasklisten Zeit" VALUE 0x14A07E AblGLKWuw 0.009 TIMSEC_1000 0.001 0.01 FORMAT "%10.8" /end CHARACTERISTIC
/begin CHARACTERISTIC tShimmy_VehDecelTime_XDU8 "Fahrzeug Verzögerungs Zeit Grenze" VALUE 0x14A0E3 AblGLKWub 15 TIMSEC_10 0 15 FORMAT "%5.2" /end CHARACTERISTIC
/begin CHARACTERISTIC tShutPermI_NoSteeringTorqueTimeOut_XDU16 "Time-out zeit fÃ¼r die TBT Grenzwert Unterschreitung. Ist der Timeout erreicht kann abgeschaltet werden." VALUE 0x1507BE AblGLKWuw 600 TIMS 0 600 /end CHARACTERISTIC
/begin CHARACTERISTIC tSsm_FaultActionMaxTime_XAU16 "Nach Ablauf dieser Zeit 0% gerampt. [0:RPS1, 1:RPS2, 2:DMS1, 3:DMS2, 4:CURR1, 5:CURR2, 6:PHASEOPEN, 7:PHASESHORT]" VAL_BLK 0x150B70 AblGLKWBuw 65000 TIMS 0 65000 NUMBER 8 FORMAT "%6.0" /end CHARACTERISTIC
/begin CHARACTERISTIC tSSWarn_MaxAllowedReductionTime_XDU16 "Maximal erlaubte Reduktionszeit" VALUE 0x1507C0 AblGLKWuw 10000 TIMMS 0 10000 FORMAT "%8.2" /end CHARACTERISTIC
/begin CHARACTERISTIC tSSWarn_MaxDeltaTime_XDU16 "So lange darfs dauern bis das EffTorqueDelta erreicht ist" VALUE 0x1507C2 AblGLKWuw 5000 TIMMS 0 5000 FORMAT "%8.3" /end CHARACTERISTIC
/begin CHARACTERISTIC tSSWarn_ResetStickSlipTime_XDU16 "Zeitschwelle für tSSWarn_SlipTime_xdu32 -> Rücksetzen Stick Slip Zaehler" VALUE 0x1507C4 AblGLKWuw 10 TIMS 55 65 FORMAT "%6.3" /end CHARACTERISTIC
/begin CHARACTERISTIC tSSWarn_TimeMaxNHigh_XDU16 "Zeitschwelle für hohe Drehzahlen" VALUE 0x1507C6 AblGLKWuw 5000 TIMMS 0 5000 FORMAT "%8.3" /end CHARACTERISTIC
/begin CHARACTERISTIC tSSWarn_TimeMaxNnotZero_XDU16 "Zeitschwelle für Zustand 'RotSpeedNotZero'" VALUE 0x1507C8 AblGLKWuw 5000 TIMMS 0 5000 FORMAT "%8.3" /end CHARACTERISTIC
/begin CHARACTERISTIC tSSWarn_TimeMinNLow_XDU16 "Zeitschwelle für kleine Drehzahlen" VALUE 0x1507CA AblGLKWuw 5000 TIMMS 0 5000 FORMAT "%8.3" /end CHARACTERISTIC
/begin CHARACTERISTIC tSSWarn_VibrationPause_XDU16 "Vibration Pause" VALUE 0x1507CC AblGLKWuw 62 TIMMS 0 62 FORMAT "%8.5" /end CHARACTERISTIC
/begin CHARACTERISTIC tSSWarn_VibrationPeriod_XDU8 "Stick-Slip Feedback Periode" VALUE 0x150B24 AblGLKWub 20 TIMMS 45 65 FORMAT "%5.2" /end CHARACTERISTIC
/begin CHARACTERISTIC tSSWarn_VibrationRampTime_XDU16 "Vibration Rampenzeit" VALUE 0x1507CE AblGLKWuw 400 TIMMS 1800 2200 FORMAT "%8.3" /end CHARACTERISTIC
/begin CHARACTERISTIC tStStp_SwCondFullToLowRedDownMs_XDU16 "StartStop Timer Schaltbedingung Zustandswechsel FULL -> LO_RED_DOWN" VALUE 0x1507D0 AblGLKWuw 59999 ZU0 1 60000 FORMAT "%8.2" /end CHARACTERISTIC
/begin CHARACTERISTIC tStStp_SwCondHiRedToFullMs_XDU16 "StartStop Timer Schaltbedingung Zustandswechsel HI_RED -> FULL" VALUE 0x1507D2 AblGLKWuw 59999 ZU0 1 60000 FORMAT "%8.2" /end CHARACTERISTIC
/begin CHARACTERISTIC tStStp_SwCondHiRedToLowRedUpMs_XDU16 "StartStop Timer Schaltbedingung Zustandswechsel HI_RED -> LOW_RED_UP" VALUE 0x1507D4 AblGLKWuw 59999 ZU0 1 60000 FORMAT "%8.2" /end CHARACTERISTIC
/begin CHARACTERISTIC tStStp_SwCondLowRedDownToFullMs_XDU16 "StartStop Timer Schaltbedingung Zustandswechsel LO_RED_DOWN -> FULL" VALUE 0x1507D6 AblGLKWuw 59999 ZU0 1 60000 FORMAT "%8.2" /end CHARACTERISTIC
/begin CHARACTERISTIC tStStp_SwCondLowRedDownToHiRedMs_XDU16 "StartStop Timer Schaltbedingung Zustandswechsel LO_RED_DOWN -> HI_RED" VALUE 0x1507D8 AblGLKWuw 59999 ZU0 1 60000 FORMAT "%8.2" /end CHARACTERISTIC
/begin CHARACTERISTIC tStStp_SwCondLowRedUpToFullMs_XDU16 "StartStop Timer Schaltbedingung Zustandswechsel LOW_RED_UP -> FULL" VALUE 0x1507DA AblGLKWuw 59999 ZU0 1 60000 FORMAT "%8.2" /end CHARACTERISTIC
/begin CHARACTERISTIC tStStp_SwCondLowRedUpToHiRedMs_XDU16 "StartStop Timer Schaltbedingung Zustandswechsel LOW_RED_UP -> HI_RED" VALUE 0x1507DC AblGLKWuw 59999 ZU0 1 60000 FORMAT "%8.2" /end CHARACTERISTIC
/begin CHARACTERISTIC vRackPo_RotAngGradientDiffMax_XDU16 "Maximal erlaubte Gradientenabweichung zwischen Rotorwelle und berechneter Rackposition (bzgl. Rotor)" VALUE 0x150882 AblGLKWuw 2.46094 ROTPOS 0 2.460938 FORMAT "%8.6" /end CHARACTERISTIC
/begin CHARACTERISTIC vRackPo_RotorSpeedTolerance_XDU16 "Grenzwert fuer den Vergleich der Rotordrehzahl aus Zahnstangengeschwindigkeit mit Rotordrehzahl aus der HWLib" VALUE 0x150884 AblGLKWuw 30000 VROT 0 30000 FORMAT "%3.0" /end CHARACTERISTIC
/begin CHARACTERISTIC vRackProt_MaxAbsSteeringAngleSpeed_XDU16 "maximale Lenkwinkelgeschwindigkeit für Reduzierung" VALUE 0x150886 AblGLKWuw 1500 SAS_8 0 1500 FORMAT "%8.3" /end CHARACTERISTIC
/begin CHARACTERISTIC vRackProt_MaxAbsVehicleSpeed_XDU16 "maximale Fahrzeuggeschwindigkeit für Reduzierung" VALUE 0x150888 AblGLKWuw 5 VFZHIGH 0 5 FORMAT "%8.6" /end CHARACTERISTIC
/begin CHARACTERISTIC vRemoteSteerCtrl_DeadBandRackSpeed_XDU16 "dead band threshold of nominal rack speed" VALUE 0x15088A AblGLKWuw 100 RACKSPEED128 0 100 FORMAT "%8.4" /end CHARACTERISTIC
/begin CHARACTERISTIC vRemoteSteerCtrl_MaxGradRackSpeed_XDU16 "maximum allowed desired rack speed gradient" VALUE 0x15088C AblGLKWuw 10 RACKSPEED128 0 10 FORMAT "%8.5" /end CHARACTERISTIC
/begin CHARACTERISTIC vRemoteSteerCtrl_MaxRackSpeed_XDU16 "maximum allowed desired rack speed" VALUE 0x15088E AblGLKWuw 200 RACKSPEED128 0 200 FORMAT "%8.4" /end CHARACTERISTIC
/begin CHARACTERISTIC vRemoteSteerCtrl_RSCMaxVehicleSpeed_XDU16 "maximum allowed vehicle speed to enable rack position controller/RSC main" VALUE 0x150890 AblGLKWuw 15 VFZHIGH 0 15 FORMAT "%8.5" /end CHARACTERISTIC
/begin CHARACTERISTIC vRemoteSteerCtrl_SafetyLimitMaxVehicleSpeed_XDU16 "safety limit of maximum allowed vehicle speed" VALUE 0x150892 AblGLKWuw 10 VFZHIGH 0 10 FORMAT "%8.5" /end CHARACTERISTIC
/begin CHARACTERISTIC vRpCorr_STMinVehicleSpeed_XDU16 "Schwelle Fahrzeuggeschwindigkeit Kurzzeitkorrektur" VALUE 0x150894 AblGLKWuw 255 VFZHIGH 0 255 FORMAT "%8.4" /end CHARACTERISTIC
/begin CHARACTERISTIC vRpCorr_VehicleSpeedWeight_XDU16 "Geschwindigkeit, oberhalb der mit Faktor 1 gelernt wird" VALUE 0x150896 AblGLKWuw 240 VFZ 10 250 FORMAT "%8.4" /end CHARACTERISTIC
/begin CHARACTERISTIC vRpSync_MaxCalibVehicleSpeed_XDU16 "Schwelle Fahrzeuggeschwindigkeit, oberhalb der nicht kalibriert werden kann" VALUE 0x150898 AblGLKWuw 255 VFZHIGH 0 255 FORMAT "%8.4" /end CHARACTERISTIC
/begin CHARACTERISTIC vSsm_ShortCircuit_VehSpeedLimit_XDU16 "VehicleSpeed Grenzwert für die Mosfet SC Abschaltstrategie. Bei VehicleSpeed < Limit wird abgeschaltet." VALUE 0x15089A AblGLKWuw 80 VFZHIGH 0 80 FORMAT "%8.5" /end CHARACTERISTIC
/begin CHARACTERISTIC vSSWarn_MinVehicleSpeed_XDU16 "untere Schwelle für Fahrzeuggeschwindigkeit" VALUE 0x15089C AblGLKWuw 200 VFZHIGH 0 200 FORMAT "%8.4" /end CHARACTERISTIC
/begin CHARACTERISTIC vStStp_AbsSteerAngleSpeedLowRedDownToHiRed_XDU16 "StartStop Absolute Lenkwinkelgeschwindigkeit für Statuswechsel LOW_RED_DOWN -> HI_RED and LOW_RED_UP -> HI_RED" VALUE 0x1508A2 AblGLKWuw 200 SAS_8 0 200 FORMAT "%8.4" /end CHARACTERISTIC
/begin CHARACTERISTIC vStStp_VehicleSpeedToHighGoImmediateToFull_XDU16 "StartStop Fahrzeuggeschwindigkeit zu hoch: sofortiger Wechsel in Zustand Full" VALUE 0x1508A4 AblGLKWuw 20 VFZHIGH 0 20 FORMAT "%8.5" /end CHARACTERISTIC
/begin CHARACTERISTIC vStStp_VehSpeedFullToLowRedDown_XDU16 "StartStop Fehrzeuggeschwindigkeit für Statuswechsel FULL -> LOW_RED_DOWN" VALUE 0x1508A6 AblGLKWuw 500 VFZHIGH 0 500 FORMAT "%8.4" /end CHARACTERISTIC
/begin CHARACTERISTIC vStStp_VehSpeedHiRedToLowRedUp_XDU16 "StartStop Fehrzeuggeschwindigkeit für Statuswechsel HI_RED -> LOW_RED_UP" VALUE 0x1508A8 AblGLKWuw 500 VFZHIGH 0 500 FORMAT "%8.4" /end CHARACTERISTIC
/begin CHARACTERISTIC vStStp_VehSpeedLowRedDownToHiRed_XDU16 "StartStop Fehrzeuggeschwindigkeit für Statuswechsel LOW_RED_DOWN -> HI_RED" VALUE 0x1508AA AblGLKWuw 500 VFZHIGH 0 500 FORMAT "%8.4" /end CHARACTERISTIC
/begin CHARACTERISTIC vStStp_VehSpeedLowRedToFull_XDU16 "StartStop Fehrzeuggeschwindigkeit für Statuswechsel LOW_RED -> FULL" VALUE 0x1508AC AblGLKWuw 500 VFZHIGH 0 500 FORMAT "%8.4" /end CHARACTERISTIC
/begin CHARACTERISTIC vStStp_VehSpeedLowRedUpToHiRed_XDU16 "StartStop Fehrzeuggeschwindigkeit für Statuswechsel LOW_RED_UP -> HI_RED" VALUE 0x1508AE AblGLKWuw 500 VFZHIGH 0 500 FORMAT "%8.4" /end CHARACTERISTIC
/begin CHARACTERISTIC wRackPoI_MaxAbsRotbasedAngle_XDF32 "maximum possible accumulated rotor angle [rad]" VALUE 0x150460 AblGLKWfl4 250 ZU0 500 750 FORMAT "%10.6" /end CHARACTERISTIC
/begin CHARACTERISTIC wRackPoI_MaxTorsionBarTorsion_XDU16 "max. moegliche Verdrehung des Drehstabes" VALUE 0x1508EA AblGLKWuw 10 SA_10 0 10 FORMAT "%8.5" /end CHARACTERISTIC
/begin CHARACTERISTIC wRackPo_GradErrLimit_XDU16 "Grenzwert des Fehlerintegrals der Gradientenüberwachung" VALUE 0x1508EC AblGLKWuw 500.01 ROTPOS 0 500.0098 FORMAT "%8.4" /end CHARACTERISTIC
/begin CHARACTERISTIC wRackPo_GradErrReductStep_XDU16 "Abbauschritt des Fehlerintegrals der Gradientenüberwachung" VALUE 0x1508EE AblGLKWuw 2850.03 ROTPOS 0 2850.029 FORMAT "%8.3" /end CHARACTERISTIC
/begin CHARACTERISTIC wRackPo_LtCorrAngleMax_XDU16 "maximal erlaubter Lernwert Langzeitkorrekturwert (in Plausi)" VALUE 0x1508F0 AblGLKWuw 500 ANGLE_1 0 500 FORMAT "%8.4" /end CHARACTERISTIC
/begin CHARACTERISTIC wRackPo_OffsetReductionStep_XDU16 "Abbaurate des Rotorwinkeloffsets nach uebergang RawInit --> FineInit; in 1/16-Grad Rotor" VALUE 0x1508F2 AblGLKWuw 720 RIGHTSH4NP 0 720 FORMAT "%8.4" /end CHARACTERISTIC
/begin CHARACTERISTIC wRackPo_RackposToleranceRA_XDU16 "Grenzwert fuer den Vergleich der Zahnstangenposition mit dem Rotorwinkel aus der HWLib" VALUE 0x1508F4 AblGLKWuw 30000 ANGLE_1 0 30000 FORMAT "%8.2" /end CHARACTERISTIC
/begin CHARACTERISTIC wRackPo_RotorAngleArray_XAS16 "Kennlinie fuer Rotorwinkel an bestimmten Positionen wg. variabler Ueberstetzung" VAL_BLK 0x150CA8 AblGLKWBsw 21000 ANGLE_1 0 21000 NUMBER 10 FORMAT "%8.2" /end CHARACTERISTIC
/begin CHARACTERISTIC wRackPo_RotorStiffnessLimit_XDU8 "Max compensation for Accumulated Rotorangle" VALUE 0x150B36 AblGLKWub 255 ANGLE_1 0 255 FORMAT "%5.1" /end CHARACTERISTIC
/begin CHARACTERISTIC wRackPo_RotorStiffnessMaxRate_XDU8 "max. Aenderung des Kompensationswerts je ms" VALUE 0x150B37 AblGLKWub 255 ANGLE_1 0 255 FORMAT "%5.1" /end CHARACTERISTIC
/begin CHARACTERISTIC wRackPo_RotorStiffnessOffset_XAU16 "Kompensationswert des Rotorwinkels, abhängig vom Motormoment" CURVE 0x151664 AblGLKLuw 260 ANGLE_1 0 260 FORMAT "%8.4"
 /begin AXIS_DESCR STD_AXIS mRackPo_AbsLimitedMotorTorque_xdu16 MMOT 10 0 10 FORMAT "%8.5" DEPOSIT ABSOLUTE /end AXIS_DESCR
/end CHARACTERISTIC
/begin CHARACTERISTIC wRackPo_StCorrAngleMax_XDU16 "maximal erlaubter Lernwert Kurzzeitkorrekturwert (in Plausi)" VALUE 0x1508F6 AblGLKWuw 500 ANGLE_1 0 500 FORMAT "%8.4" /end CHARACTERISTIC
/begin CHARACTERISTIC wRackPo_SteeringAngleArray_XAS16 "Kennlinie fuer Lenkwinkel an bestimmten Positionen wg. variabler Ueberstetzung" VAL_BLK 0x150CBC AblGLKWBsw 1500 SA_10 0 1500 NUMBER 10 FORMAT "%8.3" /end CHARACTERISTIC
/begin CHARACTERISTIC wRackPo_SteeringAngleMax_XDU16 "maximaler gueltiger Lenkwinkelbereich bei Plausi" VALUE 0x1508F8 AblGLKWuw 800 SA_10 0 800 FORMAT "%8.4" /end CHARACTERISTIC
/begin CHARACTERISTIC wRackPo_SteeringAngleRealArray_XAS16 "Kennlinie fuer Lenkwinkel an bestimmten Positionen wg. variabler Ueberstetzung" VAL_BLK 0x150CD0 AblGLKWBsw 1500 SA_10 0 1500 NUMBER 10 FORMAT "%8.3" /end CHARACTERISTIC
/begin CHARACTERISTIC wRemoteSteerCtrl_MaxReqSteeringAngle_XDU16 "permitted steering angle range in RSC Active State  0.96*max" VALUE 0x1508FA AblGLKWuw 800 SA_10 0 800 FORMAT "%8.4" /end CHARACTERISTIC
/begin CHARACTERISTIC wRemoteSteerCtrl_SteeringAngleInc_XDU16 "permitted steering angle range incremeent for remote command" VALUE 0x1508FC AblGLKWuw 800 SA_10 0 800 FORMAT "%8.4" /end CHARACTERISTIC
/begin CHARACTERISTIC wRpCorr_LTACompIntegRange_XDU16 "Arbeitsbereich Langzeitkorrektur" VALUE 0x1508FE AblGLKWuw 600 ANGLE_1 0 600 FORMAT "%8.4" /end CHARACTERISTIC
/begin CHARACTERISTIC wRpCorr_LTACompMaxAngle_XDU16 "max. Korrekturwinkel Langzeitkorrektur bzgl. Rotor" VALUE 0x150900 AblGLKWuw 600 ANGLE_1 0 600 FORMAT "%8.4" /end CHARACTERISTIC
/begin CHARACTERISTIC wRpCorr_Resolution_XDU16 "Resolution Adjustments for slow learning or learning only significant changes" VALUE 0x150B38 AblGLKWub 254 ANGLE_1 1 255 FORMAT "%5.1" /end CHARACTERISTIC
/begin CHARACTERISTIC wRpCorr_STACompIntegRange_XDU16 "Arbeitsbereich Kurzzeitkorrektur (unkorrigierter Rotorwinkel)" VALUE 0x150902 AblGLKWuw 600 ANGLE_1 0 600 FORMAT "%8.4" /end CHARACTERISTIC
/begin CHARACTERISTIC wRpCorr_STACompMaxAngle_XDU16 "max. Korrekturwinkel Kurzzeitkorrektur; Begrenzung des korr. Rotorwinkels und Integrals" VALUE 0x150904 AblGLKWuw 600 ANGLE_1 0 600 FORMAT "%8.4" /end CHARACTERISTIC
/begin CHARACTERISTIC wRpSync_AdditionalToleranceEstimSync_XDU16 "zusaetzliche Toleranz bei LWS-Index Plausi" VALUE 0x150906 AblGLKWuw 10000 ANGLE_1 0 10000 FORMAT "%8.2" /end CHARACTERISTIC
/begin CHARACTERISTIC wRpSync_AdditionalToleranceOneTurn_XDU16 "zusaetzliche Toleranz bei LWS-Index Plausi bei +-360° Lenkwinkel" VALUE 0x150908 AblGLKWuw 10000 ANGLE_1 0 10000 FORMAT "%8.2" /end CHARACTERISTIC
/begin CHARACTERISTIC wRpSync_AdditionalToleranceRawSync_XDU16 "zusaetzliche Toleranz bei LWS-Index Plausi" VALUE 0x15090A AblGLKWuw 10000 ANGLE_1 0 10000 FORMAT "%8.2" /end CHARACTERISTIC
/begin CHARACTERISTIC wRpSync_AllowedIndexShift_XDU16 "zulaessige Verschiebung des Index gegenueber internem Lenkwinkel" VALUE 0x15090C AblGLKWuw 15000 ANGLE_1 0 15000 FORMAT "%8.2" /end CHARACTERISTIC
/begin CHARACTERISTIC wRpSync_IndexTolerance_XDU16 "Toleranzband Indexbreite Abweichung vom EEPROM-Wert bei Init(*uebersetzung Motorumdr. zu Lenkradumdrehung) fuer Mittenindex" VALUE 0x15090E AblGLKWuw 200 ANGLE_1 0 200 FORMAT "%8.4" /end CHARACTERISTIC
/begin CHARACTERISTIC wRpSync_MaxAllowedIdxHyst_XDS16 "Maximal erlaubte Indexhysterese (fÃ¼r alle Indizes)" VALUE 0x150910 AblGLKWsw 1200 ANGLE_1 -600 600 FORMAT "%8.4" /end CHARACTERISTIC
/begin CHARACTERISTIC wRpSync_MaxAllowedIdxWidthCenter_XDU16 "Maximal erlaubte Indexbreite (nur mittlerer Index)" VALUE 0x150912 AblGLKWuw 599 ANGLE_1 301 900 FORMAT "%8.4" /end CHARACTERISTIC
/begin CHARACTERISTIC wRpSync_MaxAllowedIdxWidthDelta_XDU8 "Maximal erlaubtes Delta zwischen der gespeicherten Indexbreite und der frisch berechneten Indexbreite (fÃ¼r alle 3 Indizes)" VALUE 0x150B39 AblGLKWub 255 ANGLE_1 0 255 FORMAT "%5.1" /end CHARACTERISTIC
/begin CHARACTERISTIC wRpSync_MaxAllowedIdxWidth_XDU16 "Maximal erlaubte Indexbreite (fÃ¼r alle Indizes)" VALUE 0x150914 AblGLKWuw 599 ANGLE_1 301 900 FORMAT "%8.4" /end CHARACTERISTIC
/begin CHARACTERISTIC wRpSync_MaxRotorAngleForCalib_XDU16 "maximaler Winkelbereich, in dem eine Kalibrierung erlaubt ist(*uebersetzung Motorumdr. zu Lenkradumdrehung)" VALUE 0x150916 AblGLKWuw 1000 ANGLE_1 0 1000 FORMAT "%8.3" /end CHARACTERISTIC
/begin CHARACTERISTIC wRpSync_MinAllowedIdxHyst_XDS16 "Minimal erlaubte Indexhysterese (fÃ¼r alle Indizes)" VALUE 0x150918 AblGLKWsw 1200 ANGLE_1 -600 600 FORMAT "%8.4" /end CHARACTERISTIC
/begin CHARACTERISTIC wRpSync_MinAllowedIdxWidthCenter_XDU16 "Minimal erlaubte Indexbreite (nur mittlerer Index)" VALUE 0x15091A AblGLKWuw 300 ANGLE_1 0 300 FORMAT "%8.4" /end CHARACTERISTIC
/begin CHARACTERISTIC wRpSync_MinAllowedIdxWidth_XDU16 "Minimal erlaubte Indexbreite (fÃ¼r alle Indizes)" VALUE 0x15091C AblGLKWuw 300 ANGLE_1 0 300 FORMAT "%8.4" /end CHARACTERISTIC
/begin CHARACTERISTIC wRpSync_MinSteeringRangeHalf_XDU16 "Minimaler Lenkbereich fuer Mittenerkennung auf Rotorwinkel bezogen, halbiert (~250Â°LW)" VALUE 0x15091E AblGLKWuw 14500 ANGLE_1 500 15000 FORMAT "%8.2" /end CHARACTERISTIC
/begin CHARACTERISTIC wRpSync_MinSyncDiffRaw_XDU16 "Mindestabweichung Rotorwinkel(Lenkwinkel) zu Indexmitte, ab der nachsynchronisiert wird bei RawInit" VALUE 0x150920 AblGLKWuw 20000 ANGLE_1 0 20000 FORMAT "%8.2" /end CHARACTERISTIC
/begin CHARACTERISTIC wRpSync_MinSyncDiff_XDU16 "Mindestabweichung Rotorwinkel(Lenkwinkel) zu Indexmitte ab der nachsynchronisiert wird" VALUE 0x150922 AblGLKWuw 20000 ANGLE_1 0 20000 FORMAT "%8.2" /end CHARACTERISTIC
/begin CHARACTERISTIC wRpSync_RotAngRange4CalibJob_XDU16 "maximaler Winkelbereich, in dem ein Kalibrierjob (EOL mit Ist-Lw-Vorgabe) akzeptiert wird" VALUE 0x150924 AblGLKWuw 16000 ANGLE_1 0 16000 FORMAT "%8.2" /end CHARACTERISTIC
/begin CHARACTERISTIC wRpSync_RotAngRangeStraight_XDU16 "max. Bereich des Rotorwinkels fuer Init aus Geradeauslauf" VALUE 0x150926 AblGLKWuw 4000 ANGLE_1 0 4000 FORMAT "%8.3" /end CHARACTERISTIC
/begin CHARACTERISTIC wRpSync_SACalibAngle_XDS16 "Lenkwinkeloffset beim Kalibrieren" VALUE 0x150928 AblGLKWsw 400 SA_10 -200 200 FORMAT "%8.4" /end CHARACTERISTIC
/begin CHARACTERISTIC wRpSync_SameIdxTol_XDU16 "Rotorwinkelbereich in dem Index Flanken dem selben Index zugewiesen werden." VALUE 0x15092A AblGLKWuw 2000 ANGLE_1 0 2000 FORMAT "%8.3" /end CHARACTERISTIC
/begin CHARACTERISTIC wRpSync_SteeringWheelOneTurn_XDU16 "Lenkradumdrehung in Grad Rotorwinkel" VALUE 0x15092C AblGLKWuw 9000 ANGLE_1 3000 12000 FORMAT "%8.2" /end CHARACTERISTIC
/begin CHARACTERISTIC wRWCon_MaxWheelAngle_XDU16 "maximum allowed convertable wheel angle" VALUE 0x15092E AblGLKWuw 120 ROADWHEELANGLE_RSH8 0 120 FORMAT "%8.4" /end CHARACTERISTIC
/begin CHARACTERISTIC wRWCon_WheelAngle_XAU16 "wheel angle array" VAL_BLK 0x150CE4 AblGLKWBuw 75 ROADWHEELANGLE_RSH8 0 75 NUMBER 10 FORMAT "%8.5" /end CHARACTERISTIC
/begin CHARACTERISTIC wShimmy_SteeringAngleMax_XDU16 "Max Lenkwinkel Shimmy Akt" VALUE 0x14A096 AblGLKWuw 60 SA_10 0 60 FORMAT "%8.5" /end CHARACTERISTIC
/begin CHARACTERISTIC wSsm_ShortCircuit_SteeringAngleLimit_XDU32 "Lenkwinkel Grenzwert für Mosfet SC Abschaltstrategie. Bei Lenkwinkel < Limit wird abgeschaltet." VALUE 0x150464 AblGLKWul 20 SA_10 0 20 FORMAT "%13.10" /end CHARACTERISTIC
/begin CHARACTERISTIC wSSWarn_MaxSteeringAngle_XDU16 "maximaler Lenkwinkel für Erkennung Stick-Slip" VALUE 0x150930 AblGLKWuw 500 SA_10 0 500 FORMAT "%8.4" /end CHARACTERISTIC
/begin CHARACTERISTIC xRackPo_RotorSpeedFilterFactor_XDU16 "Filter Faktor des PT1-Filters für SteeringAngleSpeed" VALUE 0x150A1C AblGLKWuw 0.999023 RIGHTSH10NP 0.0009765625 1 FORMAT "%8.6" /end CHARACTERISTIC
/begin CHARACTERISTIC xRackProt_GradRedRampDown_XDU16 "Reduktiongradient für negativen Gradienten [Faktor/ms]" VALUE 0x150A1E AblGLKWuw 1 RIGHTSH15NP 0 1 FORMAT "%8.6" /end CHARACTERISTIC
/begin CHARACTERISTIC xRackProt_GradRedRampUp_XDU16 "Reduktiongradient für positiven Gradienten [Faktor/ms]" VALUE 0x150A20 AblGLKWuw 1 RIGHTSH15NP 0 1 FORMAT "%8.6" /end CHARACTERISTIC
/begin CHARACTERISTIC xRackProt_TargetReductionLevel_XDU16 "Zielreduktionsgrad" VALUE 0x150A22 AblGLKWuw 1 RIGHTSH15NP 0 1 FORMAT "%8.6" /end CHARACTERISTIC
/begin CHARACTERISTIC xRemoteSteerCtrl_FeedForwardFiltFact_XDU16 "filter factor feed-forward controlled nominal rack position" VALUE 0x150A24 AblGLKWuw 1 RIGHTSH10NP 0 1 FORMAT "%8.6" /end CHARACTERISTIC
/begin CHARACTERISTIC xRemoteSteerCtrl_PositionDPart_XDF32 "D-part position controller" VALUE 0x1504E8 AblGLKWfl4 100 ZU0 0 100 FORMAT "%10.6" /end CHARACTERISTIC
/begin CHARACTERISTIC xRemoteSteerCtrl_PositionIMax_XDF32 "maximum allowed I-part position controller" VALUE 0x1504EC AblGLKWfl4 2000 ZU0 0 2000 FORMAT "%10.5" /end CHARACTERISTIC
/begin CHARACTERISTIC xRemoteSteerCtrl_PositionIPart_XDF32 "I-part position controller" VALUE 0x1504F0 AblGLKWfl4 100 ZU0 0 100 FORMAT "%10.6" /end CHARACTERISTIC
/begin CHARACTERISTIC xRemoteSteerCtrl_PositionPPart_XDF32 "P-part position controller" VALUE 0x1504F4 AblGLKWfl4 2000 ZU0 0 2000 FORMAT "%10.5" /end CHARACTERISTIC
/begin CHARACTERISTIC xRemoteSteerCtrl_RackSpeedDPart_XDF32 "D-part speed controller" VALUE 0x1504F8 AblGLKWfl4 2 ZU0 0 2 FORMAT "%10.8" /end CHARACTERISTIC
/begin CHARACTERISTIC xRemoteSteerCtrl_RackSpeedIMax_XDF32 "maximum allowed I-part speed controller" VALUE 0x1504FC AblGLKWfl4 8 ZU0 0 8 FORMAT "%10.8" /end CHARACTERISTIC
/begin CHARACTERISTIC xRemoteSteerCtrl_RackSpeedIPart_XDF32 "I-part speed controller" VALUE 0x150500 AblGLKWfl4 1 ZU0 0 1 FORMAT "%10.8" /end CHARACTERISTIC
/begin CHARACTERISTIC xRemoteSteerCtrl_RackSpeedPPart_XDF32 "P-part speed controller" VALUE 0x150504 AblGLKWfl4 2 ZU0 0 2 FORMAT "%10.8" /end CHARACTERISTIC
/begin CHARACTERISTIC xRotSp_RotAccelerationFilterFact_XDU16_00___A "Filterfaktor der gefilterten Rotorbeschleunigung" VALUE 0x15830C AblGLKWuw 0.5 RIGHTSH7NP 0 0.5 FORMAT "%9.7" /end CHARACTERISTIC
/begin CHARACTERISTIC xRotSp_RotAccelerationFilterFact_XDU16_01___A "Filterfaktor der gefilterten Rotorbeschleunigung" VALUE 0x15830E AblGLKWuw 0.5 RIGHTSH7NP 0 0.5 FORMAT "%9.7" /end CHARACTERISTIC
/begin CHARACTERISTIC xRotSp_RotAccelerationFilterFact_XDU16_02___A "Filterfaktor der gefilterten Rotorbeschleunigung" VALUE 0x158310 AblGLKWuw 0.5 RIGHTSH7NP 0 0.5 FORMAT "%9.7" /end CHARACTERISTIC
/begin CHARACTERISTIC xRotSp_RotAccelerationFilterFact_XDU16_03___A "Filterfaktor der gefilterten Rotorbeschleunigung" VALUE 0x158312 AblGLKWuw 0.5 RIGHTSH7NP 0 0.5 FORMAT "%9.7" /end CHARACTERISTIC
/begin CHARACTERISTIC xRotSp_RotAccelerationFilterFact_XDU16_04___A "Filterfaktor der gefilterten Rotorbeschleunigung" VALUE 0x158314 AblGLKWuw 0.5 RIGHTSH7NP 0 0.5 FORMAT "%9.7" /end CHARACTERISTIC
/begin CHARACTERISTIC xRotSp_RotAccelerationFilterFact_XDU16_05___A "Filterfaktor der gefilterten Rotorbeschleunigung" VALUE 0x158316 AblGLKWuw 0.5 RIGHTSH7NP 0 0.5 FORMAT "%9.7" /end CHARACTERISTIC
/begin CHARACTERISTIC xRotSp_RotAccelerationFilterFact_XDU16_06___A "Filterfaktor der gefilterten Rotorbeschleunigung" VALUE 0x158318 AblGLKWuw 0.5 RIGHTSH7NP 0 0.5 FORMAT "%9.7" /end CHARACTERISTIC
/begin CHARACTERISTIC xRotSp_RotAccelerationFilterFact_XDU16_07___A "Filterfaktor der gefilterten Rotorbeschleunigung" VALUE 0x15831A AblGLKWuw 0.5 RIGHTSH7NP 0 0.5 FORMAT "%9.7" /end CHARACTERISTIC
/begin CHARACTERISTIC xRotSp_RotAccelerationFilterFact_XDU16_08___A "Filterfaktor der gefilterten Rotorbeschleunigung" VALUE 0x15831C AblGLKWuw 0.5 RIGHTSH7NP 0 0.5 FORMAT "%9.7" /end CHARACTERISTIC
/begin CHARACTERISTIC xRotSp_RotAccelerationFilterFact_XDU16_09___A "Filterfaktor der gefilterten Rotorbeschleunigung" VALUE 0x15831E AblGLKWuw 0.5 RIGHTSH7NP 0 0.5 FORMAT "%9.7" /end CHARACTERISTIC
/begin CHARACTERISTIC xRotSp_RotAccelerationFilterFact_XDU16_10___A "Filterfaktor der gefilterten Rotorbeschleunigung" VALUE 0x158320 AblGLKWuw 0.5 RIGHTSH7NP 0 0.5 FORMAT "%9.7" /end CHARACTERISTIC
/begin CHARACTERISTIC xRotSp_RotAccelerationFilterFact_XDU16_11___A "Filterfaktor der gefilterten Rotorbeschleunigung" VALUE 0x158322 AblGLKWuw 0.5 RIGHTSH7NP 0 0.5 FORMAT "%9.7" /end CHARACTERISTIC
/begin CHARACTERISTIC xRotSp_RotAccelerationFilterFact_XDU16_12___A "Filterfaktor der gefilterten Rotorbeschleunigung" VALUE 0x158324 AblGLKWuw 0.5 RIGHTSH7NP 0 0.5 FORMAT "%9.7" /end CHARACTERISTIC
/begin CHARACTERISTIC xRotSp_RotAccelerationFilterFact_XDU16_13___A "Filterfaktor der gefilterten Rotorbeschleunigung" VALUE 0x158326 AblGLKWuw 0.5 RIGHTSH7NP 0 0.5 FORMAT "%9.7" /end CHARACTERISTIC
/begin CHARACTERISTIC xRotSp_RotAccelerationFilterFact_XDU16_14___A "Filterfaktor der gefilterten Rotorbeschleunigung" VALUE 0x158328 AblGLKWuw 0.5 RIGHTSH7NP 0 0.5 FORMAT "%9.7" /end CHARACTERISTIC
/begin CHARACTERISTIC xRotSp_RotAccelerationFilterFact_XDU16_15___A "Filterfaktor der gefilterten Rotorbeschleunigung" VALUE 0x15832A AblGLKWuw 0.5 RIGHTSH7NP 0 0.5 FORMAT "%9.7" /end CHARACTERISTIC
/begin CHARACTERISTIC xRotSp_RotAccelerationFilterFact_XDU16_16___A "Filterfaktor der gefilterten Rotorbeschleunigung" VALUE 0x15832C AblGLKWuw 0.5 RIGHTSH7NP 0 0.5 FORMAT "%9.7" /end CHARACTERISTIC
/begin CHARACTERISTIC xRotSp_RotAccelerationFilterFact_XDU16_17___A "Filterfaktor der gefilterten Rotorbeschleunigung" VALUE 0x15832E AblGLKWuw 0.5 RIGHTSH7NP 0 0.5 FORMAT "%9.7" /end CHARACTERISTIC
/begin CHARACTERISTIC xRotSp_RotAccelerationFilterFact_XDU16_18___A "Filterfaktor der gefilterten Rotorbeschleunigung" VALUE 0x158330 AblGLKWuw 0.5 RIGHTSH7NP 0 0.5 FORMAT "%9.7" /end CHARACTERISTIC
/begin CHARACTERISTIC xRotSp_RotAccelerationFilterFact_XDU16_19___A "Filterfaktor der gefilterten Rotorbeschleunigung" VALUE 0x158332 AblGLKWuw 0.5 RIGHTSH7NP 0 0.5 FORMAT "%9.7" /end CHARACTERISTIC
/begin CHARACTERISTIC xRotSp_RotAccelerationFilterFact_XDU16_20___A "Filterfaktor der gefilterten Rotorbeschleunigung" VALUE 0x158334 AblGLKWuw 0.5 RIGHTSH7NP 0 0.5 FORMAT "%9.7" /end CHARACTERISTIC
/begin CHARACTERISTIC xRotSp_RotAccelerationFilterFact_XDU16_21___A "Filterfaktor der gefilterten Rotorbeschleunigung" VALUE 0x158336 AblGLKWuw 0.5 RIGHTSH7NP 0 0.5 FORMAT "%9.7" /end CHARACTERISTIC
/begin CHARACTERISTIC xRotSp_RotAccelerationFilterFact_XDU16_22___A "Filterfaktor der gefilterten Rotorbeschleunigung" VALUE 0x158338 AblGLKWuw 0.5 RIGHTSH7NP 0 0.5 FORMAT "%9.7" /end CHARACTERISTIC
/begin CHARACTERISTIC xRotSp_RotAccelerationFilterFact_XDU16_23___A "Filterfaktor der gefilterten Rotorbeschleunigung" VALUE 0x15833A AblGLKWuw 0.5 RIGHTSH7NP 0 0.5 FORMAT "%9.7" /end CHARACTERISTIC
/begin CHARACTERISTIC xRotSp_RotAccelerationFilterFact_XDU16_24___A "Filterfaktor der gefilterten Rotorbeschleunigung" VALUE 0x15833C AblGLKWuw 0.5 RIGHTSH7NP 0 0.5 FORMAT "%9.7" /end CHARACTERISTIC
/begin CHARACTERISTIC xRotSp_RotAccelerationFilterFact_XDU16_25___A "Filterfaktor der gefilterten Rotorbeschleunigung" VALUE 0x15833E AblGLKWuw 0.5 RIGHTSH7NP 0 0.5 FORMAT "%9.7" /end CHARACTERISTIC
/begin CHARACTERISTIC xRotSp_RotAccelerationFilterFact_XDU16_26___A "Filterfaktor der gefilterten Rotorbeschleunigung" VALUE 0x158340 AblGLKWuw 0.5 RIGHTSH7NP 0 0.5 FORMAT "%9.7" /end CHARACTERISTIC
/begin CHARACTERISTIC xRotSp_RotAccelerationFilterFact_XDU16_27___A "Filterfaktor der gefilterten Rotorbeschleunigung" VALUE 0x158342 AblGLKWuw 0.5 RIGHTSH7NP 0 0.5 FORMAT "%9.7" /end CHARACTERISTIC
/begin CHARACTERISTIC xRotSp_RotAccelerationFilterFact_XDU16_28___A "Filterfaktor der gefilterten Rotorbeschleunigung" VALUE 0x158344 AblGLKWuw 0.5 RIGHTSH7NP 0 0.5 FORMAT "%9.7" /end CHARACTERISTIC
/begin CHARACTERISTIC xRotSp_RotAccelerationFilterFact_XDU16_29___A "Filterfaktor der gefilterten Rotorbeschleunigung" VALUE 0x158346 AblGLKWuw 0.5 RIGHTSH7NP 0 0.5 FORMAT "%9.7" /end CHARACTERISTIC
/begin CHARACTERISTIC xRotSp_RotAccelerationFilterFact_XDU16_30___A "Filterfaktor der gefilterten Rotorbeschleunigung" VALUE 0x158348 AblGLKWuw 0.5 RIGHTSH7NP 0 0.5 FORMAT "%9.7" /end CHARACTERISTIC
/begin CHARACTERISTIC xRotSp_RotAccelerationFilterFact_XDU16_31___A "Filterfaktor der gefilterten Rotorbeschleunigung" VALUE 0x15834A AblGLKWuw 0.5 RIGHTSH7NP 0 0.5 FORMAT "%9.7" /end CHARACTERISTIC
/begin CHARACTERISTIC xRotSp_RotAccelerationFilterFact_XDU16_32___A "Filterfaktor der gefilterten Rotorbeschleunigung" VALUE 0x15834C AblGLKWuw 0.5 RIGHTSH7NP 0 0.5 FORMAT "%9.7" /end CHARACTERISTIC
/begin CHARACTERISTIC xRotSp_RotAccelerationFilterFact_XDU16_33___A "Filterfaktor der gefilterten Rotorbeschleunigung" VALUE 0x15834E AblGLKWuw 0.5 RIGHTSH7NP 0 0.5 FORMAT "%9.7" /end CHARACTERISTIC
/begin CHARACTERISTIC xRotSp_RotAccelerationFilterFact_XDU16_34___A "Filterfaktor der gefilterten Rotorbeschleunigung" VALUE 0x158350 AblGLKWuw 0.5 RIGHTSH7NP 0 0.5 FORMAT "%9.7" /end CHARACTERISTIC
/begin CHARACTERISTIC xRotSp_RotAccelerationFilterFact_XDU16_35___A "Filterfaktor der gefilterten Rotorbeschleunigung" VALUE 0x158352 AblGLKWuw 0.5 RIGHTSH7NP 0 0.5 FORMAT "%9.7" /end CHARACTERISTIC
/begin CHARACTERISTIC xRotSp_RotAccelerationLowFilterFact_XDU16_00___A "Geringer Filterfaktor der nicht gefilterten Rotorbeschleunigung" VALUE 0x158354 AblGLKWuw 1 RIGHTSH6NP 0 1 FORMAT "%8.6" /end CHARACTERISTIC
/begin CHARACTERISTIC xRotSp_RotAccelerationLowFilterFact_XDU16_01___A "Geringer Filterfaktor der nicht gefilterten Rotorbeschleunigung" VALUE 0x158356 AblGLKWuw 1 RIGHTSH6NP 0 1 FORMAT "%8.6" /end CHARACTERISTIC
/begin CHARACTERISTIC xRotSp_RotAccelerationLowFilterFact_XDU16_02___A "Geringer Filterfaktor der nicht gefilterten Rotorbeschleunigung" VALUE 0x158358 AblGLKWuw 1 RIGHTSH6NP 0 1 FORMAT "%8.6" /end CHARACTERISTIC
/begin CHARACTERISTIC xRotSp_RotAccelerationLowFilterFact_XDU16_03___A "Geringer Filterfaktor der nicht gefilterten Rotorbeschleunigung" VALUE 0x15835A AblGLKWuw 1 RIGHTSH6NP 0 1 FORMAT "%8.6" /end CHARACTERISTIC
/begin CHARACTERISTIC xRotSp_RotAccelerationLowFilterFact_XDU16_04___A "Geringer Filterfaktor der nicht gefilterten Rotorbeschleunigung" VALUE 0x15835C AblGLKWuw 1 RIGHTSH6NP 0 1 FORMAT "%8.6" /end CHARACTERISTIC
/begin CHARACTERISTIC xRotSp_RotAccelerationLowFilterFact_XDU16_05___A "Geringer Filterfaktor der nicht gefilterten Rotorbeschleunigung" VALUE 0x15835E AblGLKWuw 1 RIGHTSH6NP 0 1 FORMAT "%8.6" /end CHARACTERISTIC
/begin CHARACTERISTIC xRotSp_RotAccelerationLowFilterFact_XDU16_06___A "Geringer Filterfaktor der nicht gefilterten Rotorbeschleunigung" VALUE 0x158360 AblGLKWuw 1 RIGHTSH6NP 0 1 FORMAT "%8.6" /end CHARACTERISTIC
/begin CHARACTERISTIC xRotSp_RotAccelerationLowFilterFact_XDU16_07___A "Geringer Filterfaktor der nicht gefilterten Rotorbeschleunigung" VALUE 0x158362 AblGLKWuw 1 RIGHTSH6NP 0 1 FORMAT "%8.6" /end CHARACTERISTIC
/begin CHARACTERISTIC xRotSp_RotAccelerationLowFilterFact_XDU16_08___A "Geringer Filterfaktor der nicht gefilterten Rotorbeschleunigung" VALUE 0x158364 AblGLKWuw 1 RIGHTSH6NP 0 1 FORMAT "%8.6" /end CHARACTERISTIC
/begin CHARACTERISTIC xRotSp_RotAccelerationLowFilterFact_XDU16_09___A "Geringer Filterfaktor der nicht gefilterten Rotorbeschleunigung" VALUE 0x158366 AblGLKWuw 1 RIGHTSH6NP 0 1 FORMAT "%8.6" /end CHARACTERISTIC
/begin CHARACTERISTIC xRotSp_RotAccelerationLowFilterFact_XDU16_10___A "Geringer Filterfaktor der nicht gefilterten Rotorbeschleunigung" VALUE 0x158368 AblGLKWuw 1 RIGHTSH6NP 0 1 FORMAT "%8.6" /end CHARACTERISTIC
/begin CHARACTERISTIC xRotSp_RotAccelerationLowFilterFact_XDU16_11___A "Geringer Filterfaktor der nicht gefilterten Rotorbeschleunigung" VALUE 0x15836A AblGLKWuw 1 RIGHTSH6NP 0 1 FORMAT "%8.6" /end CHARACTERISTIC
/begin CHARACTERISTIC xRotSp_RotAccelerationLowFilterFact_XDU16_12___A "Geringer Filterfaktor der nicht gefilterten Rotorbeschleunigung" VALUE 0x15836C AblGLKWuw 1 RIGHTSH6NP 0 1 FORMAT "%8.6" /end CHARACTERISTIC
/begin CHARACTERISTIC xRotSp_RotAccelerationLowFilterFact_XDU16_13___A "Geringer Filterfaktor der nicht gefilterten Rotorbeschleunigung" VALUE 0x15836E AblGLKWuw 1 RIGHTSH6NP 0 1 FORMAT "%8.6" /end CHARACTERISTIC
/begin CHARACTERISTIC xRotSp_RotAccelerationLowFilterFact_XDU16_14___A "Geringer Filterfaktor der nicht gefilterten Rotorbeschleunigung" VALUE 0x158370 AblGLKWuw 1 RIGHTSH6NP 0 1 FORMAT "%8.6" /end CHARACTERISTIC
/begin CHARACTERISTIC xRotSp_RotAccelerationLowFilterFact_XDU16_15___A "Geringer Filterfaktor der nicht gefilterten Rotorbeschleunigung" VALUE 0x158372 AblGLKWuw 1 RIGHTSH6NP 0 1 FORMAT "%8.6" /end CHARACTERISTIC
/begin CHARACTERISTIC xRotSp_RotAccelerationLowFilterFact_XDU16_16___A "Geringer Filterfaktor der nicht gefilterten Rotorbeschleunigung" VALUE 0x158374 AblGLKWuw 1 RIGHTSH6NP 0 1 FORMAT "%8.6" /end CHARACTERISTIC
/begin CHARACTERISTIC xRotSp_RotAccelerationLowFilterFact_XDU16_17___A "Geringer Filterfaktor der nicht gefilterten Rotorbeschleunigung" VALUE 0x158376 AblGLKWuw 1 RIGHTSH6NP 0 1 FORMAT "%8.6" /end CHARACTERISTIC
/begin CHARACTERISTIC xRotSp_RotAccelerationLowFilterFact_XDU16_18___A "Geringer Filterfaktor der nicht gefilterten Rotorbeschleunigung" VALUE 0x158378 AblGLKWuw 1 RIGHTSH6NP 0 1 FORMAT "%8.6" /end CHARACTERISTIC
/begin CHARACTERISTIC xRotSp_RotAccelerationLowFilterFact_XDU16_19___A "Geringer Filterfaktor der nicht gefilterten Rotorbeschleunigung" VALUE 0x15837A AblGLKWuw 1 RIGHTSH6NP 0 1 FORMAT "%8.6" /end CHARACTERISTIC
/begin CHARACTERISTIC xRotSp_RotAccelerationLowFilterFact_XDU16_20___A "Geringer Filterfaktor der nicht gefilterten Rotorbeschleunigung" VALUE 0x15837C AblGLKWuw 1 RIGHTSH6NP 0 1 FORMAT "%8.6" /end CHARACTERISTIC
/begin CHARACTERISTIC xRotSp_RotAccelerationLowFilterFact_XDU16_21___A "Geringer Filterfaktor der nicht gefilterten Rotorbeschleunigung" VALUE 0x15837E AblGLKWuw 1 RIGHTSH6NP 0 1 FORMAT "%8.6" /end CHARACTERISTIC
/begin CHARACTERISTIC xRotSp_RotAccelerationLowFilterFact_XDU16_22___A "Geringer Filterfaktor der nicht gefilterten Rotorbeschleunigung" VALUE 0x158380 AblGLKWuw 1 RIGHTSH6NP 0 1 FORMAT "%8.6" /end CHARACTERISTIC
/begin CHARACTERISTIC xRotSp_RotAccelerationLowFilterFact_XDU16_23___A "Geringer Filterfaktor der nicht gefilterten Rotorbeschleunigung" VALUE 0x158382 AblGLKWuw 1 RIGHTSH6NP 0 1 FORMAT "%8.6" /end CHARACTERISTIC
/begin CHARACTERISTIC xRotSp_RotAccelerationLowFilterFact_XDU16_24___A "Geringer Filterfaktor der nicht gefilterten Rotorbeschleunigung" VALUE 0x158384 AblGLKWuw 1 RIGHTSH6NP 0 1 FORMAT "%8.6" /end CHARACTERISTIC
/begin CHARACTERISTIC xRotSp_RotAccelerationLowFilterFact_XDU16_25___A "Geringer Filterfaktor der nicht gefilterten Rotorbeschleunigung" VALUE 0x158386 AblGLKWuw 1 RIGHTSH6NP 0 1 FORMAT "%8.6" /end CHARACTERISTIC
/begin CHARACTERISTIC xRotSp_RotAccelerationLowFilterFact_XDU16_26___A "Geringer Filterfaktor der nicht gefilterten Rotorbeschleunigung" VALUE 0x158388 AblGLKWuw 1 RIGHTSH6NP 0 1 FORMAT "%8.6" /end CHARACTERISTIC
/begin CHARACTERISTIC xRotSp_RotAccelerationLowFilterFact_XDU16_27___A "Geringer Filterfaktor der nicht gefilterten Rotorbeschleunigung" VALUE 0x15838A AblGLKWuw 1 RIGHTSH6NP 0 1 FORMAT "%8.6" /end CHARACTERISTIC
/begin CHARACTERISTIC xRotSp_RotAccelerationLowFilterFact_XDU16_28___A "Geringer Filterfaktor der nicht gefilterten Rotorbeschleunigung" VALUE 0x15838C AblGLKWuw 1 RIGHTSH6NP 0 1 FORMAT "%8.6" /end CHARACTERISTIC
/begin CHARACTERISTIC xRotSp_RotAccelerationLowFilterFact_XDU16_29___A "Geringer Filterfaktor der nicht gefilterten Rotorbeschleunigung" VALUE 0x15838E AblGLKWuw 1 RIGHTSH6NP 0 1 FORMAT "%8.6" /end CHARACTERISTIC
/begin CHARACTERISTIC xRotSp_RotAccelerationLowFilterFact_XDU16_30___A "Geringer Filterfaktor der nicht gefilterten Rotorbeschleunigung" VALUE 0x158390 AblGLKWuw 1 RIGHTSH6NP 0 1 FORMAT "%8.6" /end CHARACTERISTIC
/begin CHARACTERISTIC xRotSp_RotAccelerationLowFilterFact_XDU16_31___A "Geringer Filterfaktor der nicht gefilterten Rotorbeschleunigung" VALUE 0x158392 AblGLKWuw 1 RIGHTSH6NP 0 1 FORMAT "%8.6" /end CHARACTERISTIC
/begin CHARACTERISTIC xRotSp_RotAccelerationLowFilterFact_XDU16_32___A "Geringer Filterfaktor der nicht gefilterten Rotorbeschleunigung" VALUE 0x158394 AblGLKWuw 1 RIGHTSH6NP 0 1 FORMAT "%8.6" /end CHARACTERISTIC
/begin CHARACTERISTIC xRotSp_RotAccelerationLowFilterFact_XDU16_33___A "Geringer Filterfaktor der nicht gefilterten Rotorbeschleunigung" VALUE 0x158396 AblGLKWuw 1 RIGHTSH6NP 0 1 FORMAT "%8.6" /end CHARACTERISTIC
/begin CHARACTERISTIC xRotSp_RotAccelerationLowFilterFact_XDU16_34___A "Geringer Filterfaktor der nicht gefilterten Rotorbeschleunigung" VALUE 0x158398 AblGLKWuw 1 RIGHTSH6NP 0 1 FORMAT "%8.6" /end CHARACTERISTIC
/begin CHARACTERISTIC xRotSp_RotAccelerationLowFilterFact_XDU16_35___A "Geringer Filterfaktor der nicht gefilterten Rotorbeschleunigung" VALUE 0x15839A AblGLKWuw 1 RIGHTSH6NP 0 1 FORMAT "%8.6" /end CHARACTERISTIC
/begin CHARACTERISTIC xRotSp_RotSpeedFilterFactAcceleration_XDU16_00___A "Filterfaktor der gefilterten Rotordrehzahl für die Beschleunigung" VALUE 0x15839C AblGLKWuw 0.499023 RIGHTSH10NP 0.0009765625 0.5 FORMAT "%9.7" /end CHARACTERISTIC
/begin CHARACTERISTIC xRotSp_RotSpeedFilterFactAcceleration_XDU16_01___A "Filterfaktor der gefilterten Rotordrehzahl für die Beschleunigung" VALUE 0x15839E AblGLKWuw 0.499023 RIGHTSH10NP 0.0009765625 0.5 FORMAT "%9.7" /end CHARACTERISTIC
/begin CHARACTERISTIC xRotSp_RotSpeedFilterFactAcceleration_XDU16_02___A "Filterfaktor der gefilterten Rotordrehzahl für die Beschleunigung" VALUE 0x1583A0 AblGLKWuw 0.499023 RIGHTSH10NP 0.0009765625 0.5 FORMAT "%9.7" /end CHARACTERISTIC
/begin CHARACTERISTIC xRotSp_RotSpeedFilterFactAcceleration_XDU16_03___A "Filterfaktor der gefilterten Rotordrehzahl für die Beschleunigung" VALUE 0x1583A2 AblGLKWuw 0.499023 RIGHTSH10NP 0.0009765625 0.5 FORMAT "%9.7" /end CHARACTERISTIC
/begin CHARACTERISTIC xRotSp_RotSpeedFilterFactAcceleration_XDU16_04___A "Filterfaktor der gefilterten Rotordrehzahl für die Beschleunigung" VALUE 0x1583A4 AblGLKWuw 0.499023 RIGHTSH10NP 0.0009765625 0.5 FORMAT "%9.7" /end CHARACTERISTIC
/begin CHARACTERISTIC xRotSp_RotSpeedFilterFactAcceleration_XDU16_05___A "Filterfaktor der gefilterten Rotordrehzahl für die Beschleunigung" VALUE 0x1583A6 AblGLKWuw 0.499023 RIGHTSH10NP 0.0009765625 0.5 FORMAT "%9.7" /end CHARACTERISTIC
/begin CHARACTERISTIC xRotSp_RotSpeedFilterFactAcceleration_XDU16_06___A "Filterfaktor der gefilterten Rotordrehzahl für die Beschleunigung" VALUE 0x1583A8 AblGLKWuw 0.499023 RIGHTSH10NP 0.0009765625 0.5 FORMAT "%9.7" /end CHARACTERISTIC
/begin CHARACTERISTIC xRotSp_RotSpeedFilterFactAcceleration_XDU16_07___A "Filterfaktor der gefilterten Rotordrehzahl für die Beschleunigung" VALUE 0x1583AA AblGLKWuw 0.499023 RIGHTSH10NP 0.0009765625 0.5 FORMAT "%9.7" /end CHARACTERISTIC
/begin CHARACTERISTIC xRotSp_RotSpeedFilterFactAcceleration_XDU16_08___A "Filterfaktor der gefilterten Rotordrehzahl für die Beschleunigung" VALUE 0x1583AC AblGLKWuw 0.499023 RIGHTSH10NP 0.0009765625 0.5 FORMAT "%9.7" /end CHARACTERISTIC
/begin CHARACTERISTIC xRotSp_RotSpeedFilterFactAcceleration_XDU16_09___A "Filterfaktor der gefilterten Rotordrehzahl für die Beschleunigung" VALUE 0x1583AE AblGLKWuw 0.499023 RIGHTSH10NP 0.0009765625 0.5 FORMAT "%9.7" /end CHARACTERISTIC
/begin CHARACTERISTIC xRotSp_RotSpeedFilterFactAcceleration_XDU16_10___A "Filterfaktor der gefilterten Rotordrehzahl für die Beschleunigung" VALUE 0x1583B0 AblGLKWuw 0.499023 RIGHTSH10NP 0.0009765625 0.5 FORMAT "%9.7" /end CHARACTERISTIC
/begin CHARACTERISTIC xRotSp_RotSpeedFilterFactAcceleration_XDU16_11___A "Filterfaktor der gefilterten Rotordrehzahl für die Beschleunigung" VALUE 0x1583B2 AblGLKWuw 0.499023 RIGHTSH10NP 0.0009765625 0.5 FORMAT "%9.7" /end CHARACTERISTIC
/begin CHARACTERISTIC xRotSp_RotSpeedFilterFactAcceleration_XDU16_12___A "Filterfaktor der gefilterten Rotordrehzahl für die Beschleunigung" VALUE 0x1583B4 AblGLKWuw 0.499023 RIGHTSH10NP 0.0009765625 0.5 FORMAT "%9.7" /end CHARACTERISTIC
/begin CHARACTERISTIC xRotSp_RotSpeedFilterFactAcceleration_XDU16_13___A "Filterfaktor der gefilterten Rotordrehzahl für die Beschleunigung" VALUE 0x1583B6 AblGLKWuw 0.499023 RIGHTSH10NP 0.0009765625 0.5 FORMAT "%9.7" /end CHARACTERISTIC
/begin CHARACTERISTIC xRotSp_RotSpeedFilterFactAcceleration_XDU16_14___A "Filterfaktor der gefilterten Rotordrehzahl für die Beschleunigung" VALUE 0x1583B8 AblGLKWuw 0.499023 RIGHTSH10NP 0.0009765625 0.5 FORMAT "%9.7" /end CHARACTERISTIC
/begin CHARACTERISTIC xRotSp_RotSpeedFilterFactAcceleration_XDU16_15___A "Filterfaktor der gefilterten Rotordrehzahl für die Beschleunigung" VALUE 0x1583BA AblGLKWuw 0.499023 RIGHTSH10NP 0.0009765625 0.5 FORMAT "%9.7" /end CHARACTERISTIC
/begin CHARACTERISTIC xRotSp_RotSpeedFilterFactAcceleration_XDU16_16___A "Filterfaktor der gefilterten Rotordrehzahl für die Beschleunigung" VALUE 0x1583BC AblGLKWuw 0.499023 RIGHTSH10NP 0.0009765625 0.5 FORMAT "%9.7" /end CHARACTERISTIC
/begin CHARACTERISTIC xRotSp_RotSpeedFilterFactAcceleration_XDU16_17___A "Filterfaktor der gefilterten Rotordrehzahl für die Beschleunigung" VALUE 0x1583BE AblGLKWuw 0.499023 RIGHTSH10NP 0.0009765625 0.5 FORMAT "%9.7" /end CHARACTERISTIC
/begin CHARACTERISTIC xRotSp_RotSpeedFilterFactAcceleration_XDU16_18___A "Filterfaktor der gefilterten Rotordrehzahl für die Beschleunigung" VALUE 0x1583C0 AblGLKWuw 0.499023 RIGHTSH10NP 0.0009765625 0.5 FORMAT "%9.7" /end CHARACTERISTIC
/begin CHARACTERISTIC xRotSp_RotSpeedFilterFactAcceleration_XDU16_19___A "Filterfaktor der gefilterten Rotordrehzahl für die Beschleunigung" VALUE 0x1583C2 AblGLKWuw 0.499023 RIGHTSH10NP 0.0009765625 0.5 FORMAT "%9.7" /end CHARACTERISTIC
/begin CHARACTERISTIC xRotSp_RotSpeedFilterFactAcceleration_XDU16_20___A "Filterfaktor der gefilterten Rotordrehzahl für die Beschleunigung" VALUE 0x1583C4 AblGLKWuw 0.499023 RIGHTSH10NP 0.0009765625 0.5 FORMAT "%9.7" /end CHARACTERISTIC
/begin CHARACTERISTIC xRotSp_RotSpeedFilterFactAcceleration_XDU16_21___A "Filterfaktor der gefilterten Rotordrehzahl für die Beschleunigung" VALUE 0x1583C6 AblGLKWuw 0.499023 RIGHTSH10NP 0.0009765625 0.5 FORMAT "%9.7" /end CHARACTERISTIC
/begin CHARACTERISTIC xRotSp_RotSpeedFilterFactAcceleration_XDU16_22___A "Filterfaktor der gefilterten Rotordrehzahl für die Beschleunigung" VALUE 0x1583C8 AblGLKWuw 0.499023 RIGHTSH10NP 0.0009765625 0.5 FORMAT "%9.7" /end CHARACTERISTIC
/begin CHARACTERISTIC xRotSp_RotSpeedFilterFactAcceleration_XDU16_23___A "Filterfaktor der gefilterten Rotordrehzahl für die Beschleunigung" VALUE 0x1583CA AblGLKWuw 0.499023 RIGHTSH10NP 0.0009765625 0.5 FORMAT "%9.7" /end CHARACTERISTIC
/begin CHARACTERISTIC xRotSp_RotSpeedFilterFactAcceleration_XDU16_24___A "Filterfaktor der gefilterten Rotordrehzahl für die Beschleunigung" VALUE 0x1583CC AblGLKWuw 0.499023 RIGHTSH10NP 0.0009765625 0.5 FORMAT "%9.7" /end CHARACTERISTIC
/begin CHARACTERISTIC xRotSp_RotSpeedFilterFactAcceleration_XDU16_25___A "Filterfaktor der gefilterten Rotordrehzahl für die Beschleunigung" VALUE 0x1583CE AblGLKWuw 0.499023 RIGHTSH10NP 0.0009765625 0.5 FORMAT "%9.7" /end CHARACTERISTIC
/begin CHARACTERISTIC xRotSp_RotSpeedFilterFactAcceleration_XDU16_26___A "Filterfaktor der gefilterten Rotordrehzahl für die Beschleunigung" VALUE 0x1583D0 AblGLKWuw 0.499023 RIGHTSH10NP 0.0009765625 0.5 FORMAT "%9.7" /end CHARACTERISTIC
/begin CHARACTERISTIC xRotSp_RotSpeedFilterFactAcceleration_XDU16_27___A "Filterfaktor der gefilterten Rotordrehzahl für die Beschleunigung" VALUE 0x1583D2 AblGLKWuw 0.499023 RIGHTSH10NP 0.0009765625 0.5 FORMAT "%9.7" /end CHARACTERISTIC
/begin CHARACTERISTIC xRotSp_RotSpeedFilterFactAcceleration_XDU16_28___A "Filterfaktor der gefilterten Rotordrehzahl für die Beschleunigung" VALUE 0x1583D4 AblGLKWuw 0.499023 RIGHTSH10NP 0.0009765625 0.5 FORMAT "%9.7" /end CHARACTERISTIC
/begin CHARACTERISTIC xRotSp_RotSpeedFilterFactAcceleration_XDU16_29___A "Filterfaktor der gefilterten Rotordrehzahl für die Beschleunigung" VALUE 0x1583D6 AblGLKWuw 0.499023 RIGHTSH10NP 0.0009765625 0.5 FORMAT "%9.7" /end CHARACTERISTIC
/begin CHARACTERISTIC xRotSp_RotSpeedFilterFactAcceleration_XDU16_30___A "Filterfaktor der gefilterten Rotordrehzahl für die Beschleunigung" VALUE 0x1583D8 AblGLKWuw 0.499023 RIGHTSH10NP 0.0009765625 0.5 FORMAT "%9.7" /end CHARACTERISTIC
/begin CHARACTERISTIC xRotSp_RotSpeedFilterFactAcceleration_XDU16_31___A "Filterfaktor der gefilterten Rotordrehzahl für die Beschleunigung" VALUE 0x1583DA AblGLKWuw 0.499023 RIGHTSH10NP 0.0009765625 0.5 FORMAT "%9.7" /end CHARACTERISTIC
/begin CHARACTERISTIC xRotSp_RotSpeedFilterFactAcceleration_XDU16_32___A "Filterfaktor der gefilterten Rotordrehzahl für die Beschleunigung" VALUE 0x1583DC AblGLKWuw 0.499023 RIGHTSH10NP 0.0009765625 0.5 FORMAT "%9.7" /end CHARACTERISTIC
/begin CHARACTERISTIC xRotSp_RotSpeedFilterFactAcceleration_XDU16_33___A "Filterfaktor der gefilterten Rotordrehzahl für die Beschleunigung" VALUE 0x1583DE AblGLKWuw 0.499023 RIGHTSH10NP 0.0009765625 0.5 FORMAT "%9.7" /end CHARACTERISTIC
/begin CHARACTERISTIC xRotSp_RotSpeedFilterFactAcceleration_XDU16_34___A "Filterfaktor der gefilterten Rotordrehzahl für die Beschleunigung" VALUE 0x1583E0 AblGLKWuw 0.499023 RIGHTSH10NP 0.0009765625 0.5 FORMAT "%9.7" /end CHARACTERISTIC
/begin CHARACTERISTIC xRotSp_RotSpeedFilterFactAcceleration_XDU16_35___A "Filterfaktor der gefilterten Rotordrehzahl für die Beschleunigung" VALUE 0x1583E2 AblGLKWuw 0.499023 RIGHTSH10NP 0.0009765625 0.5 FORMAT "%9.7" /end CHARACTERISTIC
/begin CHARACTERISTIC xRotSp_RotSpeedFilterFact_XDU16_00___A "Filterfaktor der gefilterten Rotorgeschwindigkeit" VALUE 0x1583E4 AblGLKWuw 0.499023 RIGHTSH10NP 0.0009765625 0.5 FORMAT "%9.7" /end CHARACTERISTIC
/begin CHARACTERISTIC xRotSp_RotSpeedFilterFact_XDU16_01___A "Filterfaktor der gefilterten Rotorgeschwindigkeit" VALUE 0x1583E6 AblGLKWuw 0.499023 RIGHTSH10NP 0.0009765625 0.5 FORMAT "%9.7" /end CHARACTERISTIC
/begin CHARACTERISTIC xRotSp_RotSpeedFilterFact_XDU16_02___A "Filterfaktor der gefilterten Rotorgeschwindigkeit" VALUE 0x1583E8 AblGLKWuw 0.499023 RIGHTSH10NP 0.0009765625 0.5 FORMAT "%9.7" /end CHARACTERISTIC
/begin CHARACTERISTIC xRotSp_RotSpeedFilterFact_XDU16_03___A "Filterfaktor der gefilterten Rotorgeschwindigkeit" VALUE 0x1583EA AblGLKWuw 0.499023 RIGHTSH10NP 0.0009765625 0.5 FORMAT "%9.7" /end CHARACTERISTIC
/begin CHARACTERISTIC xRotSp_RotSpeedFilterFact_XDU16_04___A "Filterfaktor der gefilterten Rotorgeschwindigkeit" VALUE 0x1583EC AblGLKWuw 0.499023 RIGHTSH10NP 0.0009765625 0.5 FORMAT "%9.7" /end CHARACTERISTIC
/begin CHARACTERISTIC xRotSp_RotSpeedFilterFact_XDU16_05___A "Filterfaktor der gefilterten Rotorgeschwindigkeit" VALUE 0x1583EE AblGLKWuw 0.499023 RIGHTSH10NP 0.0009765625 0.5 FORMAT "%9.7" /end CHARACTERISTIC
/begin CHARACTERISTIC xRotSp_RotSpeedFilterFact_XDU16_06___A "Filterfaktor der gefilterten Rotorgeschwindigkeit" VALUE 0x1583F0 AblGLKWuw 0.499023 RIGHTSH10NP 0.0009765625 0.5 FORMAT "%9.7" /end CHARACTERISTIC
/begin CHARACTERISTIC xRotSp_RotSpeedFilterFact_XDU16_07___A "Filterfaktor der gefilterten Rotorgeschwindigkeit" VALUE 0x1583F2 AblGLKWuw 0.499023 RIGHTSH10NP 0.0009765625 0.5 FORMAT "%9.7" /end CHARACTERISTIC
/begin CHARACTERISTIC xRotSp_RotSpeedFilterFact_XDU16_08___A "Filterfaktor der gefilterten Rotorgeschwindigkeit" VALUE 0x1583F4 AblGLKWuw 0.499023 RIGHTSH10NP 0.0009765625 0.5 FORMAT "%9.7" /end CHARACTERISTIC
/begin CHARACTERISTIC xRotSp_RotSpeedFilterFact_XDU16_09___A "Filterfaktor der gefilterten Rotorgeschwindigkeit" VALUE 0x1583F6 AblGLKWuw 0.499023 RIGHTSH10NP 0.0009765625 0.5 FORMAT "%9.7" /end CHARACTERISTIC
/begin CHARACTERISTIC xRotSp_RotSpeedFilterFact_XDU16_10___A "Filterfaktor der gefilterten Rotorgeschwindigkeit" VALUE 0x1583F8 AblGLKWuw 0.499023 RIGHTSH10NP 0.0009765625 0.5 FORMAT "%9.7" /end CHARACTERISTIC
/begin CHARACTERISTIC xRotSp_RotSpeedFilterFact_XDU16_11___A "Filterfaktor der gefilterten Rotorgeschwindigkeit" VALUE 0x1583FA AblGLKWuw 0.499023 RIGHTSH10NP 0.0009765625 0.5 FORMAT "%9.7" /end CHARACTERISTIC
/begin CHARACTERISTIC xRotSp_RotSpeedFilterFact_XDU16_12___A "Filterfaktor der gefilterten Rotorgeschwindigkeit" VALUE 0x1583FC AblGLKWuw 0.499023 RIGHTSH10NP 0.0009765625 0.5 FORMAT "%9.7" /end CHARACTERISTIC
/begin CHARACTERISTIC xRotSp_RotSpeedFilterFact_XDU16_13___A "Filterfaktor der gefilterten Rotorgeschwindigkeit" VALUE 0x1583FE AblGLKWuw 0.499023 RIGHTSH10NP 0.0009765625 0.5 FORMAT "%9.7" /end CHARACTERISTIC
/begin CHARACTERISTIC xRotSp_RotSpeedFilterFact_XDU16_14___A "Filterfaktor der gefilterten Rotorgeschwindigkeit" VALUE 0x158400 AblGLKWuw 0.499023 RIGHTSH10NP 0.0009765625 0.5 FORMAT "%9.7" /end CHARACTERISTIC
/begin CHARACTERISTIC xRotSp_RotSpeedFilterFact_XDU16_15___A "Filterfaktor der gefilterten Rotorgeschwindigkeit" VALUE 0x158402 AblGLKWuw 0.499023 RIGHTSH10NP 0.0009765625 0.5 FORMAT "%9.7" /end CHARACTERISTIC
/begin CHARACTERISTIC xRotSp_RotSpeedFilterFact_XDU16_16___A "Filterfaktor der gefilterten Rotorgeschwindigkeit" VALUE 0x158404 AblGLKWuw 0.499023 RIGHTSH10NP 0.0009765625 0.5 FORMAT "%9.7" /end CHARACTERISTIC
/begin CHARACTERISTIC xRotSp_RotSpeedFilterFact_XDU16_17___A "Filterfaktor der gefilterten Rotorgeschwindigkeit" VALUE 0x158406 AblGLKWuw 0.499023 RIGHTSH10NP 0.0009765625 0.5 FORMAT "%9.7" /end CHARACTERISTIC
/begin CHARACTERISTIC xRotSp_RotSpeedFilterFact_XDU16_18___A "Filterfaktor der gefilterten Rotorgeschwindigkeit" VALUE 0x158408 AblGLKWuw 0.499023 RIGHTSH10NP 0.0009765625 0.5 FORMAT "%9.7" /end CHARACTERISTIC
/begin CHARACTERISTIC xRotSp_RotSpeedFilterFact_XDU16_19___A "Filterfaktor der gefilterten Rotorgeschwindigkeit" VALUE 0x15840A AblGLKWuw 0.499023 RIGHTSH10NP 0.0009765625 0.5 FORMAT "%9.7" /end CHARACTERISTIC
/begin CHARACTERISTIC xRotSp_RotSpeedFilterFact_XDU16_20___A "Filterfaktor der gefilterten Rotorgeschwindigkeit" VALUE 0x15840C AblGLKWuw 0.499023 RIGHTSH10NP 0.0009765625 0.5 FORMAT "%9.7" /end CHARACTERISTIC
/begin CHARACTERISTIC xRotSp_RotSpeedFilterFact_XDU16_21___A "Filterfaktor der gefilterten Rotorgeschwindigkeit" VALUE 0x15840E AblGLKWuw 0.499023 RIGHTSH10NP 0.0009765625 0.5 FORMAT "%9.7" /end CHARACTERISTIC
/begin CHARACTERISTIC xRotSp_RotSpeedFilterFact_XDU16_22___A "Filterfaktor der gefilterten Rotorgeschwindigkeit" VALUE 0x158410 AblGLKWuw 0.499023 RIGHTSH10NP 0.0009765625 0.5 FORMAT "%9.7" /end CHARACTERISTIC
/begin CHARACTERISTIC xRotSp_RotSpeedFilterFact_XDU16_23___A "Filterfaktor der gefilterten Rotorgeschwindigkeit" VALUE 0x158412 AblGLKWuw 0.499023 RIGHTSH10NP 0.0009765625 0.5 FORMAT "%9.7" /end CHARACTERISTIC
/begin CHARACTERISTIC xRotSp_RotSpeedFilterFact_XDU16_24___A "Filterfaktor der gefilterten Rotorgeschwindigkeit" VALUE 0x158414 AblGLKWuw 0.499023 RIGHTSH10NP 0.0009765625 0.5 FORMAT "%9.7" /end CHARACTERISTIC
/begin CHARACTERISTIC xRotSp_RotSpeedFilterFact_XDU16_25___A "Filterfaktor der gefilterten Rotorgeschwindigkeit" VALUE 0x158416 AblGLKWuw 0.499023 RIGHTSH10NP 0.0009765625 0.5 FORMAT "%9.7" /end CHARACTERISTIC
/begin CHARACTERISTIC xRotSp_RotSpeedFilterFact_XDU16_26___A "Filterfaktor der gefilterten Rotorgeschwindigkeit" VALUE 0x158418 AblGLKWuw 0.499023 RIGHTSH10NP 0.0009765625 0.5 FORMAT "%9.7" /end CHARACTERISTIC
/begin CHARACTERISTIC xRotSp_RotSpeedFilterFact_XDU16_27___A "Filterfaktor der gefilterten Rotorgeschwindigkeit" VALUE 0x15841A AblGLKWuw 0.499023 RIGHTSH10NP 0.0009765625 0.5 FORMAT "%9.7" /end CHARACTERISTIC
/begin CHARACTERISTIC xRotSp_RotSpeedFilterFact_XDU16_28___A "Filterfaktor der gefilterten Rotorgeschwindigkeit" VALUE 0x15841C AblGLKWuw 0.499023 RIGHTSH10NP 0.0009765625 0.5 FORMAT "%9.7" /end CHARACTERISTIC
/begin CHARACTERISTIC xRotSp_RotSpeedFilterFact_XDU16_29___A "Filterfaktor der gefilterten Rotorgeschwindigkeit" VALUE 0x15841E AblGLKWuw 0.499023 RIGHTSH10NP 0.0009765625 0.5 FORMAT "%9.7" /end CHARACTERISTIC
/begin CHARACTERISTIC xRotSp_RotSpeedFilterFact_XDU16_30___A "Filterfaktor der gefilterten Rotorgeschwindigkeit" VALUE 0x158420 AblGLKWuw 0.499023 RIGHTSH10NP 0.0009765625 0.5 FORMAT "%9.7" /end CHARACTERISTIC
/begin CHARACTERISTIC xRotSp_RotSpeedFilterFact_XDU16_31___A "Filterfaktor der gefilterten Rotorgeschwindigkeit" VALUE 0x158422 AblGLKWuw 0.499023 RIGHTSH10NP 0.0009765625 0.5 FORMAT "%9.7" /end CHARACTERISTIC
/begin CHARACTERISTIC xRotSp_RotSpeedFilterFact_XDU16_32___A "Filterfaktor der gefilterten Rotorgeschwindigkeit" VALUE 0x158424 AblGLKWuw 0.499023 RIGHTSH10NP 0.0009765625 0.5 FORMAT "%9.7" /end CHARACTERISTIC
/begin CHARACTERISTIC xRotSp_RotSpeedFilterFact_XDU16_33___A "Filterfaktor der gefilterten Rotorgeschwindigkeit" VALUE 0x158426 AblGLKWuw 0.499023 RIGHTSH10NP 0.0009765625 0.5 FORMAT "%9.7" /end CHARACTERISTIC
/begin CHARACTERISTIC xRotSp_RotSpeedFilterFact_XDU16_34___A "Filterfaktor der gefilterten Rotorgeschwindigkeit" VALUE 0x158428 AblGLKWuw 0.499023 RIGHTSH10NP 0.0009765625 0.5 FORMAT "%9.7" /end CHARACTERISTIC
/begin CHARACTERISTIC xRotSp_RotSpeedFilterFact_XDU16_35___A "Filterfaktor der gefilterten Rotorgeschwindigkeit" VALUE 0x15842A AblGLKWuw 0.499023 RIGHTSH10NP 0.0009765625 0.5 FORMAT "%9.7" /end CHARACTERISTIC
/begin CHARACTERISTIC xRpCorr_LTACompIntegFactor_XDU16 "Integrationsfaktor Langzeitkorrektur" VALUE 0x150A26 AblGLKWuw 0.0209961 RIGHTSH16NP 0 0.02099609 FORMAT "%10.8" /end CHARACTERISTIC
/begin CHARACTERISTIC xRpCorr_STIntegrationFactor_XDU16 "Integrationsfaktor Kurzzeitkorrektur; Lerngeschwindigkeit" VALUE 0x150A28 AblGLKWuw 0.899994 RIGHTSH16NP 0 0.8999939 FORMAT "%9.7" /end CHARACTERISTIC
/begin CHARACTERISTIC xRpSync_TorsionRpsFactor_XDU16 "Factor for TorsionTwist to RPS compensation" VALUE 0x150A2A AblGLKWuw 2 TBTSTIFFHIGH 0 2 FORMAT "%8.6" /end CHARACTERISTIC
/begin CHARACTERISTIC xRWCon_RackPos2WheelAngleRatio_XAU16 "ratio of rack position to wheel angle" VAL_BLK 0x150E9C AblGLKWBuw 1.95001 RIGHTSH15NP 0 1.950012 NUMBER 10 FORMAT "%8.6" /end CHARACTERISTIC
/begin CHARACTERISTIC xSafCtrl_DPart_XDU16 "D Part" VALUE 0x150A2C AblGLKWuw 30 RIGHTSH10NP 0 30 FORMAT "%8.5" /end CHARACTERISTIC
/begin CHARACTERISTIC xSafCtrl_InertiaFactor_XDS16 "Inertia Faktor" VALUE 0x150A2E AblGLKWsw 2 RIGHTSH10NP -1 1 FORMAT "%8.6" /end CHARACTERISTIC
/begin CHARACTERISTIC xSafCtrl_IPart_XDU16 "I Part" VALUE 0x150A30 AblGLKWuw 1 RIGHTSH15NP 0 1 FORMAT "%8.6" /end CHARACTERISTIC
/begin CHARACTERISTIC xSafCtrl_PPart_XDU16 "P Part" VALUE 0x150A32 AblGLKWuw 10 RIGHTSH10NP 0 10 FORMAT "%8.5" /end CHARACTERISTIC
/begin CHARACTERISTIC xShimmy_A11_XDU16_0___A "Parameter A11" VALUE 0x15842C AblGLKWuw 3.90002 RIGHTSH13NP 0 3.900024 FORMAT "%8.6" /end CHARACTERISTIC
/begin CHARACTERISTIC xShimmy_A11_XDU16_1___A "Parameter A11" VALUE 0x15842E AblGLKWuw 3.90002 RIGHTSH13NP 0 3.900024 FORMAT "%8.6" /end CHARACTERISTIC
/begin CHARACTERISTIC xShimmy_A11_XDU16_2___A "Parameter A11" VALUE 0x158430 AblGLKWuw 3.90002 RIGHTSH13NP 0 3.900024 FORMAT "%8.6" /end CHARACTERISTIC
/begin CHARACTERISTIC xShimmy_A11_XDU16_3___A "Parameter A11" VALUE 0x158432 AblGLKWuw 3.90002 RIGHTSH13NP 0 3.900024 FORMAT "%8.6" /end CHARACTERISTIC
/begin CHARACTERISTIC xShimmy_A11_XDU16_4___A "Parameter A11" VALUE 0x158434 AblGLKWuw 3.90002 RIGHTSH13NP 0 3.900024 FORMAT "%8.6" /end CHARACTERISTIC
/begin CHARACTERISTIC xShimmy_A11_XDU16_5___A "Parameter A11" VALUE 0x158436 AblGLKWuw 3.90002 RIGHTSH13NP 0 3.900024 FORMAT "%8.6" /end CHARACTERISTIC
/begin CHARACTERISTIC xShimmy_A12_XDS16_0___A "Parameter A12" VALUE 0x158438 AblGLKWsw 7.80005 RIGHTSH13NP -3.900024 3.900024 FORMAT "%8.6" /end CHARACTERISTIC
/begin CHARACTERISTIC xShimmy_A12_XDS16_1___A "Parameter A12" VALUE 0x15843A AblGLKWsw 7.80005 RIGHTSH13NP -3.900024 3.900024 FORMAT "%8.6" /end CHARACTERISTIC
/begin CHARACTERISTIC xShimmy_A12_XDS16_2___A "Parameter A12" VALUE 0x15843C AblGLKWsw 7.80005 RIGHTSH13NP -3.900024 3.900024 FORMAT "%8.6" /end CHARACTERISTIC
/begin CHARACTERISTIC xShimmy_A12_XDS16_3___A "Parameter A12" VALUE 0x15843E AblGLKWsw 7.80005 RIGHTSH13NP -3.900024 3.900024 FORMAT "%8.6" /end CHARACTERISTIC
/begin CHARACTERISTIC xShimmy_A12_XDS16_4___A "Parameter A12" VALUE 0x158440 AblGLKWsw 7.80005 RIGHTSH13NP -3.900024 3.900024 FORMAT "%8.6" /end CHARACTERISTIC
/begin CHARACTERISTIC xShimmy_A12_XDS16_5___A "Parameter A12" VALUE 0x158442 AblGLKWsw 7.80005 RIGHTSH13NP -3.900024 3.900024 FORMAT "%8.6" /end CHARACTERISTIC
/begin CHARACTERISTIC xShimmy_A13_XDU16 "Parameter A13" VALUE 0x14A0B4 AblGLKWuw 3 RIGHTSH13NP 0 3 FORMAT "%8.6" /end CHARACTERISTIC
/begin CHARACTERISTIC xShimmy_A21_XDS16_0___A "Parameter Estimator A21" VALUE 0x158444 AblGLKWsw 8 RIGHTSH12NP -4 4 FORMAT "%8.6" /end CHARACTERISTIC
/begin CHARACTERISTIC xShimmy_A21_XDS16_1___A "Parameter Estimator A21" VALUE 0x158446 AblGLKWsw 8 RIGHTSH12NP -4 4 FORMAT "%8.6" /end CHARACTERISTIC
/begin CHARACTERISTIC xShimmy_A21_XDS16_2___A "Parameter Estimator A21" VALUE 0x158448 AblGLKWsw 8 RIGHTSH12NP -4 4 FORMAT "%8.6" /end CHARACTERISTIC
/begin CHARACTERISTIC xShimmy_A21_XDS16_3___A "Parameter Estimator A21" VALUE 0x15844A AblGLKWsw 8 RIGHTSH12NP -4 4 FORMAT "%8.6" /end CHARACTERISTIC
/begin CHARACTERISTIC xShimmy_A21_XDS16_4___A "Parameter Estimator A21" VALUE 0x15844C AblGLKWsw 8 RIGHTSH12NP -4 4 FORMAT "%8.6" /end CHARACTERISTIC
/begin CHARACTERISTIC xShimmy_A21_XDS16_5___A "Parameter Estimator A21" VALUE 0x15844E AblGLKWsw 8 RIGHTSH12NP -4 4 FORMAT "%8.6" /end CHARACTERISTIC
/begin CHARACTERISTIC xShimmy_A22L_XAU16_0___A "Kennlinie A22L" CURVE 0x15F354 AblGLKLuw 30 RIGHTSH10NP 0 30 FORMAT "%8.5"
 /begin AXIS_DESCR STD_AXIS qShimmy_Freq_xdu16 RIGHTSH7NP 5 0 25 FORMAT "%8.5" DEPOSIT ABSOLUTE /end AXIS_DESCR
/end CHARACTERISTIC
/begin CHARACTERISTIC xShimmy_A22L_XAU16_1___A "Kennlinie A22L" CURVE 0x15F36C AblGLKLuw 30 RIGHTSH10NP 0 30 FORMAT "%8.5"
 /begin AXIS_DESCR STD_AXIS qShimmy_Freq_xdu16 RIGHTSH7NP 5 0 25 FORMAT "%8.5" DEPOSIT ABSOLUTE /end AXIS_DESCR
/end CHARACTERISTIC
/begin CHARACTERISTIC xShimmy_A22L_XAU16_2___A "Kennlinie A22L" CURVE 0x15F384 AblGLKLuw 30 RIGHTSH10NP 0 30 FORMAT "%8.5"
 /begin AXIS_DESCR STD_AXIS qShimmy_Freq_xdu16 RIGHTSH7NP 5 0 25 FORMAT "%8.5" DEPOSIT ABSOLUTE /end AXIS_DESCR
/end CHARACTERISTIC
/begin CHARACTERISTIC xShimmy_A22L_XAU16_3___A "Kennlinie A22L" CURVE 0x15F39C AblGLKLuw 30 RIGHTSH10NP 0 30 FORMAT "%8.5"
 /begin AXIS_DESCR STD_AXIS qShimmy_Freq_xdu16 RIGHTSH7NP 5 0 25 FORMAT "%8.5" DEPOSIT ABSOLUTE /end AXIS_DESCR
/end CHARACTERISTIC
/begin CHARACTERISTIC xShimmy_A22L_XAU16_4___A "Kennlinie A22L" CURVE 0x15F3B4 AblGLKLuw 30 RIGHTSH10NP 0 30 FORMAT "%8.5"
 /begin AXIS_DESCR STD_AXIS qShimmy_Freq_xdu16 RIGHTSH7NP 5 0 25 FORMAT "%8.5" DEPOSIT ABSOLUTE /end AXIS_DESCR
/end CHARACTERISTIC
/begin CHARACTERISTIC xShimmy_A22L_XAU16_5___A "Kennlinie A22L" CURVE 0x15F3CC AblGLKLuw 30 RIGHTSH10NP 0 30 FORMAT "%8.5"
 /begin AXIS_DESCR STD_AXIS qShimmy_Freq_xdu16 RIGHTSH7NP 5 0 25 FORMAT "%8.5" DEPOSIT ABSOLUTE /end AXIS_DESCR
/end CHARACTERISTIC
/begin CHARACTERISTIC xShimmy_A23_XDS16_0___A "Parameter Estimator A23" VALUE 0x158450 AblGLKWsw 60 RIGHTSH10NP -30 30 FORMAT "%8.5" /end CHARACTERISTIC
/begin CHARACTERISTIC xShimmy_A23_XDS16_1___A "Parameter Estimator A23" VALUE 0x158452 AblGLKWsw 60 RIGHTSH10NP -30 30 FORMAT "%8.5" /end CHARACTERISTIC
/begin CHARACTERISTIC xShimmy_A23_XDS16_2___A "Parameter Estimator A23" VALUE 0x158454 AblGLKWsw 60 RIGHTSH10NP -30 30 FORMAT "%8.5" /end CHARACTERISTIC
/begin CHARACTERISTIC xShimmy_A23_XDS16_3___A "Parameter Estimator A23" VALUE 0x158456 AblGLKWsw 60 RIGHTSH10NP -30 30 FORMAT "%8.5" /end CHARACTERISTIC
/begin CHARACTERISTIC xShimmy_A23_XDS16_4___A "Parameter Estimator A23" VALUE 0x158458 AblGLKWsw 60 RIGHTSH10NP -30 30 FORMAT "%8.5" /end CHARACTERISTIC
/begin CHARACTERISTIC xShimmy_A23_XDS16_5___A "Parameter Estimator A23" VALUE 0x15845A AblGLKWsw 60 RIGHTSH10NP -30 30 FORMAT "%8.5" /end CHARACTERISTIC
/begin CHARACTERISTIC xShimmy_A31_XDS16_0___A "Parameter Estimator A31" VALUE 0x15845C AblGLKWsw 8 RIGHTSH12NP -4 4 FORMAT "%8.6" /end CHARACTERISTIC
/begin CHARACTERISTIC xShimmy_A31_XDS16_1___A "Parameter Estimator A31" VALUE 0x15845E AblGLKWsw 8 RIGHTSH12NP -4 4 FORMAT "%8.6" /end CHARACTERISTIC
/begin CHARACTERISTIC xShimmy_A31_XDS16_2___A "Parameter Estimator A31" VALUE 0x158460 AblGLKWsw 8 RIGHTSH12NP -4 4 FORMAT "%8.6" /end CHARACTERISTIC
/begin CHARACTERISTIC xShimmy_A31_XDS16_3___A "Parameter Estimator A31" VALUE 0x158462 AblGLKWsw 8 RIGHTSH12NP -4 4 FORMAT "%8.6" /end CHARACTERISTIC
/begin CHARACTERISTIC xShimmy_A31_XDS16_4___A "Parameter Estimator A31" VALUE 0x158464 AblGLKWsw 8 RIGHTSH12NP -4 4 FORMAT "%8.6" /end CHARACTERISTIC
/begin CHARACTERISTIC xShimmy_A31_XDS16_5___A "Parameter Estimator A31" VALUE 0x158466 AblGLKWsw 8 RIGHTSH12NP -4 4 FORMAT "%8.6" /end CHARACTERISTIC
/begin CHARACTERISTIC xShimmy_B11_XDS16_0___A "Parameter Estimator B11" VALUE 0x158468 AblGLKWsw 1.97998 RIGHTSH15NP -0.9899902 0.9899902 FORMAT "%9.7" /end CHARACTERISTIC
/begin CHARACTERISTIC xShimmy_B11_XDS16_1___A "Parameter Estimator B11" VALUE 0x15846A AblGLKWsw 1.97998 RIGHTSH15NP -0.9899902 0.9899902 FORMAT "%9.7" /end CHARACTERISTIC
/begin CHARACTERISTIC xShimmy_B11_XDS16_2___A "Parameter Estimator B11" VALUE 0x15846C AblGLKWsw 1.97998 RIGHTSH15NP -0.9899902 0.9899902 FORMAT "%9.7" /end CHARACTERISTIC
/begin CHARACTERISTIC xShimmy_B11_XDS16_3___A "Parameter Estimator B11" VALUE 0x15846E AblGLKWsw 1.97998 RIGHTSH15NP -0.9899902 0.9899902 FORMAT "%9.7" /end CHARACTERISTIC
/begin CHARACTERISTIC xShimmy_B11_XDS16_4___A "Parameter Estimator B11" VALUE 0x158470 AblGLKWsw 1.97998 RIGHTSH15NP -0.9899902 0.9899902 FORMAT "%9.7" /end CHARACTERISTIC
/begin CHARACTERISTIC xShimmy_B11_XDS16_5___A "Parameter Estimator B11" VALUE 0x158472 AblGLKWsw 1.97998 RIGHTSH15NP -0.9899902 0.9899902 FORMAT "%9.7" /end CHARACTERISTIC
/begin CHARACTERISTIC xShimmy_B21L_XAU16_0___A "Kennlinie B21L" CURVE 0x15F3E4 AblGLKLuw 63 RIGHTSH10NP 0 63 FORMAT "%8.5"
 /begin AXIS_DESCR STD_AXIS qShimmy_Freq_xdu16 RIGHTSH7NP 5 0 25 FORMAT "%8.5" DEPOSIT ABSOLUTE /end AXIS_DESCR
/end CHARACTERISTIC
/begin CHARACTERISTIC xShimmy_B21L_XAU16_1___A "Kennlinie B21L" CURVE 0x15F3FC AblGLKLuw 63 RIGHTSH10NP 0 63 FORMAT "%8.5"
 /begin AXIS_DESCR STD_AXIS qShimmy_Freq_xdu16 RIGHTSH7NP 5 0 25 FORMAT "%8.5" DEPOSIT ABSOLUTE /end AXIS_DESCR
/end CHARACTERISTIC
/begin CHARACTERISTIC xShimmy_B21L_XAU16_2___A "Kennlinie B21L" CURVE 0x15F414 AblGLKLuw 63 RIGHTSH10NP 0 63 FORMAT "%8.5"
 /begin AXIS_DESCR STD_AXIS qShimmy_Freq_xdu16 RIGHTSH7NP 5 0 25 FORMAT "%8.5" DEPOSIT ABSOLUTE /end AXIS_DESCR
/end CHARACTERISTIC
/begin CHARACTERISTIC xShimmy_B21L_XAU16_3___A "Kennlinie B21L" CURVE 0x15F42C AblGLKLuw 63 RIGHTSH10NP 0 63 FORMAT "%8.5"
 /begin AXIS_DESCR STD_AXIS qShimmy_Freq_xdu16 RIGHTSH7NP 5 0 25 FORMAT "%8.5" DEPOSIT ABSOLUTE /end AXIS_DESCR
/end CHARACTERISTIC
/begin CHARACTERISTIC xShimmy_B21L_XAU16_4___A "Kennlinie B21L" CURVE 0x15F444 AblGLKLuw 63 RIGHTSH10NP 0 63 FORMAT "%8.5"
 /begin AXIS_DESCR STD_AXIS qShimmy_Freq_xdu16 RIGHTSH7NP 5 0 25 FORMAT "%8.5" DEPOSIT ABSOLUTE /end AXIS_DESCR
/end CHARACTERISTIC
/begin CHARACTERISTIC xShimmy_B21L_XAU16_5___A "Kennlinie B21L" CURVE 0x15F45C AblGLKLuw 63 RIGHTSH10NP 0 63 FORMAT "%8.5"
 /begin AXIS_DESCR STD_AXIS qShimmy_Freq_xdu16 RIGHTSH7NP 5 0 25 FORMAT "%8.5" DEPOSIT ABSOLUTE /end AXIS_DESCR
/end CHARACTERISTIC
/begin CHARACTERISTIC xShimmy_B22L_XAU16_0___A "Kennlinie B22L" CURVE 0x15F474 AblGLKLuw 63 RIGHTSH10NP 0 63 FORMAT "%8.5"
 /begin AXIS_DESCR STD_AXIS qShimmy_Freq_xdu16 RIGHTSH7NP 5 0 25 FORMAT "%8.5" DEPOSIT ABSOLUTE /end AXIS_DESCR
/end CHARACTERISTIC
/begin CHARACTERISTIC xShimmy_B22L_XAU16_1___A "Kennlinie B22L" CURVE 0x15F48C AblGLKLuw 63 RIGHTSH10NP 0 63 FORMAT "%8.5"
 /begin AXIS_DESCR STD_AXIS qShimmy_Freq_xdu16 RIGHTSH7NP 5 0 25 FORMAT "%8.5" DEPOSIT ABSOLUTE /end AXIS_DESCR
/end CHARACTERISTIC
/begin CHARACTERISTIC xShimmy_B22L_XAU16_2___A "Kennlinie B22L" CURVE 0x15F4A4 AblGLKLuw 63 RIGHTSH10NP 0 63 FORMAT "%8.5"
 /begin AXIS_DESCR STD_AXIS qShimmy_Freq_xdu16 RIGHTSH7NP 5 0 25 FORMAT "%8.5" DEPOSIT ABSOLUTE /end AXIS_DESCR
/end CHARACTERISTIC
/begin CHARACTERISTIC xShimmy_B22L_XAU16_3___A "Kennlinie B22L" CURVE 0x15F4BC AblGLKLuw 63 RIGHTSH10NP 0 63 FORMAT "%8.5"
 /begin AXIS_DESCR STD_AXIS qShimmy_Freq_xdu16 RIGHTSH7NP 5 0 25 FORMAT "%8.5" DEPOSIT ABSOLUTE /end AXIS_DESCR
/end CHARACTERISTIC
/begin CHARACTERISTIC xShimmy_B22L_XAU16_4___A "Kennlinie B22L" CURVE 0x15F4D4 AblGLKLuw 63 RIGHTSH10NP 0 63 FORMAT "%8.5"
 /begin AXIS_DESCR STD_AXIS qShimmy_Freq_xdu16 RIGHTSH7NP 5 0 25 FORMAT "%8.5" DEPOSIT ABSOLUTE /end AXIS_DESCR
/end CHARACTERISTIC
/begin CHARACTERISTIC xShimmy_B22L_XAU16_5___A "Kennlinie B22L" CURVE 0x15F4EC AblGLKLuw 63 RIGHTSH10NP 0 63 FORMAT "%8.5"
 /begin AXIS_DESCR STD_AXIS qShimmy_Freq_xdu16 RIGHTSH7NP 5 0 25 FORMAT "%8.5" DEPOSIT ABSOLUTE /end AXIS_DESCR
/end CHARACTERISTIC
/begin CHARACTERISTIC xShimmy_B23L_XAU16_0___A "Kennlinie B23L" CURVE 0x15F504 AblGLKLuw 63 RIGHTSH10NP 0 63 FORMAT "%8.5"
 /begin AXIS_DESCR STD_AXIS qShimmy_Freq_xdu16 RIGHTSH7NP 5 0 25 FORMAT "%8.5" DEPOSIT ABSOLUTE /end AXIS_DESCR
/end CHARACTERISTIC
/begin CHARACTERISTIC xShimmy_B23L_XAU16_1___A "Kennlinie B23L" CURVE 0x15F51C AblGLKLuw 63 RIGHTSH10NP 0 63 FORMAT "%8.5"
 /begin AXIS_DESCR STD_AXIS qShimmy_Freq_xdu16 RIGHTSH7NP 5 0 25 FORMAT "%8.5" DEPOSIT ABSOLUTE /end AXIS_DESCR
/end CHARACTERISTIC
/begin CHARACTERISTIC xShimmy_B23L_XAU16_2___A "Kennlinie B23L" CURVE 0x15F534 AblGLKLuw 63 RIGHTSH10NP 0 63 FORMAT "%8.5"
 /begin AXIS_DESCR STD_AXIS qShimmy_Freq_xdu16 RIGHTSH7NP 5 0 25 FORMAT "%8.5" DEPOSIT ABSOLUTE /end AXIS_DESCR
/end CHARACTERISTIC
/begin CHARACTERISTIC xShimmy_B23L_XAU16_3___A "Kennlinie B23L" CURVE 0x15F54C AblGLKLuw 63 RIGHTSH10NP 0 63 FORMAT "%8.5"
 /begin AXIS_DESCR STD_AXIS qShimmy_Freq_xdu16 RIGHTSH7NP 5 0 25 FORMAT "%8.5" DEPOSIT ABSOLUTE /end AXIS_DESCR
/end CHARACTERISTIC
/begin CHARACTERISTIC xShimmy_B23L_XAU16_4___A "Kennlinie B23L" CURVE 0x15F564 AblGLKLuw 63 RIGHTSH10NP 0 63 FORMAT "%8.5"
 /begin AXIS_DESCR STD_AXIS qShimmy_Freq_xdu16 RIGHTSH7NP 5 0 25 FORMAT "%8.5" DEPOSIT ABSOLUTE /end AXIS_DESCR
/end CHARACTERISTIC
/begin CHARACTERISTIC xShimmy_B23L_XAU16_5___A "Kennlinie B23L" CURVE 0x15F57C AblGLKLuw 63 RIGHTSH10NP 0 63 FORMAT "%8.5"
 /begin AXIS_DESCR STD_AXIS qShimmy_Freq_xdu16 RIGHTSH7NP 5 0 25 FORMAT "%8.5" DEPOSIT ABSOLUTE /end AXIS_DESCR
/end CHARACTERISTIC
/begin CHARACTERISTIC xShimmy_B24L_XAU16_0___A "Kennlinie B24L" CURVE 0x15F594 AblGLKLuw 63 RIGHTSH10NP 0 63 FORMAT "%8.5"
 /begin AXIS_DESCR STD_AXIS qShimmy_Freq_xdu16 RIGHTSH7NP 5 0 25 FORMAT "%8.5" DEPOSIT ABSOLUTE /end AXIS_DESCR
/end CHARACTERISTIC
/begin CHARACTERISTIC xShimmy_B24L_XAU16_1___A "Kennlinie B24L" CURVE 0x15F5AC AblGLKLuw 63 RIGHTSH10NP 0 63 FORMAT "%8.5"
 /begin AXIS_DESCR STD_AXIS qShimmy_Freq_xdu16 RIGHTSH7NP 5 0 25 FORMAT "%8.5" DEPOSIT ABSOLUTE /end AXIS_DESCR
/end CHARACTERISTIC
/begin CHARACTERISTIC xShimmy_B24L_XAU16_2___A "Kennlinie B24L" CURVE 0x15F5C4 AblGLKLuw 63 RIGHTSH10NP 0 63 FORMAT "%8.5"
 /begin AXIS_DESCR STD_AXIS qShimmy_Freq_xdu16 RIGHTSH7NP 5 0 25 FORMAT "%8.5" DEPOSIT ABSOLUTE /end AXIS_DESCR
/end CHARACTERISTIC
/begin CHARACTERISTIC xShimmy_B24L_XAU16_3___A "Kennlinie B24L" CURVE 0x15F5DC AblGLKLuw 63 RIGHTSH10NP 0 63 FORMAT "%8.5"
 /begin AXIS_DESCR STD_AXIS qShimmy_Freq_xdu16 RIGHTSH7NP 5 0 25 FORMAT "%8.5" DEPOSIT ABSOLUTE /end AXIS_DESCR
/end CHARACTERISTIC
/begin CHARACTERISTIC xShimmy_B24L_XAU16_4___A "Kennlinie B24L" CURVE 0x15F5F4 AblGLKLuw 63 RIGHTSH10NP 0 63 FORMAT "%8.5"
 /begin AXIS_DESCR STD_AXIS qShimmy_Freq_xdu16 RIGHTSH7NP 5 0 25 FORMAT "%8.5" DEPOSIT ABSOLUTE /end AXIS_DESCR
/end CHARACTERISTIC
/begin CHARACTERISTIC xShimmy_B24L_XAU16_5___A "Kennlinie B24L" CURVE 0x15F60C AblGLKLuw 63 RIGHTSH10NP 0 63 FORMAT "%8.5"
 /begin AXIS_DESCR STD_AXIS qShimmy_Freq_xdu16 RIGHTSH7NP 5 0 25 FORMAT "%8.5" DEPOSIT ABSOLUTE /end AXIS_DESCR
/end CHARACTERISTIC
/begin CHARACTERISTIC xShimmy_B25L_XAU16_0___A "Kennlinie B25L" CURVE 0x15F624 AblGLKLuw 63 RIGHTSH10NP 0 63 FORMAT "%8.5"
 /begin AXIS_DESCR STD_AXIS qShimmy_Freq_xdu16 RIGHTSH7NP 5 0 25 FORMAT "%8.5" DEPOSIT ABSOLUTE /end AXIS_DESCR
/end CHARACTERISTIC
/begin CHARACTERISTIC xShimmy_B25L_XAU16_1___A "Kennlinie B25L" CURVE 0x15F63C AblGLKLuw 63 RIGHTSH10NP 0 63 FORMAT "%8.5"
 /begin AXIS_DESCR STD_AXIS qShimmy_Freq_xdu16 RIGHTSH7NP 5 0 25 FORMAT "%8.5" DEPOSIT ABSOLUTE /end AXIS_DESCR
/end CHARACTERISTIC
/begin CHARACTERISTIC xShimmy_B25L_XAU16_2___A "Kennlinie B25L" CURVE 0x15F654 AblGLKLuw 63 RIGHTSH10NP 0 63 FORMAT "%8.5"
 /begin AXIS_DESCR STD_AXIS qShimmy_Freq_xdu16 RIGHTSH7NP 5 0 25 FORMAT "%8.5" DEPOSIT ABSOLUTE /end AXIS_DESCR
/end CHARACTERISTIC
/begin CHARACTERISTIC xShimmy_B25L_XAU16_3___A "Kennlinie B25L" CURVE 0x15F66C AblGLKLuw 63 RIGHTSH10NP 0 63 FORMAT "%8.5"
 /begin AXIS_DESCR STD_AXIS qShimmy_Freq_xdu16 RIGHTSH7NP 5 0 25 FORMAT "%8.5" DEPOSIT ABSOLUTE /end AXIS_DESCR
/end CHARACTERISTIC
/begin CHARACTERISTIC xShimmy_B25L_XAU16_4___A "Kennlinie B25L" CURVE 0x15F684 AblGLKLuw 63 RIGHTSH10NP 0 63 FORMAT "%8.5"
 /begin AXIS_DESCR STD_AXIS qShimmy_Freq_xdu16 RIGHTSH7NP 5 0 25 FORMAT "%8.5" DEPOSIT ABSOLUTE /end AXIS_DESCR
/end CHARACTERISTIC
/begin CHARACTERISTIC xShimmy_B25L_XAU16_5___A "Kennlinie B25L" CURVE 0x15F69C AblGLKLuw 63 RIGHTSH10NP 0 63 FORMAT "%8.5"
 /begin AXIS_DESCR STD_AXIS qShimmy_Freq_xdu16 RIGHTSH7NP 5 0 25 FORMAT "%8.5" DEPOSIT ABSOLUTE /end AXIS_DESCR
/end CHARACTERISTIC
/begin CHARACTERISTIC xShimmy_C1_XDS16_0___A "Parameter C1" VALUE 0x158474 AblGLKWsw 1.97998 RIGHTSH15NP -0.9899902 0.9899902 FORMAT "%9.7" /end CHARACTERISTIC
/begin CHARACTERISTIC xShimmy_C1_XDS16_1___A "Parameter C1" VALUE 0x158476 AblGLKWsw 1.97998 RIGHTSH15NP -0.9899902 0.9899902 FORMAT "%9.7" /end CHARACTERISTIC
/begin CHARACTERISTIC xShimmy_C1_XDS16_2___A "Parameter C1" VALUE 0x158478 AblGLKWsw 1.97998 RIGHTSH15NP -0.9899902 0.9899902 FORMAT "%9.7" /end CHARACTERISTIC
/begin CHARACTERISTIC xShimmy_C1_XDS16_3___A "Parameter C1" VALUE 0x15847A AblGLKWsw 1.97998 RIGHTSH15NP -0.9899902 0.9899902 FORMAT "%9.7" /end CHARACTERISTIC
/begin CHARACTERISTIC xShimmy_C1_XDS16_4___A "Parameter C1" VALUE 0x15847C AblGLKWsw 1.97998 RIGHTSH15NP -0.9899902 0.9899902 FORMAT "%9.7" /end CHARACTERISTIC
/begin CHARACTERISTIC xShimmy_C1_XDS16_5___A "Parameter C1" VALUE 0x15847E AblGLKWsw 1.97998 RIGHTSH15NP -0.9899902 0.9899902 FORMAT "%9.7" /end CHARACTERISTIC
/begin CHARACTERISTIC xShimmy_CompBoundary_XDU16 "Kompensations-Grenze" VALUE 0x14A0B6 AblGLKWuw 1 RIGHTSH10NP 0 1 FORMAT "%8.6" /end CHARACTERISTIC
/begin CHARACTERISTIC xShimmy_CompensationActive_XDU8 "Shimmy Kompensation Aktiv" VALUE 0x14A0E4 AblGLKWub 1 ZU0 0 1 FORMAT "%5.3" /end CHARACTERISTIC
/begin CHARACTERISTIC xShimmy_CompHyster_XDU16 "Kompensations-Grenze fuer Hysterese" VALUE 0x14A0B8 AblGLKWuw 1 RIGHTSH10NP 0 1 FORMAT "%8.6" /end CHARACTERISTIC
/begin CHARACTERISTIC xShimmy_CountOff_XDU16 "Verzoegerung Statusmaschine waehrend Hysterese" VALUE 0x14A0BA AblGLKWuw 20 TIMSEC_1000 0 20 FORMAT "%8.5" /end CHARACTERISTIC
/begin CHARACTERISTIC xShimmy_CountOn_XDU16 "Verzoegerung Statusmaschine beim Einschalten" VALUE 0x14A0BC AblGLKWuw 1 TIMSEC_1000 0 1 FORMAT "%8.6" /end CHARACTERISTIC
/begin CHARACTERISTIC xShimmy_DampingFactorDecel_XDU16 "Dämpfungs Faktor nur bei der Verzögerung" VALUE 0x14A0BE AblGLKWuw 5 RIGHTSH7NP 0 5 FORMAT "%8.6" /end CHARACTERISTIC
/begin CHARACTERISTIC xShimmy_DampingFactorNorm_XDU16 "Dämpfungs Faktor bei Beschl." VALUE 0x14A0C0 AblGLKWuw 5 RIGHTSH7NP 0 5 FORMAT "%8.6" /end CHARACTERISTIC
/begin CHARACTERISTIC xShimmy_FeedbackFactor_XDS16_0___A "Feedback Faktor , muss 0.8 sein, bei ShimmyV2, wegen Motormomenten-MBR (bei ShimmyV1 TorsionBar-MBR)" VALUE 0x158480 AblGLKWsw 1.8125 RIGHTSH6NP -0.90625 0.90625 FORMAT "%9.7" /end CHARACTERISTIC
/begin CHARACTERISTIC xShimmy_FeedbackFactor_XDS16_1___A "Feedback Faktor , muss 0.8 sein, bei ShimmyV2, wegen Motormomenten-MBR (bei ShimmyV1 TorsionBar-MBR)" VALUE 0x158482 AblGLKWsw 1.8125 RIGHTSH6NP -0.90625 0.90625 FORMAT "%9.7" /end CHARACTERISTIC
/begin CHARACTERISTIC xShimmy_FeedbackFactor_XDS16_2___A "Feedback Faktor , muss 0.8 sein, bei ShimmyV2, wegen Motormomenten-MBR (bei ShimmyV1 TorsionBar-MBR)" VALUE 0x158484 AblGLKWsw 1.8125 RIGHTSH6NP -0.90625 0.90625 FORMAT "%9.7" /end CHARACTERISTIC
/begin CHARACTERISTIC xShimmy_FeedbackFactor_XDS16_3___A "Feedback Faktor , muss 0.8 sein, bei ShimmyV2, wegen Motormomenten-MBR (bei ShimmyV1 TorsionBar-MBR)" VALUE 0x158486 AblGLKWsw 1.8125 RIGHTSH6NP -0.90625 0.90625 FORMAT "%9.7" /end CHARACTERISTIC
/begin CHARACTERISTIC xShimmy_FeedbackFactor_XDS16_4___A "Feedback Faktor , muss 0.8 sein, bei ShimmyV2, wegen Motormomenten-MBR (bei ShimmyV1 TorsionBar-MBR)" VALUE 0x158488 AblGLKWsw 1.8125 RIGHTSH6NP -0.90625 0.90625 FORMAT "%9.7" /end CHARACTERISTIC
/begin CHARACTERISTIC xShimmy_FeedbackFactor_XDS16_5___A "Feedback Faktor , muss 0.8 sein, bei ShimmyV2, wegen Motormomenten-MBR (bei ShimmyV1 TorsionBar-MBR)" VALUE 0x15848A AblGLKWsw 1.8125 RIGHTSH6NP -0.90625 0.90625 FORMAT "%9.7" /end CHARACTERISTIC
/begin CHARACTERISTIC xShimmy_MotorTorqueFactor_XAU16 "Fahrzeuggeschw. abhängiger Faktor auf das Motor Moment" CURVE 0x14A168 AblGLKLuw 1 RIGHTSH10NP 0 1 FORMAT "%8.6"
 /begin AXIS_DESCR STD_AXIS vApplI_AbsVehicleSpeedFilt_xdu16 VFZHIGH 6 0 255 FORMAT "%8.4" DEPOSIT ABSOLUTE /end AXIS_DESCR
/end CHARACTERISTIC
/begin CHARACTERISTIC xShimmy_PinionSign_XDS8 "PinionSign zur Zusätzlichen Drehung des Shimmy-Motormoments" VALUE 0x14A0E5 AblGLKWsb 2 ZU0 -1 1 FORMAT "%5.3" /end CHARACTERISTIC
/begin CHARACTERISTIC xShimmy_RampFactor_XDU16 "Ramp Faktor Motormoment" VALUE 0x14A0C2 AblGLKWuw 1 RIGHTSH10NP 0 1 FORMAT "%8.6" /end CHARACTERISTIC
/begin CHARACTERISTIC xShimmy_ShimmyActFactor_XDS16_0___A "Shimmy Aktiv (Shimmy Pos = 1; Shimmy Neg = -1; Shimmy Pas =0), muss -1 sein, bei ShimmyV2" VALUE 0x15848C AblGLKWsw 4 TBTHIGH -2 2 FORMAT "%8.6" /end CHARACTERISTIC
/begin CHARACTERISTIC xShimmy_ShimmyActFactor_XDS16_1___A "Shimmy Aktiv (Shimmy Pos = 1; Shimmy Neg = -1; Shimmy Pas =0), muss -1 sein, bei ShimmyV2" VALUE 0x15848E AblGLKWsw 4 TBTHIGH -2 2 FORMAT "%8.6" /end CHARACTERISTIC
/begin CHARACTERISTIC xShimmy_ShimmyActFactor_XDS16_2___A "Shimmy Aktiv (Shimmy Pos = 1; Shimmy Neg = -1; Shimmy Pas =0), muss -1 sein, bei ShimmyV2" VALUE 0x158490 AblGLKWsw 4 TBTHIGH -2 2 FORMAT "%8.6" /end CHARACTERISTIC
/begin CHARACTERISTIC xShimmy_ShimmyActFactor_XDS16_3___A "Shimmy Aktiv (Shimmy Pos = 1; Shimmy Neg = -1; Shimmy Pas =0), muss -1 sein, bei ShimmyV2" VALUE 0x158492 AblGLKWsw 4 TBTHIGH -2 2 FORMAT "%8.6" /end CHARACTERISTIC
/begin CHARACTERISTIC xShimmy_ShimmyActFactor_XDS16_4___A "Shimmy Aktiv (Shimmy Pos = 1; Shimmy Neg = -1; Shimmy Pas =0), muss -1 sein, bei ShimmyV2" VALUE 0x158494 AblGLKWsw 4 TBTHIGH -2 2 FORMAT "%8.6" /end CHARACTERISTIC
/begin CHARACTERISTIC xShimmy_ShimmyActFactor_XDS16_5___A "Shimmy Aktiv (Shimmy Pos = 1; Shimmy Neg = -1; Shimmy Pas =0), muss -1 sein, bei ShimmyV2" VALUE 0x158496 AblGLKWsw 4 TBTHIGH -2 2 FORMAT "%8.6" /end CHARACTERISTIC
/begin CHARACTERISTIC xShimmy_TorqFactor_XDU16_0___A "Faktor auf das Shimmy Moment" VALUE 0x158498 AblGLKWuw 9.5 RIGHTSH10NP 0.5 10 FORMAT "%8.5" /end CHARACTERISTIC
/begin CHARACTERISTIC xShimmy_TorqFactor_XDU16_1___A "Faktor auf das Shimmy Moment" VALUE 0x15849A AblGLKWuw 9.5 RIGHTSH10NP 0.5 10 FORMAT "%8.5" /end CHARACTERISTIC
/begin CHARACTERISTIC xShimmy_TorqFactor_XDU16_2___A "Faktor auf das Shimmy Moment" VALUE 0x15849C AblGLKWuw 9.5 RIGHTSH10NP 0.5 10 FORMAT "%8.5" /end CHARACTERISTIC
/begin CHARACTERISTIC xShimmy_TorqFactor_XDU16_3___A "Faktor auf das Shimmy Moment" VALUE 0x15849E AblGLKWuw 9.5 RIGHTSH10NP 0.5 10 FORMAT "%8.5" /end CHARACTERISTIC
/begin CHARACTERISTIC xShimmy_TorqFactor_XDU16_4___A "Faktor auf das Shimmy Moment" VALUE 0x1584A0 AblGLKWuw 9.5 RIGHTSH10NP 0.5 10 FORMAT "%8.5" /end CHARACTERISTIC
/begin CHARACTERISTIC xShimmy_TorqFactor_XDU16_5___A "Faktor auf das Shimmy Moment" VALUE 0x1584A2 AblGLKWuw 9.5 RIGHTSH10NP 0.5 10 FORMAT "%8.5" /end CHARACTERISTIC
/begin CHARACTERISTIC xShimmy_WheelAccelBeta_XDU16 "Filter Faktor des PT1-Filters für Beschleunigung (Filter Faktor = 1-EXP(-W2*Ts))" VALUE 0x14A0C4 AblGLKWuw 0.984375 VFZHIGH 0 0.984375 FORMAT "%9.7" /end CHARACTERISTIC
/begin CHARACTERISTIC xShimmy_WheelAccelPole_XDU16 "Filter abschalt Frequenz (Cutoff Frequency W2 = 2*pi*Fc)" VALUE 0x14A0C6 AblGLKWuw 99 VFZHIGH 1 100 FORMAT "%8.4" /end CHARACTERISTIC
/begin CHARACTERISTIC xSsm_FaultActionRedLevel_XAU16 "Reductionslevel für Reduzierung bei einem bestimmten Fehler [0:RPS1, 1:RPS2, 2:DMS1, 3:DMS2, 4:CURR1, 5:CURR2, 6:PHASEOPEN, 7:PHASESHORT]" VAL_BLK 0x150B80 AblGLKWBuw 100 RSH15 0 100 NUMBER 8 FORMAT "%8.4" /end CHARACTERISTIC
/begin CHARACTERISTIC xSSWarn_ReductionGradient_XDU16 "Reduction Rampensteigung" VALUE 0x150A34 AblGLKWuw 1 RIGHTSH15NP 0 1 FORMAT "%8.6" /end CHARACTERISTIC
/begin CHARACTERISTIC xSSWarn_ReductionLevel_XDU16 "Reduzierungsstufe 0 - 1 [0 - 100%]" VALUE 0x150A36 AblGLKWuw 1 RIGHTSH15NP 0 1 FORMAT "%8.6" /end CHARACTERISTIC
/begin CHARACTERISTIC xSSWarn_RotorSpeedFilter_XDU16 "Filterkonstante für Drehzahlfilterung" VALUE 0x150A38 AblGLKWuw 1 RIGHTSH8NP 0 1 FORMAT "%8.6" /end CHARACTERISTIC
/begin CHARACTERISTIC xStStp_GradientInitial_XDU16 "StartStop Reduktionsgradient default state" VALUE 0x150A3A AblGLKWuw 100 RSH15_GRAD1MS 0 100 FORMAT "%8.4" /end CHARACTERISTIC
/begin CHARACTERISTIC xStStp_GradientStateFull_XDU16 "StartStop Reduktionsgradient Status FULL" VALUE 0x150A3C AblGLKWuw 100 RSH15_GRAD1MS 0 100 FORMAT "%8.4" /end CHARACTERISTIC
/begin CHARACTERISTIC xStStp_GradientStateHiRed_XDU16 "StartStop Reduktionsgradient Status HI_RED" VALUE 0x150A3E AblGLKWuw 100 RSH15_GRAD1MS 0 100 FORMAT "%8.4" /end CHARACTERISTIC
/begin CHARACTERISTIC xStStp_GradientStateLoRedDown_XDU16 "StartStop Reduktionsgradient Status LO_RED_DOWN" VALUE 0x150A40 AblGLKWuw 100 RSH15_GRAD1MS 0 100 FORMAT "%8.4" /end CHARACTERISTIC
/begin CHARACTERISTIC xStStp_GradientStateLoRedUp_XDU16 "StartStop Reduktionsgradient Status LO_RED_UP" VALUE 0x150A42 AblGLKWuw 100 RSH15_GRAD1MS 0 100 FORMAT "%8.4" /end CHARACTERISTIC
/begin CHARACTERISTIC xStStp_LevelStateFull_XDU16 "StartStop Reduktionslevel Status FULL" VALUE 0x150A44 AblGLKWuw 100 RSH15_GRAD1MS 0 100 FORMAT "%8.4" /end CHARACTERISTIC
/begin CHARACTERISTIC xStStp_LevelStateHiRed_XDU16 "StartStop Reduktionslevel Status HI_RED" VALUE 0x150A46 AblGLKWuw 100 RSH15_GRAD1MS 0 100 FORMAT "%8.4" /end CHARACTERISTIC
/begin CHARACTERISTIC xStStp_LevelStateInitial_XDU16 "StartStop Reduktionslevel default state" VALUE 0x150A48 AblGLKWuw 100 RSH15_GRAD1MS 0 100 FORMAT "%8.4" /end CHARACTERISTIC
/begin CHARACTERISTIC xStStp_LevelStateLoRedDown_XDU16 "StartStop Reduktionslevel Status LO_RED_DOWN" VALUE 0x150A4A AblGLKWuw 100 RSH15_GRAD1MS 0 100 FORMAT "%8.4" /end CHARACTERISTIC
/begin CHARACTERISTIC xStStp_LevelStateLoRedUp_XDU16 "StartStop Reduktionslevel Status LO_RED_UP" VALUE 0x150A4C AblGLKWuw 100 RSH15_GRAD1MS 0 100 FORMAT "%8.4" /end CHARACTERISTIC
/begin CHARACTERISTIC ySsm_FaultActionGradient_XAU16 "Gradienten für Reduzierung [0:RPS1, 1:RPS2, 2:DMS1, 3:DMS2, 4:CURR1, 5:CURR2, 6:PHASEOPEN, 7:PHASESHORT]" VAL_BLK 0x150B90 AblGLKWBuw 1 RIGHTSH15NP 0 1 NUMBER 8 FORMAT "%8.6" /end CHARACTERISTIC
/begin CHARACTERISTIC zRpSync_IdxposLoopCounter_XDU8 "Loop counter for DMS5 or DMS6 selection" VALUE 0x150B60 AblGLKWub 6 ANGLE_1 1 7 FORMAT "%5.3" /end CHARACTERISTIC
/begin CHARACTERISTIC zSSWarn_SSCounterMax_XDU16 "Schwelle Stick-Slip-Zaehler ab der Feedbackfunktion aktiviert wird" VALUE 0x150A8E AblGLKWuw 20000 ZU0 0 20000 FORMAT "%8.2" /end CHARACTERISTIC
/begin MEASUREMENT aRotSp_RotorAccelDelayed_xds32 "Rotorbeschleunigung verzögert" SLONG RIGHTSH12NP 1 100 -500 500 FORMAT "%13.9" ECU_ADDRESS 0xFEBE8C40 /end MEASUREMENT
/begin MEASUREMENT aRotSp_RotorAccelFiltDelayed_xds32 "Rotorbeschleunigung gefiltert verzögert" SLONG RIGHTSH13NP 1 100 -500 500 FORMAT "%13.9" ECU_ADDRESS 0xFEBE8C44 /end MEASUREMENT
/begin MEASUREMENT fcnRxEnable_xdb "activate reception of can messages" UWORD BIT 1 100 0 1 BIT_MASK 0x1 FORMAT "%5.3" ECU_ADDRESS 0xFEBE9436 /end MEASUREMENT
/begin MEASUREMENT fRackPo_RackSpeedValidOld_xdu8 "verzoegertes Gueltigkeitsflag des iSAS Rackspeed" UBYTE ZU0 1 100 0 1 FORMAT "%5.3" ECU_ADDRESS 0xFEBE949E /end MEASUREMENT
/begin MEASUREMENT fRackPo_RpRefValidOld_xdu8 "verzoegertes Gueltigkeitsflag des iSAS RackposRef" UBYTE ZU0 1 100 0 1 FORMAT "%5.3" ECU_ADDRESS 0xFEBE949F /end MEASUREMENT
/begin MEASUREMENT fRackPo_SaValidOld_xdu8 "verzoegertes Gueltigkeitsflag des iSAS" UBYTE ZU0 1 100 0 1 FORMAT "%5.3" ECU_ADDRESS 0xFEBE94A0 /end MEASUREMENT
/begin MEASUREMENT fRemoteSteerCtrl_LastRscArbitrationResultPassive_xdb "" UWORD ZU0 1 100 0 1 BIT_MASK 0x1 FORMAT "%5.3" ECU_ADDRESS 0xFEBE94A1 /end MEASUREMENT
/begin MEASUREMENT fRemoteSteerCtrl_MonSafeOk_xdb "Indicates whether the MonitorSafe checks report OK (1) or if they have detected a problem (0)" UWORD ZU0 1 100 0 1 BIT_MASK 0x1 FORMAT "%5.3" ECU_ADDRESS 0xFEBE94A2 /end MEASUREMENT
/begin MEASUREMENT fRotSp_IntRotorSpd_ValidDelayed_xdb "Hwlib RotorSpeed gültiger Wert verzögert" UWORD ZU0 1 100 0 1 BIT_MASK 0x1 FORMAT "%5.3" ECU_ADDRESS 0xFEBE94A4 /end MEASUREMENT
/begin MEASUREMENT fRpCorr_LearnCond_xdu8 "Lernbedingungen erfuellt fuer LW-Korrektur: 0x01-LTCorr, 0x02-STCorr" UBYTE ZU0 1 100 0 255 FORMAT "%5.1" ECU_ADDRESS 0xFEBE94A5 /end MEASUREMENT
/begin MEASUREMENT fRpCorr_ResetAdaptiveData_xdu8 " " UBYTE ZU0 1 100 0 255 FORMAT "%5.1" ECU_ADDRESS 0xFEBE94A6 /end MEASUREMENT
/begin MEASUREMENT fRpSync_CalcCalibRps_xdb "Flag for calculation of Offset CalibRps" UBYTE BIT 1 100 0 1 BIT_MASK 0x1 FORMAT "%5.3" ECU_ADDRESS 0xFEBE94A7 /end MEASUREMENT
/begin MEASUREMENT fRpSync_CalibWriteError_xdb "Flag to Check NvM is written to RTE for Calib" UBYTE BIT 1 100 0 1 BIT_MASK 0x1 FORMAT "%5.3" ECU_ADDRESS 0xFEBE94A8 /end MEASUREMENT
/begin MEASUREMENT fRpSync_CalibWriteTrigger_xdb "flag to Trigger NvM calls for Calib block" UBYTE BIT 1 100 0 1 BIT_MASK 0x1 FORMAT "%5.3" ECU_ADDRESS 0xFEBE94A9 /end MEASUREMENT
/begin MEASUREMENT fRpSync_IndexErrorFound_xdu8 "Fehler erkannt in Indexmonitoring" UBYTE ZU0 1 100 0 255 FORMAT "%5.1" ECU_ADDRESS 0xFEBE94AA /end MEASUREMENT
/begin MEASUREMENT fRpSync_IndexFound_xdu8 "Index erkannt im erwarteteten Indexbereich" UBYTE ZU0 1 100 0 255 FORMAT "%5.1" ECU_ADDRESS 0xFEBE94AB /end MEASUREMENT
/begin MEASUREMENT fRpSync_Initialrun_xdb "Initial run latch" UBYTE BIT 1 100 0 1 BIT_MASK 0x1 FORMAT "%5.3" ECU_ADDRESS 0xFEBE94AC /end MEASUREMENT
/begin MEASUREMENT fRpSync_LowSteerDyn_xdb "Flag welches angibt, ob niedrige Lenkdynamik erkannt wurde (0: keine niedrige Lenkdynamik, 1: niedrige Lenkdynamik)." UWORD ZU0 1 100 0 1 BIT_MASK 0x1 FORMAT "%5.3" ECU_ADDRESS 0xFEBE94AD /end MEASUREMENT
/begin MEASUREMENT fRpSync_NewSyncNeeded_xdb "Sync Reset latch" UBYTE BIT 1 100 0 1 BIT_MASK 0x1 FORMAT "%5.3" ECU_ADDRESS 0xFEBE94AE /end MEASUREMENT
/begin MEASUREMENT fRpSync_NvRamInitWritten_xdb "flag to reset the init-upon loss of precalib" UBYTE BIT 1 100 0 1 BIT_MASK 0x1 FORMAT "%5.3" ECU_ADDRESS 0xFEBE94AF /end MEASUREMENT
/begin MEASUREMENT fRpSync_OldCalibDFBlock_xdb "DF calib block old latch" UBYTE BIT 1 100 0 1 BIT_MASK 0x1 FORMAT "%5.3" ECU_ADDRESS 0xFEBE94B0 /end MEASUREMENT
/begin MEASUREMENT fRpSync_ResetIdxEdges_xdb "Flag for Reset Index edges" UBYTE BIT 1 100 0 1 BIT_MASK 0x1 FORMAT "%5.3" ECU_ADDRESS 0xFEBE94B1 /end MEASUREMENT
/begin MEASUREMENT fRpSync_ResetInitFcn_xdb "Flag zum Zuruecksetzen der Init-Funktionen" UBYTE BIT 1 100 0 1 BIT_MASK 0x1 FORMAT "%5.3" ECU_ADDRESS 0xFEBE94B2 /end MEASUREMENT
/begin MEASUREMENT fRpSync_ResetPreCalInit_xdb "flag to reset the init-upon loss of precalib" UBYTE BIT 1 100 0 1 BIT_MASK 0x1 FORMAT "%5.3" ECU_ADDRESS 0xFEBE94B3 /end MEASUREMENT
/begin MEASUREMENT fRpSync_ReSyncDone_xdb "Nachsynchronisation des Rotorwinkels auf Index ist erfolgt" UBYTE BIT 1 100 0 1 BIT_MASK 0x1 FORMAT "%5.3" ECU_ADDRESS 0xFEBE94B4 /end MEASUREMENT
/begin MEASUREMENT fRpSync_RotAngSyncCalib_xdb "Flag Aufsynchronisation fuer Kalibrierung ist erfolgt" UBYTE BIT 1 100 0 1 BIT_MASK 0x1 FORMAT "%5.3" ECU_ADDRESS 0xFEBE94B5 /end MEASUREMENT
/begin MEASUREMENT fRpSync_SaValidOld_xdu8 "verzoegertes Gueltigkeitsflag des iSAS" UBYTE ZU0 1 100 0 1 FORMAT "%5.3" ECU_ADDRESS 0xFEBE94B6 /end MEASUREMENT
/begin MEASUREMENT fRpSync_SyncWriteError_xdb "Flag to Check NvM is written to RTE for Sync" UBYTE BIT 1 100 0 1 BIT_MASK 0x1 FORMAT "%5.3" ECU_ADDRESS 0xFEBE94B7 /end MEASUREMENT
/begin MEASUREMENT fRpSync_ValidityDelayed_xdb "Index Signal and Accumulated RotorAngle delayed" UBYTE BIT 1 100 0 1 BIT_MASK 0x1 FORMAT "%5.3" ECU_ADDRESS 0xFEBE94B8 /end MEASUREMENT
/begin MEASUREMENT fRpSync_WrtNvrInitData_xdb "Schreiben des DF-Blocks fuer iSAS Sync-Daten veranlassen" UBYTE BIT 1 100 0 1 BIT_MASK 0x1 FORMAT "%5.3" ECU_ADDRESS 0xFEBE94B9 /end MEASUREMENT
/begin MEASUREMENT fRpSync_WrtNvr_CalibData_xdb "Schreiben des DF-Blocks fuer iSAS Calib-Daten veranlassen" UBYTE BIT 1 100 0 1 BIT_MASK 0x1 FORMAT "%5.3" ECU_ADDRESS 0xFEBE94BA /end MEASUREMENT
/begin MEASUREMENT fShutPermI_ShutdownPermission_xdu8 "Flag um der Software zu zeigen ob ein Shutdown erlaubt ist oder nicht." UBYTE ZU0 1 100 0 1 FORMAT "%5.3" ECU_ADDRESS 0xFEBE94BE /end MEASUREMENT
/begin MEASUREMENT fSSWarnI_VibrationEnabled_xdu8 "Der Signal für die dauerhafte Speicherung zeigt an, dass die 'Frostschutzwirkung' im nächsten Schlüsselzyklus wieder aktiviert werden sollte" UBYTE ZU0 1 100 0 255 FORMAT "%5.1" ECU_ADDRESS 0xFEBE94BF /end MEASUREMENT
/begin MEASUREMENT fSSWarn_AntifreezJobResultOK_xdu8 " To check status of JobResult and Service ID of Antifreeze" UBYTE ZU0 1 100 0 2 FORMAT "%5.3" ECU_ADDRESS 0xFEBE94C0 /end MEASUREMENT
/begin MEASUREMENT fSSWarn_CounterJobResultOK_xdb " To check status of JobResult and Service ID  of counter " UBYTE ZU0 1 100 0 1 FORMAT "%5.3" ECU_ADDRESS 0xFEBE94C1 /end MEASUREMENT
/begin MEASUREMENT fSSWarn_NVMWriteError_xdb "Shows write error has detected and sets Monid" UBYTE BIT 1 100 0 1 BIT_MASK 0x1 FORMAT "%5.3" ECU_ADDRESS 0xFEBE94C2 /end MEASUREMENT
/begin MEASUREMENT fSSWarn_VibrationActivated_xdu8 "Vibrations Drehmoment Status" UBYTE ZU0 1 100 0 255 FORMAT "%5.1" ECU_ADDRESS 0xFEBE94C3 /end MEASUREMENT
/begin MEASUREMENT fStStp_OutputState_xdb "Condition Check für Measure Time und Wait Time" UBYTE BIT 1 100 0 1 BIT_MASK 0x1 FORMAT "%5.3" ECU_ADDRESS 0xFEBE94C4 /end MEASUREMENT
/begin MEASUREMENT fStStp_OverLimitSwitchStateFull_xdb "Grenzbedingungen ueberschritten: Springe in Full assist" UBYTE BIT 1 100 0 1 BIT_MASK 0x1 FORMAT "%5.3" ECU_ADDRESS 0xFEBE94C5 /end MEASUREMENT
/begin MEASUREMENT fStStp_PowerAssistOn_xdb "PowerAssist-Funktion Ein" UBYTE BIT 1 100 0 1 BIT_MASK 0x1 FORMAT "%5.3" ECU_ADDRESS 0xFEBE94C6 /end MEASUREMENT
/begin MEASUREMENT lEpsIn_0x122_Indication_xdu8 "" UBYTE ZU0 1 100 0 10 FORMAT "%5.2" ECU_ADDRESS 0xFEBE94D6 /end MEASUREMENT
/begin MEASUREMENT lEpsIn_0x142_Indication_xdu8 "" UBYTE ZU0 1 100 0 10 FORMAT "%5.2" ECU_ADDRESS 0xFEBE94D7 /end MEASUREMENT
/begin MEASUREMENT lEpsIn_0x245_Indication_xdu8 "" UBYTE ZU0 1 100 0 10 FORMAT "%5.2" ECU_ADDRESS 0xFEBE94D8 /end MEASUREMENT
/begin MEASUREMENT lEpsIn_0x252_Indication_xdu8 "" UBYTE ZU0 1 100 0 10 FORMAT "%5.2" ECU_ADDRESS 0xFEBE94D9 /end MEASUREMENT
/begin MEASUREMENT lEpsIn_0x3A1_Indication_xdu8 "" UBYTE ZU0 1 100 0 10 FORMAT "%5.2" ECU_ADDRESS 0xFEBE94DA /end MEASUREMENT
/begin MEASUREMENT lEpsIn_0x3FE_Indication_xdu8 "" UBYTE ZU0 1 100 0 10 FORMAT "%5.2" ECU_ADDRESS 0xFEBE94DB /end MEASUREMENT
/begin MEASUREMENT lRackPoI_LTCorrRackPos_xds16 "Langzeitkorrekturwinkel bzgl. Zahnstangenposition [mm]" SWORD RACKPOS128 1 100 -10 10 FORMAT "%8.5" ECU_ADDRESS 0xFEBE8FE6 /end MEASUREMENT
/begin MEASUREMENT lRackPoI_RackPositionRef_xds16 "Zahnstangenposition [mm] bzgl. Referenzposition (Index, extSAS, TAS)" SWORD RACKPOS128 1 100 -200 200 FORMAT "%8.4" ECU_ADDRESS 0xFEBE8FE8 /end MEASUREMENT
/begin MEASUREMENT lRackPoI_STCorrRackPos_xds16 "Kurzzeitkorrekturwinkel bzgl. Zahnstangenposition [mm]" SWORD RACKPOS128 1 100 -10 10 FORMAT "%8.5" ECU_ADDRESS 0xFEBE8FEA /end MEASUREMENT
/begin MEASUREMENT lRackPo_RackPositionCorr_xds16 "RackPostion Corrected LT+ST" SWORD RACKPOS128 1 100 -256 255.9922 FORMAT "%8.4" ECU_ADDRESS 0xFEBE8FEC /end MEASUREMENT
/begin MEASUREMENT lRackPo_RackPositionRefNotVal_xds16 "Zahnstangenposition [mm] bzgl. Referenzposition (Index, extSAS, TAS) nicht plausibilisiert" SWORD RACKPOS128 1 100 -200 200 FORMAT "%8.4" ECU_ADDRESS 0xFEBE8FEE /end MEASUREMENT
/begin MEASUREMENT lRemoteSteerCtrlI_DesiredRackPosition_xds16 "desired rack position" SWORD RACKPOS128 1 100 -200 200 FORMAT "%8.4" ECU_ADDRESS 0xFEBE8FF0 /end MEASUREMENT
/begin MEASUREMENT lRemoteSteerCtrl_DesiredRackPosFilt_xds16 "filtrated desired rack position" SWORD RACKPOS128 1 100 -200 200 FORMAT "%8.4" ECU_ADDRESS 0xFEBE8FF2 /end MEASUREMENT
/begin MEASUREMENT mLkaI_TorqueReq_xds16 "" SWORD TBTHIGH 1 100 -10.24023 10.23047 FORMAT "%8.5" ECU_ADDRESS 0xFEBE90FC /end MEASUREMENT
/begin MEASUREMENT mRackPo_AbsLimitedMotorTorque_xdu16 "Abs Limited MotorTorque" UWORD MMOT 1 100 0 10 FORMAT "%8.5" ECU_ADDRESS 0xFEBE9134 /end MEASUREMENT
/begin MEASUREMENT mRemoteSteerCtrlI_DesMotTrqOffset4Check_xds16 "Desired motor torque offset of Remote Steering Control to be read by Check component only" SWORD MMOT 1 100 -16 16 FORMAT "%8.5" ECU_ADDRESS 0xFEBE9136 /end MEASUREMENT
/begin MEASUREMENT mRemoteSteerCtrlI_DesMotTrqOffset_xds16 "Desired motor torque offset of Automatic Parking Control" SWORD MMOT 1 100 -16 16 FORMAT "%8.5" ECU_ADDRESS 0xFEBE8F5A /end MEASUREMENT
/begin MEASUREMENT mRemoteSteerCtrlI_DesSteerTrqOffset4Check_xds16 "Desired steering torque offset of Remote Steering Control to be read by Check component only" SWORD TBTHIGH 1 100 -10 10 FORMAT "%8.5" ECU_ADDRESS 0xFEBE9138 /end MEASUREMENT
/begin MEASUREMENT mRemoteSteerCtrlI_DesSteerTrqOffset_xds16 "Desired steer torque offset of Automatic Parking Control" SWORD TBTHIGH 1 100 -10 10 FORMAT "%8.5" ECU_ADDRESS 0xFEBE8F5C /end MEASUREMENT
/begin MEASUREMENT mRemoteSteerCtrl_DesMotTrqOffsetChecked_xds16 "Steer torque offset which has been subjected to the MakeSafe measures" SWORD MMOT 1 100 -16 16 FORMAT "%8.5" ECU_ADDRESS 0xFEBE8F5E /end MEASUREMENT
/begin MEASUREMENT mRemoteSteerCtrl_DesSteerTrqOffsetChecked_xds16 "Steer torque offset which has been subjected to the MakeSafe measures" SWORD TBTHIGH 1 100 -10 10 FORMAT "%8.5" ECU_ADDRESS 0xFEBE8F60 /end MEASUREMENT
/begin MEASUREMENT mSafCtrlI_MotorTorque_xds16 "Summe von SafetyController motor torque und MTL_MMOT" SWORD MMOT 1 100 -12 12 FORMAT "%8.5" ECU_ADDRESS 0xFEBE913A /end MEASUREMENT
/begin MEASUREMENT mSafCtrlI_MotTrq4Check_xds16 "Safety controller motor torque for check" SWORD MMOT 1 100 -4 4 FORMAT "%8.6" ECU_ADDRESS 0xFEBE913C /end MEASUREMENT
/begin MEASUREMENT mSafCtrlI_MotTrqFromMTL_xds16 "Begrenztes Motormoment durch MotorTorqueLimiter das im SafCtrl ggf. deaktiviert wurde" SWORD MMOT 1 100 -12 12 FORMAT "%8.5" ECU_ADDRESS 0xFEBE913E /end MEASUREMENT
/begin MEASUREMENT mSafCtrl_DPart_xds16 "Safety controller DPart torque" SWORD MMOT 1 100 -20 20 FORMAT "%8.5" ECU_ADDRESS 0xFEBE9140 /end MEASUREMENT
/begin MEASUREMENT mSafCtrl_InertiaTorque_xds16 "Safety controller inertia torque" SWORD MMOT 1 100 -20 20 FORMAT "%8.5" ECU_ADDRESS 0xFEBE9142 /end MEASUREMENT
/begin MEASUREMENT mSafCtrl_IPart_xds32 "Safety controller IPart torque" SLONG RIGHTSH15NP 1 100 -4 4 FORMAT "%13.11" ECU_ADDRESS 0xFEBE8CD8 /end MEASUREMENT
/begin MEASUREMENT mSafCtrl_LowerLimitCheck_xds16 "Safety controller lower limit" SWORD MMOT 1 100 -4 4 FORMAT "%8.6" ECU_ADDRESS 0xFEBE9144 /end MEASUREMENT
/begin MEASUREMENT mSafCtrl_LowerLimit_xds16 "Safety controller lower limit" SWORD MMOT 1 100 -4 0 FORMAT "%8.6" ECU_ADDRESS 0xFEBE9146 /end MEASUREMENT
/begin MEASUREMENT mSafCtrl_MotorTorque4Sum_xds16 "SafetyController motor torque" SWORD MMOT 1 100 -4 4 FORMAT "%8.6" ECU_ADDRESS 0xFEBE9148 /end MEASUREMENT
/begin MEASUREMENT mSafCtrl_PPart_xds16 "Safety controller PPart torque" SWORD MMOT 1 100 -20 20 FORMAT "%8.5" ECU_ADDRESS 0xFEBE914A /end MEASUREMENT
/begin MEASUREMENT mSafCtrl_TbtDeviation_xds16 "TBT deviation as input for controller" SWORD TBTHIGH 1 100 -25 25 FORMAT "%8.5" ECU_ADDRESS 0xFEBE914C /end MEASUREMENT
/begin MEASUREMENT mSafCtrl_UpperLimitCheck_xds16 "Safety controller upper limit" SWORD MMOT 1 100 -4 4 FORMAT "%8.6" ECU_ADDRESS 0xFEBE914E /end MEASUREMENT
/begin MEASUREMENT mSafCtrl_UpperLimit_xds16 "Safety controller upper limit" SWORD MMOT 1 100 0 4 FORMAT "%8.6" ECU_ADDRESS 0xFEBE9150 /end MEASUREMENT
/begin MEASUREMENT mShimmy_AmpTBT_xdu16 "Amplitude des Shimmy-Drehstabmoments" UWORD MMOT 1 100 0 2 FORMAT "%8.6" ECU_ADDRESS 0xFEBE9156 /end MEASUREMENT
/begin MEASUREMENT mShimmy_EstimatedTorsionBarTorque_xds16 "TorsionBar-Moment, das vom Beobachter geschätzt wird (y_obs=C*x_obs)" SWORD TBTHIGH 1 100 -25 25 FORMAT "%8.5" ECU_ADDRESS 0xFEBE9158 /end MEASUREMENT
/begin MEASUREMENT mShimmy_EstimatorIn_xds16 "Eingangsgrösse des Estimators" SWORD RIGHTSH10NP 1 100 -1 1 FORMAT "%8.6" ECU_ADDRESS 0xFEBE915A /end MEASUREMENT
/begin MEASUREMENT mShimmy_EstMotTorque_xds16 "berechnetes Motormoment aus dem Zustandsraummodel" SWORD RIGHTSH10NP 1 100 -10 10 FORMAT "%8.5" ECU_ADDRESS 0xFEBE915C /end MEASUREMENT
/begin MEASUREMENT mShimmy_FeedbackValue_xds16 "Wert der Modell Rückführung" SWORD MMOT 1 100 -1 1 FORMAT "%8.6" ECU_ADDRESS 0xFEBE915E /end MEASUREMENT
/begin MEASUREMENT mShimmy_MotorTorqueChecked_xds16 "Durch MakeSafe abgesichertes Shimmy-Motormoment. Muss noch von Monitor überprüft werden." SWORD MMOT 1 100 -0.5 0.5 FORMAT "%9.7" ECU_ADDRESS 0xFEBE9160 /end MEASUREMENT
/begin MEASUREMENT mSSWarn_EffectiveTorque_xds16 "Messgröße Effektivmoment" SWORD MMOT 1 100 -8 8 FORMAT "%8.6" ECU_ADDRESS 0xFEBE9162 /end MEASUREMENT
/begin MEASUREMENT mSSWarn_WarnTorqueDT_xdf32 "Integral der Abweichung Stick-Slip Wackel-Moment (Nm * ms)" FLOAT32_IEEE ZU0 1 100 -100 100 FORMAT "%10.6" ECU_ADDRESS 0xFEBE8CDC /end MEASUREMENT
/begin MEASUREMENT nRackPoI_RotorSpeed_xds16 "Rotor speed with Gear sign compensated" SWORD VROT 1 100 -13000 13000 FORMAT "%3.0" ECU_ADDRESS 0xFEBE91B4 /end MEASUREMENT
/begin MEASUREMENT nRackPo_RotorSpeedDeviation_xds16 "RotorSpeed deviation from RackSpeed in Plausi" SWORD VROT 1 100 -32768 32767 FORMAT "%3.0" ECU_ADDRESS 0xFEBE91B6 /end MEASUREMENT
/begin MEASUREMENT nRackPo_RotorSpeedFromRackSpeed_xds16 "RotorSpeed from RackSpeed in Plausi" SWORD VROT 1 100 -32768 32767 FORMAT "%3.0" ECU_ADDRESS 0xFEBE91B8 /end MEASUREMENT
/begin MEASUREMENT nRotSp_FilteredRotorSpeedDelayed_xds32 "Gefilterte Rotordrehzahl verzögert" SLONG RIGHTSH10NP 1 100 -13000 13000 FORMAT "%13.7" ECU_ADDRESS 0xFEBE8CE4 /end MEASUREMENT
/begin MEASUREMENT nRotSp_RotorSpeedFiltDelayed_Acc_xds16 "RotorSpeed Filtered Delayed für die RotorAcceleration-Berechnung" SWORD VROT 1 100 -13000 13000 FORMAT "%3.0" ECU_ADDRESS 0xFEBE91BA /end MEASUREMENT
/begin MEASUREMENT nRotSp_RotorSpeedFiltDelayed_xds32 "Rotordrehzahl gefiltert verzögert" SLONG RIGHTSH10NP 1 100 -13000 13000 FORMAT "%13.7" ECU_ADDRESS 0xFEBE8CE8 /end MEASUREMENT
/begin MEASUREMENT nSSWarn_RotorSpeedFilt_xds16 "gefilterte Rotordrehzahl für Stick-Slip-Warning" SWORD VROT 1 100 -32768 32767 FORMAT "%3.0" ECU_ADDRESS 0xFEBE91BC /end MEASUREMENT
/begin MEASUREMENT qShimmy_BandWidth_xdu16 "Band Breite" UWORD RIGHTSH7NP 1 100 0 2 FORMAT "%8.6" ECU_ADDRESS 0xFEBE91C8 /end MEASUREMENT
/begin MEASUREMENT qShimmy_FreqOld_xdu16 "Shimmy Frequenz [Hz]" UWORD RIGHTSH7NP 1 100 0 25 FORMAT "%8.5" ECU_ADDRESS 0xFEBE91CA /end MEASUREMENT
/begin MEASUREMENT qShimmy_Freq_xdu16 "Shimmy Frequenz [Hz]" UWORD RIGHTSH7NP 1 100 0 30 FORMAT "%8.5" ECU_ADDRESS 0xFEBE91CC /end MEASUREMENT
/begin MEASUREMENT qShimmy_Op1_xdf32 "1. Übergabewert vom 100ms Task zum 1ms Task" FLOAT32_IEEE FLOAT 1 100 -2 2 FORMAT "%16.14" ECU_ADDRESS 0xFEBE8CEC /end MEASUREMENT
/begin MEASUREMENT qShimmy_Op2_xdf32 "2. Übergabewert vom 100ms Task zum 1ms Task" FLOAT32_IEEE FLOAT 1 100 -2 2 FORMAT "%16.14" ECU_ADDRESS 0xFEBE8CF0 /end MEASUREMENT
/begin MEASUREMENT qShimmy_Op3_xdf32 "3. Übergabewert vom 100ms Task zum 1ms Task" FLOAT32_IEEE FLOAT 1 100 -2 2 FORMAT "%16.14" ECU_ADDRESS 0xFEBE8CF4 /end MEASUREMENT
/begin MEASUREMENT sEpsInI_IndicationFlagStatus_xdu8 "Global Engine Running Status" UWORD BIT 1 100 0 1 BIT_MASK 0x1 FORMAT "%5.3" ECU_ADDRESS 0xFEBE955E /end MEASUREMENT
/begin MEASUREMENT sFltManI_RequestEcuState_xdu8 "ECU-Status anfordern" UBYTE ZU0 1 100 0 3 FORMAT "%5.3" ECU_ADDRESS 0xFEBE9569 /end MEASUREMENT
/begin MEASUREMENT sRackPoI_PlausiState_xdu8 "ausgang von main monitoring: 0-Plausi off, 1-active+ok, 2-GoErrRev, 3-GoErrPerm" UBYTE ZU0 1 100 0 3 FORMAT "%5.3" ECU_ADDRESS 0xFEBE95B7 /end MEASUREMENT
/begin MEASUREMENT sRackPoI_RackPositionRefState_xdu8 "Status der RackPosition bzgl Referenzposition (zB Index)" UBYTE ZU0 1 100 0 5 FORMAT "%5.3" ECU_ADDRESS 0xFEBE95B8 /end MEASUREMENT
/begin MEASUREMENT sRackPoI_RotAngQualifier_xdu8 "Status des aufintegrierten Rotorwinkels" UBYTE ZU0 1 100 0 11 FORMAT "%5.2" ECU_ADDRESS 0xFEBE95B9 /end MEASUREMENT
/begin MEASUREMENT sRackPoI_StateRequest_xdu8 "Angeforderung Statuswechsel der Statusmaschine: 0-nop, 1-init, 2-err_rev, 3-err_perm" UBYTE ZU0 1 100 0 3 FORMAT "%5.3" ECU_ADDRESS 0xFEBE95BA /end MEASUREMENT
/begin MEASUREMENT sRackPo_ErrorDetected_xdu16 "Bitmuster für LW Fehler" UWORD ZU0 1 100 0 65535 FORMAT "%8.2" ECU_ADDRESS 0xFEBE91E0 /end MEASUREMENT
/begin MEASUREMENT sRackPo_ErrState_xdu8 "state of ErrorHandling" UBYTE ZU0 1 100 0 255 FORMAT "%5.1" ECU_ADDRESS 0xFEBE95BB /end MEASUREMENT
/begin MEASUREMENT sRackPo_ErrSubState_xdu8 "substate of ErrorHandling, when ACTIVE" UBYTE ZU0 1 100 0 255 FORMAT "%5.1" ECU_ADDRESS 0xFEBE95BC /end MEASUREMENT
/begin MEASUREMENT sRackPo_ForceSAInvalid_xdu8 "Flag, um Lenkwinkel ungültig zu machen" UBYTE ZU0 1 100 0 3 FORMAT "%5.3" ECU_ADDRESS 0xFEBE95BD /end MEASUREMENT
/begin MEASUREMENT sRackPo_InitStatedelay_xdu8 "Init State Delay" UBYTE ZU0 1 100 0 11 FORMAT "%5.2" ECU_ADDRESS 0xFEBE95BE /end MEASUREMENT
/begin MEASUREMENT sRackPo_QualifierStatemachine_xdu8 "Statemachine for RackPosQualifier: 1-invalid, 2-goErrPerm, 3-goErrRev, 4-valid" UBYTE ZU0 1 100 0 5 FORMAT "%5.3" ECU_ADDRESS 0xFEBE95BF /end MEASUREMENT
/begin MEASUREMENT sRemoteSteerCtrlI_Activate_xdu8 "Indicates whether APC shall actively calculate and request a torque (1 means active)." UBYTE ZU0 1 100 0 1 FORMAT "%5.3" ECU_ADDRESS 0xFEBE95C0 /end MEASUREMENT
/begin MEASUREMENT sRemoteSteerCtrlI_EpsRscState_xdu8 "RSC: internal state for external ECU: 0=failure, 1=available, 3=Active" UBYTE ZU0 1 100 0 6 FORMAT "%5.3" ECU_ADDRESS 0xFEBE95C1 /end MEASUREMENT
/begin MEASUREMENT sRemoteSteerCtrlI_MakeSafeAndMonState_xdu8 "Indicates whether the MakeSafe and MonitorSafe checks report OK (0) or if they have detected a problem (1) or if HandsOn was detected (2) or if invalid arbitration was detected (3)." UBYTE ZU0 1 100 0 3 FORMAT "%5.3" ECU_ADDRESS 0xFEBE95C2 /end MEASUREMENT
/begin MEASUREMENT sRemoteSteerCtrl_FctCoCtrlState_xdu8 "return value of the FunctionCoordinator" UBYTE ZU0 1 100 0 99 FORMAT "%5.2" ECU_ADDRESS 0xFEBE95C3 /end MEASUREMENT
/begin MEASUREMENT sRemoteSteerCtrl_FeatureState_xdu8 "internal feature state for FunctionCoordinator" UBYTE ZU0 1 100 0 5 FORMAT "%5.3" ECU_ADDRESS 0xFEBE95C4 /end MEASUREMENT
/begin MEASUREMENT sRemoteSteerCtrl_InhibitCode_xdu32 "Fault inhbit check" ULONG ZU0 1 100 0 65535 FORMAT "%13.7" ECU_ADDRESS 0xFEBE8D00 /end MEASUREMENT
/begin MEASUREMENT sRemoteSteerCtrl_MakeSafeState_xdu8 "Indicates whether the MakeSafe checks report OK (0), if they have detected a problem (1) or if HandsOn was detected (2)." UBYTE ZU0 1 100 0 2 FORMAT "%5.3" ECU_ADDRESS 0xFEBE95C5 /end MEASUREMENT
/begin MEASUREMENT sRpCorr_JobResultOK_xdu8 " " UBYTE ZU0 1 100 0 3 FORMAT "%5.3" ECU_ADDRESS 0xFEBE95C7 /end MEASUREMENT
/begin MEASUREMENT sRpCorr_ResetCorrection_xdu8 "Torque state from AddOnCoordinator" UBYTE ZU0 1 100 0 3 FORMAT "%5.3" ECU_ADDRESS 0xFEBE95C8 /end MEASUREMENT
/begin MEASUREMENT sRpSyncI_AccRotAngOffsetIndexStateNVR_xdu8 "0-invalid, 1-raw, 2-exactly" UBYTE ZU0 1 100 0 255 FORMAT "%5.1" ECU_ADDRESS 0xFEBE95C9 /end MEASUREMENT
/begin MEASUREMENT sRpSyncI_CalibAllowed_xdu8 "calibration: 1-allowed, 0-not allowed" UBYTE ZU0 1 100 0 1 FORMAT "%5.3" ECU_ADDRESS 0xFEBE95CA /end MEASUREMENT
/begin MEASUREMENT sRpSyncI_IdxMiddlesQual_xau8 "QualitÃ¤t der Indexmitten (Array mit drei Elementen), 0: Position unbekannt, 1: Indexmitte erkannt mit niedriger QualitÃ¤t, 2: Indexmitte erkannt mit hoher QualitÃ¤t." UBYTE ZU0 1 100 0 2 FORMAT "%5.3" ECU_ADDRESS 0xFEBE9654 MATRIX_DIM 7 1 1 /end MEASUREMENT
/begin MEASUREMENT sRpSyncI_InitOffsetControl_xdu8 "Init Offset Control: 0-no action, 1-Sync without ramp, 2-Sync with Ramp" UBYTE ZU0 1 100 0 2 FORMAT "%5.3" ECU_ADDRESS 0xFEBE95CB /end MEASUREMENT
/begin MEASUREMENT sRpSyncI_InitState_xdu8 "0-invalid, 1-raw, 2-exactly; for storing in NVRAM" UBYTE ZU0 1 100 0 2 FORMAT "%5.3" ECU_ADDRESS 0xFEBE95CC /end MEASUREMENT
/begin MEASUREMENT sRpSyncI_NoInitCause_xdu16 "Ursache des NoInit-Fehlers" UWORD ZU0 1 100 0 65535 FORMAT "%8.2" ECU_ADDRESS 0xFEBE91E2 /end MEASUREMENT
/begin MEASUREMENT sRpSyncI_PlausiState_xdu8 "output of synchronization monitoring: 0-Plausi off, 1-active+ok, 2-GoErrRev, 3-GoErrPerm" UBYTE ZU0 1 100 0 3 FORMAT "%5.3" ECU_ADDRESS 0xFEBE95CD /end MEASUREMENT
/begin MEASUREMENT sRpSyncI_RefPosState_xdu8 "0-invalid, 1-raw, 2-exactly, [3-initwait (not used)], 4-exactly checked" UBYTE ZU0 1 100 0 11 FORMAT "%5.2" ECU_ADDRESS 0xFEBE95CE /end MEASUREMENT
/begin MEASUREMENT sRpSyncI_RotAngInitState_xdu8 "0-NoInit, 1-ErrPerm, 2-ErrRev, 3-Rel, 4-Estim,... 8-RawNoChk, 9-Raw, 10-ExactNoChk, 11-Exact" UBYTE ZU0 1 100 0 11 FORMAT "%5.2" ECU_ADDRESS 0xFEBE95CF /end MEASUREMENT
/begin MEASUREMENT sRpSyncI_Statemachine_xdu8 "state of synchronization statemachine, 0-Start, 1-Rel, 2-Estim, 3-Raw, 4-Exact, 5-ErrRev, 6-ErrPerm" UBYTE ZU0 1 100 0 6 FORMAT "%5.3" ECU_ADDRESS 0xFEBE95D0 /end MEASUREMENT
/begin MEASUREMENT sRpSync_CalibCorrReset_xdu8 "calib correction reset" UBYTE ZU0 1 100 0 255 FORMAT "%5.1" ECU_ADDRESS 0xFEBE95D2 /end MEASUREMENT
/begin MEASUREMENT sRpSync_CalibCtrlLocked_xdu8 "Verriegelung von CalibControl, solange Aktion noch nicht abgeschlossen ist" UBYTE ZU0 1 100 0 3 FORMAT "%5.3" ECU_ADDRESS 0xFEBE95D3 /end MEASUREMENT
/begin MEASUREMENT sRpSync_CalibCtrlSuccess_xdu8 "Returnwert von CalibControl moeglich" UBYTE ZU0 1 100 0 5 FORMAT "%5.3" ECU_ADDRESS 0xFEBE95D4 /end MEASUREMENT
/begin MEASUREMENT sRpSync_CalibNvWrite_xdu8 "States of Calib Write (States are generated by TL hence state value tend to change)" UBYTE ZU0 1 100 0 3 FORMAT "%5.3" ECU_ADDRESS 0xFEBE95D5 /end MEASUREMENT
/begin MEASUREMENT sRpSync_CalibRamping_xdu8 "Ramping Selector Calibration: 0-no action, 1-sync without ramping, 2-sync with ramping" UBYTE ZU0 1 100 0 2 FORMAT "%5.3" ECU_ADDRESS 0xFEBE95D6 /end MEASUREMENT
/begin MEASUREMENT sRpSync_CalibStatemachine_xdu8 "States of Calib state Machine (States are generated by TL hence state value tend to change)" UBYTE ZU0 1 100 0 5 FORMAT "%5.3" ECU_ADDRESS 0xFEBE95D7 /end MEASUREMENT
/begin MEASUREMENT sRpSync_CalibState_xdu8 "Kalibrierstatus (0-start, 1-precalib, 2-nocalib, 3-calibok)" UBYTE ZU0 1 100 0 255 FORMAT "%5.1" ECU_ADDRESS 0xFEBE95D8 /end MEASUREMENT
/begin MEASUREMENT sRpSync_CalibStatusEncode_xdu8 "calib status Encode" UBYTE ZU0 1 100 0 255 FORMAT "%5.1" ECU_ADDRESS 0xFEBE95D9 /end MEASUREMENT
/begin MEASUREMENT sRpSync_DesiredCalibMode_xdu8 "Angeforderter Kalibriermodus" UBYTE ZU0 1 100 0 3 FORMAT "%5.3" ECU_ADDRESS 0xFEBE95DA /end MEASUREMENT
/begin MEASUREMENT sRpSync_ErrHandling_xdu8 "Error Handling state flow value hold" UBYTE ZU0 1 100 0 255 FORMAT "%5.1" ECU_ADDRESS 0xFEBE95DB /end MEASUREMENT
/begin MEASUREMENT sRpSync_ErrLogging_xdu8 "Error Handling state flow value hold" UBYTE ZU0 1 100 0 255 FORMAT "%5.1" ECU_ADDRESS 0xFEBE95DC /end MEASUREMENT
/begin MEASUREMENT sRpSync_ErrorDetected_xdu16 "Bitmuster für LW Fehler" UWORD ZU0 1 100 0 65535 FORMAT "%8.2" ECU_ADDRESS 0xFEBE91E4 /end MEASUREMENT
/begin MEASUREMENT sRpSync_ErrSubState_xdu8 "substate of ErrorHandling Sync, when ACTIVE" UBYTE ZU0 1 100 0 255 FORMAT "%5.1" ECU_ADDRESS 0xFEBE95DD /end MEASUREMENT
/begin MEASUREMENT sRpSync_EventEntry_NoInit_xdu8 "state of NoInit error" UBYTE ZU0 1 100 0 2 FORMAT "%5.3" ECU_ADDRESS 0xFEBE95DE /end MEASUREMENT
/begin MEASUREMENT sRpSync_IdxFlanksFallNegSpdQual_xau8 "QualitÃ¤t der fallenden Index-Flanken bei negativer Lenkwinkelgeschwindigkeit (Array mit drei Elementen), 0: keine Flanke erkannt, 1: Flanke erkannt mit niedriger QualitÃ¤t, 2: Flanke erkannt mit hoher QualitÃ¤t." UBYTE ZU0 1 100 0 2 FORMAT "%5.3" ECU_ADDRESS 0xFEBE965C MATRIX_DIM 7 1 1 /end MEASUREMENT
/begin MEASUREMENT sRpSync_IdxFlanksFallPosSpdQual_xau8 "QualitÃ¤t der fallenden Index-Flanken bei positiver Lenkwinkelgeschwindigkeit (Array mit drei Elementen), 0: keine Flanke erkannt, 1: Flanke erkannt mit niedriger QualitÃ¤t, 2: Flanke erkannt mit hoher QualitÃ¤t." UBYTE ZU0 1 100 0 2 FORMAT "%5.3" ECU_ADDRESS 0xFEBE9664 MATRIX_DIM 7 1 1 /end MEASUREMENT
/begin MEASUREMENT sRpSync_IdxFlanksRiseNegSpdQual_xau8 "QualitÃ¤t der steigenden Index-Flanken bei negativer Lenkwinkelgeschwindigkeit (Array mit drei Elementen), 0: keine Flanke erkannt, 1: Flanke erkannt mit niedriger QualitÃ¤t, 2: Flanke erkannt mit hoher QualitÃ¤t." UBYTE ZU0 1 100 0 2 FORMAT "%5.3" ECU_ADDRESS 0xFEBE966C MATRIX_DIM 7 1 1 /end MEASUREMENT
/begin MEASUREMENT sRpSync_IdxFlanksRisePosSpdQual_xau8 "QualitÃ¤t der steigenden Index-Flanken bei positiver Lenkwinkelgeschwindigkeit (Array mit drei Elementen), 0: keine Flanke erkannt, 1: Flanke erkannt mit niedriger QualitÃ¤t, 2: Flanke erkannt mit hoher QualitÃ¤t." UBYTE ZU0 1 100 0 2 FORMAT "%5.3" ECU_ADDRESS 0xFEBE9674 MATRIX_DIM 7 1 1 /end MEASUREMENT
/begin MEASUREMENT sRpSync_IdxSearchPlausiFail_xdu8 "Status welches angbit, ob die Plausibilisierung der Indexsuche einen Fehler erkannt hat (0: kein Fehler, 1: Fehler)." UBYTE ZU0 1 100 0 255 FORMAT "%5.1" ECU_ADDRESS 0xFEBE95DF /end MEASUREMENT
/begin MEASUREMENT sRpSync_IndexSignalold_xdu8 "Index Signal Old" UBYTE ZU0 1 100 0 1 FORMAT "%5.3" ECU_ADDRESS 0xFEBE95E0 /end MEASUREMENT
/begin MEASUREMENT sRpSync_InitStatusEncode_xdu16 "Statemachine status Encode" UWORD ZU0 1 100 0 65535 FORMAT "%8.2" ECU_ADDRESS 0xFEBE91E6 /end MEASUREMENT
/begin MEASUREMENT sRpSync_JobResultOKCalib_xdu8 "NvM feedback for Read/ write request - Calib Block" UBYTE ZU0 1 100 0 3 FORMAT "%5.3" ECU_ADDRESS 0xFEBE95E1 /end MEASUREMENT
/begin MEASUREMENT sRpSync_JobResultOKSync_xdu8 "NvM feedback for Read/ write request - Sync Block " UBYTE ZU0 1 100 0 3 FORMAT "%5.3" ECU_ADDRESS 0xFEBE95E2 /end MEASUREMENT
/begin MEASUREMENT sRpSync_NoInitCauseBkp_xdu16 "gespeicherte Ursache des letzten NoInit-Fehlers" UWORD ZU0 1 100 0 65535 FORMAT "%8.2" ECU_ADDRESS 0xFEBE91E8 /end MEASUREMENT
/begin MEASUREMENT sRpSync_NvWriteStateCalib_xdu8 "Write Status flag for RackPosCalib [0-Init; 1-Request NvM Write; 2-NvM Write Error]" UBYTE ZU0 1 100 0 2 FORMAT "%5.3" ECU_ADDRESS 0xFEBE95E3 /end MEASUREMENT
/begin MEASUREMENT sRpSync_NvWriteStateSync_xdu8 "Write Status flag for RackPosSync [0-Init; 1-Request NvM Write; 2-NvM Write Error]" UBYTE ZU0 1 100 0 2 FORMAT "%5.3" ECU_ADDRESS 0xFEBE95E4 /end MEASUREMENT
/begin MEASUREMENT sRpSync_ResyncCntrHwLibLast_xdu8 "Resync counter HW-Lib old" UBYTE ZU0 1 100 0 2 FORMAT "%5.3" ECU_ADDRESS 0xFEBE95E5 /end MEASUREMENT
/begin MEASUREMENT sRpSync_StateStatusEncode_xdu16 "Statemachine status Encode" UWORD ZU0 1 100 0 65535 FORMAT "%8.2" ECU_ADDRESS 0xFEBE91EA /end MEASUREMENT
/begin MEASUREMENT sRpSync_SuccessInitRange_xdu8 "Status der Initialisierung durch Lenkbereich" UBYTE ZU0 1 100 0 255 FORMAT "%5.1" ECU_ADDRESS 0xFEBE95E6 /end MEASUREMENT
/begin MEASUREMENT sRpSync_SuccessInitStraight_xdu8 "Status der Initialisierung durch Geradeausfahrt" UBYTE ZU0 1 100 0 255 FORMAT "%5.1" ECU_ADDRESS 0xFEBE95E7 /end MEASUREMENT
/begin MEASUREMENT sRpSync_SuccessResync_xdu8 "Status der Initialisierung durch Resynchronisation" UBYTE ZU0 1 100 0 255 FORMAT "%5.1" ECU_ADDRESS 0xFEBE95E8 /end MEASUREMENT
/begin MEASUREMENT sRpSync_SyncActCenterCheck_xdu8 "Sync Act Center init check" UBYTE ZU0 1 100 0 5 FORMAT "%5.3" ECU_ADDRESS 0xFEBE95E9 /end MEASUREMENT
/begin MEASUREMENT sRpSync_SyncActSuccess_xdu8 "Initialisierung aus Init-Funktionen moeglich: 0-nop, 1-rst, 2-estim, 3-raw, 4-exact, 5-resync" UBYTE ZU0 1 100 0 5 FORMAT "%5.3" ECU_ADDRESS 0xFEBE95EA /end MEASUREMENT
/begin MEASUREMENT sRpSync_SyncCheck_xdu8 "States of synccheck state Machine (States are generated by TL hence state value tend to change)" UBYTE ZU0 1 100 0 4 FORMAT "%5.3" ECU_ADDRESS 0xFEBE95EB /end MEASUREMENT
/begin MEASUREMENT sRpSync_SyncNvWrite_xdu8 "States of sync Write (States are generated by TL hence state value tend to change)" UBYTE ZU0 1 100 0 3 FORMAT "%5.3" ECU_ADDRESS 0xFEBE95EC /end MEASUREMENT
/begin MEASUREMENT sRpSync_SyncRamping_xdu8 "Ramping Selector: 0-no action, 1-sync without ramping, 2-sync with ramping" UBYTE ZU0 1 100 0 2 FORMAT "%5.3" ECU_ADDRESS 0xFEBE95ED /end MEASUREMENT
/begin MEASUREMENT sRpSync_SyncStatemachine_xdu8 "States of sync state Machine (States are generated by TL hence state value tend to change)" UBYTE ZU0 1 100 0 8 FORMAT "%5.3" ECU_ADDRESS 0xFEBE95EE /end MEASUREMENT
/begin MEASUREMENT sShimmy_FeatureState_xdu8 "ShimmyCompensation interner Mode Manager Status" UBYTE ZU0 1 100 0 5 FORMAT "%5.3" ECU_ADDRESS 0xFEBE95EF /end MEASUREMENT
/begin MEASUREMENT sShimmy_Status_xdu8 "Shimmy-Status" UBYTE ZU0 1 100 0 10 FORMAT "%5.2" ECU_ADDRESS 0xFEBE95F0 /end MEASUREMENT
/begin MEASUREMENT sShutCoI_ShutdownRequest_xdu8 "Flag um der Software zu zeigen ob ein Shutdown angefragt wurde und welcher." UBYTE ZU0 1 100 0 11 FORMAT "%5.2" ECU_ADDRESS 0xFEBE95F1 /end MEASUREMENT
/begin MEASUREMENT sSrcI_SafetyRampControl_xdu8 "SafetyRampController Status" UBYTE ZU0 1 100 0 3 FORMAT "%5.3" ECU_ADDRESS 0xFEBE4B22 /end MEASUREMENT
/begin MEASUREMENT sSrc_SafetyRampStatus_xdu8 "SafetyRampController Status" UBYTE ZU0 1 100 0 3 FORMAT "%5.3" ECU_ADDRESS 0xFEBE95F2 /end MEASUREMENT
/begin MEASUREMENT sSsmI_DeactivateAssist_xdu8 "Setzen Sie den Trigger, um den Assist auf der Grundlage des in errorLvl vorhandenen Fehlers zu deaktivieren" UBYTE ZU0 1 100 0 1 FORMAT "%5.3" ECU_ADDRESS 0xFEBE95F3 /end MEASUREMENT
/begin MEASUREMENT sSsm_Dummy_CPRErrLvl_mdu8 "Dummy fuer SafeStateManagerSupp" UBYTE ZU0 1 100 0 2 FORMAT "%5.3" ECU_ADDRESS 0xFEBE95F4 /end MEASUREMENT
/begin MEASUREMENT sSsm_Dummy_CPRErrLvl_Red_mdu8 "Dummy fuer SafeStateManagerSupp" UBYTE ZU0 1 100 0 2 FORMAT "%5.3" ECU_ADDRESS 0xFEBE42B8 /end MEASUREMENT
/begin MEASUREMENT sSSWarnI_ErrLvl_Red_xdu8 "Fehlerstufe der StickSlipWarning" UBYTE ZU0 1 100 0 255 FORMAT "%5.1" ECU_ADDRESS 0xFEBE95F5 /end MEASUREMENT
/begin MEASUREMENT sSSWarnI_ErrLvl_xdu8 "Fehlerstufe der StickSlipWarning" UBYTE ZU0 1 100 0 255 FORMAT "%5.1" ECU_ADDRESS 0xFEBE95F6 /end MEASUREMENT
/begin MEASUREMENT sSSWarn_NvWriteState_xdu8 "State of Write chart (0-Ready;1-Request is pushed ; 2- Error shall be locked)" UBYTE ZU0 1 100 0 3 FORMAT "%5.3" ECU_ADDRESS 0xFEBE95F7 /end MEASUREMENT
/begin MEASUREMENT sSSWarn_ShutdownRequest_xdu8 "SSW shutdown request status" UBYTE ZU0 1 100 0 255 FORMAT "%5.1" ECU_ADDRESS 0xFEBE95F8 /end MEASUREMENT
/begin MEASUREMENT sSSWarn_StickSlipStatus_xdu8 "Stick-Slip Status" UBYTE ZU0 1 100 0 255 FORMAT "%5.1" ECU_ADDRESS 0xFEBE95F9 /end MEASUREMENT
/begin MEASUREMENT sStStp_ForceState_xdu8 "StartStop ForceStatus (10=FULL, 11=LO_RED_DOWN, 12=HI_RED, 13=LO_RED_UP)" UBYTE ZU0 1 100 0 255 FORMAT "%5.1" ECU_ADDRESS 0xFEBE95FA /end MEASUREMENT
/begin MEASUREMENT sStStp_State_xdu8 "StartStop Status (0=FULL, 1=LO_RED_DOWN, 2=HI_RED, 3=LO_RED_UP, 255=Initial/)" UBYTE ZU0 1 100 0 255 FORMAT "%5.1" ECU_ADDRESS 0xFEBE95FB /end MEASUREMENT
/begin MEASUREMENT tRackPo_AheadErrorFilterTimer_xdu16 "Filterzeit fuer Ahead-Fehler" UWORD TIMMS 1 100 0 65535 FORMAT "%8.2" ECU_ADDRESS 0xFEBE9202 /end MEASUREMENT
/begin MEASUREMENT tRackPo_ForceSAInvalidtimer_xdu8 "counter timer to disable toggle behaviour for ForceSA invalid" UBYTE TIMMS 1 100 0 250 FORMAT "%5.1" ECU_ADDRESS 0xFEBE960C /end MEASUREMENT
/begin MEASUREMENT tRackPo_MainErrorFilterTimer_xdu16 "redundante Filterzeit fuer allg. RackPos-Fehler" UWORD TIMMS 1 100 0 65535 FORMAT "%8.2" ECU_ADDRESS 0xFEBE9204 /end MEASUREMENT
/begin MEASUREMENT tRackPo_RackSpeedErrorFilterTimer_xdu16 "redundante Filterzeit fuer RackSpeed-Fehler" UWORD TIMMS 1 100 0 65535 FORMAT "%8.2" ECU_ADDRESS 0xFEBE9206 /end MEASUREMENT
/begin MEASUREMENT tRackPo_RefErrorFilterTimer_xdu16 "redundante Filterzeit fuer RackPosRef-Fehler" UWORD TIMMS 1 100 0 65535 FORMAT "%8.2" ECU_ADDRESS 0xFEBE9208 /end MEASUREMENT
/begin MEASUREMENT tRpCorr_IntegTimedelay_xdu8 "Integral time delay" UBYTE TIMSEC_10 1 100 0 25.5 FORMAT "%5.2" ECU_ADDRESS 0xFEBE960D /end MEASUREMENT
/begin MEASUREMENT tRpSync_AheadDetTimer_xdu16 "Filterzeit fuer Ahead-Erkennung beim Initialisieren des iSAS" UWORD TIMSEC_100 1 100 0 655.35 FORMAT "%8.4" ECU_ADDRESS 0xFEBE920A /end MEASUREMENT
/begin MEASUREMENT tRpSync_IdxPosErrorFilterTimer_xdu16 "Filterzeit fuer RackPosSync-Fehler bzgl. Indexposition" UWORD TIMMS 1 100 0 65535 FORMAT "%8.2" ECU_ADDRESS 0xFEBE920C /end MEASUREMENT
/begin MEASUREMENT tRpSync_IdxVldErrorFilterTimer_xdu16 "Filterzeit fuer RackPosSync-Fehler bzgl. Indexsignal Gültigkeit" UWORD TIMMS 1 100 0 65535 FORMAT "%8.2" ECU_ADDRESS 0xFEBE920E /end MEASUREMENT
/begin MEASUREMENT tRpSync_IndexHighTimer_xdu16 "Filterzeit fuer Index = high beim Initialisieren des iSAS" UWORD TIMSEC_100 1 100 0 655.35 FORMAT "%8.4" ECU_ADDRESS 0xFEBE9210 /end MEASUREMENT
/begin MEASUREMENT tShutPerm_NoSteeringTorqueStartTime_xdu16 "Speichert die Systemzeit bei der TBT Grenzwert unterschritten wurde, benÃ¶tigt fÃ¼r die Bestimmung des Timeouts" UWORD ZU0 1 100 0 65535 FORMAT "%8.2" ECU_ADDRESS 0xFEBE9212 /end MEASUREMENT
/begin MEASUREMENT tSSWarn_FeedbackTimer_xdu16 "FeedbackTimer" UWORD TIMMS 1 100 0 65535 FORMAT "%8.2" ECU_ADDRESS 0xFEBE9214 /end MEASUREMENT
/begin MEASUREMENT vEpsInI_VehicleSpeedForUDS_xds16 "Fahrzeug Geschwindigkeit Rohwert" SWORD VFZHIGH 1 100 -100 500 FORMAT "%8.4" ECU_ADDRESS 0xFEBE9248 /end MEASUREMENT
/begin MEASUREMENT vRackPo_RackSpeedNotVal_xds16 "Zahnstangengeschwindigkeit nicht plausibilisiert [mm/s]" SWORD RACKSPEED128 1 100 -250 250 FORMAT "%8.4" ECU_ADDRESS 0xFEBE926E /end MEASUREMENT
/begin MEASUREMENT vRemoteSteerCtrl_DesiredRackSpeed_xds16 "desired rack speed incl. feed-forward controlled part" SWORD RACKSPEED128 1 100 -250 250 FORMAT "%8.4" ECU_ADDRESS 0xFEBE9270 /end MEASUREMENT
/begin MEASUREMENT vRemoteSteerCtrl_LimitedDesiredRackSpeed_xds16 "gradient limited desired rack speed" SWORD RACKSPEED128 1 100 -250 250 FORMAT "%8.4" ECU_ADDRESS 0xFEBE9272 /end MEASUREMENT
/begin MEASUREMENT wRackPoI_AccumRotorAngle_xds32 "Accumulated RotorAngle" SLONG ANGLE_1 1 100 -100000 100000 FORMAT "%13.6" ECU_ADDRESS 0xFEBE8DF8 /end MEASUREMENT
/begin MEASUREMENT wRackPoI_RotorAngleRamped_xds32 "RotorAngle ramped with the fine offset" SLONG ANGLE_1 1 100 -100000 100000 FORMAT "%13.6" ECU_ADDRESS 0xFEBE8DFC /end MEASUREMENT
/begin MEASUREMENT wRackPoI_RotorAngleRev_xdu16 "single turn RotorAngle" UWORD ANGLE_1 1 100 0 360 FORMAT "%8.4" ECU_ADDRESS 0xFEBE92AE /end MEASUREMENT
/begin MEASUREMENT wRackPo_AccRaOffsetBuff_xds32 "Buffered Change in Offset of AccRotAngle in Plausi" SLONG RIGHTSH4NP 1 100 -134217728 134217727.938 FORMAT "%13.3" ECU_ADDRESS 0xFEBE8E00 /end MEASUREMENT
/begin MEASUREMENT wRackPo_AccRotAngOffDelay_xds32 "complete offset to accumulated rotor angle from hw-lib, delayed" SLONG ANGLE_1 1 100 -50000 50000 FORMAT "%13.7" ECU_ADDRESS 0xFEBE8E04 /end MEASUREMENT
/begin MEASUREMENT wRackPo_AccRotAngOffsetCurr_xds32 "current offset to accumulated rotor angle from hw-lib used in RpMain, scaled 1/16 deg. rotor" SLONG RIGHTSH4NP 1 100 -50000 50000 FORMAT "%13.7" ECU_ADDRESS 0xFEBE8E08 /end MEASUREMENT
/begin MEASUREMENT wRackPo_ErrorIntegral_xds32 "Error Integral" SLONG ROTPOS 1 100 -2850.02929688 2850.02929688 FORMAT "%13.8" ECU_ADDRESS 0xFEBE8E0C /end MEASUREMENT
/begin MEASUREMENT wRackPo_GradLim_xds32 "Gradient Limitation" SLONG ANGLE_1 1 100 -1250 1250 FORMAT "%13.8" ECU_ADDRESS 0xFEBE8E10 /end MEASUREMENT
/begin MEASUREMENT wRackPo_Ramp_xds32 "Ramp value of RackPos" SLONG RIGHTSH4NP 1 100 -30000 30000 FORMAT "%13.7" ECU_ADDRESS 0xFEBE8E14 /end MEASUREMENT
/begin MEASUREMENT wRackPo_RotorAngleDeviationRef_xds16 "RotorAngle from RackPosRef deviation in Plausi" SWORD ANGLE_1 1 100 -32768 32767 FORMAT "%8.2" ECU_ADDRESS 0xFEBE92B0 /end MEASUREMENT
/begin MEASUREMENT wRackPo_RotorAngleDeviation_xds16 "RotorAngle from RackPos deviation in Plausi" SWORD ANGLE_1 1 100 -32768 32767 FORMAT "%8.2" ECU_ADDRESS 0xFEBE92B2 /end MEASUREMENT
/begin MEASUREMENT wRackPo_RotorAngleDevLowLim_xds16 "Lower limit of RotorAngle from RackPos deviation in Plausi" SWORD ANGLE_1 1 100 -32768 32767 FORMAT "%8.2" ECU_ADDRESS 0xFEBE92B4 /end MEASUREMENT
/begin MEASUREMENT wRackPo_RotorAngleDevUpLim_xds16 "Upper limit of RotorAngle from RackPos deviation in Plausi" SWORD ANGLE_1 1 100 -32768 32767 FORMAT "%8.2" ECU_ADDRESS 0xFEBE92B6 /end MEASUREMENT
/begin MEASUREMENT wRackPo_RotorAngleFromRackPosRef_xds16 "RotorAngle calculated from RackPositionRef" SWORD ANGLE_1 1 100 -32768 32767 FORMAT "%8.2" ECU_ADDRESS 0xFEBE92B8 /end MEASUREMENT
/begin MEASUREMENT wRackPo_RotorAngleFromRackPos_xds16 "RotorAngle calculated from RackPosition" SWORD ANGLE_1 1 100 -32768 32767 FORMAT "%8.2" ECU_ADDRESS 0xFEBE92BA /end MEASUREMENT
/begin MEASUREMENT wRackPo_SteeringAngleNotCorr_xds16 "Lenkwinkel berechnet aus Rotorwinkel, ohne Lang-/Kurzzeitkorrektur" SWORD SA_10 1 100 -1000 1000 FORMAT "%8.3" ECU_ADDRESS 0xFEBE92BC /end MEASUREMENT
/begin MEASUREMENT wRemoteSteerCtrlI_RscDesiredAngle_xds16 "RSC: desired steering angle" SWORD SA_10 1 100 -1000 1000 FORMAT "%8.3" ECU_ADDRESS 0xFEBE92BE /end MEASUREMENT
/begin MEASUREMENT wRpCorrI_RotAngLTCorrNVR_xds16 "RotorAngle Langzeitkorrektur" SWORD ANGLE_1 1 100 -600 600 FORMAT "%8.4" ECU_ADDRESS 0xFEBE92C0 /end MEASUREMENT
/begin MEASUREMENT wRpCorrI_RotAngSTCorr_xds16 "Rotor Kurzzeitkorrektur" SWORD ANGLE_1 1 100 -600 600 FORMAT "%8.4" ECU_ADDRESS 0xFEBE92C2 /end MEASUREMENT
/begin MEASUREMENT wRpCorr_LTIntegral_xds32 "Integral des Langzeitkorrekturwerts des Lenkwinkels" SLONG RIGHTSH14NP 1 100 -131072 131071.999939 FORMAT "%13.6" ECU_ADDRESS 0xFEBE8E18 /end MEASUREMENT
/begin MEASUREMENT wRpCorr_STIntegral_xds32 "Integral des Kurzzeitkorrekturwerts des Lenkwinkels" SLONG RIGHTSH14NP 1 100 -131072 131071.999939 FORMAT "%13.6" ECU_ADDRESS 0xFEBE8E1C /end MEASUREMENT
/begin MEASUREMENT wRpSyncI_AccRotAngOffsetCalibNVR_xds16 "calib-offset to index" SWORD ANGLE_1 1 100 -32768 32767 FORMAT "%8.2" ECU_ADDRESS 0xFEBE92C4 /end MEASUREMENT
/begin MEASUREMENT wRpSyncI_AccRotAngOffsetIndexNVR_xds16 "init-offset hwc to index" SWORD ANGLE_1 1 100 -32000 32000 FORMAT "%8.2" ECU_ADDRESS 0xFEBE92C6 /end MEASUREMENT
/begin MEASUREMENT wRpSyncI_AccRotAngOffset_xds32 "complete offset to accumulated rotor angle from hw-lib." SLONG ANGLE_1 1 100 -2147483648 2147483647 FORMAT "%13.2" ECU_ADDRESS 0xFEBE8E20 /end MEASUREMENT
/begin MEASUREMENT wRpSyncI_IdxMiddles_xas32 "Rotorwinkel der Indexmitten (Array mit drei Elementen), 99999 bedeutet: Position unbekannt." SLONG ANGLE_1 1 100 -32000 99999 FORMAT "%13.7" ECU_ADDRESS 0xFEBE999C MATRIX_DIM 7 1 1 /end MEASUREMENT
/begin MEASUREMENT wRpSyncI_IndexHysteresisNVR_xds16 "hysterese RotationIndex / iLWS" SWORD ANGLE_1 1 100 -32768 32767 FORMAT "%8.2" ECU_ADDRESS 0xFEBE92C8 /end MEASUREMENT
/begin MEASUREMENT wRpSyncI_IndexWidthNVR_xdu16 "counter RotationIndex Len / iLWS" UWORD ANGLE_1 1 100 0 65535 FORMAT "%8.2" ECU_ADDRESS 0xFEBE92CA /end MEASUREMENT
/begin MEASUREMENT wRpSyncI_RefPosOffset_xds16 "offset from accumulated rotor angle from hw-lib to fix reference position (e.g. index)" SWORD ANGLE_1 1 100 -30000 30000 FORMAT "%8.2" ECU_ADDRESS 0xFEBE92CC /end MEASUREMENT
/begin MEASUREMENT wRpSyncI_RotAngOffsetCalibNVR_xds16 "calib position within singleturn rotor angle" SWORD ANGLE_1 1 100 -400 400 FORMAT "%8.4" ECU_ADDRESS 0xFEBE92CE /end MEASUREMENT
/begin MEASUREMENT wRpSync_AbsTorsionBarTwist_xdu16 "Torsion Bar Twist abs value" UWORD SA_10 1 100 0 6553.5 FORMAT "%8.3" ECU_ADDRESS 0xFEBE92D2 /end MEASUREMENT
/begin MEASUREMENT wRpSync_AccRotAngOffsetCalibIdx_xds16 "Offset zwischen Indexmitte und kalibrierter Nullposition; lokale Kopie" SWORD ANGLE_1 1 100 -32768 32767 FORMAT "%8.2" ECU_ADDRESS 0xFEBE92D4 /end MEASUREMENT
/begin MEASUREMENT wRpSync_AccRotAngOffsetIndex_xds16 "Offset zwischen Rotorwinkel aus HwLib und Indexmitte; lokale Kopie" SWORD ANGLE_1 1 100 -21450 21450 FORMAT "%8.2" ECU_ADDRESS 0xFEBE92D6 /end MEASUREMENT
/begin MEASUREMENT wRpSync_AccumRotorAngold_xds32 "Accumulated RotorAngle delayed" SLONG ANGLE_1 1 100 -100000 100000 FORMAT "%13.6" ECU_ADDRESS 0xFEBE8E24 /end MEASUREMENT
/begin MEASUREMENT wRpSync_CalibCtrlOffsetCalibIdx_xds16 "Kalibrieroffset" SWORD ANGLE_1 1 100 -32768 32767 FORMAT "%8.2" ECU_ADDRESS 0xFEBE92D8 /end MEASUREMENT
/begin MEASUREMENT wRpSync_CalibCtrlOffsetIndex_xds16 "..." SWORD ANGLE_1 1 100 -5000 5000 FORMAT "%8.3" ECU_ADDRESS 0xFEBE92DA /end MEASUREMENT
/begin MEASUREMENT wRpSync_IdxFlanksFallNegSpd_xas32 "Rotorwinkel der fallenden Index-Flanken bei negativer Lenkwinkelgeschwindigkeit (Array mit drei Elementen), 99999 bedeutet: keine Flanke erkannt." SLONG ANGLE_1 1 100 -32000 99999 FORMAT "%13.7" ECU_ADDRESS 0xFEBE99B8 MATRIX_DIM 7 1 1 /end MEASUREMENT
/begin MEASUREMENT wRpSync_IdxFlanksFallPosSpd_xas32 "Rotorwinkel der fallenden Index-Flanken bei positiver Lenkwinkelgeschwindigkeit (Array mit drei Elementen), 99999 bedeutet: keine Flanke erkannt." SLONG ANGLE_1 1 100 -32000 99999 FORMAT "%13.7" ECU_ADDRESS 0xFEBE99D4 MATRIX_DIM 7 1 1 /end MEASUREMENT
/begin MEASUREMENT wRpSync_IdxFlanksRiseNegSpd_xas32 "Rotorwinkel der steigenden Index-Flanken bei negativer Lenkwinkelgeschwindigkeit (Array mit drei Elementen), 99999 bedeutet: keine Flanke erkannt." SLONG ANGLE_1 1 100 -32000 99999 FORMAT "%13.7" ECU_ADDRESS 0xFEBE99F0 MATRIX_DIM 7 1 1 /end MEASUREMENT
/begin MEASUREMENT wRpSync_IdxFlanksRisePosSpd_xas32 "Rotorwinkel der steigenden Index-Flanken bei positiver Lenkwinkelgeschwindigkeit (Array mit drei Elementen), 99999 bedeutet: keine Flanke erkannt." SLONG ANGLE_1 1 100 -32000 99999 FORMAT "%13.7" ECU_ADDRESS 0xFEBE9A0C MATRIX_DIM 7 1 1 /end MEASUREMENT
/begin MEASUREMENT wRpSync_IdxHystereses_xas32 "Hysterese der Flanken an einer Indexposition (Array mit drei Elementen) Einheit: Rotorwinkel, 99999 bedeutet: Hysterese unbekannt." SLONG ANGLE_1 1 100 -32000 99999 FORMAT "%13.7" ECU_ADDRESS 0xFEBE9A28 MATRIX_DIM 7 1 1 /end MEASUREMENT
/begin MEASUREMENT wRpSync_IdxWidths_xas32 "Breite eines Index (Array mit drei Elementen) Einheit: Rotorwinkel, 99999 bedeutet: Breite unbekannt." SLONG ANGLE_1 1 100 -32000 99999 FORMAT "%13.7" ECU_ADDRESS 0xFEBE9A44 MATRIX_DIM 7 1 1 /end MEASUREMENT
/begin MEASUREMENT wRpSync_IndexHighRangeCenter_xdu16 "Bereich, in dem das Indexsignal = 1 sein kann in der Lenkungsmitte" UWORD ANGLE_1 1 100 0 65535 FORMAT "%8.2" ECU_ADDRESS 0xFEBE92DC /end MEASUREMENT
/begin MEASUREMENT wRpSync_IndexHysteresis_xds32 "IndexHysteresis ..." SLONG ANGLE_1 1 100 -2147483648 2147483647 FORMAT "%13.2" ECU_ADDRESS 0xFEBE8E28 /end MEASUREMENT
/begin MEASUREMENT wRpSync_IndexPositionInitRange_xds16 "Index Position aus Initialisierung durch Lenkbereich" SWORD ANGLE_1 1 100 -32768 32767 FORMAT "%8.2" ECU_ADDRESS 0xFEBE92DE /end MEASUREMENT
/begin MEASUREMENT wRpSync_IndexPositionInitStraight_xds16 "Index Position aus Initialisierung durch Geradeausfahrt" SWORD ANGLE_1 1 100 -32768 32767 FORMAT "%8.2" ECU_ADDRESS 0xFEBE92E0 /end MEASUREMENT
/begin MEASUREMENT wRpSync_IndexPositionResync_xds16 "Index Position aus Resynchronisation" SWORD ANGLE_1 1 100 -32768 32767 FORMAT "%8.2" ECU_ADDRESS 0xFEBE92E2 /end MEASUREMENT
/begin MEASUREMENT wRpSync_IndexWidth_xds32 "IndexWidth ..." SLONG ANGLE_1 1 100 -2147483648 2147483647 FORMAT "%13.2" ECU_ADDRESS 0xFEBE8E2C /end MEASUREMENT
/begin MEASUREMENT wRpSync_RotAngMax_xds32 "maximaler Rotorwinkel aus Initialisierung" SLONG ANGLE_1 1 100 -2147483648 2147483647 FORMAT "%13.2" ECU_ADDRESS 0xFEBE8E30 /end MEASUREMENT
/begin MEASUREMENT wRpSync_RotAngMin_xds32 "minimaler Rotorwinkel waus Initialisierung" SLONG ANGLE_1 1 100 -2147483648 2147483647 FORMAT "%13.2" ECU_ADDRESS 0xFEBE8E34 /end MEASUREMENT
/begin MEASUREMENT wRpSync_RotAngOffsetCalib_xds16 "Kalibrierposition innerhalb des Singleturn Rotorwinkel" SWORD ANGLE_1 1 100 0 359 FORMAT "%8.4" ECU_ADDRESS 0xFEBE92E4 /end MEASUREMENT
/begin MEASUREMENT wRpSync_StoredIdxHystereses_xas32 "Gespeicherte Hysterese der Flanken an einer Indexposition, kann mit der momentan berechneten Hysterese verglichen werden (Array mit drei Elementen) Einheit: Rotorwinkel, 99999 bedeutet: Hysterese unbekannt." SLONG ANGLE_1 1 100 -32000 99999 FORMAT "%13.7" ECU_ADDRESS 0xFEBE9A60 MATRIX_DIM 7 1 1 /end MEASUREMENT
/begin MEASUREMENT wRpSync_StoredIdxWidths_xas32 "Gespeicherte Breite eines Index, kann mit der momentan berechneten Breite verglichen werden (Array mit drei Elementen) Einheit: Rotorwinkel, 99999 bedeutet: Breite unbekannt." SLONG ANGLE_1 1 100 -32000 99999 FORMAT "%13.7" ECU_ADDRESS 0xFEBE9A7C MATRIX_DIM 7 1 1 /end MEASUREMENT
/begin MEASUREMENT wRpSync_StoredRAIn_xds16 "Rotorwinkel, wenn der erwartete Indexbereich betreten wird" SWORD ANGLE_1 1 100 -32768 32767 FORMAT "%8.2" ECU_ADDRESS 0xFEBE92E6 /end MEASUREMENT
/begin MEASUREMENT wRpSync_SyncActIndexPosition_xds16 "ermittelte Indexposition (Mittenindex) aus Init-Funktionen" SWORD ANGLE_1 1 100 -32768 32767 FORMAT "%8.2" ECU_ADDRESS 0xFEBE92E8 /end MEASUREMENT
/begin MEASUREMENT wRWConI_AbsFrontWheelAngleCorr_xdu16 "absolute front wheel angle with long-time steering angle correction" UWORD ROADWHEELANGLE_RSH8 1 100 0 81.91016 FORMAT "%8.5" ECU_ADDRESS 0xFEBE92EA /end MEASUREMENT
/begin MEASUREMENT wRWConI_AbsFrontWheelAngle_xdu16 "absolute front wheel angle" UWORD ROADWHEELANGLE_RSH8 1 100 0 81.91016 FORMAT "%8.5" ECU_ADDRESS 0xFEBE92EC /end MEASUREMENT
/begin MEASUREMENT wRWConI_FrontWheelAngleCorr_xds16 "front wheel angle with long-time steering angle correction" SWORD ROADWHEELANGLE_RSH8 1 100 -81.91016 81.91016 FORMAT "%8.5" ECU_ADDRESS 0xFEBE92EE /end MEASUREMENT
/begin MEASUREMENT wRWConI_FrontWheelAngleOffset_xds16 "front wheel angle offset due to long- and short-time steering angle correction" SWORD ROADWHEELANGLE_RSH8 1 100 -3.199219 3.148438 FORMAT "%8.6" ECU_ADDRESS 0xFEBE92F0 /end MEASUREMENT
/begin MEASUREMENT wRWConI_FrontWheelAngle_xds16 "front wheel angle" SWORD ROADWHEELANGLE_RSH8 1 100 -81.91016 81.91016 FORMAT "%8.5" ECU_ADDRESS 0xFEBE92F2 /end MEASUREMENT
/begin MEASUREMENT xEpsInI_AccelPedalPosition_xdu16 "Position des Gaspedals" UWORD RIGHTSH10NP 1 100 0 1024 FORMAT "%8.3" ECU_ADDRESS 0xFEBE9332 /end MEASUREMENT
/begin MEASUREMENT xRemoteSteerCtrlI_DesActRetFuncFact4Check_xdu16 "Desired ActiveReturn function factor of RemoteSteeringControl to be read by Check component only" UWORD RIGHTSH10NP 1 100 0 1 FORMAT "%8.6" ECU_ADDRESS 0xFEBE9372 /end MEASUREMENT
/begin MEASUREMENT xRemoteSteerCtrlI_DesActRetFuncFact_xdu16 "Desired ActiveReturn function factor of RemoteSteeringControl" UWORD RIGHTSH10NP 1 100 0 1 FORMAT "%8.6" ECU_ADDRESS 0xFEBE9374 /end MEASUREMENT
/begin MEASUREMENT xRemoteSteerCtrl_DesActRetFuncFactChecked_xdu16 "ActiveReturn function factor which has been subjected to the MakeSafe measures" UWORD RIGHTSH10NP 1 100 0 1 FORMAT "%8.6" ECU_ADDRESS 0xFEBE9376 /end MEASUREMENT
/begin MEASUREMENT xRpCorr_BlendFactorOld_xdu8 "Blend factor delay" UBYTE RIGHTSH4NP 1 100 0 1 FORMAT "%5.3" ECU_ADDRESS 0xFEBE9613 /end MEASUREMENT
/begin MEASUREMENT xRWConI_RatioRackPos2WheelAngle_xdu16 "ratio between rack position and front wheel angle" UWORD RIGHTSH15NP 1 100 0 1 FORMAT "%8.6" ECU_ADDRESS 0xFEBE9378 /end MEASUREMENT
/begin MEASUREMENT xShimmy_A44_xds16 "Wert A44" SWORD RIGHTSH10NP 1 100 -30 30 FORMAT "%8.5" ECU_ADDRESS 0xFEBE937A /end MEASUREMENT
/begin MEASUREMENT xShimmy_B21_xdu16 "Wert B21" UWORD RIGHTSH10NP 1 100 0 63 FORMAT "%8.5" ECU_ADDRESS 0xFEBE937C /end MEASUREMENT
/begin MEASUREMENT xShimmy_B22_xdu16 "Wert B22" UWORD RIGHTSH10NP 1 100 0 63 FORMAT "%8.5" ECU_ADDRESS 0xFEBE937E /end MEASUREMENT
/begin MEASUREMENT xShimmy_B23_xdu16 "Wert B23" UWORD RIGHTSH10NP 1 100 0 63 FORMAT "%8.5" ECU_ADDRESS 0xFEBE9380 /end MEASUREMENT
/begin MEASUREMENT xShimmy_B24_xdu16 "Wert B24" UWORD RIGHTSH10NP 1 100 0 63 FORMAT "%8.5" ECU_ADDRESS 0xFEBE9382 /end MEASUREMENT
/begin MEASUREMENT xShimmy_B25_xdu16 "Wert B25" UWORD RIGHTSH10NP 1 100 0 63 FORMAT "%8.5" ECU_ADDRESS 0xFEBE9384 /end MEASUREMENT
/begin MEASUREMENT xShimmy_LimFactor_xdu16 "Limitierungsfaktor des ShimmyMoments" UWORD RIGHTSH10NP 1 100 0 1 FORMAT "%8.6" ECU_ADDRESS 0xFEBE9386 /end MEASUREMENT
/begin MEASUREMENT xShimmy_MotorTorqueFactor_xdu16 "Fahrzeuggeschwindigkeitsabhängiger Limitierungsfaktor des ShimmyMoments" UWORD RIGHTSH10NP 1 100 0 1 FORMAT "%8.6" ECU_ADDRESS 0xFEBE9388 /end MEASUREMENT
/begin MEASUREMENT xSsmI_FailOpRampLevel_xdu16 "Berechnetes Notlauf-Rampenziel" UWORD ZU0 1 100 0 32768 FORMAT "%8.2" ECU_ADDRESS 0xFEBE938A /end MEASUREMENT
/begin MEASUREMENT yApplI_LogicalGearSelected_xdu8 "Gear selected" UBYTE ZU0 1 100 0 15 FORMAT "%5.2" ECU_ADDRESS 0xFEBE961D /end MEASUREMENT
/begin MEASUREMENT yApplI_PowerModeSelected_xdu8 "PowerModeSts " UBYTE ZU0 1 100 0 7 FORMAT "%5.3" ECU_ADDRESS 0xFEBE961F /end MEASUREMENT
/begin MEASUREMENT yApplI_VehicleSpeedFlag_xdu8 "Global Vehicle Speed Status" UWORD BIT 1 100 0 1 BIT_MASK 0x1 FORMAT "%5.3" ECU_ADDRESS 0xFEBE9621 /end MEASUREMENT
/begin MEASUREMENT yApplI_VehOdometer_xdu32 "Vehicle Odometer" ULONG RATIO_100 1 100 0 42949672.95 FORMAT "%13.2" ECU_ADDRESS 0xFEBE8E74 /end MEASUREMENT
/begin MEASUREMENT yeeSicSelector1_xdu8 "SIC measure selector 1" UBYTE ZU0 1 100 0 255 FORMAT "%5.1" ECU_ADDRESS 0xFEBE9416 /end MEASUREMENT
/begin MEASUREMENT yeeSicSelector2_xdu8 "SIC measure selector 2" UBYTE ZU0 1 100 0 255 FORMAT "%5.1" ECU_ADDRESS 0xFEBE9417 /end MEASUREMENT
/begin MEASUREMENT yeeSicTiming1_xdu16 "SIC measure timing 1" UWORD ZU0 1 100 0 65535 FORMAT "%8.2" ECU_ADDRESS 0xFEBE93B6 /end MEASUREMENT
/begin MEASUREMENT yeeSicTiming2_xdu16 "SIC measure timing 2" UWORD ZU0 1 100 0 65535 FORMAT "%8.2" ECU_ADDRESS 0xFEBE93B8 /end MEASUREMENT
/begin MEASUREMENT yeeVehVar_xdu8 "" UBYTE ZU0 1 100 0 4 FORMAT "%5.3" ECU_ADDRESS 0xFEBE9626 /end MEASUREMENT
/begin MEASUREMENT ySsmI_FailOpRedGrad_xdu16 "Berechneter Notlauf-Rampengradient" UWORD ZU0 1 100 0 32768 FORMAT "%8.2" ECU_ADDRESS 0xFEBE93C8 /end MEASUREMENT
/begin MEASUREMENT zEpsInI_TimeDay_xdu8 "TimeDay " UBYTE ZU0 1 100 0 31 FORMAT "%5.2" ECU_ADDRESS 0xFEBE9642 /end MEASUREMENT
/begin MEASUREMENT zEpsInI_TimeHour_xdu8 "TimeHour " UBYTE ZU0 1 100 0 31 FORMAT "%5.2" ECU_ADDRESS 0xFEBE9643 /end MEASUREMENT
/begin MEASUREMENT zEpsInI_TimeMinutes_xdu8 "TimeMinutes " UBYTE ZU0 1 100 0 63 FORMAT "%5.2" ECU_ADDRESS 0xFEBE9644 /end MEASUREMENT
/begin MEASUREMENT zEpsInI_TimeMouth_xdu8 "TimeMouth " UBYTE ZU0 1 100 0 15 FORMAT "%5.2" ECU_ADDRESS 0xFEBE9645 /end MEASUREMENT
/begin MEASUREMENT zEpsInI_TimeSecond_xdu8 "TimeSecond " UBYTE ZU0 1 100 0 63 FORMAT "%5.2" ECU_ADDRESS 0xFEBE9646 /end MEASUREMENT
/begin MEASUREMENT zEpsInI_Year_xdu16 "TimeYear " UWORD ZU0 1 100 2000 2059 FORMAT "%8.3" ECU_ADDRESS 0xFEBE93E8 /end MEASUREMENT
/begin MEASUREMENT zRemoteSteerCtrl_HandsOnCounter_xdu16 "Diverse stored counter value of HandsOnDetection" UWORD TIMMS 1 100 0 1000 FORMAT "%8.3" ECU_ADDRESS 0xFEBE93F2 /end MEASUREMENT
/begin MEASUREMENT zRpCorrI_CalibCycleCounterLTNVR_xdu8 "counter for calibration cycle, stored in NVR corr block" UBYTE ZU0 1 100 0 255 FORMAT "%5.1" ECU_ADDRESS 0xFEBE964E /end MEASUREMENT
/begin MEASUREMENT zRpSyncI_CalibCycleCounterClbNVR_xdu8 "counter for calibration cycle, stored in NVR calib block" UBYTE ZU0 1 100 0 255 FORMAT "%5.1" ECU_ADDRESS 0xFEBE964F /end MEASUREMENT
/begin MEASUREMENT zRpSyncI_CalibCycleCounterSyncNVR_xdu8 "counter for calibration cycle, stored in NVR sync block" UBYTE ZU0 1 100 0 255 FORMAT "%5.1" ECU_ADDRESS 0xFEBE9650 /end MEASUREMENT
/begin MEASUREMENT zRpSyncI_SyncCycleCounterNVR_xdu8 "counter for sync-cycle from HwLib, stored in NVR" UBYTE ZU0 1 100 0 255 FORMAT "%5.1" ECU_ADDRESS 0xFEBE9651 /end MEASUREMENT
/begin MEASUREMENT zRpSync_JobcallCounterCalib_xdu16 "Counter to measure the number of JobStatus callback invokes - Calib" UWORD ZU0 1 100 0 65535 FORMAT "%8.2" ECU_ADDRESS 0xFEBE93F4 /end MEASUREMENT
/begin MEASUREMENT zRpSync_JobcallCounterSync_xdu16 "Counter to measure the number of JobStatus callback invokes - Sync" UWORD ZU0 1 100 0 65535 FORMAT "%8.2" ECU_ADDRESS 0xFEBE93F6 /end MEASUREMENT
/begin MEASUREMENT zRpSync_ServoSlipDetectedOld_xdu16 "servo slip detected old" UWORD ZU0 1 100 0 65535 FORMAT "%8.2" ECU_ADDRESS 0xFEBE93F8 /end MEASUREMENT
/begin MEASUREMENT zSSDetI_DetectionCounter_xdu16 "Zähler der bereits erkannten Schlupfstellen in einem Zündzyklus" UWORD ZU0 1 100 0 65535 FORMAT "%8.2" ECU_ADDRESS 0xFEBE93FA /end MEASUREMENT
/begin MEASUREMENT zSSDet_JustUpdated_xdu8 "Flag für zeigt an, ob bei der entsprechenden Probe ein Verrutschen festgestellt wurde" UBYTE ZU0 1 100 0 1 FORMAT "%5.3" ECU_ADDRESS 0xFEBE9652 /end MEASUREMENT
/begin MEASUREMENT zSSVerI_LifeTimeCounter_xdu16 "Zähler der bereits erkannten und geprüft Schlupfstellen zu Lebzeiten" UWORD ZU0 1 100 0 500 FORMAT "%8.4" ECU_ADDRESS 0xFEBE93FC /end MEASUREMENT
/begin MEASUREMENT zSSWarnI_StickSlipCounter1_xdu16 "Stick-Slip Zähler-1" UWORD ZU0 1 100 0 65535 FORMAT "%8.2" ECU_ADDRESS 0xFEBE93FE /end MEASUREMENT
/begin MEASUREMENT zSSWarnI_StickSlipCounter2_xdu16 "Stick-Slip Zähler-2" UWORD ZU0 1 100 0 65535 FORMAT "%8.2" ECU_ADDRESS 0xFEBE9400 /end MEASUREMENT
/begin MEASUREMENT zSSWarnI_StickSlipCounter3_xdu16 "Stick-Slip Zähler-3" UWORD ZU0 1 100 0 65535 FORMAT "%8.2" ECU_ADDRESS 0xFEBE9402 /end MEASUREMENT
/begin MEASUREMENT zSSWarnI_StickSlipCounter4_xdu16 "Stick-Slip Zähler-4" UWORD ZU0 1 100 0 65535 FORMAT "%8.2" ECU_ADDRESS 0xFEBE9404 /end MEASUREMENT
/begin MEASUREMENT zSSWarnI_StickSlipCounter5_xdu16 "Stick-Slip Zähler-5" UWORD ZU0 1 100 0 65535 FORMAT "%8.2" ECU_ADDRESS 0xFEBE9406 /end MEASUREMENT
/begin MEASUREMENT zSSWarnI_StickSlipCounter6_xdu16 "Stick-Slip Zähler-6" UWORD ZU0 1 100 0 65535 FORMAT "%8.2" ECU_ADDRESS 0xFEBE9408 /end MEASUREMENT
/begin MEASUREMENT zSSWarn_JobcallCounter_xdu16 "Jobcallback Counter" UWORD ZU0 1 100 0 65535 FORMAT "%8.2" ECU_ADDRESS 0xFEBE940A /end MEASUREMENT
/begin MEASUREMENT zSSWarn_StickSlipCounterDetected_xdu16 "Stick-Slip Zähler-Detected" UWORD ZU0 1 100 0 65535 FORMAT "%8.2" ECU_ADDRESS 0xFEBE940C /end MEASUREMENT
/begin MEASUREMENT zSSWarn_StickSlipCounter_xdu16 "Anzahl erkannter Stick-Slip Zyklen" UWORD ZU0 1 100 0 65535 FORMAT "%8.2" ECU_ADDRESS 0xFEBE940E /end MEASUREMENT
/begin COMPU_METHOD ANGLE_1 "" RAT_FUNC "%6.2" "Â°" COEFFS 0 1 0 0 0 1 /end COMPU_METHOD
/begin COMPU_METHOD BIT "" RAT_FUNC "%6.2" "Bitanzeige" COEFFS 0 1 0 0 0 1 /end COMPU_METHOD
/begin COMPU_METHOD FLOAT "" RAT_FUNC "%16.7" "NA" COEFFS 0 1 0 0 0 1 /end COMPU_METHOD
/begin COMPU_METHOD FREQHZ "" RAT_FUNC "%6.3" "Hz" COEFFS 0 8 0 0 0 1 /end COMPU_METHOD
/begin COMPU_METHOD MMOT "" RAT_FUNC "%6.5" "Nm" COEFFS 0 1024 0 0 0 1 /end COMPU_METHOD
/begin COMPU_METHOD RACKPOS128 "" RAT_FUNC "%6.4" "mm" COEFFS 0 128 0 0 0 1 /end COMPU_METHOD
/begin COMPU_METHOD RACKSPEED128 "" RAT_FUNC "%6.4" "mm/s" COEFFS 0 128 0 0 0 1 /end COMPU_METHOD
/begin COMPU_METHOD RATIO_100 "" RAT_FUNC "%6.4" "-" COEFFS 0 100 0 0 0 1 /end COMPU_METHOD
/begin COMPU_METHOD RIGHTSH10NP "" RAT_FUNC "%6.5" "" COEFFS 0 1024 0 0 0 1 /end COMPU_METHOD
/begin COMPU_METHOD RIGHTSH12NP "" RAT_FUNC "%6.5" "" COEFFS 0 4096 0 0 0 1 /end COMPU_METHOD
/begin COMPU_METHOD RIGHTSH13NP "" RAT_FUNC "%6.5" "1" COEFFS 0 8192 0 0 0 1 /end COMPU_METHOD
/begin COMPU_METHOD RIGHTSH14NP "" RAT_FUNC "%7.6" "" COEFFS 0 16384 0 0 0 1 /end COMPU_METHOD
/begin COMPU_METHOD RIGHTSH15NP "" RAT_FUNC "%7.6" "" COEFFS 0 32768 0 0 0 1 /end COMPU_METHOD
/begin COMPU_METHOD RIGHTSH16NP "" RAT_FUNC "%7.6" "" COEFFS 0 65536 0 0 0 1 /end COMPU_METHOD
/begin COMPU_METHOD RIGHTSH4NP "" RAT_FUNC "%6.4" "" COEFFS 0 16 0 0 0 1 /end COMPU_METHOD
/begin COMPU_METHOD RIGHTSH6NP "" RAT_FUNC "%6.4" "" COEFFS 0 64 0 0 0 1 /end COMPU_METHOD
/begin COMPU_METHOD RIGHTSH7NP "" RAT_FUNC "%6.4" "" COEFFS 0 128 0 0 0 1 /end COMPU_METHOD
/begin COMPU_METHOD RIGHTSH8NP "" RAT_FUNC "%6.4" "" COEFFS 0 256 0 0 0 1 /end COMPU_METHOD
/begin COMPU_METHOD ROADWHEELANGLE_RSH8 "" RAT_FUNC "%6.4" "Â°" COEFFS 0 256 0 0 0 1 /end COMPU_METHOD
/begin COMPU_METHOD ROTPOS "" RAT_FUNC "%6.3" "Â°" COEFFS 0 11.3777777778 0 0 0 1 /end COMPU_METHOD
/begin COMPU_METHOD RSH15 "" RAT_FUNC "%6.4" "%" COEFFS 0 327.68 0 0 0 1 /end COMPU_METHOD
/begin COMPU_METHOD RSH15_GRAD1MS "" RAT_FUNC "%6.4" "% / ms" COEFFS 0 327.68 0 0 0 1 /end COMPU_METHOD
/begin COMPU_METHOD SAS_8 "" RAT_FUNC "%6.3" "Â°/s" COEFFS 0 8 0 0 0 1 /end COMPU_METHOD
/begin COMPU_METHOD SA_10 "" RAT_FUNC "%6.3" "Â°" COEFFS 0 10 0 0 0 1 /end COMPU_METHOD
/begin COMPU_METHOD TBTHIGH "" RAT_FUNC "%6.5" "Nm" COEFFS 0 1024 0 0 0 1 /end COMPU_METHOD
/begin COMPU_METHOD TBTSTIFFHIGH "" RAT_FUNC "%6.5" "NM / Â°" COEFFS 0 1024 0 0 0 1 /end COMPU_METHOD
/begin COMPU_METHOD TIMMS "" RAT_FUNC "%6.2" "ms" COEFFS 0 1 0 0 0 1 /end COMPU_METHOD
/begin COMPU_METHOD TIMS "" RAT_FUNC "%6.2" "s" COEFFS 0 1 0 0 0 1 /end COMPU_METHOD
/begin COMPU_METHOD TIMSEC "" RAT_FUNC "%6.4" "SEC" COEFFS 0 100 0 0 0 1 /end COMPU_METHOD
/begin COMPU_METHOD TIMSEC_10 "" RAT_FUNC "%6.3" "s" COEFFS 0 10 0 0 0 1 /end COMPU_METHOD
/begin COMPU_METHOD TIMSEC_100 "" RAT_FUNC "%6.4" "s" COEFFS 0 100 0 0 0 1 /end COMPU_METHOD
/begin COMPU_METHOD TIMSEC_1000 "" RAT_FUNC "%6.5" "s" COEFFS 0 1000 0 0 0 1 /end COMPU_METHOD
/begin COMPU_METHOD TORGRAD "" RAT_FUNC "%6.5" "Nm/ms" COEFFS 0 1024 0 0 0 1 /end COMPU_METHOD
/begin COMPU_METHOD VFZ "" RAT_FUNC "%6.2" "km/h" COEFFS 0 1 0 0 0 1 /end COMPU_METHOD
/begin COMPU_METHOD VFZHIGH "" RAT_FUNC "%6.4" "km/h" COEFFS 0 64 0 0 0 1 /end COMPU_METHOD
/begin COMPU_METHOD VROT "" RAT_FUNC "%3.1" "1/min" COEFFS 0 1 0 0 0 1 /end COMPU_METHOD
/begin COMPU_METHOD ZU0 "" RAT_FUNC "%6.2" "" COEFFS 0 1 0 0 0 1 /end COMPU_METHOD
/begin FUNCTION RackPos_Correction "RackPos Correction kgt"
 /begin DEF_CHARACTERISTIC mRpCorr_LTATBT_XDU16 mRpCorr_LTMaxMotTorq_XDU16 mRpCorr_STMaxMotTorq_XDU16 mRpCorr_STMaxTBT_XDU16 sRpCorr_ConfigFlagsCorr_XDU8 tRpCorr_CycleTimeRpCorr_XDU8 tRpCorr_DetectionTimerLT_XDU8 tRpCorr_DetectionTimerST_XDU8 tRpCorr_LTimeIntegTime_XDU8 vRpCorr_STMinVehicleSpeed_XDU16 vRpCorr_VehicleSpeedWeight_XDU16 wRpCorr_LTACompIntegRange_XDU16 wRpCorr_LTACompMaxAngle_XDU16 wRpCorr_Resolution_XDU16 wRpCorr_STACompIntegRange_XDU16 wRpCorr_STACompMaxAngle_XDU16 xRpCorr_LTACompIntegFactor_XDU16 xRpCorr_STIntegrationFactor_XDU16 /end DEF_CHARACTERISTIC
 /begin OUT_MEASUREMENT fRpCorr_LearnCond_xdu8 fRpCorr_ResetAdaptiveData_xdu8 sRpCorr_JobResultOK_xdu8 sRpCorr_ResetCorrection_xdu8 tRpCorr_IntegTimedelay_xdu8 wRpCorr_LTIntegral_xds32 wRpCorr_STIntegral_xds32 xRpCorr_BlendFactorOld_xdu8 /end OUT_MEASUREMENT
/end FUNCTION
/begin FUNCTION RackPos_Correction_Interface "RackPos Correction Interface kgt"
 /begin OUT_MEASUREMENT wRpCorrI_RotAngLTCorrNVR_xds16 wRpCorrI_RotAngSTCorr_xds16 zRpCorrI_CalibCycleCounterLTNVR_xdu8 /end OUT_MEASUREMENT
/end FUNCTION
/begin FUNCTION RackPos_Main "RackPosition Main kgt"
 /begin DEF_CHARACTERISTIC IRackPo_RackPositionArray_XAS16 sRackPo_ConfigFlagsMain_XDU16 wRackPo_OffsetReductionStep_XDU16 wRackPo_RotorAngleArray_XAS16 wRackPo_RotorStiffnessLimit_XDU8 wRackPo_RotorStiffnessMaxRate_XDU8 wRackPo_RotorStiffnessOffset_XAU16 wRackPo_SteeringAngleArray_XAS16 xRackPo_RotorSpeedFilterFactor_XDU16 /end DEF_CHARACTERISTIC
 /begin OUT_MEASUREMENT lRackPo_RackPositionCorr_xds16 lRackPo_RackPositionRefNotVal_xds16 mRackPo_AbsLimitedMotorTorque_xdu16 sRackPo_ForceSAInvalid_xdu8 sRackPo_InitStatedelay_xdu8 sRackPo_QualifierStatemachine_xdu8 tRackPo_ForceSAInvalidtimer_xdu8 vRackPo_RackSpeedNotVal_xds16 wRackPo_AccRotAngOffDelay_xds32 wRackPo_AccRotAngOffsetCurr_xds32 wRackPo_GradLim_xds32 wRackPo_Ramp_xds32 wRackPo_SteeringAngleNotCorr_xds16 /end OUT_MEASUREMENT
/end FUNCTION
/begin FUNCTION RackPos_MainPlausi "RackPosition Plausi kgt"
 /begin DEF_CHARACTERISTIC lRackPo_RackPositionMax_XDU16 lRackPo_RackPosRangeAhead_XDU16 nRackPo_MaxRotorSpeedRackSpeedPlausi_XDU16 sRackPo_ConfigFlagsMainPlausiActivErr_XDU16 sRackPo_ConfigFlagsMainPlausiReactErr_XDU16 tRackPo_ErrorFilterAheadTimeout_XDU16 tRackPo_ErrorFilterTimeout_XDU16 vRackPo_RotAngGradientDiffMax_XDU16 vRackPo_RotorSpeedTolerance_XDU16 wRackPo_GradErrLimit_XDU16 wRackPo_GradErrReductStep_XDU16 wRackPo_LtCorrAngleMax_XDU16 wRackPo_RackposToleranceRA_XDU16 wRackPo_StCorrAngleMax_XDU16 wRackPo_SteeringAngleMax_XDU16 /end DEF_CHARACTERISTIC
 /begin OUT_MEASUREMENT fRackPo_RackSpeedValidOld_xdu8 fRackPo_RpRefValidOld_xdu8 fRackPo_SaValidOld_xdu8 nRackPo_RotorSpeedDeviation_xds16 nRackPo_RotorSpeedFromRackSpeed_xds16 sRackPo_ErrorDetected_xdu16 sRackPo_ErrState_xdu8 sRackPo_ErrSubState_xdu8 tRackPo_AheadErrorFilterTimer_xdu16 tRackPo_MainErrorFilterTimer_xdu16 tRackPo_RackSpeedErrorFilterTimer_xdu16 tRackPo_RefErrorFilterTimer_xdu16 wRackPo_AccRaOffsetBuff_xds32 wRackPo_ErrorIntegral_xds32 wRackPo_RotorAngleDeviationRef_xds16 wRackPo_RotorAngleDeviation_xds16 wRackPo_RotorAngleDevLowLim_xds16 wRackPo_RotorAngleDevUpLim_xds16 wRackPo_RotorAngleFromRackPosRef_xds16 wRackPo_RotorAngleFromRackPos_xds16 /end OUT_MEASUREMENT
/end FUNCTION
/begin FUNCTION RackPos_Main_Interface "RackPosition Main Interface kgt"
 /begin DEF_CHARACTERISTIC wRackPoI_MaxAbsRotbasedAngle_XDF32 wRackPoI_MaxTorsionBarTorsion_XDU16 /end DEF_CHARACTERISTIC
 /begin OUT_MEASUREMENT lRackPoI_LTCorrRackPos_xds16 lRackPoI_RackPositionRef_xds16 lRackPoI_STCorrRackPos_xds16 nRackPoI_RotorSpeed_xds16 sRackPoI_PlausiState_xdu8 sRackPoI_RackPositionRefState_xdu8 sRackPoI_RotAngQualifier_xdu8 sRackPoI_StateRequest_xdu8 wRackPoI_AccumRotorAngle_xds32 wRackPoI_RotorAngleRamped_xds32 wRackPoI_RotorAngleRev_xdu16 /end OUT_MEASUREMENT
/end FUNCTION
/begin FUNCTION RackPos_Main_Supp "" /begin DEF_CHARACTERISTIC wRackPo_SteeringAngleRealArray_XAS16 /end DEF_CHARACTERISTIC /end FUNCTION
/begin FUNCTION RackPos_Sync_CalibControl "RackPosition Synchronization kgt for calibration control"
 /begin DEF_CHARACTERISTIC fRpSync_StartKalibrieren_XDU8 mRpSync_MaxCalibTBTorq_XDU16 sRpSync_CalibControl_XDU8 vRpSync_MaxCalibVehicleSpeed_XDU16 wRpSync_MaxRotorAngleForCalib_XDU16 wRpSync_RotAngRange4CalibJob_XDU16 wRpSync_SACalibAngle_XDS16 /end DEF_CHARACTERISTIC
 /begin OUT_MEASUREMENT sRpSync_CalibCorrReset_xdu8 sRpSync_CalibCtrlLocked_xdu8 sRpSync_CalibCtrlSuccess_xdu8 sRpSync_CalibStatusEncode_xdu8 sRpSync_DesiredCalibMode_xdu8 wRpSync_CalibCtrlOffsetCalibIdx_xds16 wRpSync_CalibCtrlOffsetIndex_xds16 /end OUT_MEASUREMENT
/end FUNCTION
/begin FUNCTION RackPos_Sync_IndexSearch "RackPosition Synchronization kgt for index search"
 /begin DEF_CHARACTERISTIC mRpSync_MaxMMotLowDyn_XDU16 mRpSync_MaxTBTGradForIdxSearch_XDU16 mRpSync_MaxTBTLowDyn_XDU16 nRpSync_MaxRotSpdLowDyn_XDU16 nRpSync_MinRotSpdForIdxSearch_XDU16 wRpSync_MaxAllowedIdxHyst_XDS16 wRpSync_MaxAllowedIdxWidthCenter_XDU16 wRpSync_MaxAllowedIdxWidthDelta_XDU8 wRpSync_MaxAllowedIdxWidth_XDU16 wRpSync_MinAllowedIdxHyst_XDS16 wRpSync_MinAllowedIdxWidthCenter_XDU16 wRpSync_MinAllowedIdxWidth_XDU16 wRpSync_SameIdxTol_XDU16 xRpSync_TorsionRpsFactor_XDU16 zRpSync_IdxposLoopCounter_XDU8 /end DEF_CHARACTERISTIC
 /begin OUT_MEASUREMENT fRpSync_LowSteerDyn_xdb sRpSync_IdxFlanksFallNegSpdQual_xau8 sRpSync_IdxFlanksFallPosSpdQual_xau8 sRpSync_IdxFlanksRiseNegSpdQual_xau8 sRpSync_IdxFlanksRisePosSpdQual_xau8 sRpSync_IdxSearchPlausiFail_xdu8 wRpSync_AbsTorsionBarTwist_xdu16 wRpSync_IdxFlanksFallNegSpd_xas32 wRpSync_IdxFlanksFallPosSpd_xas32 wRpSync_IdxFlanksRiseNegSpd_xas32 wRpSync_IdxFlanksRisePosSpd_xas32 wRpSync_IdxHystereses_xas32 wRpSync_IdxWidths_xas32 wRpSync_StoredIdxHystereses_xas32 wRpSync_StoredIdxWidths_xas32 /end OUT_MEASUREMENT
/end FUNCTION
/begin FUNCTION RackPos_Sync_Interface "RackPosition Synchronization prototype kgt"
 /begin OUT_MEASUREMENT sRpSyncI_AccRotAngOffsetIndexStateNVR_xdu8 sRpSyncI_CalibAllowed_xdu8 sRpSyncI_IdxMiddlesQual_xau8 sRpSyncI_InitOffsetControl_xdu8 sRpSyncI_InitState_xdu8 sRpSyncI_NoInitCause_xdu16 sRpSyncI_PlausiState_xdu8 sRpSyncI_RefPosState_xdu8 sRpSyncI_RotAngInitState_xdu8 sRpSyncI_Statemachine_xdu8 wRpSyncI_AccRotAngOffsetCalibNVR_xds16 wRpSyncI_AccRotAngOffsetIndexNVR_xds16 wRpSyncI_AccRotAngOffset_xds32 wRpSyncI_IdxMiddles_xas32 wRpSyncI_IndexHysteresisNVR_xds16 wRpSyncI_IndexWidthNVR_xdu16 wRpSyncI_RefPosOffset_xds16 wRpSyncI_RotAngOffsetCalibNVR_xds16 zRpSyncI_CalibCycleCounterClbNVR_xdu8 zRpSyncI_CalibCycleCounterSyncNVR_xdu8 zRpSyncI_SyncCycleCounterNVR_xdu8 /end OUT_MEASUREMENT
/end FUNCTION
/begin FUNCTION RackPos_Sync_Plausi "RackPosition Synchronization kgt for monitoring"
 /begin DEF_CHARACTERISTIC sRpSync_ConfigFlagsSyncPlausiActivErr_XDU16 sRpSync_ConfigFlagsSyncPlausiReactErr_XDU16 tRpSync_ErrorFilterIdxPosTimeout_XDU16 tRpSync_ErrorFilterIdxVldTimeout_XDU16 wRpSync_AdditionalToleranceEstimSync_XDU16 wRpSync_AdditionalToleranceOneTurn_XDU16 wRpSync_AdditionalToleranceRawSync_XDU16 wRpSync_AllowedIndexShift_XDU16 wRpSync_SteeringWheelOneTurn_XDU16 /end DEF_CHARACTERISTIC
 /begin OUT_MEASUREMENT fRpSync_IndexErrorFound_xdu8 fRpSync_IndexFound_xdu8 fRpSync_SaValidOld_xdu8 sRpSync_ErrHandling_xdu8 sRpSync_ErrLogging_xdu8 sRpSync_ErrorDetected_xdu16 tRpSync_IdxPosErrorFilterTimer_xdu16 tRpSync_IdxVldErrorFilterTimer_xdu16 wRpSync_IndexHighRangeCenter_xdu16 wRpSync_StoredRAIn_xds16 /end OUT_MEASUREMENT
/end FUNCTION
/begin FUNCTION RackPos_Sync_Statemachine "RackPosition Synchronization statemachine kgt"
 /begin DEF_CHARACTERISTIC sRpSync_ConfigFlagsIdx2_XDU16 sRpSync_ConfigFlagsIdx_XDU16 wRpSync_MinSyncDiffRaw_XDU16 wRpSync_MinSyncDiff_XDU16 /end DEF_CHARACTERISTIC
 /begin OUT_MEASUREMENT fRpSync_CalcCalibRps_xdb fRpSync_CalibWriteError_xdb fRpSync_CalibWriteTrigger_xdb fRpSync_Initialrun_xdb fRpSync_NewSyncNeeded_xdb fRpSync_NvRamInitWritten_xdb fRpSync_OldCalibDFBlock_xdb fRpSync_ResetIdxEdges_xdb fRpSync_ResetInitFcn_xdb fRpSync_ResetPreCalInit_xdb fRpSync_ReSyncDone_xdb fRpSync_RotAngSyncCalib_xdb fRpSync_SyncWriteError_xdb fRpSync_ValidityDelayed_xdb fRpSync_WrtNvrInitData_xdb fRpSync_WrtNvr_CalibData_xdb sRpSync_CalibNvWrite_xdu8 sRpSync_CalibRamping_xdu8 sRpSync_CalibStatemachine_xdu8 sRpSync_CalibState_xdu8 sRpSync_ErrSubState_xdu8 sRpSync_EventEntry_NoInit_xdu8 sRpSync_IndexSignalold_xdu8 sRpSync_JobResultOKCalib_xdu8 sRpSync_JobResultOKSync_xdu8 sRpSync_NoInitCauseBkp_xdu16 sRpSync_NvWriteStateCalib_xdu8 sRpSync_NvWriteStateSync_xdu8 sRpSync_ResyncCntrHwLibLast_xdu8 sRpSync_StateStatusEncode_xdu16 sRpSync_SyncCheck_xdu8 sRpSync_SyncNvWrite_xdu8 sRpSync_SyncRamping_xdu8 sRpSync_SyncStatemachine_xdu8 wRpSync_AccRotAngOffsetCalibIdx_xds16 wRpSync_AccRotAngOffsetIndex_xds16 wRpSync_AccumRotorAngold_xds32 wRpSync_RotAngOffsetCalib_xds16 zRpSync_JobcallCounterCalib_xdu16 zRpSync_JobcallCounterSync_xdu16 zRpSync_ServoSlipDetectedOld_xdu16 /end OUT_MEASUREMENT
/end FUNCTION
/begin FUNCTION RackPos_Sync_SyncActions "RackPosition Synchronization kgt for syncronization actions"
 /begin DEF_CHARACTERISTIC tRpSync_InitTimeStraight_XDU16 wRpSync_IndexTolerance_XDU16 wRpSync_MinSteeringRangeHalf_XDU16 wRpSync_RotAngRangeStraight_XDU16 /end DEF_CHARACTERISTIC
 /begin OUT_MEASUREMENT sRpSync_InitStatusEncode_xdu16 sRpSync_SuccessInitRange_xdu8 sRpSync_SuccessInitStraight_xdu8 sRpSync_SuccessResync_xdu8 sRpSync_SyncActCenterCheck_xdu8 sRpSync_SyncActSuccess_xdu8 tRpSync_AheadDetTimer_xdu16 tRpSync_IndexHighTimer_xdu16 wRpSync_IndexHysteresis_xds32 wRpSync_IndexPositionInitRange_xds16 wRpSync_IndexPositionInitStraight_xds16 wRpSync_IndexPositionResync_xds16 wRpSync_IndexWidth_xds32 wRpSync_RotAngMax_xds32 wRpSync_RotAngMin_xds32 wRpSync_SyncActIndexPosition_xds16 /end OUT_MEASUREMENT
/end FUNCTION
/begin FUNCTION RackProtection "Überlastschutz der EPS Mechanik"
 /begin DEF_CHARACTERISTIC mRackProt_LimitRedMotorTorque_XDU16 mRackProt_MaxAbsTorsionBarTorqueRampUp_XDU16 mRackProt_MinAbsTorsionBarTorqueRampDown_XDU16 tRackProt_TimeRedRampDown_XDU16 tRackProt_TimeRedRampUp_XDU16 vRackProt_MaxAbsSteeringAngleSpeed_XDU16 vRackProt_MaxAbsVehicleSpeed_XDU16 xRackProt_GradRedRampDown_XDU16 xRackProt_GradRedRampUp_XDU16 xRackProt_TargetReductionLevel_XDU16 /end DEF_CHARACTERISTIC
/end FUNCTION
/begin FUNCTION RackWheelConverter "Converter: rack position to front wheel angle"
 /begin DEF_CHARACTERISTIC lRWCon_RackPosition_XAU16 wRWCon_WheelAngle_XAU16 xRWCon_RackPos2WheelAngleRatio_XAU16 /end DEF_CHARACTERISTIC
/end FUNCTION
/begin FUNCTION RackWheelConverterI "Konvertierer: Zahnstangenposition <--> Frontradwinkel - Interface"
 /begin OUT_MEASUREMENT wRWConI_AbsFrontWheelAngleCorr_xdu16 wRWConI_AbsFrontWheelAngle_xdu16 wRWConI_FrontWheelAngleCorr_xds16 wRWConI_FrontWheelAngleOffset_xds16 wRWConI_FrontWheelAngle_xds16 xRWConI_RatioRackPos2WheelAngle_xdu16 /end OUT_MEASUREMENT
/end FUNCTION
/begin FUNCTION RackWheelConverterInv "Converter: front wheel angle to rack position" /begin DEF_CHARACTERISTIC wRWCon_MaxWheelAngle_XDU16 /end DEF_CHARACTERISTIC /end FUNCTION
/begin FUNCTION RemoteSteeringControl "RemoteSteeringControl"
 /begin DEF_CHARACTERISTIC fRemoteSteerCtrl_EnableDesRackPosFilt_XDU8 fRemoteSteerCtrl_EnableFeedForward_XDU8 mRemoteSteerCtrl_DeadBandTBT_XDU16 tRemoteSteerCtrl_CycleTimeController_XDU8 tRemoteSteerCtrl_CycleTimeControlVariable_XDU8 vRemoteSteerCtrl_DeadBandRackSpeed_XDU16 vRemoteSteerCtrl_MaxGradRackSpeed_XDU16 vRemoteSteerCtrl_MaxRackSpeed_XDU16 xRemoteSteerCtrl_FeedForwardFiltFact_XDU16 xRemoteSteerCtrl_PositionDPart_XDF32 xRemoteSteerCtrl_PositionIMax_XDF32 xRemoteSteerCtrl_PositionIPart_XDF32 xRemoteSteerCtrl_PositionPPart_XDF32 xRemoteSteerCtrl_RackSpeedDPart_XDF32 xRemoteSteerCtrl_RackSpeedIMax_XDF32 xRemoteSteerCtrl_RackSpeedIPart_XDF32 xRemoteSteerCtrl_RackSpeedPPart_XDF32 /end DEF_CHARACTERISTIC
 /begin OUT_MEASUREMENT lRemoteSteerCtrl_DesiredRackPosFilt_xds16 vRemoteSteerCtrl_DesiredRackSpeed_xds16 vRemoteSteerCtrl_LimitedDesiredRackSpeed_xds16 /end OUT_MEASUREMENT
/end FUNCTION
/begin FUNCTION RemoteSteeringControlCheck "RemoteSteeringControlCheck"
 /begin DEF_CHARACTERISTIC mRemoteSteerCtrl_CheckHandsOnTorqLim_XDU16 tRemoteSteerCtrl_CheckHandsOnSwOffTime_XDU16 vRemoteSteerCtrl_SafetyLimitMaxVehicleSpeed_XDU16 /end DEF_CHARACTERISTIC
 /begin OUT_MEASUREMENT fRemoteSteerCtrl_LastRscArbitrationResultPassive_xdb fRemoteSteerCtrl_MonSafeOk_xdb mRemoteSteerCtrl_DesMotTrqOffsetChecked_xds16 mRemoteSteerCtrl_DesSteerTrqOffsetChecked_xds16 sRemoteSteerCtrl_MakeSafeState_xdu8 xRemoteSteerCtrl_DesActRetFuncFactChecked_xdu16 zRemoteSteerCtrl_HandsOnCounter_xdu16 /end OUT_MEASUREMENT
/end FUNCTION
/begin FUNCTION RemoteSteeringControlCheckI "RemoteSteeringControlCheckI - interface"
 /begin OUT_MEASUREMENT mRemoteSteerCtrlI_DesMotTrqOffset_xds16 mRemoteSteerCtrlI_DesSteerTrqOffset_xds16 sRemoteSteerCtrlI_MakeSafeAndMonState_xdu8 xRemoteSteerCtrlI_DesActRetFuncFact_xdu16 /end OUT_MEASUREMENT
/end FUNCTION
/begin FUNCTION RemoteSteeringControlI "RemoteSteeringControlI - interface"
 /begin OUT_MEASUREMENT mRemoteSteerCtrlI_DesMotTrqOffset4Check_xds16 mRemoteSteerCtrlI_DesSteerTrqOffset4Check_xds16 xRemoteSteerCtrlI_DesActRetFuncFact4Check_xdu16 /end OUT_MEASUREMENT
/end FUNCTION
/begin FUNCTION RemoteSteeringControlSupp "RemoteSteeringControlSupp"
 /begin DEF_CHARACTERISTIC lRemoteSteerCtrl_MaxRackPosDiff_XDU16 lRemoteSteerCtrl_MaxRackPosGrad_XDU16 mRemoteSteerCtrl_HandsOnTorqLim_XDU16 tRemoteSteerCtrl_CycleTime_XDU8 tRemoteSteerCtrl_DrivingCmdDelayTime_XDU32 tRemoteSteerCtrl_HandsOnSwOffTime_XDU16 vRemoteSteerCtrl_RSCMaxVehicleSpeed_XDU16 wRemoteSteerCtrl_MaxReqSteeringAngle_XDU16 wRemoteSteerCtrl_SteeringAngleInc_XDU16 /end DEF_CHARACTERISTIC
 /begin OUT_MEASUREMENT sRemoteSteerCtrlI_EpsRscState_xdu8 sRemoteSteerCtrl_FctCoCtrlState_xdu8 sRemoteSteerCtrl_FeatureState_xdu8 sRemoteSteerCtrl_InhibitCode_xdu32 wRemoteSteerCtrlI_RscDesiredAngle_xds16 /end OUT_MEASUREMENT
/end FUNCTION
/begin FUNCTION RemoteSteeringControlSuppI "RemoteSteeringControlSuppI - interface"
 /begin OUT_MEASUREMENT lRemoteSteerCtrlI_DesiredRackPosition_xds16 sRemoteSteerCtrlI_Activate_xdu8 /end OUT_MEASUREMENT
/end FUNCTION
/begin FUNCTION RomCrcCheck "ROM CRC Check ueber die Memory Layout Bloecke" /end FUNCTION
/begin FUNCTION RotorSpeed "Mess- und Applikationsgrößen RotorSpeed"
 /begin DEF_CHARACTERISTIC xRotSp_RotAccelerationFilterFact_XDU16_00___A xRotSp_RotAccelerationFilterFact_XDU16_01___A xRotSp_RotAccelerationFilterFact_XDU16_02___A xRotSp_RotAccelerationFilterFact_XDU16_03___A xRotSp_RotAccelerationFilterFact_XDU16_04___A xRotSp_RotAccelerationFilterFact_XDU16_05___A xRotSp_RotAccelerationFilterFact_XDU16_06___A xRotSp_RotAccelerationFilterFact_XDU16_07___A xRotSp_RotAccelerationFilterFact_XDU16_08___A xRotSp_RotAccelerationFilterFact_XDU16_09___A xRotSp_RotAccelerationFilterFact_XDU16_10___A xRotSp_RotAccelerationFilterFact_XDU16_11___A xRotSp_RotAccelerationFilterFact_XDU16_12___A xRotSp_RotAccelerationFilterFact_XDU16_13___A xRotSp_RotAccelerationFilterFact_XDU16_14___A xRotSp_RotAccelerationFilterFact_XDU16_15___A xRotSp_RotAccelerationFilterFact_XDU16_16___A xRotSp_RotAccelerationFilterFact_XDU16_17___A xRotSp_RotAccelerationFilterFact_XDU16_18___A xRotSp_RotAccelerationFilterFact_XDU16_19___A xRotSp_RotAccelerationFilterFact_XDU16_20___A xRotSp_RotAccelerationFilterFact_XDU16_21___A xRotSp_RotAccelerationFilterFact_XDU16_22___A xRotSp_RotAccelerationFilterFact_XDU16_23___A xRotSp_RotAccelerationFilterFact_XDU16_24___A xRotSp_RotAccelerationFilterFact_XDU16_25___A xRotSp_RotAccelerationFilterFact_XDU16_26___A xRotSp_RotAccelerationFilterFact_XDU16_27___A xRotSp_RotAccelerationFilterFact_XDU16_28___A xRotSp_RotAccelerationFilterFact_XDU16_29___A xRotSp_RotAccelerationFilterFact_XDU16_30___A xRotSp_RotAccelerationFilterFact_XDU16_31___A xRotSp_RotAccelerationFilterFact_XDU16_32___A xRotSp_RotAccelerationFilterFact_XDU16_33___A xRotSp_RotAccelerationFilterFact_XDU16_34___A xRotSp_RotAccelerationFilterFact_XDU16_35___A xRotSp_RotAccelerationLowFilterFact_XDU16_00___A xRotSp_RotAccelerationLowFilterFact_XDU16_01___A xRotSp_RotAccelerationLowFilterFact_XDU16_02___A xRotSp_RotAccelerationLowFilterFact_XDU16_03___A xRotSp_RotAccelerationLowFilterFact_XDU16_04___A xRotSp_RotAccelerationLowFilterFact_XDU16_05___A xRotSp_RotAccelerationLowFilterFact_XDU16_06___A xRotSp_RotAccelerationLowFilterFact_XDU16_07___A xRotSp_RotAccelerationLowFilterFact_XDU16_08___A xRotSp_RotAccelerationLowFilterFact_XDU16_09___A xRotSp_RotAccelerationLowFilterFact_XDU16_10___A xRotSp_RotAccelerationLowFilterFact_XDU16_11___A xRotSp_RotAccelerationLowFilterFact_XDU16_12___A xRotSp_RotAccelerationLowFilterFact_XDU16_13___A xRotSp_RotAccelerationLowFilterFact_XDU16_14___A xRotSp_RotAccelerationLowFilterFact_XDU16_15___A xRotSp_RotAccelerationLowFilterFact_XDU16_16___A xRotSp_RotAccelerationLowFilterFact_XDU16_17___A xRotSp_RotAccelerationLowFilterFact_XDU16_18___A xRotSp_RotAccelerationLowFilterFact_XDU16_19___A xRotSp_RotAccelerationLowFilterFact_XDU16_20___A xRotSp_RotAccelerationLowFilterFact_XDU16_21___A xRotSp_RotAccelerationLowFilterFact_XDU16_22___A xRotSp_RotAccelerationLowFilterFact_XDU16_23___A xRotSp_RotAccelerationLowFilterFact_XDU16_24___A xRotSp_RotAccelerationLowFilterFact_XDU16_25___A xRotSp_RotAccelerationLowFilterFact_XDU16_26___A xRotSp_RotAccelerationLowFilterFact_XDU16_27___A xRotSp_RotAccelerationLowFilterFact_XDU16_28___A xRotSp_RotAccelerationLowFilterFact_XDU16_29___A xRotSp_RotAccelerationLowFilterFact_XDU16_30___A xRotSp_RotAccelerationLowFilterFact_XDU16_31___A xRotSp_RotAccelerationLowFilterFact_XDU16_32___A xRotSp_RotAccelerationLowFilterFact_XDU16_33___A xRotSp_RotAccelerationLowFilterFact_XDU16_34___A xRotSp_RotAccelerationLowFilterFact_XDU16_35___A xRotSp_RotSpeedFilterFactAcceleration_XDU16_00___A xRotSp_RotSpeedFilterFactAcceleration_XDU16_01___A xRotSp_RotSpeedFilterFactAcceleration_XDU16_02___A xRotSp_RotSpeedFilterFactAcceleration_XDU16_03___A xRotSp_RotSpeedFilterFactAcceleration_XDU16_04___A xRotSp_RotSpeedFilterFactAcceleration_XDU16_05___A xRotSp_RotSpeedFilterFactAcceleration_XDU16_06___A xRotSp_RotSpeedFilterFactAcceleration_XDU16_07___A xRotSp_RotSpeedFilterFactAcceleration_XDU16_08___A xRotSp_RotSpeedFilterFactAcceleration_XDU16_09___A xRotSp_RotSpeedFilterFactAcceleration_XDU16_10___A xRotSp_RotSpeedFilterFactAcceleration_XDU16_11___A xRotSp_RotSpeedFilterFactAcceleration_XDU16_12___A xRotSp_RotSpeedFilterFactAcceleration_XDU16_13___A xRotSp_RotSpeedFilterFactAcceleration_XDU16_14___A xRotSp_RotSpeedFilterFactAcceleration_XDU16_15___A xRotSp_RotSpeedFilterFactAcceleration_XDU16_16___A xRotSp_RotSpeedFilterFactAcceleration_XDU16_17___A xRotSp_RotSpeedFilterFactAcceleration_XDU16_18___A xRotSp_RotSpeedFilterFactAcceleration_XDU16_19___A xRotSp_RotSpeedFilterFactAcceleration_XDU16_20___A xRotSp_RotSpeedFilterFactAcceleration_XDU16_21___A xRotSp_RotSpeedFilterFactAcceleration_XDU16_22___A xRotSp_RotSpeedFilterFactAcceleration_XDU16_23___A xRotSp_RotSpeedFilterFactAcceleration_XDU16_24___A xRotSp_RotSpeedFilterFactAcceleration_XDU16_25___A xRotSp_RotSpeedFilterFactAcceleration_XDU16_26___A xRotSp_RotSpeedFilterFactAcceleration_XDU16_27___A xRotSp_RotSpeedFilterFactAcceleration_XDU16_28___A xRotSp_RotSpeedFilterFactAcceleration_XDU16_29___A xRotSp_RotSpeedFilterFactAcceleration_XDU16_30___A xRotSp_RotSpeedFilterFactAcceleration_XDU16_31___A xRotSp_RotSpeedFilterFactAcceleration_XDU16_32___A xRotSp_RotSpeedFilterFactAcceleration_XDU16_33___A xRotSp_RotSpeedFilterFactAcceleration_XDU16_34___A xRotSp_RotSpeedFilterFactAcceleration_XDU16_35___A xRotSp_RotSpeedFilterFact_XDU16_00___A xRotSp_RotSpeedFilterFact_XDU16_01___A xRotSp_RotSpeedFilterFact_XDU16_02___A xRotSp_RotSpeedFilterFact_XDU16_03___A xRotSp_RotSpeedFilterFact_XDU16_04___A xRotSp_RotSpeedFilterFact_XDU16_05___A xRotSp_RotSpeedFilterFact_XDU16_06___A xRotSp_RotSpeedFilterFact_XDU16_07___A xRotSp_RotSpeedFilterFact_XDU16_08___A xRotSp_RotSpeedFilterFact_XDU16_09___A xRotSp_RotSpeedFilterFact_XDU16_10___A xRotSp_RotSpeedFilterFact_XDU16_11___A xRotSp_RotSpeedFilterFact_XDU16_12___A xRotSp_RotSpeedFilterFact_XDU16_13___A xRotSp_RotSpeedFilterFact_XDU16_14___A xRotSp_RotSpeedFilterFact_XDU16_15___A xRotSp_RotSpeedFilterFact_XDU16_16___A xRotSp_RotSpeedFilterFact_XDU16_17___A xRotSp_RotSpeedFilterFact_XDU16_18___A xRotSp_RotSpeedFilterFact_XDU16_19___A xRotSp_RotSpeedFilterFact_XDU16_20___A xRotSp_RotSpeedFilterFact_XDU16_21___A xRotSp_RotSpeedFilterFact_XDU16_22___A xRotSp_RotSpeedFilterFact_XDU16_23___A xRotSp_RotSpeedFilterFact_XDU16_24___A xRotSp_RotSpeedFilterFact_XDU16_25___A xRotSp_RotSpeedFilterFact_XDU16_26___A xRotSp_RotSpeedFilterFact_XDU16_27___A xRotSp_RotSpeedFilterFact_XDU16_28___A xRotSp_RotSpeedFilterFact_XDU16_29___A xRotSp_RotSpeedFilterFact_XDU16_30___A xRotSp_RotSpeedFilterFact_XDU16_31___A xRotSp_RotSpeedFilterFact_XDU16_32___A xRotSp_RotSpeedFilterFact_XDU16_33___A xRotSp_RotSpeedFilterFact_XDU16_34___A xRotSp_RotSpeedFilterFact_XDU16_35___A /end DEF_CHARACTERISTIC
 /begin OUT_MEASUREMENT aRotSp_RotorAccelDelayed_xds32 aRotSp_RotorAccelFiltDelayed_xds32 fRotSp_IntRotorSpd_ValidDelayed_xdb nRotSp_FilteredRotorSpeedDelayed_xds32 nRotSp_RotorSpeedFiltDelayed_Acc_xds16 nRotSp_RotorSpeedFiltDelayed_xds32 /end OUT_MEASUREMENT
/end FUNCTION
/begin FUNCTION RotorSpeedI "RotorSpeedI" /end FUNCTION
/begin FUNCTION SafCtrlCheck "SafCtrlCheck"
 /begin OUT_MEASUREMENT mSafCtrl_LowerLimitCheck_xds16 mSafCtrl_MotorTorque4Sum_xds16 mSafCtrl_UpperLimitCheck_xds16 /end OUT_MEASUREMENT
/end FUNCTION
/begin FUNCTION SafCtrlCheckInterface "SafCtrlCheck - interface" /begin OUT_MEASUREMENT mSafCtrlI_MotorTorque_xds16 /end OUT_MEASUREMENT /end FUNCTION
/begin FUNCTION SafeStateManager "SafeStateManager"
 /begin DEF_CHARACTERISTIC nSsm_ShortCircuit_RotorSpeedLimit_XDU16 tSsm_FaultActionMaxTime_XAU16 vSsm_ShortCircuit_VehSpeedLimit_XDU16 wSsm_ShortCircuit_SteeringAngleLimit_XDU32 xSsm_FaultActionRedLevel_XAU16 ySsm_FaultActionGradient_XAU16 /end DEF_CHARACTERISTIC
 /begin OUT_MEASUREMENT sFltManI_RequestEcuState_xdu8 xSsmI_FailOpRampLevel_xdu16 ySsmI_FailOpRedGrad_xdu16 /end OUT_MEASUREMENT
/end FUNCTION
/begin FUNCTION SafeStateManagerCommon "SafeStateManager" /begin OUT_MEASUREMENT sSsmI_DeactivateAssist_xdu8 /end OUT_MEASUREMENT /end FUNCTION
/begin FUNCTION SafeStateManagerSupp "SafeStateManagerSupp" /begin OUT_MEASUREMENT sSsm_Dummy_CPRErrLvl_mdu8 sSsm_Dummy_CPRErrLvl_Red_mdu8 /end OUT_MEASUREMENT /end FUNCTION
/begin FUNCTION SafetyController "Safety Controller"
 /begin DEF_CHARACTERISTIC fSafCtrl_EnableLimitation_XDU8 mSafCtrl_DesiredTorsionBarTor_XDU16 mSafCtrl_MaxTorsionBarTor_XDU16 xSafCtrl_DPart_XDU16 xSafCtrl_InertiaFactor_XDS16 xSafCtrl_IPart_XDU16 xSafCtrl_PPart_XDU16 /end DEF_CHARACTERISTIC
 /begin OUT_MEASUREMENT mSafCtrl_DPart_xds16 mSafCtrl_InertiaTorque_xds16 mSafCtrl_IPart_xds32 mSafCtrl_LowerLimit_xds16 mSafCtrl_PPart_xds16 mSafCtrl_TbtDeviation_xds16 mSafCtrl_UpperLimit_xds16 /end OUT_MEASUREMENT
/end FUNCTION
/begin FUNCTION SafetyControllerI "SafetyControllerI" /begin DEF_CHARACTERISTIC mSafCtrlI_MaxSafCtrlMotorTorque_XAU16 /end DEF_CHARACTERISTIC /begin IN_MEASUREMENT mApplI_AbsTorsionBarTorque_xdu16 /end IN_MEASUREMENT /begin OUT_MEASUREMENT mSafCtrlI_MotTrq4Check_xds16 mSafCtrlI_MotTrqFromMTL_xds16 /end OUT_MEASUREMENT /end FUNCTION
/begin FUNCTION SafetyRampController "SA and SLOA Detection" /begin OUT_MEASUREMENT sSrc_SafetyRampStatus_xdu8 /end OUT_MEASUREMENT /end FUNCTION
/begin FUNCTION SafetyRampControllerI "SA and SLOA Detection Interface" /begin OUT_MEASUREMENT sSrcI_SafetyRampControl_xdu8 /end OUT_MEASUREMENT /end FUNCTION
/begin FUNCTION SafetyRampControllerSupp "SA and SLOA Detection"
 /begin DEF_CHARACTERISTIC mSrcI_MaxSafeRampDownReqTorque_XDU16 mSrcI_MaxSafeRampUpReqTorque_XDU16 /end DEF_CHARACTERISTIC
/end FUNCTION
/begin FUNCTION ServoSlipDet "ServoSlipDetection kgt" /begin DEF_CHARACTERISTIC mSSDet_MaxTorqueOffset_XDU16 /end DEF_CHARACTERISTIC /begin OUT_MEASUREMENT zSSDet_JustUpdated_xdu8 /end OUT_MEASUREMENT /end FUNCTION
/begin FUNCTION ServoSlipDet_Interface "ServoSlipDetection Schnittstelle kgt" /begin OUT_MEASUREMENT zSSDetI_DetectionCounter_xdu16 /end OUT_MEASUREMENT /end FUNCTION
/begin FUNCTION ServoSlipVerifying_Interface "ServoSlipVerifying Schnittstelle kgt" /begin OUT_MEASUREMENT zSSVerI_LifeTimeCounter_xdu16 /end OUT_MEASUREMENT /end FUNCTION
/begin FUNCTION Shimmy "Shimmy Compensation"
 /begin DEF_CHARACTERISTIC aShimmy_VehDecelTh_XDS16 mShimmy_AmpTBTMax_XDU16 mShimmy_MaxMotorTorq_XDU16 qShimmy_FrequencyMax_XDU8 qShimmy_FrequencyMin_XDU8 tShimmy_CountMaxAmp_XDU16 tShimmy_Time_XDU16 tShimmy_VehDecelTime_XDU8 wShimmy_SteeringAngleMax_XDU16 xShimmy_A11_XDU16_0___A xShimmy_A11_XDU16_1___A xShimmy_A11_XDU16_2___A xShimmy_A11_XDU16_3___A xShimmy_A11_XDU16_4___A xShimmy_A11_XDU16_5___A xShimmy_A12_XDS16_0___A xShimmy_A12_XDS16_1___A xShimmy_A12_XDS16_2___A xShimmy_A12_XDS16_3___A xShimmy_A12_XDS16_4___A xShimmy_A12_XDS16_5___A xShimmy_A13_XDU16 xShimmy_A21_XDS16_0___A xShimmy_A21_XDS16_1___A xShimmy_A21_XDS16_2___A xShimmy_A21_XDS16_3___A xShimmy_A21_XDS16_4___A xShimmy_A21_XDS16_5___A xShimmy_A22L_XAU16_0___A xShimmy_A22L_XAU16_1___A xShimmy_A22L_XAU16_2___A xShimmy_A22L_XAU16_3___A xShimmy_A22L_XAU16_4___A xShimmy_A22L_XAU16_5___A xShimmy_A23_XDS16_0___A xShimmy_A23_XDS16_1___A xShimmy_A23_XDS16_2___A xShimmy_A23_XDS16_3___A xShimmy_A23_XDS16_4___A xShimmy_A23_XDS16_5___A xShimmy_A31_XDS16_0___A xShimmy_A31_XDS16_1___A xShimmy_A31_XDS16_2___A xShimmy_A31_XDS16_3___A xShimmy_A31_XDS16_4___A xShimmy_A31_XDS16_5___A xShimmy_B11_XDS16_0___A xShimmy_B11_XDS16_1___A xShimmy_B11_XDS16_2___A xShimmy_B11_XDS16_3___A xShimmy_B11_XDS16_4___A xShimmy_B11_XDS16_5___A xShimmy_B21L_XAU16_0___A xShimmy_B21L_XAU16_1___A xShimmy_B21L_XAU16_2___A xShimmy_B21L_XAU16_3___A xShimmy_B21L_XAU16_4___A xShimmy_B21L_XAU16_5___A xShimmy_B22L_XAU16_0___A xShimmy_B22L_XAU16_1___A xShimmy_B22L_XAU16_2___A xShimmy_B22L_XAU16_3___A xShimmy_B22L_XAU16_4___A xShimmy_B22L_XAU16_5___A xShimmy_B23L_XAU16_0___A xShimmy_B23L_XAU16_1___A xShimmy_B23L_XAU16_2___A xShimmy_B23L_XAU16_3___A xShimmy_B23L_XAU16_4___A xShimmy_B23L_XAU16_5___A xShimmy_B24L_XAU16_0___A xShimmy_B24L_XAU16_1___A xShimmy_B24L_XAU16_2___A xShimmy_B24L_XAU16_3___A xShimmy_B24L_XAU16_4___A xShimmy_B24L_XAU16_5___A xShimmy_B25L_XAU16_0___A xShimmy_B25L_XAU16_1___A xShimmy_B25L_XAU16_2___A xShimmy_B25L_XAU16_3___A xShimmy_B25L_XAU16_4___A xShimmy_B25L_XAU16_5___A xShimmy_C1_XDS16_0___A xShimmy_C1_XDS16_1___A xShimmy_C1_XDS16_2___A xShimmy_C1_XDS16_3___A xShimmy_C1_XDS16_4___A xShimmy_C1_XDS16_5___A xShimmy_CompBoundary_XDU16 xShimmy_CompensationActive_XDU8 xShimmy_CompHyster_XDU16 xShimmy_CountOff_XDU16 xShimmy_CountOn_XDU16 xShimmy_DampingFactorDecel_XDU16 xShimmy_DampingFactorNorm_XDU16 xShimmy_FeedbackFactor_XDS16_0___A xShimmy_FeedbackFactor_XDS16_1___A xShimmy_FeedbackFactor_XDS16_2___A xShimmy_FeedbackFactor_XDS16_3___A xShimmy_FeedbackFactor_XDS16_4___A xShimmy_FeedbackFactor_XDS16_5___A xShimmy_MotorTorqueFactor_XAU16 xShimmy_PinionSign_XDS8 xShimmy_RampFactor_XDU16 xShimmy_ShimmyActFactor_XDS16_0___A xShimmy_ShimmyActFactor_XDS16_1___A xShimmy_ShimmyActFactor_XDS16_2___A xShimmy_ShimmyActFactor_XDS16_3___A xShimmy_ShimmyActFactor_XDS16_4___A xShimmy_ShimmyActFactor_XDS16_5___A xShimmy_TorqFactor_XDU16_0___A xShimmy_TorqFactor_XDU16_1___A xShimmy_TorqFactor_XDU16_2___A xShimmy_TorqFactor_XDU16_3___A xShimmy_TorqFactor_XDU16_4___A xShimmy_TorqFactor_XDU16_5___A xShimmy_WheelAccelBeta_XDU16 xShimmy_WheelAccelPole_XDU16 /end DEF_CHARACTERISTIC
 /begin IN_MEASUREMENT vApplI_AbsVehicleSpeedFilt_xdu16 /end IN_MEASUREMENT
 /begin OUT_MEASUREMENT mShimmy_AmpTBT_xdu16 mShimmy_EstimatedTorsionBarTorque_xds16 mShimmy_EstimatorIn_xds16 mShimmy_EstMotTorque_xds16 mShimmy_FeedbackValue_xds16 qShimmy_BandWidth_xdu16 qShimmy_FreqOld_xdu16 qShimmy_Freq_xdu16 qShimmy_Op1_xdf32 qShimmy_Op2_xdf32 qShimmy_Op3_xdf32 sShimmy_FeatureState_xdu8 sShimmy_Status_xdu8 xShimmy_A44_xds16 xShimmy_B21_xdu16 xShimmy_B22_xdu16 xShimmy_B23_xdu16 xShimmy_B24_xdu16 xShimmy_B25_xdu16 xShimmy_LimFactor_xdu16 xShimmy_MotorTorqueFactor_xdu16 /end OUT_MEASUREMENT
/end FUNCTION
/begin FUNCTION ShimmyCheck "Shimmy Compensation Check" /begin DEF_CHARACTERISTIC mShimmy_MaxSafetyMotorTorq_XDU16 /end DEF_CHARACTERISTIC /begin OUT_MEASUREMENT mShimmy_MotorTorqueChecked_xds16 /end OUT_MEASUREMENT /end FUNCTION
/begin FUNCTION ShutdownCoordinator "Komponente die alle Shutdown und Reset Anfragen koordiniert." /begin OUT_MEASUREMENT sShutCoI_ShutdownRequest_xdu8 /end OUT_MEASUREMENT /end FUNCTION
/begin FUNCTION ShutdownPermission "Komponente die, falls die Situation es erlaubt, einen Software Shutdown erlaubt."
 /begin DEF_CHARACTERISTIC mShutPermI_NoSteeringTorqueBorder_XDU16 mShutPermI_ShutdownVehSpeedBorder_XDU16_0___A mShutPermI_ShutdownVehSpeedBorder_XDU16_1___A mShutPermI_ShutdownVehSpeedBorder_XDU16_2___A mShutPermI_ShutdownVehSpeedBorder_XDU16_3___A mShutPermI_ShutdownVehSpeedBorder_XDU16_4___A mShutPermI_ShutdownVehSpeedBorder_XDU16_5___A tShutPermI_NoSteeringTorqueTimeOut_XDU16 /end DEF_CHARACTERISTIC
 /begin OUT_MEASUREMENT fShutPermI_ShutdownPermission_xdu8 tShutPerm_NoSteeringTorqueStartTime_xdu16 /end OUT_MEASUREMENT
/end FUNCTION
/begin FUNCTION SignalProvider "Damosgrï¿½ï¿½en der Komponente SignalProvider"
 /begin OUT_MEASUREMENT fcnRxEnable_xdb lEpsIn_0x122_Indication_xdu8 lEpsIn_0x142_Indication_xdu8 lEpsIn_0x245_Indication_xdu8 lEpsIn_0x252_Indication_xdu8 lEpsIn_0x3A1_Indication_xdu8 lEpsIn_0x3FE_Indication_xdu8 mLkaI_TorqueReq_xds16 sEpsInI_IndicationFlagStatus_xdu8 vEpsInI_VehicleSpeedForUDS_xds16 xEpsInI_AccelPedalPosition_xdu16 yApplI_LogicalGearSelected_xdu8 yApplI_PowerModeSelected_xdu8 yApplI_VehicleSpeedFlag_xdu8 yApplI_VehOdometer_xdu32 yeeVehVar_xdu8 zEpsInI_TimeDay_xdu8 zEpsInI_TimeHour_xdu8 zEpsInI_TimeMinutes_xdu8 zEpsInI_TimeMouth_xdu8 zEpsInI_TimeSecond_xdu8 zEpsInI_Year_xdu16 /end OUT_MEASUREMENT
/end FUNCTION
/begin FUNCTION SimpleVar "SimpleVar"
 /begin OUT_MEASUREMENT yeeSicSelector1_xdu8 yeeSicSelector2_xdu8 yeeSicTiming1_xdu16 yeeSicTiming2_xdu16 /end OUT_MEASUREMENT
/end FUNCTION
/begin FUNCTION SSWarn ""
 /begin OUT_MEASUREMENT fSSWarnI_VibrationEnabled_xdu8 sSSWarnI_ErrLvl_Red_xdu8 sSSWarnI_ErrLvl_xdu8 zSSWarnI_StickSlipCounter1_xdu16 zSSWarnI_StickSlipCounter2_xdu16 zSSWarnI_StickSlipCounter3_xdu16 zSSWarnI_StickSlipCounter4_xdu16 zSSWarnI_StickSlipCounter5_xdu16 zSSWarnI_StickSlipCounter6_xdu16 /end OUT_MEASUREMENT
/end FUNCTION
/begin FUNCTION SSWarnMain "Stick-Slip Warnung"
 /begin DEF_CHARACTERISTIC mSSWarn_DeltaEffectiveTorque_XDU16 mSSWarn_EffTrqHigh_XDU16 mSSWarn_EffTrqLow_XDU16 mSSWarn_SSFeedbackTorque_XDU16 nSSWarn_RotSpeedHigh_XDU16 nSSWarn_RotSpeedLow_XDU16 tSSWarn_MaxAllowedReductionTime_XDU16 tSSWarn_MaxDeltaTime_XDU16 tSSWarn_ResetStickSlipTime_XDU16 tSSWarn_TimeMaxNHigh_XDU16 tSSWarn_TimeMaxNnotZero_XDU16 tSSWarn_TimeMinNLow_XDU16 tSSWarn_VibrationPause_XDU16 tSSWarn_VibrationPeriod_XDU8 tSSWarn_VibrationRampTime_XDU16 vSSWarn_MinVehicleSpeed_XDU16 wSSWarn_MaxSteeringAngle_XDU16 xSSWarn_ReductionGradient_XDU16 xSSWarn_ReductionLevel_XDU16 xSSWarn_RotorSpeedFilter_XDU16 zSSWarn_SSCounterMax_XDU16 /end DEF_CHARACTERISTIC
 /begin OUT_MEASUREMENT fSSWarn_AntifreezJobResultOK_xdu8 fSSWarn_CounterJobResultOK_xdb fSSWarn_NVMWriteError_xdb fSSWarn_VibrationActivated_xdu8 mSSWarn_EffectiveTorque_xds16 nSSWarn_RotorSpeedFilt_xds16 sSSWarn_NvWriteState_xdu8 sSSWarn_ShutdownRequest_xdu8 sSSWarn_StickSlipStatus_xdu8 tSSWarn_FeedbackTimer_xdu16 zSSWarn_JobcallCounter_xdu16 zSSWarn_StickSlipCounterDetected_xdu16 zSSWarn_StickSlipCounter_xdu16 /end OUT_MEASUREMENT
/end FUNCTION
/begin FUNCTION SSWarnPlausi "Stick-Slip Warnung - plausi pruefen"
 /begin DEF_CHARACTERISTIC mSSWarn_MaxFeedbackTorqueDT_XDF32 mSSWarn_MaxFeedbackTorque_XDF32 /end DEF_CHARACTERISTIC
 /begin OUT_MEASUREMENT mSSWarn_WarnTorqueDT_xdf32 /end OUT_MEASUREMENT
/end FUNCTION
/begin FUNCTION StartStop "Mess- und Applikationsgrößen StartStop"
 /begin DEF_CHARACTERISTIC fStStp_FailopActive_XDB fStStp_FuncActive_XDB mStStp_ToBarTorqueLowRedDownToHiRed_XDU16 nStStp_EngineSpeedToHighGoImmediateToFull_XDU16 nStStp_SpeedEngFullToLowRedDown_XDU16 nStStp_SpeedEngLowRedDownToFull_XDU16 tStStp_SwCondFullToLowRedDownMs_XDU16 tStStp_SwCondHiRedToFullMs_XDU16 tStStp_SwCondHiRedToLowRedUpMs_XDU16 tStStp_SwCondLowRedDownToFullMs_XDU16 tStStp_SwCondLowRedDownToHiRedMs_XDU16 tStStp_SwCondLowRedUpToFullMs_XDU16 tStStp_SwCondLowRedUpToHiRedMs_XDU16 vStStp_AbsSteerAngleSpeedLowRedDownToHiRed_XDU16 vStStp_VehicleSpeedToHighGoImmediateToFull_XDU16 vStStp_VehSpeedFullToLowRedDown_XDU16 vStStp_VehSpeedHiRedToLowRedUp_XDU16 vStStp_VehSpeedLowRedDownToHiRed_XDU16 vStStp_VehSpeedLowRedToFull_XDU16 vStStp_VehSpeedLowRedUpToHiRed_XDU16 xStStp_GradientInitial_XDU16 xStStp_GradientStateFull_XDU16 xStStp_GradientStateHiRed_XDU16 xStStp_GradientStateLoRedDown_XDU16 xStStp_GradientStateLoRedUp_XDU16 xStStp_LevelStateFull_XDU16 xStStp_LevelStateHiRed_XDU16 xStStp_LevelStateInitial_XDU16 xStStp_LevelStateLoRedDown_XDU16 xStStp_LevelStateLoRedUp_XDU16 /end DEF_CHARACTERISTIC
 /begin OUT_MEASUREMENT fStStp_OutputState_xdb fStStp_OverLimitSwitchStateFull_xdb fStStp_PowerAssistOn_xdb sStStp_ForceState_xdu8 sStStp_State_xdu8 /end OUT_MEASUREMENT
/end FUNCTION
/begin RECORD_LAYOUT AblGLKLuw FNC_VALUES 3 UWORD COLUMN_DIR DIRECT AXIS_PTS_X 2 UWORD INDEX_INCR DIRECT NO_AXIS_PTS_X 1 UWORD /end RECORD_LAYOUT
/begin RECORD_LAYOUT AblGLKWBsw FNC_VALUES 1 SWORD COLUMN_DIR DIRECT /end RECORD_LAYOUT
/begin RECORD_LAYOUT AblGLKWBuw FNC_VALUES 1 UWORD COLUMN_DIR DIRECT /end RECORD_LAYOUT
/begin RECORD_LAYOUT AblGLKWfl4 FNC_VALUES 1 FLOAT32_IEEE COLUMN_DIR DIRECT /end RECORD_LAYOUT
/begin RECORD_LAYOUT AblGLKWsb FNC_VALUES 1 SBYTE COLUMN_DIR DIRECT /end RECORD_LAYOUT
/begin RECORD_LAYOUT AblGLKWsw FNC_VALUES 1 SWORD COLUMN_DIR DIRECT /end RECORD_LAYOUT
/begin RECORD_LAYOUT AblGLKWub FNC_VALUES 1 UBYTE COLUMN_DIR DIRECT /end RECORD_LAYOUT
/begin RECORD_LAYOUT AblGLKWul FNC_VALUES 1 ULONG COLUMN_DIR DIRECT /end RECORD_LAYOUT
/begin RECORD_LAYOUT AblGLKWuw FNC_VALUES 1 UWORD COLUMN_DIR DIRECT /end RECORD_LAYOUT
/end MODULE
/end PROJECT
