ASAP2_VERSION 1 70
/begin PROJECT _DF0_D01 "SCU3_B3_VAR_01"
/begin HEADER "" VERSION "DF0_D01_D_01_00" PROJECT_NO _DF0_D01 /end HEADER
/begin MODULE XCP_EPS_ECU "CMP"
/begin MOD_COMMON "" BYTE_ORDER MSB_LAST ALIGNMENT_BYTE 1 ALIGNMENT_WORD 2 ALIGNMENT_LONG 4 ALIGNMENT_FLOAT32_IEEE 4 ALIGNMENT_FLOAT64_IEEE 8 /end MOD_COMMON
/begin MEASUREMENT yAraDiagI_AsicSasStatemachine_gde "ASIC SAS Statemachine" UBYTE NO_UNIT 1 100 0 255 ECU_ADDRESS 0xFEBEB970 /end MEASUREMENT
/begin MEASUREMENT zAraDiag_StartupPersistentCounterValue_gdu8 "Startup persistant value" UBYTE NO_UNIT 1 100 0 255 ECU_ADDRESS 0xFEBEB971 /end MEASUREMENT
/begin MEASUREMENT zAraDiagI_AsicCounterCos_gds16 "" SWORD NO_UNIT 1 100 -32768 32767 ECU_ADDRESS 0xFEBEB96A /end MEASUREMENT
/begin MEASUREMENT zAraDiagI_AsicCounterSin_gds16 "" SWORD NO_UNIT 1 100 -32768 32767 ECU_ADDRESS 0xFEBEB96C /end MEASUREMENT
/begin MEASUREMENT sAraRotCalcI_Status_gde "MultiturnCalc status" UBYTE NO_UNIT 1 100 0 255 ECU_ADDRESS 0xFEBEB990 /end MEASUREMENT
/begin MEASUREMENT wAraRotCalc_PreviousSensorPosition_gdf32 "Rotor sensor postion of the previos ms cycle" FLOAT32_IEEE ANG_RAD_REAL 1 100 0 6.283185 ECU_ADDRESS 0xFEBEB978 /end MEASUREMENT
/begin MEASUREMENT wHwlI_AbsRotbasedAngle_gdf32 "Absolute steering angle of the internal steering angle sensor. Variable range is defined by wExtInI_MaxAbsRotbasedAngle_GDF32." FLOAT32_IEEE ANG_RAD_REAL 1 100 -750 750 ECU_ADDRESS 0xFEBEE138 /end MEASUREMENT
/begin MEASUREMENT yAraRotCalc_StateMachine_gde "" UBYTE NO_UNIT 1 100 0 3 ECU_ADDRESS 0xFEBEB991 /end MEASUREMENT
/begin MEASUREMENT zAraRotCalcI_AngleOverflowCounter_gdu16 "" UWORD NO_UNIT 1 100 0 65535 ECU_ADDRESS 0xFEBEB98C /end MEASUREMENT
/begin MEASUREMENT zAraRotCalcI_StartedFromZeroCounter_gdu16 "" UWORD NO_UNIT 1 100 0 65535 ECU_ADDRESS 0xFEBEB98E /end MEASUREMENT
/begin MEASUREMENT sCscAdcI_AdcDiagStatusFsa_gde "ADC diagnosis status bit " UBYTE NO_UNIT 1 100 0 255 ECU_ADDRESS 0xFEBEB998 /end MEASUREMENT
/begin MEASUREMENT sCscAsicI_AsicDiagStatusFsa_gde "Asic Diagnosis Status" UWORD NO_UNIT 1 100 0 65535 ECU_ADDRESS 0xFEBEB9BC /end MEASUREMENT
/begin MEASUREMENT yCscAsic_AreAllSuCooCheckDone_gde "SuCoo Check status" UBYTE NO_UNIT 1 100 0 255 ECU_ADDRESS 0xFEBEB9C0 /end MEASUREMENT
/begin MEASUREMENT yCscAsic_AscCommDiagStatus_gde "Asic Comm Diag status" UBYTE NO_UNIT 1 100 0 255 ECU_ADDRESS 0xFEBEB9C1 /end MEASUREMENT
/begin MEASUREMENT yCscAsic_AscFault_gde "Asic Fault info" UBYTE NO_UNIT 1 100 0 255 ECU_ADDRESS 0xFEBEB9C2 /end MEASUREMENT
/begin MEASUREMENT yCscAsic_AsicErrorFlags_gde "Asic Error Flags" UBYTE NO_UNIT 1 100 0 255 ECU_ADDRESS 0xFEBEB9C3 /end MEASUREMENT
/begin MEASUREMENT yCscAsic_McuErrTimeStamp_gdu32 "Mcu Error Timestamp" ULONG NO_UNIT 1 100 0 4294967295 ECU_ADDRESS 0xFEBEB9A0 /end MEASUREMENT
/begin MEASUREMENT yCscAsic_PsEnDiagStatus_gde "PsEn Status" UBYTE NO_UNIT 1 100 0 255 ECU_ADDRESS 0xFEBEB9C4 /end MEASUREMENT
/begin MEASUREMENT yCscAsic_SeqDependentFlag_gau16 "Flag for dependent startup tests" UWORD NO_UNIT 1 100 0 65535 ECU_ADDRESS 0xFEBEB9CC MATRIX_DIM 12 1 1 /end MEASUREMENT
/begin MEASUREMENT yCscAsic_SeqIdFinished_gdu32 "Status of finished test sequence" ULONG NO_UNIT 1 100 0 4294967295 ECU_ADDRESS 0xFEBEB9A4 /end MEASUREMENT
/begin MEASUREMENT yCscAsic_SeqIdStarted_gdu32 "Status of started test sequence" ULONG NO_UNIT 1 100 0 4294967295 ECU_ADDRESS 0xFEBEB9A8 /end MEASUREMENT
/begin MEASUREMENT yCscAsic_StrtUpTestFinished_gau32 "Status of started test " ULONG NO_UNIT 1 100 0 4294967295 ECU_ADDRESS 0xFEBEB9E4 MATRIX_DIM 12 1 1 /end MEASUREMENT
/begin MEASUREMENT yCscAsic_StrtUpTestStarted_gau32 "Status of finished test " ULONG NO_UNIT 1 100 0 4294967295 ECU_ADDRESS 0xFEBEBA14 MATRIX_DIM 12 1 1 /end MEASUREMENT
/begin MEASUREMENT yCscAsic_SuCooSeqStarted_gdu32 "SuCoo Sequence Started Info" ULONG NO_UNIT 1 100 0 4294967295 ECU_ADDRESS 0xFEBEB9AC /end MEASUREMENT
/begin MEASUREMENT yCscAsic_SuppVoltInError_gdu8 "Supply voltage error status" UBYTE NO_UNIT 1 100 0 255 ECU_ADDRESS 0xFEBEB9C5 /end MEASUREMENT
/begin MEASUREMENT yCscAsic_UndervoltageDetected_gde "Undervoltage status" UBYTE NO_UNIT 1 100 0 255 ECU_ADDRESS 0xFEBEBA88 MATRIX_DIM 12 1 1 /end MEASUREMENT
/begin MEASUREMENT zCscAsic_AscCommDebounceCntr_gdu8 "Asic Comm Debounce Counter" UBYTE NO_UNIT 1 100 0 255 ECU_ADDRESS 0xFEBEB9C6 /end MEASUREMENT
/begin MEASUREMENT zCscAsic_HlAliveErrCtr_gdu8 "Hl alive counter info" UBYTE NO_UNIT 1 100 0 255 ECU_ADDRESS 0xFEBEB9C7 /end MEASUREMENT
/begin MEASUREMENT zCscAsic_HlAliveMissedCallCtr_gdu8 "Hl alive missed call counter info" UBYTE NO_UNIT 1 100 0 255 ECU_ADDRESS 0xFEBEB9C8 /end MEASUREMENT
/begin MEASUREMENT zCscAsic_PsEnDebounceCntr_gdu8 "PsEn Debounce Counter" UBYTE NO_UNIT 1 100 0 255 ECU_ADDRESS 0xFEBEB9C9 /end MEASUREMENT
/begin MEASUREMENT zCscAsic_SasWupCtr_gdu8 "Sas Wakeup Counter value" UBYTE NO_UNIT 1 100 0 255 ECU_ADDRESS 0xFEBEB9CA /end MEASUREMENT
/begin MEASUREMENT zCscAsic_SuppVoltageCtr_gdu32 "Supply voltage counter" ULONG NO_UNIT 1 100 0 4294967295 ECU_ADDRESS 0xFEBEB9B8 /end MEASUREMENT
/begin MEASUREMENT zCscAsic_SuppVoltInError_gdu8 "VoltIn error counter" UBYTE NO_UNIT 1 100 0 255 ECU_ADDRESS 0xFEBEB9CB /end MEASUREMENT
/begin MEASUREMENT sCscI_ChipsetFaultInfo_gde "HwLib internal interface from CSC to the FaStInd is required, to indicate chipset and HL alive counter errors" UBYTE NO_UNIT 1 100 0 2 ECU_ADDRESS 0xFEBEBAA0 /end MEASUREMENT
/begin MEASUREMENT sCscI_FaultIndicationState_gde "Functionality state of CSC" UBYTE NO_UNIT 1 100 0 7 ECU_ADDRESS 0xFEBEBAA1 /end MEASUREMENT
/begin MEASUREMENT yCscFsa_IsRedStorErrEntry_gdu8 "" UBYTE NO_UNIT 1 100 0 1 ECU_ADDRESS 0xFEBEBAA2 /end MEASUREMENT
/begin MEASUREMENT yCscFsa_RedErrAddress_gdu32 "" ULONG NO_UNIT 1 100 0 4294967295 ECU_ADDRESS 0xFEBEBA9C /end MEASUREMENT
/begin MEASUREMENT sCscMcuI_McuDiagStatusFsa_gde "CSC Mcu diagnosis status" ULONG NO_UNIT 1 100 0 268435456 ECU_ADDRESS 0xFEBEBAA4 /end MEASUREMENT
/begin MEASUREMENT sHwlI_GuardStatusInfo_gde "Indication of access violations by the microcontroller bus masters." UBYTE NO_UNIT 1 100 0 15 ECU_ADDRESS 0xFEBEEE00 /end MEASUREMENT
/begin MEASUREMENT sAsc2PsdChk_Asc2PsdCurrState_gde "ASIC to Psd Enable State Variable" UBYTE NO_UNIT 1 100 0 7 ECU_ADDRESS 0xFEBEBAB0 /end MEASUREMENT
/begin MEASUREMENT sPsdChk_PsdBasicCurrState_gde "Psd Basic Check State Variable" UBYTE NO_UNIT 1 100 0 5 ECU_ADDRESS 0xFEBEBAD0 /end MEASUREMENT
/begin MEASUREMENT sPsdChk_StatusVddmrCheck_gde "Vddmr check status Psd Basic Check" UBYTE NO_UNIT 1 100 0 2 ECU_ADDRESS 0xFEBEBAD1 /end MEASUREMENT
/begin MEASUREMENT zPsdChk_VddmrFails_gdu8 "Vddmr check fail counter" UBYTE NO_UNIT 1 100 0 4 ECU_ADDRESS 0xFEBEBAD2 /end MEASUREMENT
/begin MEASUREMENT sShootChk_ShootProtCurrState_mde "Shoot Through Protection Check State Variable" UBYTE NO_UNIT 1 100 0 255 ECU_ADDRESS 0xFEBEA6DF /end MEASUREMENT
/begin MEASUREMENT yShootChk_Phase_mdu8 "Phase counter" UBYTE NO_UNIT 1 100 0 3 ECU_ADDRESS 0xFEBEA6E0 /end MEASUREMENT
/begin MEASUREMENT sShortChk_ShortDetCurrState_mde "Short Circuit Detetction Check State" UBYTE NO_UNIT 1 100 0 255 ECU_ADDRESS 0xFEBEA6E1 /end MEASUREMENT
/begin MEASUREMENT yShortChk_FetNumber_mdu8 "Contain Fet number for setting PWM" UBYTE NO_UNIT 1 100 0 7 ECU_ADDRESS 0xFEBEA6E2 /end MEASUREMENT
/begin MEASUREMENT ySigCoo_EnablingSignalStatus_mdu8 "Enabling status of signals PSC_EN, PS_EN and PSD_EN and FSD_EN" UBYTE NO_UNIT 1 100 0 255 ECU_ADDRESS 0xFEBEBB04 /end MEASUREMENT
/begin MEASUREMENT ySigCoo_NormedPwmHigh_mdf32 "Normalized high PWM to 12 V" FLOAT32_IEEE NO_UNIT 1 100 0 100 ECU_ADDRESS 0xFEBEBAF0 /end MEASUREMENT
/begin MEASUREMENT ySigCoo_NormedPwmLow_mdf32 "Normalized low PWM to 12 V" FLOAT32_IEEE NO_UNIT 1 100 0 100 ECU_ADDRESS 0xFEBEBAF8 /end MEASUREMENT
/begin MEASUREMENT ySigCoo_PwmFetStatus_mdu8 "FET Status of phase 1, phase 2 and phase 3" UBYTE NO_UNIT 1 100 0 255 ECU_ADDRESS 0xFEBEBB05 /end MEASUREMENT
/begin MEASUREMENT sSlowPscChk_SlowPscCurrState_gde "Slow Phase Separation Check state variable" UBYTE NO_UNIT 1 100 0 13 ECU_ADDRESS 0xFEBEBB0C /end MEASUREMENT
/begin MEASUREMENT sLatI_FaultIndicationState_gde "Functionality state of LAT" UBYTE NO_UNIT 1 100 0 7 ECU_ADDRESS 0xFEBEBB28 /end MEASUREMENT
/begin MEASUREMENT sTstCoo_CurrSigCheckStatus_gde "Current status of called Signal Check" UBYTE NO_UNIT 1 100 0 2 ECU_ADDRESS 0xFEBEBB29 /end MEASUREMENT
/begin MEASUREMENT sTstCoo_DriverErrorFlag_gde "Driver Error Flag" UBYTE NO_UNIT 1 100 0 1 ECU_ADDRESS 0xFEBEBB2A /end MEASUREMENT
/begin MEASUREMENT sTstCoo_ErrorType_gde "Current error type" UBYTE NO_UNIT 1 100 0 255 ECU_ADDRESS 0xFEBEBB2B /end MEASUREMENT
/begin MEASUREMENT sTstCoo_ErrortypeAfterFailure_gde "Error status after failure of LAT test" UBYTE NO_UNIT 1 100 0 255 ECU_ADDRESS 0xFEBEBB2C /end MEASUREMENT
/begin MEASUREMENT sTstCoo_LatCurrState_gde "LAT state" UBYTE NO_UNIT 1 100 0 11 ECU_ADDRESS 0xFEBEBB2D /end MEASUREMENT
/begin MEASUREMENT sTstCoo_LatMode_gde "LAT mode set from SVO" UBYTE NO_UNIT 1 100 0 3 ECU_ADDRESS 0xFEBEBB2E /end MEASUREMENT
/begin MEASUREMENT sTstCoo_LatReleaseStatus_gde "LAT release status" UBYTE NO_UNIT 1 100 0 1 ECU_ADDRESS 0xFEBEBB2F /end MEASUREMENT
/begin MEASUREMENT sTstCoo_OldErrorType_gde "Saved error type for error entry" UBYTE NO_UNIT 1 100 0 255 ECU_ADDRESS 0xFEBEBB30 /end MEASUREMENT
/begin MEASUREMENT yTstCoo_AscGduEnLineDisableFlags_gdu8 "Enable line Asic to Driver disable Flags" UBYTE NO_UNIT 1 100 0 255 ECU_ADDRESS 0xFEBEBB31 /end MEASUREMENT
/begin MEASUREMENT zTstCoo_CheckIndex_gdu8 "Signal Check index" UBYTE NO_UNIT 1 100 0 100 ECU_ADDRESS 0xFEBEBB32 /end MEASUREMENT
/begin MEASUREMENT suCPsdChk_uc2PsdCurrState_mde "uC to Psd Enable State Variable" UBYTE NO_UNIT 1 100 0 255 ECU_ADDRESS 0xFEBEA6E4 /end MEASUREMENT
/begin MEASUREMENT sVoltChk_PsdLogicSupplyOvCurrState_gde "Psd Logic Supply Voltage State variable" UBYTE NO_UNIT 1 100 0 5 ECU_ADDRESS 0xFEBEBB44 /end MEASUREMENT
/begin MEASUREMENT sVoltChk_VoltTestCurrState_gde "Psd Voltage Supply Check state variable" UBYTE NO_UNIT 1 100 0 5 ECU_ADDRESS 0xFEBEBB45 /end MEASUREMENT
/begin MEASUREMENT sTstNdx_SelfTestCurrState_mde "Selftest Zero Current Detection current state" UBYTE NO_UNIT 1 100 0 255 ECU_ADDRESS 0xFEBEA6E3 /end MEASUREMENT
/begin MEASUREMENT sFastPscChk_FastPscCurrState_gde "Fast Phase Separation State Variable" UBYTE NO_UNIT 1 100 0 12 ECU_ADDRESS 0xFEBEBAC0 /end MEASUREMENT
/begin MEASUREMENT zFastPscChk_FailureCounter_gdu8 "phase currents failure counter in Fast PSC check" UBYTE NO_UNIT 1 100 0 5 ECU_ADDRESS 0xFEBEBAC1 /end MEASUREMENT
/begin MEASUREMENT zFastPscChk_SampleCounter_gdu8 "Current sampling counter" UBYTE NO_UNIT 1 100 0 8 ECU_ADDRESS 0xFEBEBAC2 /end MEASUREMENT
/begin MEASUREMENT sPwmEnChk_PsdPwmEnCurrState_gde "uC to Psd Pwm Enable State Variable" UBYTE NO_UNIT 1 100 0 2 ECU_ADDRESS 0xFEBEBAD8 /end MEASUREMENT
/begin MEASUREMENT iCurrCon_IsdRefIsr_gdf32 "d reference current" FLOAT32_IEEE CURR_REAL 1 100 -150 150 ECU_ADDRESS 0xFEBEBB50 /end MEASUREMENT
/begin MEASUREMENT iCurrCon_IsqRefIsr_gdf32 "q reference current" FLOAT32_IEEE CURR_REAL 1 100 -150 150 ECU_ADDRESS 0xFEBEBB54 /end MEASUREMENT
/begin MEASUREMENT iCurrCon_OcV3FbIsdIsr_gdf32 "limited feedback current from OcV3 - direct axis" FLOAT32_IEEE CURR_REAL 1 100 -10 10 ECU_ADDRESS 0xFEBEECD8 /end MEASUREMENT
/begin MEASUREMENT iCurrCon_OcV3FbIsqIsr_gdf32 "limited feedback current from OcV3 - quadrature axis" FLOAT32_IEEE CURR_REAL 1 100 -10 10 ECU_ADDRESS 0xFEBEECDC /end MEASUREMENT
/begin MEASUREMENT iMocI_RefCurrVectorLength_gdf32 "Vector length claculated out of the Idq reference currents" FLOAT32_IEEE CURR_REAL 1 100 0 500 ECU_ADDRESS 0xFEBEECE0 /end MEASUREMENT
/begin MEASUREMENT sCurrCon_CtrlParaIndicator_gdu8 "indicator which controller parameter are used: 0- parameters for low vehicle speed,1- parameters for high or invalid vehicle speed" UBYTE NO_UNIT 1 100 0 1 ECU_ADDRESS 0xFEBEBBA0 /end MEASUREMENT
/begin MEASUREMENT sCurrCon_UnitInfoIsr_gdu8 "display of unit infos for example limitations" UBYTE NO_UNIT 1 100 0 255 ECU_ADDRESS 0xFEBEBBA1 /end MEASUREMENT
/begin MEASUREMENT uCurrConI_UsdRefIsr_gdf32 "reference voltage - direct axis" FLOAT32_IEEE VOLT_REAL 1 100 -500 500 ECU_ADDRESS 0xFEBEBB58 /end MEASUREMENT
/begin MEASUREMENT uCurrConI_UsqRefIsr_gdf32 "reference voltage - quadrature axis" FLOAT32_IEEE VOLT_REAL 1 100 -500 500 ECU_ADDRESS 0xFEBEBB60 /end MEASUREMENT
/begin MEASUREMENT yCurrCon_ControlOutputDIsr_gdf32 "d-controller output (for measurement only)" FLOAT32_IEEE NO_UNIT 1 100 -2040 2040 ECU_ADDRESS 0xFEBEBB68 /end MEASUREMENT
/begin MEASUREMENT yCurrCon_ControlOutputQIsr_gdf32 "q-controller output (for measurement only)" FLOAT32_IEEE NO_UNIT 1 100 -2040 2040 ECU_ADDRESS 0xFEBEBB6C /end MEASUREMENT
/begin MEASUREMENT yCurrCon_IntegratorDIsr_gdf32 "d-integrator (only for measurement)" FLOAT32_IEEE NO_UNIT 1 100 -2040 2040 ECU_ADDRESS 0xFEBEBB8C /end MEASUREMENT
/begin MEASUREMENT yCurrCon_IntegratorQIsr_gdf32 "q-integrator (for measurement only)" FLOAT32_IEEE NO_UNIT 1 100 -2040 2040 ECU_ADDRESS 0xFEBEBB90 /end MEASUREMENT
/begin MEASUREMENT sMcDiag_OpdState_gde "open phase detection state of UCMP" UBYTE NO_UNIT 1 100 0 4 ECU_ADDRESS 0xFEBEBC0E /end MEASUREMENT
/begin MEASUREMENT sMcDiagI_DiagState_gde "state of MOC diag" UBYTE NO_UNIT 1 100 0 255 ECU_ADDRESS 0xFEBEBC0F /end MEASUREMENT
/begin MEASUREMENT uMcDiag_DiffUcmp2_gdf32 "Ucmp difference (equations - PWM) voltage vector 2 (length or q-axis)" FLOAT32_IEEE VOLT_REAL 1 100 -360 360 ECU_ADDRESS 0xFEBEBBD8 /end MEASUREMENT
/begin MEASUREMENT uMcDiag_IntegUcmp2_gdf32 "Ucmp error integral 2 (length or q-axis)" FLOAT32_IEEE VOLT_REAL 1 100 -2880 2880 ECU_ADDRESS 0xFEBEBBDC /end MEASUREMENT
/begin MEASUREMENT wMcDiag_IntegAngleCompare_gdf32 "RotPos error integral in (degree)" FLOAT32_IEEE NO_UNIT 1 100 -2880 2880 ECU_ADDRESS 0xFEBEBBE0 /end MEASUREMENT
/begin MEASUREMENT wMcDiag_ThetaCalc_gdf32 "angle calculated by ROTPOS" FLOAT32_IEEE ANG_RAD_REAL 1 100 0 6.283185307 ECU_ADDRESS 0xFEBEBBE4 /end MEASUREMENT
/begin MEASUREMENT wMcDiag_ThetaDiff_gdf32 "angle difference ext. rotor position - calculated angle in (degree)" FLOAT32_IEEE NO_UNIT 1 100 -2880 2880 ECU_ADDRESS 0xFEBEBBE8 /end MEASUREMENT
/begin MEASUREMENT yMcDiag_DebounceValueRotPos_gdu8 "McDiag Rotpos debounce value between 0 (no issue) and 100 (error)." UBYTE NO_UNIT 1 100 0 100 ECU_ADDRESS 0xFEBEBC10 /end MEASUREMENT
/begin MEASUREMENT yMcDiag_DiffUcmp1_gdf32 "Ucmp difference (equations - PWM) voltage vector 1 (angle or d-axis)" FLOAT32_IEEE NO_UNIT 1 100 -360 360 ECU_ADDRESS 0xFEBEBBF0 /end MEASUREMENT
/begin MEASUREMENT yMcDiag_IntegUcmp1_gdf32 "Ucmp error integral 1 (angle or d-axis)" FLOAT32_IEEE NO_UNIT 1 100 -680 680 ECU_ADDRESS 0xFEBEBBF4 /end MEASUREMENT
/begin MEASUREMENT yMcDiag_RotPosDebValue20ms_gdu8 "Debounce value of Rotor position deviations over time (maximum over 20ms)" UBYTE NO_UNIT 1 100 0 100 ECU_ADDRESS 0xFEBEECE4 /end MEASUREMENT
/begin MEASUREMENT yMcDiag_Ucmp1DebValue20ms_gdu8 "Debounce value regarding mismatch between expected and recalculated voltage vector (angle or d-axis) deviations over time (maximum over 20ms)" UBYTE NO_UNIT 1 100 0 100 ECU_ADDRESS 0xFEBEECE5 /end MEASUREMENT
/begin MEASUREMENT yMcDiag_Ucmp2DebValue20ms_gdu8 "Debounce value regarding mismatch between expected and recalculated voltage vector (length or q-axis) deviations over time (maximum over 20ms)" UBYTE NO_UNIT 1 100 0 100 ECU_ADDRESS 0xFEBEECE6 /end MEASUREMENT
/begin MEASUREMENT yMcDiagI_FreezeFrameData1_gau8 "array1 for mc diag rotpos freezeframe data" UBYTE NO_UNIT 1 100 0 255 ECU_ADDRESS 0xFEBEBC00 MATRIX_DIM 4 1 1 /end MEASUREMENT
/begin MEASUREMENT yMcDiagI_FreezeFrameData2_gau8 "array2 for mc diag rotpos freezeframe data" UBYTE NO_UNIT 1 100 0 255 ECU_ADDRESS 0xFEBEBC04 MATRIX_DIM 4 1 1 /end MEASUREMENT
/begin MEASUREMENT zMcDiag_OpdCounter_gdu16 "counter for open phase detection with UCMP" UWORD NO_UNIT 1 100 0 65535 ECU_ADDRESS 0xFEBEBC0C /end MEASUREMENT
/begin MEASUREMENT mMcPlausi_ActMaxIntegLimit_gdf32 "upper limit of the error integral" FLOAT32_IEEE TORQ_REAL 1 100 0 50 ECU_ADDRESS 0xFEBEBCD0 /end MEASUREMENT
/begin MEASUREMENT mMcPlausi_Down4Integ_gdf32 "Down4Integ shows the actual value for down integrating calculation only for measurements" FLOAT32_IEEE TORQ_REAL 1 100 0 50 ECU_ADDRESS 0xFEBEECE8 /end MEASUREMENT
/begin MEASUREMENT mMcPlausi_Err4Integ_gdf32 "Err4Integ shows the actual value for up integrating calculation only for measurements" FLOAT32_IEEE TORQ_REAL 1 100 -50 50 ECU_ADDRESS 0xFEBEECEC /end MEASUREMENT
/begin MEASUREMENT mMcPlausi_LowerLimit_gdf32 "Plausi lower limit used for measurements only" FLOAT32_IEEE TORQ_REAL 1 100 -100 100 ECU_ADDRESS 0xFEBEECF0 /end MEASUREMENT
/begin MEASUREMENT mMcPlausi_RecalculatedMotorTorque_gdf32 "Theoretic motor torque as calculated by McPlausi" FLOAT32_IEEE TORQ_REAL 1 100 -15 15 ECU_ADDRESS 0xFEBEBCD4 /end MEASUREMENT
/begin MEASUREMENT mMcPlausi_RefCalibMotorTorqueLast_gaf32 "Requested motor torque (from last cycle and 2  cycles ago)" FLOAT32_IEEE TORQ_REAL 1 100 -15 15 ECU_ADDRESS 0xFEBEBCC8 MATRIX_DIM 2 1 1 /end MEASUREMENT
/begin MEASUREMENT mMcPlausi_UpperLimit_gdf32 "Plausi upper limit used for measurements only" FLOAT32_IEEE TORQ_REAL 1 100 -100 100 ECU_ADDRESS 0xFEBEECF4 /end MEASUREMENT
/begin MEASUREMENT sMcPlausi_LastMocModeBeforeOff_gde "Last MocMode before off, needed to detect mode changes for resetting the error integral" UBYTE NO_UNIT 1 100 0 64 ECU_ADDRESS 0xFEBEBCF8 /end MEASUREMENT
/begin MEASUREMENT sMcPlausi_MocLastState_gde "Current MOC state for next cycle" UBYTE NO_UNIT 1 100 0 32 ECU_ADDRESS 0xFEBEBCF9 /end MEASUREMENT
/begin MEASUREMENT sMcPlausi_RedErrStorState_gde "control word for redundant error" UBYTE NO_UNIT 1 100 0 255 ECU_ADDRESS 0xFEBEBCFA /end MEASUREMENT
/begin MEASUREMENT sMcPlausiI_PlausiState_gde "" UBYTE NO_UNIT 1 100 0 255 ECU_ADDRESS 0xFEBEBCFB /end MEASUREMENT
/begin MEASUREMENT tMcPlausi_TemporizeErrorTimeCounter_gdu16 "Temporization counter Time since error detection Error trigger needs to wait until TemporizeErrorTime is reached in ms" UWORD T_MS 1 100 0 500 ECU_ADDRESS 0xFEBEECF8 /end MEASUREMENT
/begin MEASUREMENT yMcPlausi_DataIndex_gdu8 "Index for data set of moc plausi: 0-FOC, 1-FOS, 2-OC" UBYTE NO_UNIT 1 100 0 1 ECU_ADDRESS 0xFEBEBCFC /end MEASUREMENT
/begin MEASUREMENT yMcPlausi_DebounceValue_gdu8 "McPlausi debounce value between 0 (no issue) and 100 (error)" UBYTE NO_UNIT 1 100 0 100 ECU_ADDRESS 0xFEBEBCFD /end MEASUREMENT
/begin MEASUREMENT yMcPlausi_DebounceValue20ms_gdu8 "Maximum debounce value for McPlausi" UBYTE NO_UNIT 1 100 0 100 ECU_ADDRESS 0xFEBEECFA /end MEASUREMENT
/begin MEASUREMENT yMcPlausi_IntegralValue_gdf32 "integral of torque deviations over time" FLOAT32_IEEE NO_UNIT 1 100 -100 100 ECU_ADDRESS 0xFEBEBCE8 /end MEASUREMENT
/begin MEASUREMENT yMcPlausiI_FreezeFrameData_gau8 "array for McPlausi FreezeFrame Data" UBYTE NO_UNIT 1 100 0 255 ECU_ADDRESS 0xFEBEBCF0 MATRIX_DIM 6 1 1 /end MEASUREMENT
/begin MEASUREMENT nMcStateI_LatestValidAbsSpeed_gdf32 "Oldest value of valid absolute speed of motor This variable is needed for FadeOut trigger check" FLOAT32_IEEE RPM_REAL 1 100 0 10000 ECU_ADDRESS 0xFEBEBD40 /end MEASUREMENT
/begin MEASUREMENT sHwlI_ActuatorState_gde "Indication of the output stage and the phase current measurement state" UWORD NO_UNIT 1 100 0 1023 ECU_ADDRESS 0xFEBEE13C /end MEASUREMENT
/begin MEASUREMENT sMcState_MocIsrSwitchOffIsr_gde "MocIsrSwitchOff in ISR contextf 0:TookPlace,1:Nothing" UBYTE NO_UNIT 1 100 0 1 ECU_ADDRESS 0xFEBEBD80 /end MEASUREMENT
/begin MEASUREMENT sMcState_ReqEmergencyOpNotAvail_gdu8 "Requested Emergency Operation Availability. 1:NotAvailable" UBYTE NO_UNIT 1 100 0 1 ECU_ADDRESS 0xFEBEBD81 /end MEASUREMENT
/begin MEASUREMENT sMcStateI_FaultInformation_gde "MOC fault info : 0-no fault, bitwise set from LSB+1: OcU, OcV, OcW, ScLsU, ScHsU, ScLsV, ScHsV, ScLsW, ScHsW" UWORD NO_UNIT 1 100 0 65535 ECU_ADDRESS 0xFEBEBD7C /end MEASUREMENT
/begin MEASUREMENT sMcStateI_MocMode_gde "MOC internal operation mode in task context: 0-Off, bitwise set from LSB : FOC, FOS, SC, OC" UBYTE NO_UNIT 1 100 0 255 ECU_ADDRESS 0xFEBEBD82 /end MEASUREMENT
/begin MEASUREMENT sMcStateI_MocModeIsr_gde "MOC internal operation mode in ISR context: 0-Off, bitwise set from LSB : FOC, FOS, SC, OC" UBYTE NO_UNIT 1 100 0 255 ECU_ADDRESS 0xFEBEBD83 /end MEASUREMENT
/begin MEASUREMENT sMocI_FaultIndicationState_gde "fault indication state" UBYTE NO_UNIT 1 100 0 7 ECU_ADDRESS 0xFEBEBD84 /end MEASUREMENT
/begin MEASUREMENT sMocI_IsdqState_gde "state of calculated currents - current and reference values of both axis" UWORD NO_UNIT 1 100 0 65535 ECU_ADDRESS 0xFEBEBD7E /end MEASUREMENT
/begin MEASUREMENT sMocI_MocMode_gde "MOC operation mode: 0-Off, bitwise set from LSB : FOC, FOS, SC, OC, Sensorless, FOS_Ramp, FadeOut" UBYTE NO_UNIT 1 100 0 255 ECU_ADDRESS 0xFEBEBD85 /end MEASUREMENT
/begin MEASUREMENT sMocI_MocModeIsr_gde "MOC operation mode in ISR context: 0-Off, bitwise set from LSB : FOC, FOS, SC, OC, Sensorless, FOS_Ramp, FadeOut" UBYTE NO_UNIT 1 100 0 255 ECU_ADDRESS 0xFEBEBD86 /end MEASUREMENT
/begin MEASUREMENT zMcStateI_MocActiveCounter_gdu32 "number of interrupts since the MocMode has not been off(task context)" ULONG NO_UNIT 1 100 0 65535 ECU_ADDRESS 0xFEBEBD74 /end MEASUREMENT
/begin MEASUREMENT yMoCoCo_AdFinishedCounter_gdu8 "AdFinished Counter" UBYTE NO_UNIT 1 100 0 7 ECU_ADDRESS 0xFEBEBD98 /end MEASUREMENT
/begin MEASUREMENT iPstCtrl_AvgBattCurr_gaf32 "Batterycurrent from PreWait, TestCurr1, TestCurr2 and PostWait (average filtered over last 10ms)" FLOAT32_IEEE CURR_REAL 1 100 0 150 ECU_ADDRESS 0xFEBEBDCC MATRIX_DIM 4 1 1 /end MEASUREMENT
/begin MEASUREMENT iPstCtrl_TestIdcRef_gdf32 "Calculated reference dc-current fort Pst (measurement)" FLOAT32_IEEE CURR_REAL 1 100 0 150 ECU_ADDRESS 0xFEBEBDA4 /end MEASUREMENT
/begin MEASUREMENT iPstCtrlI_IdTestCurrent_gdf32 "Pst-current reference for d-axis" FLOAT32_IEEE CURR_REAL 1 100 -500 500 ECU_ADDRESS 0xFEBEBDA8 /end MEASUREMENT
/begin MEASUREMENT nPstCtrl_AbsMaxMeasuredRpm_gdf32 "Max measured absolute rotor speed in rpm" FLOAT32_IEEE NO_UNIT 1 100 0 15000 ECU_ADDRESS 0xFEBEBDB0 /end MEASUREMENT
/begin MEASUREMENT rPstCtrl_Impedance_gaf32 "Calculated impedance fromTestCurr1 and 2" FLOAT32_IEEE OHM_REAL 1 100 0 2 ECU_ADDRESS 0xFEBEBD9C MATRIX_DIM 2 1 1 /end MEASUREMENT
/begin MEASUREMENT sPstCtrl_ErrorState_gdu16 "Provides Error State" UWORD NO_UNIT 1 100 0 256 ECU_ADDRESS 0xFEBEBDC4 /end MEASUREMENT
/begin MEASUREMENT sPstCtrl_State_gde "Provides information about PST State" UBYTE NO_UNIT 1 100 0 255 ECU_ADDRESS 0xFEBEBDC6 /end MEASUREMENT
/begin MEASUREMENT sPstCtrl_Trigger_gde "Trigger state to control Pst" UBYTE NO_UNIT 1 100 0 3 ECU_ADDRESS 0xFEBEBDC7 /end MEASUREMENT
/begin MEASUREMENT tPstCtrl_PreCondWaitTime_gdf32 "Waiting time counter for pre-conditions" FLOAT32_IEEE T_S 1 100 0 60 ECU_ADDRESS 0xFEBEBDB4 /end MEASUREMENT
/begin MEASUREMENT tPstCtrl_TestTime_gdf32 "Counter for TestTime" FLOAT32_IEEE T_S 1 100 0 60 ECU_ADDRESS 0xFEBEBDB8 /end MEASUREMENT
/begin MEASUREMENT uPstCtrl_AvgVoltage_gaf32 "Batteryvoltage from PreWait, TestCurr1, TestCurr2 and PostWait (average filtered over last 10ms)" FLOAT32_IEEE VOLT_REAL 1 100 0 24 ECU_ADDRESS 0xFEBEBDDC MATRIX_DIM 4 1 1 /end MEASUREMENT
/begin MEASUREMENT uPstCtrl_MinMeasuredVoltage_gdf32 "Min measured Voltage for error logging" FLOAT32_IEEE VOLT_REAL 1 100 0 24 ECU_ADDRESS 0xFEBEBDBC /end MEASUREMENT
/begin MEASUREMENT uPstCtrl_VoltDrop_gdf32 "VoltageDrop between PreWait and PostWait" FLOAT32_IEEE VOLT_REAL 1 100 -10 10 ECU_ADDRESS 0xFEBEBDC0 /end MEASUREMENT
/begin MEASUREMENT yPstCtrl_FreezeFrameData_gau8 "Contains FreezeFrame Data" UBYTE NO_UNIT 1 100 0 255 ECU_ADDRESS 0xFEBEBDEC MATRIX_DIM 20 1 1 /end MEASUREMENT
/begin MEASUREMENT zPstCtrl_PstAvgActCnt_gdu8 "Counter average calculation" UBYTE NO_UNIT 1 100 0 10 ECU_ADDRESS 0xFEBEBDC8 /end MEASUREMENT
/begin MEASUREMENT zPstCtrl_TestRepCnt_gdu8 "Counter for test repetitions" UBYTE NO_UNIT 1 100 0 10 ECU_ADDRESS 0xFEBEBDC9 /end MEASUREMENT
/begin MEASUREMENT iMocI_IsdRef_gdf32 "reference current - direct axis" FLOAT32_IEEE CURR_REAL 1 100 -500 500 ECU_ADDRESS 0xFEBEBE84 /end MEASUREMENT
/begin MEASUREMENT iMocI_IsqRef_gdf32 "reference current - quadrature axis" FLOAT32_IEEE CURR_REAL 1 100 -500 500 ECU_ADDRESS 0xFEBEBE8C /end MEASUREMENT
/begin MEASUREMENT nRefCurrI_RotorSpeedIntern_gdf32 "MOC intern calculated rotorspeed" FLOAT32_IEEE NO_UNIT 1 100 -1047 10000 ECU_ADDRESS 0xFEBEBE94 /end MEASUREMENT
/begin MEASUREMENT sRefCurr_UnitInfo_gdu8 "limitation info" UBYTE NO_UNIT 1 100 0 255 ECU_ADDRESS 0xFEBEBEBE /end MEASUREMENT
/begin MEASUREMENT yRefCurr_InvPsip4MRef_gdf32 "traced, inverted flux linkage (MRef component)" FLOAT32_IEEE NO_UNIT 1 100 -10000 10000 ECU_ADDRESS 0xFEBEBEA4 /end MEASUREMENT
/begin MEASUREMENT yRefCurr_LsdLsqDiff_gdf32 "difference Lsd-Lsq" FLOAT32_IEEE INDUCTANCE_REAL 1 100 -1000 1000 ECU_ADDRESS 0xFEBEBEB4 /end MEASUREMENT
/begin MEASUREMENT cReMoTo_GroundPlateTemp_gdf32 "Converted GroundplateTemp to tF32" FLOAT32_IEEE NO_UNIT 1 100 -100 500 ECU_ADDRESS 0xFEBEBFDC /end MEASUREMENT
/begin MEASUREMENT iReMoTo_Id_gdf32 "Calculated d-Current" FLOAT32_IEEE CURR_REAL 1 100 -500 500 ECU_ADDRESS 0xFEBEBFE0 /end MEASUREMENT
/begin MEASUREMENT iReMoTo_Iq_gdf32 "Calculated q-Current" FLOAT32_IEEE CURR_REAL 1 100 -500 500 ECU_ADDRESS 0xFEBEBFE4 /end MEASUREMENT
/begin MEASUREMENT mHwlI_ProvidedMotorTorque_gdf32 "Torque provided by the motor of the SCU" FLOAT32_IEEE TORQ_REAL 1 100 -12 12 ECU_ADDRESS 0xFEBEE140 /end MEASUREMENT
/begin MEASUREMENT mMocI_LocalProvidedMotorTorque_gdf32 "Local Provided Motor Torque" FLOAT32_IEEE TORQ_REAL 1 100 -12 12 ECU_ADDRESS 0xFEBEBFEC /end MEASUREMENT
/begin MEASUREMENT mReMoTo_LocalReCalcMotorTorquePrevCycl_gdf32 "Local Torque from previous cycle" FLOAT32_IEEE TORQ_REAL 1 100 -12 12 ECU_ADDRESS 0xFEBEBFF4 /end MEASUREMENT
/begin MEASUREMENT mReMoTo_ProvidedMotorTorqueOtherUC_gdf32 "Provided torque recived via IPC" FLOAT32_IEEE TORQ_REAL 1 100 -12 12 ECU_ADDRESS 0xFEBEBFF8 /end MEASUREMENT
/begin MEASUREMENT sReMoTo_DataReceivedTrigger_gdu8 "Trigger if SW received data via IPC (0 = No, 1 = Yes)" UBYTE NO_UNIT 1 100 0 1 ECU_ADDRESS 0xFEBEBFFC /end MEASUREMENT
/begin MEASUREMENT cSigProc_GroundPlateTemp_gdf32 "ground plate temperature in (degree Celsius)" FLOAT32_IEEE NO_UNIT 1 100 -70 285 ECU_ADDRESS 0xFEBEECFC /end MEASUREMENT
/begin MEASUREMENT iMocI_Isd_gdf32 "current - direct axis" FLOAT32_IEEE CURR_REAL 1 100 -500 500 ECU_ADDRESS 0xFEBEC008 /end MEASUREMENT
/begin MEASUREMENT iMocI_Isq_gdf32 "current - quadrature axis" FLOAT32_IEEE CURR_REAL 1 100 -500 500 ECU_ADDRESS 0xFEBEC010 /end MEASUREMENT
/begin MEASUREMENT iSigProc_IsaIsr_gdf32 "measured current in alpha-axis" FLOAT32_IEEE CURR_REAL 1 100 -500 500 ECU_ADDRESS 0xFEBEC018 /end MEASUREMENT
/begin MEASUREMENT iSigProc_IsbIsr_gdf32 "measured current in beta-axis" FLOAT32_IEEE CURR_REAL 1 100 -500 500 ECU_ADDRESS 0xFEBEC020 /end MEASUREMENT
/begin MEASUREMENT iSigProcI_IsdIsr_gdf32 "current - direct axis" FLOAT32_IEEE CURR_REAL 1 100 -500 500 ECU_ADDRESS 0xFEBEC028 /end MEASUREMENT
/begin MEASUREMENT iSigProcI_IsqIsr_gdf32 "current - quadrature axis" FLOAT32_IEEE CURR_REAL 1 100 -500 500 ECU_ADDRESS 0xFEBEC030 /end MEASUREMENT
/begin MEASUREMENT mSigProcI_RequestedMotorTorque_gdf32 "requested motor torque for reference current " FLOAT32_IEEE TORQ_REAL 1 100 -25 25 ECU_ADDRESS 0xFEBEC038 /end MEASUREMENT
/begin MEASUREMENT nSigProc_RotSpdFiltSc_1_Abs_gdf32 "rotor speed for short circuit mode in (RPM) valid in TASK context, absolute of previous value" FLOAT32_IEEE NO_UNIT 1 100 0 15000 ECU_ADDRESS 0xFEBEED00 /end MEASUREMENT
/begin MEASUREMENT nSigProc_RotSpdFiltSc_1_gdf32 "rotor speed for short circuit mode in (RPM) valid in TASK context, previous value" FLOAT32_IEEE NO_UNIT 1 100 -15000 15000 ECU_ADDRESS 0xFEBEED04 /end MEASUREMENT
/begin MEASUREMENT nSigProcI_OmegaSIsr_gdf32 "electrical angular velocity" FLOAT32_IEEE ANG_VEL_REAL 1 100 -5500 5500 ECU_ADDRESS 0xFEBEC03C /end MEASUREMENT
/begin MEASUREMENT nSigProcI_RotorSpeedFiltAbs_gdf32 "absolute value of external filtered rotor speed in RPM" FLOAT32_IEEE NO_UNIT 1 100 -10000 10000 ECU_ADDRESS 0xFEBEC040 /end MEASUREMENT
/begin MEASUREMENT nSigProcI_RotorSpeedInternIsr_gdf32 "internal calculated rotor speed in RPM" FLOAT32_IEEE NO_UNIT 1 100 -15000 15000 ECU_ADDRESS 0xFEBEC044 /end MEASUREMENT
/begin MEASUREMENT nSigProcI_RotSpeedElHybIsr_gdf32 "electrical angular velocity" FLOAT32_IEEE ANG_VEL_REAL 1 100 -5500 5500 ECU_ADDRESS 0xFEBEC048 /end MEASUREMENT
/begin MEASUREMENT sSigProc_RpmRangeSc_gde "RPM range indicator valid in TASK context: 0-AssistASC, 1-AssistOpen, 2-Open, 3-ASC" UBYTE NO_UNIT 1 100 0 255 ECU_ADDRESS 0xFEBEED0C /end MEASUREMENT
/begin MEASUREMENT sSigProc_UnitInfo_gdu8 "display of unit informations - TASK function" UBYTE NO_UNIT 1 100 0 255 ECU_ADDRESS 0xFEBEED0D /end MEASUREMENT
/begin MEASUREMENT sSigProc_UnitInfoIsr_gdu8 "display of unit informations - ISR function" UBYTE NO_UNIT 1 100 0 255 ECU_ADDRESS 0xFEBEED0E /end MEASUREMENT
/begin MEASUREMENT uSigProcI_OutStageVoltIntFilt_gdf32 "MOC internal filtered outstage voltage" FLOAT32_IEEE VOLT_REAL 1 100 0 48 ECU_ADDRESS 0xFEBEC050 /end MEASUREMENT
/begin MEASUREMENT wSigProcI_RotorPosElCompIwIsr_gdf32 "electrical rotor position with CompIW" FLOAT32_IEEE ANG_RAD_REAL 1 100 0 6.283185307 ECU_ADDRESS 0xFEBEC054 /end MEASUREMENT
/begin MEASUREMENT xSigProc_CalibFactor_gdf32 "calibration factor for reference torque" FLOAT32_IEEE NO_UNIT 1 100 0 2 ECU_ADDRESS 0xFEBEED08 /end MEASUREMENT
/begin MEASUREMENT ySigProcI_FreezeFrameData_gau8 "array for sigproc freezeFrame data" UBYTE NO_UNIT 1 100 0 255 ECU_ADDRESS 0xFEBEC06C MATRIX_DIM 6 1 1 /end MEASUREMENT
/begin MEASUREMENT yTaskCom_Isr2DiagLastWritten_gdu8 "index of last written buffer" UBYTE NO_UNIT 1 100 0 2 ECU_ADDRESS 0xFEBEC14C /end MEASUREMENT
/begin MEASUREMENT yTaskCom_Isr2DiagReadIndex_gdu8 "read index" UBYTE NO_UNIT 1 100 0 2 ECU_ADDRESS 0xFEBEC14D /end MEASUREMENT
/begin MEASUREMENT yTaskCom_Isr2DiagWriteIndex_gdu8 "Write index of data buffer" UBYTE NO_UNIT 1 100 0 2 ECU_ADDRESS 0xFEBEC14E /end MEASUREMENT
/begin MEASUREMENT yTaskCom_Isr2TaskLastWritten_gdu8 "index of last written buffer" UBYTE NO_UNIT 1 100 0 2 ECU_ADDRESS 0xFEBEC14F /end MEASUREMENT
/begin MEASUREMENT yTaskCom_Isr2TaskReadIndex_gdu8 "read index" UBYTE NO_UNIT 1 100 0 2 ECU_ADDRESS 0xFEBEC150 /end MEASUREMENT
/begin MEASUREMENT yTaskCom_Isr2TaskWriteIndex_gdu8 "Write index of data buffer" UBYTE NO_UNIT 1 100 0 2 ECU_ADDRESS 0xFEBEC151 /end MEASUREMENT
/begin MEASUREMENT yTaskCom_Task2IsrLastWritten_gdu8 "index of last written buffer" UBYTE NO_UNIT 1 100 0 2 ECU_ADDRESS 0xFEBEC152 /end MEASUREMENT
/begin MEASUREMENT yTaskCom_Task2IsrReadIndex_gdu8 "read index" UBYTE NO_UNIT 1 100 0 2 ECU_ADDRESS 0xFEBEC153 /end MEASUREMENT
/begin MEASUREMENT yTaskCom_Task2IsrWriteIndex_gdu8 "Write index of data buffer" UBYTE NO_UNIT 1 100 0 2 ECU_ADDRESS 0xFEBEC154 /end MEASUREMENT
/begin MEASUREMENT sVoltVec_UnitInfoIsr_gdu8 "display of unit inforamtions" UBYTE NO_UNIT 1 100 0 255 ECU_ADDRESS 0xFEBEC43C /end MEASUREMENT
/begin MEASUREMENT sVoltVecI_UsxRefLimitedFlagIsr_gdu8 "limitation flag for limited reference voltages" UBYTE NO_UNIT 1 100 0 1 ECU_ADDRESS 0xFEBEC43D /end MEASUREMENT
/begin MEASUREMENT uVoltVec_OutstageVoltFiltIsr_gdf32 "external filtered output stage voltage valid in ISR context" FLOAT32_IEEE VOLT_REAL 1 100 0 48 ECU_ADDRESS 0xFEBEC414 /end MEASUREMENT
/begin MEASUREMENT uVoltVecI_UsdRefLimitedIsr_gdf32 "limited reference voltage - direct axis" FLOAT32_IEEE VOLT_REAL 1 100 -500 500 ECU_ADDRESS 0xFEBEC418 /end MEASUREMENT
/begin MEASUREMENT uVoltVecI_UsqRefLimitedIsr_gdf32 "limited reference voltage - quadrature axis" FLOAT32_IEEE VOLT_REAL 1 100 -500 500 ECU_ADDRESS 0xFEBEC420 /end MEASUREMENT
/begin MEASUREMENT wVoltVec_RotPosAdjIsr_gaf32 "electrical rotor position with CompIW and AdjustTime" FLOAT32_IEEE ANG_RAD_REAL 1 100 0 360 ECU_ADDRESS 0xFEBEED10 MATRIX_DIM 8 1 1 /end MEASUREMENT
/begin MEASUREMENT wVoltVec_ThetaUsAdjIsr_gaf32 "ThetaUs with CompIW and AdjustTime" FLOAT32_IEEE ANG_RAD_REAL 1 100 0 360 ECU_ADDRESS 0xFEBEED30 MATRIX_DIM 8 1 1 /end MEASUREMENT
/begin MEASUREMENT wVoltVecI_AngleIsr_gaf32 "reference voltage in polar coordinates - set of angles (depending on number of provided pwm sets)" FLOAT32_IEEE ANG_RAD_REAL 1 100 0 6.283185307 ECU_ADDRESS 0xFEBEC440 MATRIX_DIM 8 1 1 /end MEASUREMENT
/begin MEASUREMENT xVoltVecI_FactorIsr_gdf32 "reference voltage in polar coordinates - length adjusted to battery voltage" FLOAT32_IEEE NO_UNIT 1 100 0 2 ECU_ADDRESS 0xFEBEC42C /end MEASUREMENT
/begin MEASUREMENT sPwmGen_FaultInformationIsr_gde "MOC fault info valid in ISR context: 0-no fault, bitwise set from LSB+1: OcU, OcV, OcW, ScLsU, ScHsU, ScLsV, ScHsV, ScLsW, ScHsW" UWORD NO_UNIT 1 100 0 65535 ECU_ADDRESS 0xFEBEBE08 /end MEASUREMENT
/begin MEASUREMENT sPwmGen_MocModeIsr_gde "operation mode of MOC valid in ISR context" UBYTE NO_UNIT 1 100 0 255 ECU_ADDRESS 0xFEBEBE0A /end MEASUREMENT
/begin MEASUREMENT sPwmGen_PwmSetOnce_gdu8 "Flag indicates PWM setting once at first calll" UBYTE NO_UNIT 1 100 0 1 ECU_ADDRESS 0xFEBEBE0B /end MEASUREMENT
/begin MEASUREMENT sPwmGen_ReqFetOpModeIsr_gde "requested FET operation mode" UBYTE NO_UNIT 1 100 0 255 ECU_ADDRESS 0xFEBEBE0C /end MEASUREMENT
/begin MEASUREMENT sPwmGen_UnitInfoIsr_gdu8 "display of unit informations" UBYTE NO_UNIT 1 100 0 255 ECU_ADDRESS 0xFEBEBE0D /end MEASUREMENT
/begin MEASUREMENT sPwmGen_WindingSignIsr_gdu8 "winding sign valid in ISR context" UBYTE NO_UNIT 1 100 0 255 ECU_ADDRESS 0xFEBEBE0E /end MEASUREMENT
/begin MEASUREMENT iMcLimp_IsqRefAbs4Oc_gdf32 "Absolute reference current Isq bevor impulse computation by DQ modulation during open circuit limphome" FLOAT32_IEEE CURR_REAL 1 100 0 500 ECU_ADDRESS 0xFEBEBCBC /end MEASUREMENT
/begin MEASUREMENT sMcLimpI_FadeOutStatus_gde "Status variable for FadeOut" UBYTE NO_UNIT 1 100 0 6 ECU_ADDRESS 0xFEBEBCC4 /end MEASUREMENT
/begin MEASUREMENT iHwlI_BatteryCurrent_gds16 "Battery current without CPU current" SWORD CURR_INT 1 100 -150 150 ECU_ADDRESS 0xFEBEE144 /end MEASUREMENT
/begin MEASUREMENT iPhcI_LocalBatteryCurrent_gds16 "Battery current of the local subsystem. Valid in the task context." SWORD CURR_INT 1 100 -150 150 ECU_ADDRESS 0xFEBEC4EC /end MEASUREMENT
/begin MEASUREMENT iPhcI_LocalBatteryCurrentIsr_gdf32 "Battery current of the local subsystem. Valid in the ISR context." FLOAT32_IEEE CURR_REAL 1 100 -150 150 ECU_ADDRESS 0xFEBEC4E4 /end MEASUREMENT
/begin MEASUREMENT cPhcCalc_LastOffsetUpdateTemperature_gdu8 "Updates the board offset temperature" UBYTE TEMP_INT 1 100 -70 185 ECU_ADDRESS 0xFEBEC5B8 /end MEASUREMENT
/begin MEASUREMENT iPhcAsicCalcI_AsicCurrent1_gdf32 "Asic-Shunt phase 1 current (task context)" FLOAT32_IEEE CURR_REAL 1 100 -3.40282346639E+38 4294967295 ECU_ADDRESS 0xFEBEC4F4 /end MEASUREMENT
/begin MEASUREMENT iPhcAsicCalcI_AsicCurrent3_gdf32 "Asic-Shunt phase 3 current (task context)" FLOAT32_IEEE CURR_REAL 1 100 -3.40282346639E+38 4294967295 ECU_ADDRESS 0xFEBEC4FC /end MEASUREMENT
/begin MEASUREMENT iPhcCalcI_PlausiCurrent1stPh1_gas16 "Array that keeps the concurrently sampled currents for GDU,Asic-Shunt and Rdson (1st=GDU,2nd=Asic or Rdson)" SWORD NO_UNIT 1 100 -1000 1000 ECU_ADDRESS 0xFEBEC57C MATRIX_DIM 3 1 1 /end MEASUREMENT
/begin MEASUREMENT iPhcCalcI_PlausiCurrent1stPh1IRQ_gas16 "Array that keeps the concurrently sampled currents for GDU, Asic-Shunt and Rdson (1st=GDU, 2nd=Asic or Rdson)" SWORD NO_UNIT 1 100 -1000 1000 ECU_ADDRESS 0xFEBEC584 MATRIX_DIM 3 1 1 /end MEASUREMENT
/begin MEASUREMENT iPhcCalcI_PlausiCurrent1stPh3_gas16 "Array that keeps the concurrently sampled currents for GDU,Asic-Shunt and Rdson (1st=GDU,2nd=Asic or Rdson)" SWORD NO_UNIT 1 100 -1000 1000 ECU_ADDRESS 0xFEBEC58C MATRIX_DIM 3 1 1 /end MEASUREMENT
/begin MEASUREMENT iPhcCalcI_PlausiCurrent1stPh3IRQ_gas16 "Array that keeps the concurrently sampled currents for GDU,Asic-Shunt and Rdson (1st=GDU,2nd=Asic or Rdson)" SWORD NO_UNIT 1 100 -1000 1000 ECU_ADDRESS 0xFEBEC594 MATRIX_DIM 3 1 1 /end MEASUREMENT
/begin MEASUREMENT iPhcCalcI_PlausiCurrent2nd_gas16 "Array that keeps the concurrently sampled currents for GDU,Asic-Shunt and Rdson (1st=GDU,2nd=Asic or Rdson)" SWORD NO_UNIT 1 100 -1000 1000 ECU_ADDRESS 0xFEBEC59C MATRIX_DIM 3 1 1 /end MEASUREMENT
/begin MEASUREMENT iPhcCalcI_PlausiCurrent2ndIRQ_gas16 "Array that keeps the concurrently sampled currents for GDU,Asic-Shunt and Rdson (1st=GDU,2nd=Asic or Rdson)" SWORD NO_UNIT 1 100 -1000 1000 ECU_ADDRESS 0xFEBEC5A4 MATRIX_DIM 3 1 1 /end MEASUREMENT
/begin MEASUREMENT iPhcGduCalcI_ShuntCurrent_gas16 "GDU phase current as integer (task context)" SWORD CURR_INT 1 100 -1000 1000 ECU_ADDRESS 0xFEBEC5AC MATRIX_DIM 3 1 1 /end MEASUREMENT
/begin MEASUREMENT iPhcI_PhaseCurrent_gaf32 "Phase currents of all three phases (valid in task context)" FLOAT32_IEEE NO_UNIT 1 100 -1000 1000 ECU_ADDRESS 0xFEBEC62C MATRIX_DIM 3 1 1 /end MEASUREMENT
/begin MEASUREMENT sHwlI_CurrRecalibState_gde "Current offset recalibration state" SBYTE NO_UNIT 1 100 0 2 ECU_ADDRESS 0xFEBEEE01 /end MEASUREMENT
/begin MEASUREMENT sPhcCalc_AllowSuspend_gde "Phc Gdu Diag Allow Suspend" UBYTE NO_UNIT 1 100 0 255 ECU_ADDRESS 0xFEBEC5B9 /end MEASUREMENT
/begin MEASUREMENT sPhcCalc_MainCalcState_gde "Phc Main Calculation state" UBYTE NO_UNIT 1 100 0 255 ECU_ADDRESS 0xFEBEC5BA /end MEASUREMENT
/begin MEASUREMENT sPhcCalc_MeasOffsState_gde "Offset measurement state machine state" UBYTE NO_UNIT 1 100 0 11 ECU_ADDRESS 0xFEBEC5BB /end MEASUREMENT
/begin MEASUREMENT sPhcCalc_MuxTestRequest_gde "Request mode of Asic test path monitor function that runs in interrupt" UBYTE NO_UNIT 1 100 0 255 ECU_ADDRESS 0xFEBEC5BC /end MEASUREMENT
/begin MEASUREMENT sPhcCalc_MuxTestResponse_gde "State of the Asic test/reference channel measurement - task context" UBYTE NO_UNIT 1 100 0 3 ECU_ADDRESS 0xFEBEC5BD /end MEASUREMENT
/begin MEASUREMENT sPhcCalc_MuxTestResponseIsr_gde "State of the Asic test/reference channel measurement which runs in interrupt context" UBYTE NO_UNIT 1 100 0 3 ECU_ADDRESS 0xFEBEC5BE /end MEASUREMENT
/begin MEASUREMENT sPhcCalc_OffsetMeasurementRequired_mde "A new offset measurement is required" UBYTE NO_UNIT 1 100 0 255 ECU_ADDRESS 0xFEBEC5BF /end MEASUREMENT
/begin MEASUREMENT sPhcCalc_OffsetMeasurementSuspended_mde "Offset measurement is suspended" UBYTE NO_UNIT 1 100 0 255 ECU_ADDRESS 0xFEBEC5C0 /end MEASUREMENT
/begin MEASUREMENT sPhcCalc_OffsetRequest_gde "Variable that controls the GDU offset measurement which runs in interrupt context" UBYTE NO_UNIT 1 100 0 255 ECU_ADDRESS 0xFEBEC5C1 /end MEASUREMENT
/begin MEASUREMENT sPhcCalc_OffsetResponse_gde "State of the GDU offset measurement which runs in interrupt context" UBYTE NO_UNIT 1 100 0 3 ECU_ADDRESS 0xFEBEC5C2 /end MEASUREMENT
/begin MEASUREMENT sPhcCalc_OffsetResponseIsr_gde "State of the GDU offset measurement which runs in interrupt context" UBYTE NO_UNIT 1 100 0 3 ECU_ADDRESS 0xFEBEC5C3 /end MEASUREMENT
/begin MEASUREMENT sPhcCalcI_AmpModeReduced_gde "Stores True if the Current amplification mode reduced" UBYTE NO_UNIT 1 100 0 255 ECU_ADDRESS 0xFEBEC5C4 /end MEASUREMENT
/begin MEASUREMENT sPhcCalcI_CurrRecalibState_gde "Flag that indicates if offset must or could be updated" UBYTE NO_UNIT 1 100 0 255 ECU_ADDRESS 0xFEBEC5C5 /end MEASUREMENT
/begin MEASUREMENT sPhcCalcI_GduOffsetUpdateRunning_gde "Flag that indicates that offset update is running" UBYTE NO_UNIT 1 100 0 1 ECU_ADDRESS 0xFEBEC5C6 /end MEASUREMENT
/begin MEASUREMENT sPhcCalcI_StartupState_gde "State of PHC startup that is triggered by start-up coordinator" UBYTE NO_UNIT 1 100 0 3 ECU_ADDRESS 0xFEBEC5C7 /end MEASUREMENT
/begin MEASUREMENT yPhcAsicCalcI_AsicAdcValue1_gdu16 "Asic-Shunt phase 1 ADC value that is used for current calculation (task context)" UWORD NO_UNIT 1 100 0 4095 ECU_ADDRESS 0xFEBEC5B4 /end MEASUREMENT
/begin MEASUREMENT yPhcAsicCalcI_AsicAdcValue3_gdu16 "Asic-Shunt phase 3 ADC value that is used for current calculation (task context)" UWORD NO_UNIT 1 100 0 4095 ECU_ADDRESS 0xFEBEC5B6 /end MEASUREMENT
/begin MEASUREMENT yPhcCalcI_DefaultMuxMode_gde "Default multiplexor scheme (mode)  for Rdson and Asic-Shunt measurement" UBYTE NO_UNIT 1 100 0 19 ECU_ADDRESS 0xFEBEC5C8 /end MEASUREMENT
/begin MEASUREMENT yPhcMuxDiagI_GainRegisterCoarse_gdu8 "Gain register setting for ASIC multiplexor test channel check" UBYTE NO_UNIT 1 100 0 7 ECU_ADDRESS 0xFEBEC5C9 /end MEASUREMENT
/begin MEASUREMENT zOffsMeasSetupTime_mdu8 "Offset Mesurement setup time" UBYTE NO_UNIT 1 100 0 255 ECU_ADDRESS 0xFEBEC5CA /end MEASUREMENT
/begin MEASUREMENT sHwlI_BatteryCurrentState_gde "Validity state of the battery current" UWORD NO_UNIT 1 100 0 32770 ECU_ADDRESS 0xFEBEE146 /end MEASUREMENT
/begin MEASUREMENT sHwlI_PhaseCurrentState_gde "Status of the phase current measurement." UWORD NO_UNIT 1 100 0 32770 ECU_ADDRESS 0xFEBEE148 /end MEASUREMENT
/begin MEASUREMENT sPhcFsa_PrevBatCurrState_gde "Battery current state of previous task cycle" UWORD NO_UNIT 1 100 0 32770 ECU_ADDRESS 0xFEBEC65C /end MEASUREMENT
/begin MEASUREMENT sPhcFsaI_IpcPhaseCurrentStatus_gdu8 "Compressed status for IPC transfer" UBYTE NO_UNIT 1 100 0 3 ECU_ADDRESS 0xFEBEC660 /end MEASUREMENT
/begin MEASUREMENT sPhcI_FaultIndicationState_gde "Fault indication state of PHC" UBYTE NO_UNIT 1 100 0 7 ECU_ADDRESS 0xFEBEC661 /end MEASUREMENT
/begin MEASUREMENT yPhcFsa_InputErrors_mdu16 "Input error storage variable" UWORD NO_UNIT 1 100 0 65536 ECU_ADDRESS 0xFEBEC65E /end MEASUREMENT
/begin MEASUREMENT yPhcPlausiI_CurrentAssignment_gae "Defines the assignment of the current measurement to the three phases" UBYTE NO_UNIT 1 100 0 3 ECU_ADDRESS 0xFEBEC662 MATRIX_DIM 3 1 1 /end MEASUREMENT
/begin MEASUREMENT iPhcGduCalc_CurrentVectorLength_gdf32 "Length of current vector for amp mode selection" FLOAT32_IEEE NO_UNIT 1 100 -3.40282346639E+38 4294967295 ECU_ADDRESS 0xFEBEC678 /end MEASUREMENT
/begin MEASUREMENT iPhcGduCalcI_ShuntCurrentIRQ_gaf32 "GDU phase current (interrupt context)" FLOAT32_IEEE NO_UNIT 1 100 -1000 1000 ECU_ADDRESS 0xFEBEC6E8 MATRIX_DIM 3 1 1 /end MEASUREMENT
/begin MEASUREMENT sPhcGduCalcI_AmpModeReducedIRQ_gde "Stores True if the Current amplification mode reduced" UBYTE NO_UNIT 1 100 0 255 ECU_ADDRESS 0xFEBEC6C0 /end MEASUREMENT
/begin MEASUREMENT xPhcGduCalcI_ConversionFactor1_gaf32 "Conversion factor for GDU current calculation" FLOAT32_IEEE NO_UNIT 1 100 -3.40282346639E+38 4294967295 ECU_ADDRESS 0xFEBEC6C8 MATRIX_DIM 4 1 1 /end MEASUREMENT
/begin MEASUREMENT xPhcGduCalcI_ConversionFactor3_gaf32 "Conversion factor for GDU current calculation" FLOAT32_IEEE NO_UNIT 1 100 -3.40282346639E+38 4294967295 ECU_ADDRESS 0xFEBEC6D8 MATRIX_DIM 4 1 1 /end MEASUREMENT
/begin MEASUREMENT yPhcGduCalc_OffsetPhase1_gdu16 "Last Adc mesaurement of current offset in Phase 1" UWORD NO_UNIT 1 100 0 4095 ECU_ADDRESS 0xFEBEC6B8 /end MEASUREMENT
/begin MEASUREMENT yPhcGduCalc_OffsetPhase3_gdu16 "Last Adc mesaurement of current offset in Phase 3" UWORD NO_UNIT 1 100 0 4095 ECU_ADDRESS 0xFEBEC6BA /end MEASUREMENT
/begin MEASUREMENT yPhcGduCalc_ShuntOffsetAmpMode_gde "Shunt offset for Amplification mode" UBYTE NO_UNIT 1 100 0 3 ECU_ADDRESS 0xFEBEC6C1 /end MEASUREMENT
/begin MEASUREMENT yPhcGduCalc_SumOffset1_gdu16 "Gdu sum of offsets" UWORD NO_UNIT 1 100 0 65535 ECU_ADDRESS 0xFEBEC6BC /end MEASUREMENT
/begin MEASUREMENT yPhcGduCalc_SumOffset3_gdu16 "Gdu sum of offset for phase3" UWORD NO_UNIT 1 100 0 65535 ECU_ADDRESS 0xFEBEC6BE /end MEASUREMENT
/begin MEASUREMENT yPhcGduCalcI_CurrentAmplificationMode_gde "" UBYTE NO_UNIT 1 100 0 3 ECU_ADDRESS 0xFEBEC6C2 /end MEASUREMENT
/begin MEASUREMENT yPhcGduCalcI_Offset1_gau16 "GDU Offset that is used for phase current calculation phase 1" UWORD NO_UNIT 1 100 0 4095 ECU_ADDRESS 0xFEBEC668 MATRIX_DIM 4 1 1 /end MEASUREMENT
/begin MEASUREMENT yPhcGduCalcI_Offset3_gau16 "GDU Offset that is used for phase current calculation phase 3" UWORD NO_UNIT 1 100 0 4095 ECU_ADDRESS 0xFEBEC670 MATRIX_DIM 4 1 1 /end MEASUREMENT
/begin MEASUREMENT yPhcGduCalcI_PreviousAmplificationMode_gde "" UBYTE NO_UNIT 1 100 0 255 ECU_ADDRESS 0xFEBEC6C3 /end MEASUREMENT
/begin MEASUREMENT zPhcGduCalc_GduOffsAvgCnt_gdu8 "Gdu offset average count" UBYTE NO_UNIT 1 100 0 255 ECU_ADDRESS 0xFEBEC6C4 /end MEASUREMENT
/begin MEASUREMENT sPhcGduDiag_CyclicOffsetUpdated_gae "GDU cyclic offset has been updated for one of the four amp modes" UBYTE NO_UNIT 1 100 0 255 ECU_ADDRESS 0xFEBEC714 MATRIX_DIM 4 1 1 /end MEASUREMENT
/begin MEASUREMENT sPhcGduDiag_CyclicOffsetUpdatedIsr_gae "GDU cyclic offset has been updated for one of the four amp modes in ISR" UBYTE NO_UNIT 1 100 0 255 ECU_ADDRESS 0xFEBEC718 MATRIX_DIM 4 1 1 /end MEASUREMENT
/begin MEASUREMENT sPhcGduDiagI_ShuntPreStatus_gde "Prefailed status of GDU (Shunt) measurement" UWORD NO_UNIT 1 100 0 65535 ECU_ADDRESS 0xFEBEC750 /end MEASUREMENT
/begin MEASUREMENT sPhcGduDiagI_ShuntStatus_gde "Error status of GDU (Shunt) measurement" UWORD NO_UNIT 1 100 0 65535 ECU_ADDRESS 0xFEBEC752 /end MEASUREMENT
/begin MEASUREMENT yPhcGduDiag_AmpMode1_gdu8 "Amp mode phase 1 at error for diagnostic freeze frame" UBYTE NO_UNIT 1 100 0 255 ECU_ADDRESS 0xFEBEED60 /end MEASUREMENT
/begin MEASUREMENT yPhcGduDiag_AmpMode3_gdu8 "Amp mode phase 3 at error for diagnostic freeze frame" UBYTE NO_UNIT 1 100 0 255 ECU_ADDRESS 0xFEBEED61 /end MEASUREMENT
/begin MEASUREMENT yPhcGduDiag_CyclicOffset1_gdu16 "Cyclic offset phase 1 at error for diagnostic freeze frame" UWORD NO_UNIT 1 100 0 4095 ECU_ADDRESS 0xFEBEED58 /end MEASUREMENT
/begin MEASUREMENT yPhcGduDiag_CyclicOffset3_gdu16 "Cyclic offset phase 3 at error for diagnostic freeze frame" UWORD NO_UNIT 1 100 0 4095 ECU_ADDRESS 0xFEBEED5A /end MEASUREMENT
/begin MEASUREMENT yPhcGduDiag_CycOffset1_gau16 "Cyclic offset phase 1 of Shunt measurement" UWORD NO_UNIT 1 100 0 4095 ECU_ADDRESS 0xFEBEC6F4 MATRIX_DIM 4 1 1 /end MEASUREMENT
/begin MEASUREMENT yPhcGduDiag_CycOffset3_gau16 "Cyclic offset phase 3 of Shunt measurement" UWORD NO_UNIT 1 100 0 4095 ECU_ADDRESS 0xFEBEC6FC MATRIX_DIM 4 1 1 /end MEASUREMENT
/begin MEASUREMENT yPhcGduDiag_StartUpOffset1_gau16 "GDU Offset measured during startup - phase 1" UWORD NO_UNIT 1 100 0 4095 ECU_ADDRESS 0xFEBEC704 MATRIX_DIM 4 1 1 /end MEASUREMENT
/begin MEASUREMENT yPhcGduDiag_StartupOffset1_gdu16 "Startup offset phase 1 at error for diagnostic freeze frame" UWORD NO_UNIT 1 100 0 4095 ECU_ADDRESS 0xFEBEED5C /end MEASUREMENT
/begin MEASUREMENT yPhcGduDiag_StartUpOffset3_gau16 "GDU Offset measured during startup - phase 3" UWORD NO_UNIT 1 100 0 4095 ECU_ADDRESS 0xFEBEC70C MATRIX_DIM 4 1 1 /end MEASUREMENT
/begin MEASUREMENT yPhcGduDiag_StartupOffset3_gdu16 "Startup offset phase 3 at error for diagnostic freeze frame" UWORD NO_UNIT 1 100 0 4095 ECU_ADDRESS 0xFEBEED5E /end MEASUREMENT
/begin MEASUREMENT zPhcGduDiag_ExceedanceCounter1_gdu8 "Phase1 exceedence counter " UBYTE NO_UNIT 1 100 0 255 ECU_ADDRESS 0xFEBEC754 /end MEASUREMENT
/begin MEASUREMENT zPhcGduDiag_ExceedanceCounter3_gdu8 "Exceedenace counter for phase3" UBYTE NO_UNIT 1 100 0 255 ECU_ADDRESS 0xFEBEC755 /end MEASUREMENT
/begin MEASUREMENT zPhcGduDiag_OffsetErrorCounter1_gau8 " cyclic offset error counter  for phase1" UBYTE NO_UNIT 1 100 0 255 ECU_ADDRESS 0xFEBEC73C MATRIX_DIM 4 1 1 /end MEASUREMENT
/begin MEASUREMENT zPhcGduDiag_OffsetErrorCounter3_gau8 "offset error counter for phase3" UBYTE NO_UNIT 1 100 0 255 ECU_ADDRESS 0xFEBEC744 MATRIX_DIM 4 1 1 /end MEASUREMENT
/begin MEASUREMENT zPhcGduDiag_StartupOffsErrCntPct_gdu8 "Startup offset error counter" UBYTE NO_UNIT 1 100 0 255 ECU_ADDRESS 0xFEBEC756 /end MEASUREMENT
/begin MEASUREMENT iPhcI_PhaseCurrentIsr_gaf32 "Phase currents of all three phases (valid in interrupt context)" FLOAT32_IEEE NO_UNIT 1 100 -1000 1000 ECU_ADDRESS 0xFEBEC77C MATRIX_DIM 3 1 1 /end MEASUREMENT
/begin MEASUREMENT iPhcPlausiI_CurrentDifference_gas16 "Current difference between Shunt and Asic-Shunt/Rdson current" SWORD NO_UNIT 1 100 -32000 32000 ECU_ADDRESS 0xFEBEC76C MATRIX_DIM 3 1 1 /end MEASUREMENT
/begin MEASUREMENT sPhcPlausiI_RedStorErrorOccured_gde "Redundant data storage error occured" UBYTE NO_UNIT 1 100 0 1 ECU_ADDRESS 0xFEBEC774 /end MEASUREMENT
/begin MEASUREMENT sPhcPlausiI_Status_gde "Status of phase current measurement (Shunt, AsicShunt, Rdson) comparison" UBYTE NO_UNIT 1 100 0 8 ECU_ADDRESS 0xFEBEC775 /end MEASUREMENT
/begin MEASUREMENT yPhcPlausiI_FreezeFrameData_gas16 "Plausibility Data for freeze frame in case of a comparison error" SWORD NO_UNIT 1 100 -32768 32767 ECU_ADDRESS 0xFEBEED64 MATRIX_DIM 4 1 1 /end MEASUREMENT
/begin MEASUREMENT zPhcPlausi_DiffCounter_gau8 "Plausi Diffrence counter " UBYTE NO_UNIT 1 100 0 255 ECU_ADDRESS 0xFEBEC776 MATRIX_DIM 3 1 1 /end MEASUREMENT
/begin MEASUREMENT sPhcDiagI_PreShunt1stStatus_gde "Range error detected in GDU shunt" UBYTE NO_UNIT 1 100 0 255 ECU_ADDRESS 0xFEBEC640 /end MEASUREMENT
/begin MEASUREMENT sPhcDiagI_PreShunt2ndStatus_gde "Range error detected in ASIC shunt" UBYTE NO_UNIT 1 100 0 255 ECU_ADDRESS 0xFEBEC641 /end MEASUREMENT
/begin MEASUREMENT yPhcMuxDiagI_MuxTestChannelVolt_gdu16 "Asic multiplexor test path voltage in Digit" UWORD NO_UNIT 1 100 0 4095 ECU_ADDRESS 0xFEBEED62 /end MEASUREMENT
/begin MEASUREMENT iPhcAsicCalcI_AsicCurrentIRQ1_gdf32 "Asic-Shunt phase 1 current (interupt context)" FLOAT32_IEEE CURR_REAL 1 100 -1000 1000 ECU_ADDRESS 0xFEBEC464 /end MEASUREMENT
/begin MEASUREMENT iPhcAsicCalcI_AsicCurrentIRQ3_gdf32 "Asic-Shunt phase 3 current (interupt context)" FLOAT32_IEEE CURR_REAL 1 100 -1000 1000 ECU_ADDRESS 0xFEBEC46C /end MEASUREMENT
/begin MEASUREMENT yPhcAsicCalc_GainFactorCoarse_mdf32 "Gain factor (coarse) for Asic-Shunt measurement based on NVshare" FLOAT32_IEEE NO_UNIT 1 100 0 1 ECU_ADDRESS 0xFEBEC474 /end MEASUREMENT
/begin MEASUREMENT yPhcAsicCalc_Gshunt1_gdf32 "Gshunt conductance of phase 1 based on NVshare value" FLOAT32_IEEE NO_UNIT 1 100 -3.40282346639E+38 4294967295 ECU_ADDRESS 0xFEBEC47C /end MEASUREMENT
/begin MEASUREMENT yPhcAsicCalc_Gshunt3_gdf32 "Gshunt conductance of phase 3 based on NVshare value" FLOAT32_IEEE NO_UNIT 1 100 -3.40282346639E+38 4294967295 ECU_ADDRESS 0xFEBEC484 /end MEASUREMENT
/begin MEASUREMENT yPhcAsicCalc_Offset_gdu16 "Last Adc mesaurement of Asic-Shunt offset" UWORD NO_UNIT 1 100 0 4095 ECU_ADDRESS 0xFEBEC4A4 /end MEASUREMENT
/begin MEASUREMENT yPhcAsicCalc_OffsMuxMode_gde "Multiplexor scheme (mode) during offset measurement" UBYTE NO_UNIT 1 100 0 19 ECU_ADDRESS 0xFEBEC4B0 /end MEASUREMENT
/begin MEASUREMENT yPhcAsicCalc_SumOffset_gdu16 "Asic-Shunt sum of offsets" UWORD NO_UNIT 1 100 0 65535 ECU_ADDRESS 0xFEBEC4A6 /end MEASUREMENT
/begin MEASUREMENT yPhcAsicCalcI_AsicAdcValueIRQ1_gdu16 "Asic-Shunt phase 1 ADC value that is used for current calculation (interrupt context)" UWORD NO_UNIT 1 100 0 4095 ECU_ADDRESS 0xFEBEC4A8 /end MEASUREMENT
/begin MEASUREMENT yPhcAsicCalcI_AsicAdcValueIRQ3_gdu16 "Asic-Shunt phase 3 ADC value that is used for current calculation (interrupt context)" UWORD NO_UNIT 1 100 0 4095 ECU_ADDRESS 0xFEBEC4AA /end MEASUREMENT
/begin MEASUREMENT yPhcAsicCalcI_GainRegisterCoarse_gdu8 "Gain register setting for Rdson measurement read from NVshare" UBYTE NO_UNIT 1 100 0 7 ECU_ADDRESS 0xFEBEC4B1 /end MEASUREMENT
/begin MEASUREMENT yPhcAsicCalcI_Offset1_gdu16 "Offset of Asic-Shunt measurement phase 1" UWORD NO_UNIT 1 100 0 4095 ECU_ADDRESS 0xFEBEC4AC /end MEASUREMENT
/begin MEASUREMENT yPhcAsicCalcI_Offset3_gdu16 "Offset of Asic-Shunt measurement phase 1" UWORD NO_UNIT 1 100 0 4095 ECU_ADDRESS 0xFEBEC4AE /end MEASUREMENT
/begin MEASUREMENT zPhcAsicCalc_OffsAvgCnt_gdu8 "Asic-Shunt offset average count" UBYTE NO_UNIT 1 100 0 255 ECU_ADDRESS 0xFEBEC4B2 /end MEASUREMENT
/begin MEASUREMENT sPhcAsicDiag_CyclicOffsetUpdated1_gde "Asic-Shunt cyclic offset of phase 1 has been updated" UBYTE NO_UNIT 1 100 0 255 ECU_ADDRESS 0xFEBEC4D8 /end MEASUREMENT
/begin MEASUREMENT sPhcAsicDiag_CyclicOffsetUpdated1Isr_gde "Asic -Shunt cyclic offset in ISR of Phase1 has been updated" UBYTE NO_UNIT 1 100 0 255 ECU_ADDRESS 0xFEBEC4D9 /end MEASUREMENT
/begin MEASUREMENT sPhcAsicDiag_CyclicOffsetUpdated3_gde "Asic-Shunt cyclic offset of phase 3 has been updated" UBYTE NO_UNIT 1 100 0 255 ECU_ADDRESS 0xFEBEC4DA /end MEASUREMENT
/begin MEASUREMENT sPhcAsicDiag_CyclicOffsetUpdated3Isr_gde "Asic-Shunt cyclic offset in ISR of Phase3 has been updated" UBYTE NO_UNIT 1 100 0 255 ECU_ADDRESS 0xFEBEC4DB /end MEASUREMENT
/begin MEASUREMENT sPhcAsicDiagI_AsicShuntPreStatus_gde "Prefailed status of Asic-Shunt measurement" UWORD NO_UNIT 1 100 0 65535 ECU_ADDRESS 0xFEBEC4CC /end MEASUREMENT
/begin MEASUREMENT sPhcAsicDiagI_AsicShuntStatus_gde "Error status of Asic-Shunt measurement" UWORD NO_UNIT 1 100 0 65535 ECU_ADDRESS 0xFEBEC4CE /end MEASUREMENT
/begin MEASUREMENT yPhcAsicDiag_CycOffset1_gdu16 "Cyclic offset phase 1 of Asic-Shunt measurement" UWORD NO_UNIT 1 100 0 4095 ECU_ADDRESS 0xFEBEC4D0 /end MEASUREMENT
/begin MEASUREMENT yPhcAsicDiag_CycOffset3_gdu16 "Cyclic offset phase 3 of Asic-Shunt measurement" UWORD NO_UNIT 1 100 0 4095 ECU_ADDRESS 0xFEBEC4D2 /end MEASUREMENT
/begin MEASUREMENT yPhcAsicDiag_StartUpOffset1_gdu16 "Startup offset of Asic-Shunt measurement phase 1" UWORD NO_UNIT 1 100 0 4095 ECU_ADDRESS 0xFEBEC4D4 /end MEASUREMENT
/begin MEASUREMENT yPhcAsicDiag_StartUpOffset3_gdu16 "Startup offset of Asic-Shunt measurement phase 3" UWORD NO_UNIT 1 100 0 4095 ECU_ADDRESS 0xFEBEC4D6 /end MEASUREMENT
/begin MEASUREMENT yPhcAsicDiagI_2ndMeasureFreezeFrameData_gas16 "Phase currents at time of error for freeze frame of 2nd measurement" SWORD NO_UNIT 1 100 -32768 32767 ECU_ADDRESS 0xFEBEED50 MATRIX_DIM 3 1 1 /end MEASUREMENT
/begin MEASUREMENT sDith_PeriodCalcState1_de "Stores Calculation State for the first 8 Periods" UBYTE NO_UNIT 1 100 0 255 ECU_ADDRESS 0xFEBEAA74 /end MEASUREMENT
/begin MEASUREMENT sDith_PeriodCalcState2_de "Stores Calculation State for the second 8 Periods" UBYTE NO_UNIT 1 100 0 255 ECU_ADDRESS 0xFEBEAA75 /end MEASUREMENT
/begin MEASUREMENT tDithI_PeriodDelta_gdf32 "Ditherin Delta calculated out of the Dithering Factor" FLOAT32_IEEE NO_UNIT 1 100 0 10 ECU_ADDRESS 0xFEBEAA70 /end MEASUREMENT
/begin MEASUREMENT yDithI_Periods1_gaf32 "Dithering Periods, First 8 values for first 500 us." FLOAT32_IEEE NO_UNIT 1 100 56.25 68.75 ECU_ADDRESS 0xFEBEAA78 MATRIX_DIM 8 1 1 /end MEASUREMENT
/begin MEASUREMENT yDithI_Periods2_gaf32 "Dithering Periods, Second 8 values for Second 500 us." FLOAT32_IEEE NO_UNIT 1 100 56.25 68.75 ECU_ADDRESS 0xFEBEAA98 MATRIX_DIM 8 1 1 /end MEASUREMENT
/begin MEASUREMENT sDithI_PeriodErrors1_gde "Stores any detected Dithering error for the first 8 Periods" UWORD NO_UNIT 1 100 0 65535 ECU_ADDRESS 0xFEBEAA68 /end MEASUREMENT
/begin MEASUREMENT sDithI_PeriodErrors2_gde "Stores any detected Dithering error for the second 8 Periods" UWORD NO_UNIT 1 100 0 65535 ECU_ADDRESS 0xFEBEAA6A /end MEASUREMENT
/begin MEASUREMENT sDithI_PlausiStatus_gdu8 "Status of Dithering Plausibility" UBYTE NO_UNIT 1 100 0 100 ECU_ADDRESS 0xFEBEAA6C /end MEASUREMENT
/begin MEASUREMENT sDriverUv_ConvRpmSave_gde "" UBYTE NO_UNIT 1 100 0 2 ECU_ADDRESS 0xFEBEC7A8 /end MEASUREMENT
/begin MEASUREMENT sDriverUv_DiagFlagsUpdated_gdu8 "indicates the status of the driver diag flags" UBYTE NO_UNIT 1 100 0 1 ECU_ADDRESS 0xFEBEC7A9 /end MEASUREMENT
/begin MEASUREMENT sDriverUv_FetErrors_gde "measurement variable for undervoltage pattern result" UWORD NO_UNIT 1 100 0 4095 ECU_ADDRESS 0xFEBEC7A4 /end MEASUREMENT
/begin MEASUREMENT sDriverUv_FetUnderTest_gde "Fet under test" UWORD NO_UNIT 1 100 0 8191 ECU_ADDRESS 0xFEBEC7A6 /end MEASUREMENT
/begin MEASUREMENT sDriverUv_PatternState_gde "Under voltage Pattern state" UBYTE NO_UNIT 1 100 0 28 ECU_ADDRESS 0xFEBEC7AA /end MEASUREMENT
/begin MEASUREMENT sDriverUv_State_gde "Driver UV state " UBYTE NO_UNIT 1 100 0 2 ECU_ADDRESS 0xFEBEC7AB /end MEASUREMENT
/begin MEASUREMENT sDriverUv_UpdateDiagRegBufferVar_gde "Diag REg Buffer" UBYTE NO_UNIT 1 100 0 1 ECU_ADDRESS 0xFEBEC7AC /end MEASUREMENT
/begin MEASUREMENT tDriverUv_RecoverTime_gdu8 "recover time " UBYTE T_MS 1 100 0 10 ECU_ADDRESS 0xFEBEC7AD /end MEASUREMENT
/begin MEASUREMENT tDriverUv_ReverenceVoltageWaitTime_gdu8 "Reference Voltage wait time " UBYTE T_MS 1 100 0 5 ECU_ADDRESS 0xFEBEC7AE /end MEASUREMENT
/begin MEASUREMENT uDriverUv_RefDCLinkVoltage_gdf32 "DC Link Referance voltage " FLOAT32_IEEE VOLT_REAL 1 100 0 1000 ECU_ADDRESS 0xFEBEC79C /end MEASUREMENT
/begin MEASUREMENT uDriverUv_RefOutputStageVoltage_gdf32 "Ref voltage of SVO" FLOAT32_IEEE VOLT_REAL 1 100 0 1000 ECU_ADDRESS 0xFEBEC7A0 /end MEASUREMENT
/begin MEASUREMENT sDriverDiag_FetDiagTriggerStatus_gde "Fet Diag detection triggered" UBYTE NO_UNIT 1 100 1 2 ECU_ADDRESS 0xFEBEC83A /end MEASUREMENT
/begin MEASUREMENT sDriverDiag_FetDiagTriggerStatusFlag_gde "Flag to get Fet Diag Trigger Status" UBYTE NO_UNIT 1 100 1 2 ECU_ADDRESS 0xFEBEC83B /end MEASUREMENT
/begin MEASUREMENT sDriverDiag_SvoUnderVoltageTriggered_gde "SVO undervoltage trigger status" UBYTE NO_UNIT 1 100 0 1 ECU_ADDRESS 0xFEBEC83C /end MEASUREMENT
/begin MEASUREMENT sDrvDiag_DiagStates_gde "Diag State" UBYTE NO_UNIT 1 100 0 8 ECU_ADDRESS 0xFEBEC83D /end MEASUREMENT
/begin MEASUREMENT sDrvDiagI_DriverDiagFlags_gde "Stores the GDU Diag flags" UWORD NO_UNIT 1 100 0 65535 ECU_ADDRESS 0xFEBEC834 /end MEASUREMENT
/begin MEASUREMENT sDrvDiagI_ErrorStatus_gdu8 "Error status of the driver diagnosis" UBYTE NO_UNIT 1 100 0 100 ECU_ADDRESS 0xFEBEC83E /end MEASUREMENT
/begin MEASUREMENT sDrvDiagI_FetErrors_gde "FET errors, detected by outputstage diagnostics (bit coded)" UWORD NO_UNIT 1 100 0 65535 ECU_ADDRESS 0xFEBEC836 /end MEASUREMENT
/begin MEASUREMENT sDrvDiagI_State_gde "Driver diagnosis status" UWORD NO_UNIT 1 100 0 1024 ECU_ADDRESS 0xFEBEC838 /end MEASUREMENT
/begin MEASUREMENT sFetDiag_ConvRpmSave_gde "conversion from short to open fet " UBYTE NO_UNIT 1 100 0 2 ECU_ADDRESS 0xFEBEC852 /end MEASUREMENT
/begin MEASUREMENT sFetDiag_DiagStates_gde "Fet Diag State" UBYTE NO_UNIT 1 100 0 24 ECU_ADDRESS 0xFEBEC853 /end MEASUREMENT
/begin MEASUREMENT sFetDiag_FinishedTests_gde "show the tested FETs " UBYTE NO_UNIT 1 100 0 255 ECU_ADDRESS 0xFEBEC854 /end MEASUREMENT
/begin MEASUREMENT sFetDiag_MonitorInfoDiagFlag_gde "To store Diag flag of Monitor Info" UWORD NO_UNIT 1 100 0 8191 ECU_ADDRESS 0xFEBEC850 /end MEASUREMENT
/begin MEASUREMENT sFetDiag_UpdateDiagRegBufferVar_gde "status of updating GDU diag register" UBYTE NO_UNIT 1 100 0 1 ECU_ADDRESS 0xFEBEC855 /end MEASUREMENT
/begin MEASUREMENT uFetDiag_RefOutputStageVoltage_gdf32 "reference outstage voltage" FLOAT32_IEEE VOLT_REAL 1 100 0 1000 ECU_ADDRESS 0xFEBEC84C /end MEASUREMENT
/begin MEASUREMENT sOpenPhase_DetectionState_gde "Detection Mode of Diagnosis" UBYTE NO_UNIT 1 100 0 0 ECU_ADDRESS 0xFEBEC8C0 /end MEASUREMENT
/begin MEASUREMENT sOpenPhase_SelectedType_gde "PWM-Pattern or CompareCurrents" UBYTE NO_UNIT 1 100 0 0 ECU_ADDRESS 0xFEBEC8C1 /end MEASUREMENT
/begin MEASUREMENT sOpenPhaseI_Errors_gde "Open Phase Detection State" UBYTE NO_UNIT 1 100 0 255 ECU_ADDRESS 0xFEBEC8C2 /end MEASUREMENT
/begin MEASUREMENT sOpenPhaseI_ErrorStatus_gdu8 "Error status 0...100 percent" UBYTE NO_UNIT 1 100 0 100 ECU_ADDRESS 0xFEBEC8C3 /end MEASUREMENT
/begin MEASUREMENT sPowCalc_InitState_gde "Shows, if Init shall perform" UBYTE NO_UNIT 1 100 0 2 ECU_ADDRESS 0xFEBEC8CC /end MEASUREMENT
/begin MEASUREMENT sPowCalc_StartUpState_gde "Shows, if StartUp shall perform" UBYTE NO_UNIT 1 100 0 3 ECU_ADDRESS 0xFEBEC8CD /end MEASUREMENT
/begin MEASUREMENT sPowCalcI_ActiveMotCtrlIsrType_gdu8 "Indicator for controller frequency 2kHz = 0 ,4kHz = 1" UBYTE NO_UNIT 1 100 0 1 ECU_ADDRESS 0xFEBEC8CE /end MEASUREMENT
/begin MEASUREMENT sPowCalcI_OutputStageStatus_gde "Output stage status valid in task context." UBYTE NO_UNIT 1 100 0 1 ECU_ADDRESS 0xFEBEC8CF /end MEASUREMENT
/begin MEASUREMENT sPowCalcI_TestPwmCycleStart_gde "Test Pwm  cycle start signal" UBYTE NO_UNIT 1 100 0 1 ECU_ADDRESS 0xFEBEC8D0 /end MEASUREMENT
/begin MEASUREMENT tPowCalcI_PfbPeriodTime_gdf32 "PWM period time for phase feedback diagnosis." FLOAT32_IEEE T_US 1 100 50 75 ECU_ADDRESS 0xFEBEC8C8 /end MEASUREMENT
/begin MEASUREMENT sPowFsa_ActCtrlCycStatusBuffer_gdu8 "Status buffer variable" UBYTE NO_UNIT 1 100 0 100 ECU_ADDRESS 0xFEBEC8FA /end MEASUREMENT
/begin MEASUREMENT sPowI_FaultIndicationState_gde "Functionality state of POW" UBYTE NO_UNIT 1 100 0 255 ECU_ADDRESS 0xFEBEC8FB /end MEASUREMENT
/begin MEASUREMENT sPowI_OutputStageState_gde "Current State of the Output Stage" UWORD NO_UNIT 1 100 0 65535 ECU_ADDRESS 0xFEBEC8F8 /end MEASUREMENT
/begin MEASUREMENT sPowMngr_OutputMode_gde "Output Stage Mode" UBYTE NO_UNIT 1 100 0 255 ECU_ADDRESS 0xFEBEAAB8 /end MEASUREMENT
/begin MEASUREMENT sPowMngr_OutputModeRequester_mde "Output Stage Mode Requester" UBYTE NO_UNIT 1 100 0 255 ECU_ADDRESS 0xFEBEAAB9 /end MEASUREMENT
/begin MEASUREMENT sPowMngrI_DisableChannels_gde "Stores all requester actions" UBYTE NO_UNIT 1 100 0 255 ECU_ADDRESS 0xFEBEAABA /end MEASUREMENT
/begin MEASUREMENT sPowOut_LastFetOutputMode_gde "Fet output mode" UBYTE NO_UNIT 1 100 0 5 ECU_ADDRESS 0xFEBEC918 /end MEASUREMENT
/begin MEASUREMENT sPowOut_MeasPwmEnabled_gde "Flag shows if PWM may be limited for current-measurement" UBYTE NO_UNIT 1 100 0 1 ECU_ADDRESS 0xFEBEC919 /end MEASUREMENT
/begin MEASUREMENT sPowOutI_BufferOutputStageStatus_gde "Buffer of output stage status valid in ISR context." UBYTE NO_UNIT 1 100 0 1 ECU_ADDRESS 0xFEBEC91A /end MEASUREMENT
/begin MEASUREMENT sPowOutI_FetOutputMode_gde "Fet output mode" UBYTE NO_UNIT 1 100 0 4 ECU_ADDRESS 0xFEBEC91B /end MEASUREMENT
/begin MEASUREMENT sPowOutI_PwmCheckOption_gde "PWM feedback check" UBYTE NO_UNIT 1 100 0 1 ECU_ADDRESS 0xFEBEC91C /end MEASUREMENT
/begin MEASUREMENT tPowOut_DeadTimesNs_gau16 "For Debug Purposes" UWORD NO_UNIT 1 100 400 1600 ECU_ADDRESS 0xFEBEC9A0 MATRIX_DIM 6 1 1 /end MEASUREMENT
/begin MEASUREMENT tPowOut_PeriodTime_gaf32 "Period Time" FLOAT32_IEEE NO_UNIT 1 100 50 75 ECU_ADDRESS 0xFEBEC920 MATRIX_DIM 8 1 1 /end MEASUREMENT
/begin MEASUREMENT tPowOutI_BufferPfbPeriodTime_gdf32 "Buffer of PWM period time valid in ISR context." FLOAT32_IEEE T_US 1 100 50 75 ECU_ADDRESS 0xFEBEC90C /end MEASUREMENT
/begin MEASUREMENT yPowOut_DeadTimeInitDone_gdu16 "" UWORD NO_UNIT 1 100 0 65535 ECU_ADDRESS 0xFEBEC914 /end MEASUREMENT
/begin MEASUREMENT yPowOut_GpTempCalc_gdu16 "Ground plate temperature for last FET dead time calculation." UWORD TEMP_INT 1 100 -70 185 ECU_ADDRESS 0xFEBEC916 /end MEASUREMENT
/begin MEASUREMENT yPowOut_PwmPhase1_gaf32 "PWM values of phase 1" FLOAT32_IEEE NO_UNIT 1 100 0 100 ECU_ADDRESS 0xFEBEC940 MATRIX_DIM 8 1 1 /end MEASUREMENT
/begin MEASUREMENT yPowOut_PwmPhase2_gaf32 "PWM values of phase 2" FLOAT32_IEEE NO_UNIT 1 100 0 100 ECU_ADDRESS 0xFEBEC960 MATRIX_DIM 8 1 1 /end MEASUREMENT
/begin MEASUREMENT yPowOut_PwmPhase3_gaf32 "PWM values of phase 3" FLOAT32_IEEE NO_UNIT 1 100 0 100 ECU_ADDRESS 0xFEBEC980 MATRIX_DIM 8 1 1 /end MEASUREMENT
/begin MEASUREMENT yPowOut_PwmValue4Diff_gaf32 "Measurement variable of the PWM value difference for Phase U,V,W" FLOAT32_IEEE NO_UNIT 1 100 0 100 ECU_ADDRESS 0xFEBEC9AC MATRIX_DIM 3 1 1 /end MEASUREMENT
/begin MEASUREMENT yPowOut_SafetyLimitedValue_gaf32 "Measurement variable of the safety limited corrected value of AsymComp for Phase U, V, W" FLOAT32_IEEE NO_UNIT 1 100 -100 100 ECU_ADDRESS 0xFEBEED70 MATRIX_DIM 3 1 1 /end MEASUREMENT
/begin MEASUREMENT yPowOutI_ReadTestPfb_gde "PWM Stuff cycle start" UBYTE NO_UNIT 1 100 0 1 ECU_ADDRESS 0xFEBEC91D /end MEASUREMENT
/begin MEASUREMENT sPscCtrl_CommonCutOffStates_gde "PscCtrl common states" UBYTE NO_UNIT 1 100 0 2 ECU_ADDRESS 0xFEBECA42 /end MEASUREMENT
/begin MEASUREMENT sPscCtrl_CutOffStates_gde "PscCtrl states" UBYTE NO_UNIT 1 100 0 2 ECU_ADDRESS 0xFEBECA43 /end MEASUREMENT
/begin MEASUREMENT sPscCtrl_ExitCondition_gde "Stores the exit condition (Gdu reenable or not)" UBYTE NO_UNIT 1 100 0 1 ECU_ADDRESS 0xFEBECA44 /end MEASUREMENT
/begin MEASUREMENT sPscCtrl_InstantCutOffStates_gde "PscCtrl instant states" UBYTE NO_UNIT 1 100 0 3 ECU_ADDRESS 0xFEBECA45 /end MEASUREMENT
/begin MEASUREMENT sPscCtrl_RequestedCutOffType_gde "Powerstage open types" UBYTE NO_UNIT 1 100 0 2 ECU_ADDRESS 0xFEBECA46 /end MEASUREMENT
/begin MEASUREMENT sPscCtrl_RotorSpeedState_gde "Shows if rotorspeed is small enough or to high for instant shut down" UBYTE NO_UNIT 1 100 0 1 ECU_ADDRESS 0xFEBECA47 /end MEASUREMENT
/begin MEASUREMENT sPscCtrl_SlowCutOffStates_gde "" UBYTE NO_UNIT 1 100 0 2 ECU_ADDRESS 0xFEBECA48 /end MEASUREMENT
/begin MEASUREMENT sPscCtrl_TimeOutState_gde "Stores if TimeOut is reached or not for delayed shutdown" UBYTE NO_UNIT 1 100 0 1 ECU_ADDRESS 0xFEBECA49 /end MEASUREMENT
/begin MEASUREMENT tPscCtrl_RotorSpeedSmallTimerMs_gdu16 "stores how long the rotor speed is small enough to shut down instantly" UWORD T_MS 1 100 0 65535 ECU_ADDRESS 0xFEBECA3C /end MEASUREMENT
/begin MEASUREMENT tPscCtrl_StartTimeMs_gdu16 "Start of the system time" UWORD T_MS 1 100 0 65535 ECU_ADDRESS 0xFEBECA3E /end MEASUREMENT
/begin MEASUREMENT tPscCtrl_TimeOutCounterMs_gdu16 "stores time for TimeOut in delayed shut down" UWORD T_MS 1 100 0 65535 ECU_ADDRESS 0xFEBECA40 /end MEASUREMENT
/begin MEASUREMENT sPscDiagI_ErrorStatus_mdu8 "Error status Psc Diagnosis in percent" UBYTE NO_UNIT 1 100 0 100 ECU_ADDRESS 0xFEBECA4A /end MEASUREMENT
/begin MEASUREMENT zPscDiag_ErrorCounter_gdu8 "PSC undervoltage error counter" UBYTE NO_UNIT 1 100 0 10 ECU_ADDRESS 0xFEBECA4B /end MEASUREMENT
/begin MEASUREMENT sPwmCheckI_Errors_gde "Contains the detected PWM feedback diagnosis errors" UBYTE NO_UNIT 1 100 0 3 ECU_ADDRESS 0xFEBECA54 /end MEASUREMENT
/begin MEASUREMENT sPwmCheckI_ErrorStatus_gdu8 "PWM feedback diagnosis error status  in percent" UBYTE NO_UNIT 1 100 0 100 ECU_ADDRESS 0xFEBECA55 /end MEASUREMENT
/begin MEASUREMENT zPwmCheck_FeedbackRestartCounter_gdu8 "Feedback restart counter" UBYTE NO_UNIT 1 100 0 255 ECU_ADDRESS 0xFEBECA56 /end MEASUREMENT
/begin MEASUREMENT iBaCuLi_IdcMaxGenCalc_gdf32 "Maximum battery current in generatoric operation mode after acceleration part" FLOAT32_IEEE CURR_REAL 1 100 0 4711 ECU_ADDRESS 0xFEBECA64 /end MEASUREMENT
/begin MEASUREMENT iBaCuLi_IdcMaxMotCalc_gdf32 "Maximum battery current in motoric operation mode after acceleration part" FLOAT32_IEEE CURR_REAL 1 100 0 4711 ECU_ADDRESS 0xFEBECA68 /end MEASUREMENT
/begin MEASUREMENT iBaCuLi_IsdFlt_gdf32 "filtered current direct axis" FLOAT32_IEEE CURR_REAL 1 100 0 500 ECU_ADDRESS 0xFEBECA6C /end MEASUREMENT
/begin MEASUREMENT mBaCuLi_MMaxMot_gdf32 "Maximum motor torque in motoric operation mode" FLOAT32_IEEE TORQ_REAL 1 100 0 4711 ECU_ADDRESS 0xFEBECA70 /end MEASUREMENT
/begin MEASUREMENT mBaCuLiI_MaxBatteryTorque_gdf32 "Battery current limitation induced maximum motor torque (Nm)" FLOAT32_IEEE TORQ_REAL 1 100 0 4711 ECU_ADDRESS 0xFEBECA74 /end MEASUREMENT
/begin MEASUREMENT mBaCuLiI_MaxBatteryTorqueGen_gdf32 "Battery current limitation induced maximum motor torque (generatoric) in Nm" FLOAT32_IEEE TORQ_REAL 1 100 0 4711 ECU_ADDRESS 0xFEBECA7C /end MEASUREMENT
/begin MEASUREMENT nBaCuLi_AbsOmegaMechMax_gdf32 "Absolute mechanical rotor speed after acceleration part" FLOAT32_IEEE NO_UNIT 1 100 0 4711 ECU_ADDRESS 0xFEBECA84 /end MEASUREMENT
/begin MEASUREMENT nBaCuLi_OmegaMechFilt_gdf32 "Filtered mechanical rotor speed" FLOAT32_IEEE NO_UNIT 1 100 -4711 4711 ECU_ADDRESS 0xFEBECA88 /end MEASUREMENT
/begin MEASUREMENT pBaCuLi_PElMaxGen_gdf32 "Maximum allowed electrical power in generatoric operation mode" FLOAT32_IEEE NO_UNIT 1 100 0 4711 ECU_ADDRESS 0xFEBECA8C /end MEASUREMENT
/begin MEASUREMENT pBaCuLi_PElMaxMot_gdf32 "Maximum allowed electrical power in motoric operation mode" FLOAT32_IEEE NO_UNIT 1 100 0 4711 ECU_ADDRESS 0xFEBECA90 /end MEASUREMENT
/begin MEASUREMENT pBaCuLi_PLossGen_gdf32 "Power loss in generatoric operation mode" FLOAT32_IEEE NO_UNIT 1 100 0 4711 ECU_ADDRESS 0xFEBECA94 /end MEASUREMENT
/begin MEASUREMENT pBaCuLi_PLossMot_gdf32 "Power loss in motoric operation mode" FLOAT32_IEEE NO_UNIT 1 100 0 4711 ECU_ADDRESS 0xFEBECA98 /end MEASUREMENT
/begin MEASUREMENT rBaCuLi_Rs_gdf32 "(Temperature dependent) electrical resistance at base" FLOAT32_IEEE NO_UNIT 1 100 0 4711 ECU_ADDRESS 0xFEBECA9C /end MEASUREMENT
/begin MEASUREMENT sBaCuLi_State_gde "Statevariable of BaCuLi" UWORD NO_UNIT 1 100 0 65535 ECU_ADDRESS 0xFEBEED7C /end MEASUREMENT
/begin MEASUREMENT sBaCuLiI_StartupFinished_gdu8 "Startup finished indicator" UBYTE NO_UNIT 1 100 0 1 ECU_ADDRESS 0xFEBECAB4 /end MEASUREMENT
/begin MEASUREMENT yBaCuLi_Isref2Filt_gdf32 "Filtered vector length reference current" FLOAT32_IEEE NO_UNIT 1 100 0 4711 ECU_ADDRESS 0xFEBECAA8 /end MEASUREMENT
/begin MEASUREMENT yBaCuLiI_MaxBatteryTorqueGrad_gdf32 "Battery current limitation induced maximum motor torque" FLOAT32_IEEE TORQ_GRAD_REAL 1 100 0 4711 ECU_ADDRESS 0xFEBECAAC /end MEASUREMENT
/begin MEASUREMENT mBoToI_MaxBoostTorque_gdf32 "Max torque that is allowed incase of boost mode" FLOAT32_IEEE TORQ_REAL 1 100 0 12 ECU_ADDRESS 0xFEBEAB5C /end MEASUREMENT
/begin MEASUREMENT yBoTo_BoostActive_du8 "0: Boost not active, 1: Boost active" UBYTE NO_UNIT 1 100 0 1 ECU_ADDRESS 0xFEBEAB60 /end MEASUREMENT
/begin MEASUREMENT yBoTo_BoostBlocked_du8 "0: Boost not available, 1: Boost ready" UBYTE NO_UNIT 1 100 0 1 ECU_ADDRESS 0xFEBEAB61 /end MEASUREMENT
/begin MEASUREMENT mCaMaToI_MaxMotorTorque_gdf32 "Max torque from the characteristic motor curve (and MaxMechanical)" FLOAT32_IEEE TORQ_REAL 1 100 0 10 ECU_ADDRESS 0xFEBECB04 /end MEASUREMENT
/begin MEASUREMENT mCaMaToI_MaxMotorTorqueGen_gdf32 "Max torque from the characteristic motor curve (and MaxMechanical)" FLOAT32_IEEE TORQ_REAL 1 100 0 10 ECU_ADDRESS 0xFEBECB0C /end MEASUREMENT
/begin MEASUREMENT mCaMaToI_NomMotorTorque_gdf32 "Max motor torque at 0 rpm from the characteristic motor curve" FLOAT32_IEEE TORQ_REAL 1 100 0 10 ECU_ADDRESS 0xFEBECB14 /end MEASUREMENT
/begin MEASUREMENT mCaMaToI_NomMotorTorqueGen_gdf32 "Max motor torque at 0 rpm from the characteristic motor curve" FLOAT32_IEEE TORQ_REAL 1 100 0 10 ECU_ADDRESS 0xFEBECB18 /end MEASUREMENT
/begin MEASUREMENT mPrmI_NomMotorTorque_gdf32 "Max motor torque at 0 rpm from the characteristic motor curve" FLOAT32_IEEE TORQ_REAL 1 100 0 10 ECU_ADDRESS 0xFEBECB1C /end MEASUREMENT
/begin MEASUREMENT nCaMaTo_AbsRotorSpeedWeight_gdf32 "Absolute rotor speed weighted with supply voltage in rpm" FLOAT32_IEEE NO_UNIT 1 100 0 20000 ECU_ADDRESS 0xFEBECB24 /end MEASUREMENT
/begin MEASUREMENT nHwlI_AbsRotSpeedVoltWeight_gdf32 "Voltage weighted rotor speed" FLOAT32_IEEE RPM_REAL 1 100 0 15000 ECU_ADDRESS 0xFEBEE14C /end MEASUREMENT
/begin MEASUREMENT iMomcI_MaxBattCurr_gdu16 "High level max battery current" UWORD CURR_INT 1 100 0 150 ECU_ADDRESS 0xFEBECB58 /end MEASUREMENT
/begin MEASUREMENT iMomcI_MaxBattCurrGeneratoric_gdu16 "High level max battery current generatoric" UWORD CURR_INT 1 100 0 200 ECU_ADDRESS 0xFEBECB5A /end MEASUREMENT
/begin MEASUREMENT mMomc_Requested_gdf32 "Local temporarily used requested motor torque" FLOAT32_IEEE TORQ_REAL 1 100 -12 12 ECU_ADDRESS 0xFEBECB2C /end MEASUREMENT
/begin MEASUREMENT mMomcI_RequestedMotorTorque_gdf32 "Requested motor torque Prm intern" FLOAT32_IEEE TORQ_REAL 1 100 -12 12 ECU_ADDRESS 0xFEBECB34 /end MEASUREMENT
/begin MEASUREMENT mMomcI_SsWarnTorque_gds16 "Remote high level ss warn torque" SWORD TORQ_INT 1 100 -12 12 ECU_ADDRESS 0xFEBECB5C /end MEASUREMENT
/begin MEASUREMENT sMomcI_BoostModeRequest_gdu8 "Remote high level boost mode request" UBYTE NO_UNIT 1 100 0 1 ECU_ADDRESS 0xFEBECB66 /end MEASUREMENT
/begin MEASUREMENT sMomcI_MotorOperationMode_gde "Motor mode" UBYTE NO_UNIT 1 100 0 1 ECU_ADDRESS 0xFEBECB67 /end MEASUREMENT
/begin MEASUREMENT sMomcI_TorqReductionCtrl_gdu8 "Trigger to control HwLib Reductions" UBYTE NO_UNIT 1 100 0 1 ECU_ADDRESS 0xFEBECB68 /end MEASUREMENT
/begin MEASUREMENT xMomcI_HlCharCurveBuckleFact_gdu16 "High level reduction factor" UWORD PERCENT_INT 1 100 0 100 ECU_ADDRESS 0xFEBECB5E /end MEASUREMENT
/begin MEASUREMENT xMomcI_HlReductionFactor_gdu16 "Remote high level reduction factor" UWORD PERCENT_INT 1 100 0 100 ECU_ADDRESS 0xFEBECB60 /end MEASUREMENT
/begin MEASUREMENT yMomcI_HlMaxTorqueGradient_gdu16 "Remote high level max torque gradient" UWORD TORQ_GRAD_INT 1 100 0 12 ECU_ADDRESS 0xFEBECB62 /end MEASUREMENT
/begin MEASUREMENT yMomcI_MaxBattCurrGradient_gdu16 "Remote high level max battery current gradient" UWORD CURR_GRAD_INT 1 100 0 120 ECU_ADDRESS 0xFEBECB64 /end MEASUREMENT
/begin MEASUREMENT yMomcI_MaxTorqueGradient_gdf32 "max torque gradient in Nm/ms" FLOAT32_IEEE TORQ_GRAD_REAL 1 100 0.01 10 ECU_ADDRESS 0xFEBECB50 /end MEASUREMENT
/begin MEASUREMENT sOscI_OutstageControlState_gde "" UBYTE NO_UNIT 1 100 1 8 ECU_ADDRESS 0xFEBECB70 /end MEASUREMENT
/begin MEASUREMENT sPrmDiagI_LimitedMotorTorqueState_gde "State of limited motor torque interface" UWORD NO_UNIT 1 100 0 65535 ECU_ADDRESS 0xFEBEAB62 /end MEASUREMENT
/begin MEASUREMENT sPrmDiagI_TorqueClipLevelsState_gde "State of clip levels" UWORD NO_UNIT 1 100 0 65535 ECU_ADDRESS 0xFEBEAB64 /end MEASUREMENT
/begin MEASUREMENT sPrmDiagI_TorqueRedLevelsState_gde "State of reduction levels" UWORD NO_UNIT 1 100 0 65535 ECU_ADDRESS 0xFEBEAB66 /end MEASUREMENT
/begin MEASUREMENT sHwlI_LimitedMotorTorqueState_gde "Validity state of the limited motor torque" UWORD NO_UNIT 1 100 0 32795 ECU_ADDRESS 0xFEBEE150 /end MEASUREMENT
/begin MEASUREMENT sHwlI_TorqueClipLevelsState_gde "Validity state clipping factors of HwLib reduction channels" UWORD NO_UNIT 1 100 0 1024 ECU_ADDRESS 0xFEBEE152 /end MEASUREMENT
/begin MEASUREMENT sHwlI_TorqueRedLevelsState_gde "Validity state of reduction factors" UWORD NO_UNIT 1 100 0 1024 ECU_ADDRESS 0xFEBEE154 /end MEASUREMENT
/begin MEASUREMENT sPrmI_FaultIndicationState_gde "Fault indication state" UBYTE NO_UNIT 1 100 0 7 ECU_ADDRESS 0xFEBECB7C /end MEASUREMENT
/begin MEASUREMENT yPrm_RedErrAddress_gdu32 "Address of Redundant error variable" ULONG NO_UNIT 1 100 0 4294967295 ECU_ADDRESS 0xFEBEED80 /end MEASUREMENT
/begin MEASUREMENT cProt_DcLinkCapDynRedMax_gdf32 "Dc link cap dynamic max temperatur with no reduction" FLOAT32_IEEE NO_UNIT 1 100 0 100 ECU_ADDRESS 0xFEBECB80 /end MEASUREMENT
/begin MEASUREMENT cProt_DcLinkCapDynRedMin_gdf32 "Dc link cap dynamic max temperatur with less support" FLOAT32_IEEE NO_UNIT 1 100 0 100 ECU_ADDRESS 0xFEBECB84 /end MEASUREMENT
/begin MEASUREMENT sPrmI_SafetyRampState_gde "Safety ramp for limp transitions" UBYTE NO_UNIT 1 100 0 2 ECU_ADDRESS 0xFEBECBBA /end MEASUREMENT
/begin MEASUREMENT sProt_DcLinkCapTempActivated_gdu8 "Temperature protection channel activated" UBYTE NO_UNIT 1 100 0 1 ECU_ADDRESS 0xFEBECBBB /end MEASUREMENT
/begin MEASUREMENT sProt_FetTempActivated_gdu8 "Temperature protection channel activated" UBYTE NO_UNIT 1 100 0 1 ECU_ADDRESS 0xFEBECBBC /end MEASUREMENT
/begin MEASUREMENT sProt_MotCoilTempActivated_gdu8 "Temperature protection channel activated" UBYTE NO_UNIT 1 100 0 1 ECU_ADDRESS 0xFEBECBBD /end MEASUREMENT
/begin MEASUREMENT sProt_OverTempActivated_gdu8 "Temperature protection channel activated" UBYTE NO_UNIT 1 100 0 1 ECU_ADDRESS 0xFEBECBBE /end MEASUREMENT
/begin MEASUREMENT sProtI_CurrentVoltageRange_gde "Provides the current voltage range" UBYTE NO_UNIT 1 100 0 4 ECU_ADDRESS 0xFEBECBBF /end MEASUREMENT
/begin MEASUREMENT sProtI_PowerSupplyTestState_gde "the status of vehicle power supply test" UBYTE NO_UNIT 1 100 0 255 ECU_ADDRESS 0xFEBECBC0 /end MEASUREMENT
/begin MEASUREMENT sProtI_StartupFinished_gdu8 "Startup finished indicator" UBYTE NO_UNIT 1 100 0 1 ECU_ADDRESS 0xFEBECBC1 /end MEASUREMENT
/begin MEASUREMENT tProt_DcLinkCapBuffer_gdu16 "Dc link cap time buffer in 001s step" UWORD NO_UNIT 1 100 0 20000 ECU_ADDRESS 0xFEBECBB0 /end MEASUREMENT
/begin MEASUREMENT tProt_TimeStampHighVolt_gdu16 "Holds the time stamp of High voltage occurance" UWORD NO_UNIT 1 100 0 65535 ECU_ADDRESS 0xFEBECBB2 /end MEASUREMENT
/begin MEASUREMENT tProt_TimeStampRecoverVolt_gdu16 "Holds the time stamp of Normal voltage occurance" UWORD NO_UNIT 1 100 0 65535 ECU_ADDRESS 0xFEBECBB4 /end MEASUREMENT
/begin MEASUREMENT xHwlI_RedPreWarnLevels_gau16 "Reduction pre-warning levels, that indicate how far a reduction is imminent." UWORD PERCENT_INT 1 100 0 100 ECU_ADDRESS 0xFEBEE158 MATRIX_DIM 10 1 1 /end MEASUREMENT
/begin MEASUREMENT xProtI_LocalRedLevels_gau16 "Array of reduction factors of local machine" UWORD PERCENT_INT 1 100 0 100 ECU_ADDRESS 0xFEBECBC4 MATRIX_DIM 10 1 1 /end MEASUREMENT
/begin MEASUREMENT xProtI_LocalRedPreWarnLevels_gau16 "torque reduction PreWarnimg Levels factor for all channels" UWORD PERCENT_INT 1 100 0 100 ECU_ADDRESS 0xFEBECBD8 MATRIX_DIM 10 1 1 /end MEASUREMENT
/begin MEASUREMENT yProt_IsFirstHighVoltEntry_gdu32 "First entry flag to set timestamp" UWORD NO_UNIT 1 100 0 1 ECU_ADDRESS 0xFEBECBB6 /end MEASUREMENT
/begin MEASUREMENT yProt_IsFirstNormalVoltEntry_gdu32 "First entry flag to set timestamp at normal voltage" UWORD NO_UNIT 1 100 0 1 ECU_ADDRESS 0xFEBECBB8 /end MEASUREMENT
/begin MEASUREMENT mSaf_SgTorque_gdf32 "Safety clipping torque" FLOAT32_IEEE TORQ_REAL 1 100 -12 12 ECU_ADDRESS 0xFEBECBEC /end MEASUREMENT
/begin MEASUREMENT mSafI_LocalLimitedTorqueSafe_gdf32 "Local limited torque after safety clipping" FLOAT32_IEEE TORQ_REAL 1 100 -12 12 ECU_ADDRESS 0xFEBECBF4 /end MEASUREMENT
/begin MEASUREMENT sSafI_ClippingActive_gdu8 "Active clipping flag" UBYTE NO_UNIT 1 100 0 1 ECU_ADDRESS 0xFEBECC18 /end MEASUREMENT
/begin MEASUREMENT xSaf_LossEnvelope_gdf32 "sudden loss envelope curve" FLOAT32_IEEE NO_UNIT 1 100 0 65535 ECU_ADDRESS 0xFEBECC00 /end MEASUREMENT
/begin MEASUREMENT xSaf_SgFactorSaSafe_gdu16 "Reduction SA safe factor" UWORD PERCENT_INT 1 100 0 32768 ECU_ADDRESS 0xFEBECC10 /end MEASUREMENT
/begin MEASUREMENT xSaf_SgFactorSloaSafe_gdu16 "Reduction SLoA safe factor" UWORD PERCENT_INT 1 100 0 32768 ECU_ADDRESS 0xFEBECC12 /end MEASUREMENT
/begin MEASUREMENT xSafI_LimitSloaFactor_gdu16 "Actual relative SLoA factor" UWORD PERCENT_INT 1 100 0 100 ECU_ADDRESS 0xFEBECC14 /end MEASUREMENT
/begin MEASUREMENT xSafI_LocalLimitedFactorSafe_gdu16 "Local reduction factor after safety clipping" UWORD PERCENT_INT 1 100 0 100 ECU_ADDRESS 0xFEBECC16 /end MEASUREMENT
/begin MEASUREMENT mHwlI_LimitedMotorTorque_gdf32 "Limited motor torque HwLib" FLOAT32_IEEE TORQ_REAL 1 100 -12 12 ECU_ADDRESS 0xFEBEAB68 /end MEASUREMENT
/begin MEASUREMENT mPrmI_LimitedMotorTorque_gdf32 "Limited motor torque local machine" FLOAT32_IEEE TORQ_REAL 1 100 -12 12 ECU_ADDRESS 0xFEBEAB6C /end MEASUREMENT
/begin MEASUREMENT xSscI_StickSlipFact_gdu16 "Shows the activity of stick slip mode (0%->SSWarnTorque active)" UWORD PERCENT_INT 1 100 0 100 ECU_ADDRESS 0xFEBEAB70 /end MEASUREMENT
/begin MEASUREMENT mTlcI_LocalLimitedTorque_gdf32 "Local limited motor torque" FLOAT32_IEEE TORQ_REAL 1 100 -12 12 ECU_ADDRESS 0xFEBECC28 /end MEASUREMENT
/begin MEASUREMENT mToLiCo_CogCompTorque_gdf32 "cogging compansation torque only for (measurement)" FLOAT32_IEEE TORQ_REAL 1 100 -0.025 0.025 ECU_ADDRESS 0xFEBEED84 /end MEASUREMENT
/begin MEASUREMENT xHwlI_MaxRequestedRedFact_gdu16 "Overall limitation factor if MaxUsableTorque is requested" UWORD PERCENT_INT 1 100 0 100 ECU_ADDRESS 0xFEBEE16C /end MEASUREMENT
/begin MEASUREMENT xHwlI_MinRedLevel_gdu16 "Current minimum reduction factor of interface xHwlI_TorqueRedLevels_gau16." UWORD PERCENT_INT 1 100 0 100 ECU_ADDRESS 0xFEBEE16E /end MEASUREMENT
/begin MEASUREMENT xPrmI_MaxRequestedRedFact_gdu16 "Local limitation factor if MaxUsableTorque is requested" UWORD PERCENT_INT 1 100 0 100 ECU_ADDRESS 0xFEBEE170 /end MEASUREMENT
/begin MEASUREMENT xTlcI_LocalLimitedFactor_gdu16 "Lowest reduction value" UWORD PERCENT_INT 1 100 0 100 ECU_ADDRESS 0xFEBECC44 /end MEASUREMENT
/begin MEASUREMENT xToLiCo_LocalLimitedClip_gdu16 "Lowest clip value" UWORD PERCENT_INT 1 100 0 100 ECU_ADDRESS 0xFEBECC46 /end MEASUREMENT
/begin MEASUREMENT mHwlI_MaxUsableTorque_gdf32 "Motor torque which can be provided by the system. Including the max. Boost Torque" FLOAT32_IEEE TORQ_REAL 1 100 0 12 ECU_ADDRESS 0xFEBEE174 /end MEASUREMENT
/begin MEASUREMENT mHwlI_MaxUsableTorqueGen_gdf32 "Maximum usable motor torque generatoric" FLOAT32_IEEE TORQ_REAL 1 100 0 12 ECU_ADDRESS 0xFEBEE178 /end MEASUREMENT
/begin MEASUREMENT mPrmI_MaxFeasibleTorque_gdf32 "Maximum feasible motor torque motoric" FLOAT32_IEEE TORQ_REAL 1 100 0 12 ECU_ADDRESS 0xFEBECC60 /end MEASUREMENT
/begin MEASUREMENT mPrmI_MaxFeasibleTorqueGen_gdf32 "Maximum feasible motor torque generatoric" FLOAT32_IEEE TORQ_REAL 1 100 0 12 ECU_ADDRESS 0xFEBECC68 /end MEASUREMENT
/begin MEASUREMENT mTmcI_LocalClippingTorques_gaf32 "Actual local clipped motor torques (index 0: max usable, index 1: mech)" FLOAT32_IEEE TORQ_REAL 1 100 0 12 ECU_ADDRESS 0xFEBECC48 MATRIX_DIM 2 1 1 /end MEASUREMENT
/begin MEASUREMENT mTmcI_LocalClippingTorquesGen_gaf32 "Actual local clipped motor torques generatoric (index 0: max usable, index 1: mech)" FLOAT32_IEEE TORQ_REAL 1 100 0 12 ECU_ADDRESS 0xFEBECC50 MATRIX_DIM 2 1 1 /end MEASUREMENT
/begin MEASUREMENT mTmcI_LocalMaxUsableTorque_gdf32 "Actual local maximum usable motor torque" FLOAT32_IEEE TORQ_REAL 1 100 0 12 ECU_ADDRESS 0xFEBECC70 /end MEASUREMENT
/begin MEASUREMENT mTmcI_LocalMaxUsableTorqueGen_gdf32 "Actual local maximum usable motor torque" FLOAT32_IEEE TORQ_REAL 1 100 0 12 ECU_ADDRESS 0xFEBECC78 /end MEASUREMENT
/begin MEASUREMENT sTmcI_RedClipActive_gdu8 "Flag to signal active reduction or clipping (limit)" UBYTE NO_UNIT 1 100 0 1 ECU_ADDRESS 0xFEBECC84 /end MEASUREMENT
/begin MEASUREMENT xHwlI_TorqueClipLevels_gau16 "Array of all torque clipping reduction channels" UWORD PERCENT_INT 1 100 0 100 ECU_ADDRESS 0xFEBEE17C MATRIX_DIM 2 1 1 /end MEASUREMENT
/begin MEASUREMENT xHwlI_TorqueRedLevels_gau16 "Array of all torque factor reduction channels" UWORD PERCENT_INT 1 100 0 100 ECU_ADDRESS 0xFEBEE180 MATRIX_DIM 10 1 1 /end MEASUREMENT
/begin MEASUREMENT xTmcI_LocalClipLevels_gau16 "Array of reduction clipped values of local machine" UWORD PERCENT_INT 1 100 0 100 ECU_ADDRESS 0xFEBECC80 MATRIX_DIM 2 1 1 /end MEASUREMENT
/begin MEASUREMENT aRpcCalcI_RotorAcceleration_gdf32 "Rotor acceleration (RPC internal)" FLOAT32_IEEE ANG_ACCEL_REAL 1 100 -52360 52360 ECU_ADDRESS 0xFEBECCA8 /end MEASUREMENT
/begin MEASUREMENT nRpcCalc_LastRotSpeedFilt_gdf32 "Save the last filtered rotor speed for acceleration calculation" FLOAT32_IEEE ANG_VEL_REAL 1 100 -1047 1047 ECU_ADDRESS 0xFEBECCB0 /end MEASUREMENT
/begin MEASUREMENT nRpcCalc_RotorSpeed_gdf32 "Rotorspeed (RPC internal)" FLOAT32_IEEE ANG_VEL_REAL 1 100 -1047 1047 ECU_ADDRESS 0xFEBECCB8 /end MEASUREMENT
/begin MEASUREMENT nRpcCalc_RotorSpeedBufferIsr_gaf32 "This varibale stores the actual rotorspeed of all ISRs for the RotSpeedAvg filt calculation" FLOAT32_IEEE ANG_VEL_REAL 1 100 -1047 1047 ECU_ADDRESS 0xFEBECD1C MATRIX_DIM 4 1 1 /end MEASUREMENT
/begin MEASUREMENT nRpcCalc_RotSpeedAvgFltIsr_gdf32 "Average-filtered rotor speed (valid in ISR)" FLOAT32_IEEE ANG_VEL_REAL 1 100 -1047 1047 ECU_ADDRESS 0xFEBECCC4 /end MEASUREMENT
/begin MEASUREMENT nRpcCalcI_RotorSpeedAvgFilt_gdf32 "Average-filtered rotor speed (valid in Task context)" FLOAT32_IEEE ANG_VEL_REAL 1 100 -1047 1047 ECU_ADDRESS 0xFEBECCCC /end MEASUREMENT
/begin MEASUREMENT nRpcCalcI_RotorSpeedFilt_gdf32 "Rotorspeed filtered (RPC internal)" FLOAT32_IEEE ANG_VEL_REAL 1 100 -1047 1047 ECU_ADDRESS 0xFEBECCD4 /end MEASUREMENT
/begin MEASUREMENT nRpcI_RotorSpeedIsr_gdf32 "Rotor speed (valid in interrupt context)" FLOAT32_IEEE NO_UNIT 1 100 -1047 1047 ECU_ADDRESS 0xFEBECCDC /end MEASUREMENT
/begin MEASUREMENT sRpcCalc_StartRpcInit_gdu8 "Flag for Rpc init function" UBYTE NO_UNIT 1 100 0 1 ECU_ADDRESS 0xFEBECD16 /end MEASUREMENT
/begin MEASUREMENT sRpcCalcI_InitState_gde "Current state of the RPC init phase" SBYTE NO_UNIT 1 100 0 2 ECU_ADDRESS 0xFEBECD17 /end MEASUREMENT
/begin MEASUREMENT sRpcCalcI_RotorPositionState_gde "Validity state of the previous rotor position" UWORD NO_UNIT 1 100 0 32776 ECU_ADDRESS 0xFEBECD14 /end MEASUREMENT
/begin MEASUREMENT tRpcCalc_SearchTime_gau16 "Current search time for min max values " UWORD T_MS 1 100 0 65535 ECU_ADDRESS 0xFEBEED88 MATRIX_DIM 1 1 1 /end MEASUREMENT
/begin MEASUREMENT tRpcCalc_TimerInitState_gdu8 "Timer for amplitude controller in init phase" UBYTE NO_UNIT 1 100 0 255 ECU_ADDRESS 0xFEBECD18 /end MEASUREMENT
/begin MEASUREMENT uRpcCalcI_VectorLength_gaf32 "Current vector length " FLOAT32_IEEE VOLT_REAL 1 100 0 3.3 ECU_ADDRESS 0xFEBECC88 MATRIX_DIM 2 1 1 /end MEASUREMENT
/begin MEASUREMENT wRpcCalc_IndividCompCorrIsr_gdf32 "Compensated difference of angle" FLOAT32_IEEE ANG_RAD_REAL 1 100 -3.14 3.14 ECU_ADDRESS 0xFEBECCE4 /end MEASUREMENT
/begin MEASUREMENT wRpcCalc_RotSensorPosIsr_gdf32 "Position of the sensor valid in ISR context" FLOAT32_IEEE ANG_RAD_REAL 1 100 0 6.283185 ECU_ADDRESS 0xFEBECCE8 /end MEASUREMENT
/begin MEASUREMENT wRpcCalc_SaveLastRotPosIsr_gdf32 "Last rotor position for rotor speed calculation" FLOAT32_IEEE ANG_RAD_REAL 1 100 0 6.2831853 ECU_ADDRESS 0xFEBECCF0 /end MEASUREMENT
/begin MEASUREMENT wRpcCalcI_RotorPosition_gdf32 "Rotor position (RPC internal)" FLOAT32_IEEE ANG_RAD_REAL 1 100 0 6.28319 ECU_ADDRESS 0xFEBECCF8 /end MEASUREMENT
/begin MEASUREMENT wRpcCalcI_RotorSensorPosition_gdf32 "Rotor sensor position without mechanical offset and compensations (RPC internal)" FLOAT32_IEEE ANG_RAD_REAL 1 100 0 6.28319 ECU_ADDRESS 0xFEBECD00 /end MEASUREMENT
/begin MEASUREMENT wRpcI_RotorPositionIsr_gdf32 "Rotor position valid in ISR context" FLOAT32_IEEE ANG_RAD_REAL 1 100 0 6.283185 ECU_ADDRESS 0xFEBECD08 /end MEASUREMENT
/begin MEASUREMENT xRpcCalc_CurrentRatio_gaf32 "Current Ratio between sine and cosine amplitude" FLOAT32_IEEE NO_UNIT 1 100 -1 1 ECU_ADDRESS 0xFEBECD10 MATRIX_DIM 1 1 1 /end MEASUREMENT
/begin MEASUREMENT uRpcDiag_CurrentOffsetCos_gaf32 "Calculated cosine offset of halfbridge signals in V" FLOAT32_IEEE VOLT_REAL 1 100 -6.6 6.6 ECU_ADDRESS 0xFEBECDA0 MATRIX_DIM 1 1 1 /end MEASUREMENT
/begin MEASUREMENT uRpcDiag_CurrentOffsetSin_gaf32 "Calculated sine offset of halfbridge signals in V" FLOAT32_IEEE VOLT_REAL 1 100 -6.6 6.6 ECU_ADDRESS 0xFEBECDA4 MATRIX_DIM 1 1 1 /end MEASUREMENT
/begin MEASUREMENT yRpcDiagI_FailureValue_gae "Failure value of RPC diagnosis" SLONG NO_UNIT 1 100 0 131071 ECU_ADDRESS 0xFEBECDA8 MATRIX_DIM 1 1 1 /end MEASUREMENT
/begin MEASUREMENT yRpcDiagI_SaveAllFailures_gau32 "Save all failures over clamp 15 cycle" ULONG NO_UNIT 1 100 0 131071 ECU_ADDRESS 0xFEBEED8C MATRIX_DIM 1 1 1 /end MEASUREMENT
/begin MEASUREMENT aHwlI_RotorAcceleration_gdf32 "Filtered Rotor acceleration" FLOAT32_IEEE ANG_ACCEL_REAL 1 100 -52360 52360 ECU_ADDRESS 0xFEBEE194 /end MEASUREMENT
/begin MEASUREMENT nHwlI_RotorSpeed_gdf32 "Average of the two previous calculated rotor speed in ISR [500us] provided in 1ms-task" FLOAT32_IEEE ANG_VEL_REAL 1 100 -1047 1047 ECU_ADDRESS 0xFEBEE198 /end MEASUREMENT
/begin MEASUREMENT nHwlI_RotorSpeedFilt_gdf32 "Filtered rotor speed" FLOAT32_IEEE ANG_VEL_REAL 1 100 -1047 1047 ECU_ADDRESS 0xFEBEE19C /end MEASUREMENT
/begin MEASUREMENT sHwlI_RotorAccelerationState_gde "Validity state of the rotor acceleration" UWORD NO_UNIT 1 100 0 32772 ECU_ADDRESS 0xFEBEE1A0 /end MEASUREMENT
/begin MEASUREMENT sHwlI_RotorPositionState_gde "Validity state of the rotor position" UWORD NO_UNIT 1 100 0 32776 ECU_ADDRESS 0xFEBEE1A2 /end MEASUREMENT
/begin MEASUREMENT sHwlI_RotorSpeedState_gde "Validity state of the rotor speed" UWORD NO_UNIT 1 100 0 32772 ECU_ADDRESS 0xFEBEE1A4 /end MEASUREMENT
/begin MEASUREMENT sRpcFsa_FaultIndState_gde "RPC fault indication state" SBYTE NO_UNIT 1 100 0 7 ECU_ADDRESS 0xFEBECDEA /end MEASUREMENT
/begin MEASUREMENT sRpcFsa_RotorAccState_gde "Validity state of the rotor acceleration" UWORD NO_UNIT 1 100 0 32772 ECU_ADDRESS 0xFEBECDE4 /end MEASUREMENT
/begin MEASUREMENT sRpcFsa_RotorPositionState_gde "Validity state of the rotor position" UWORD NO_UNIT 1 100 0 32776 ECU_ADDRESS 0xFEBECDE6 /end MEASUREMENT
/begin MEASUREMENT sRpcFsa_RotorSpeedState_gde "Validity state of the rotor speed" UWORD NO_UNIT 1 100 0 32772 ECU_ADDRESS 0xFEBECDE8 /end MEASUREMENT
/begin MEASUREMENT sRpcI_FaultIndicationState_gde "RPC fault indication state" SBYTE NO_UNIT 1 100 0 127 ECU_ADDRESS 0xFEBECDEB /end MEASUREMENT
/begin MEASUREMENT uRpcFsa_AmbCondAdcCosN_gdu16 "Local variable for ambient conditions" UWORD NO_UNIT 1 100 0 65535 ECU_ADDRESS 0xFEBEED90 /end MEASUREMENT
/begin MEASUREMENT uRpcFsa_AmbCondAdcCosP_gdu16 "Local variable for ambient conditions" UWORD NO_UNIT 1 100 0 65535 ECU_ADDRESS 0xFEBEED92 /end MEASUREMENT
/begin MEASUREMENT uRpcFsa_AmbCondAdcSinN_gdu16 "Local variable for ambient conditions" UWORD NO_UNIT 1 100 0 65535 ECU_ADDRESS 0xFEBEED94 /end MEASUREMENT
/begin MEASUREMENT uRpcFsa_AmbCondAdcSinP_gdu16 "Local variable for ambient conditions" UWORD NO_UNIT 1 100 0 65535 ECU_ADDRESS 0xFEBEED96 /end MEASUREMENT
/begin MEASUREMENT uRpcFsa_AmbCondCos_gdu16 "Local variable for ambient conditions" UWORD NO_UNIT 1 100 0 65535 ECU_ADDRESS 0xFEBEED98 /end MEASUREMENT
/begin MEASUREMENT uRpcFsa_AmbCondCurOffCos_gds16 "Local variable for ambient conditions" SWORD NO_UNIT 1 100 -17800 17800 ECU_ADDRESS 0xFEBEED9A /end MEASUREMENT
/begin MEASUREMENT uRpcFsa_AmbCondCurOffSin_gds16 "Local variable for ambient conditions" SWORD NO_UNIT 1 100 -17800 17800 ECU_ADDRESS 0xFEBEED9C /end MEASUREMENT
/begin MEASUREMENT uRpcFsa_AmbCondRotSensPos_gdu16 "Local variable for ambient conditions" UWORD NO_UNIT 1 100 0 65535 ECU_ADDRESS 0xFEBEED9E /end MEASUREMENT
/begin MEASUREMENT uRpcFsa_AmbCondSin_gdu16 "Local variable for ambient conditions" UWORD NO_UNIT 1 100 0 65535 ECU_ADDRESS 0xFEBEEDA0 /end MEASUREMENT
/begin MEASUREMENT uRpcFsa_AmbCondVecLen_gdu16 "Local variable for ambient conditions" UWORD NO_UNIT 1 100 0 65535 ECU_ADDRESS 0xFEBEEDA2 /end MEASUREMENT
/begin MEASUREMENT wRpcI_RotorPosition_gdf32 "Mechanical rotor position" FLOAT32_IEEE ANG_RAD_REAL 1 100 0 6.283185 ECU_ADDRESS 0xFEBECDCC /end MEASUREMENT
/begin MEASUREMENT wRpcI_RotorSensorPosition_gdf32 "Current sensor position (valid in task context)" FLOAT32_IEEE ANG_RAD_REAL 1 100 0 6.283185 ECU_ADDRESS 0xFEBECDD4 /end MEASUREMENT
/begin MEASUREMENT zRpcFsa_CurrentDebounceVal_gau8 "Current debounce value of RPC failures for HWLMON_ROTPOS1_SIGNAL_VECTOR, HWLMON_ROTPOS1_SIGNAL_OFFSET, HWLMON_ROTPOS2_SIGNAL_VECTOR not used in SingleRps, HWLMON_ROTPOS2_SIGNAL_OFFSET not used in SingleRps" UBYTE NO_UNIT 1 100 0 255 ECU_ADDRESS 0xFEBECDDC MATRIX_DIM 4 1 1 /end MEASUREMENT
/begin MEASUREMENT sRpcPlausiI_State_gde "Current state of RPC SW plausibilisation" UBYTE NO_UNIT 1 100 0 17 ECU_ADDRESS 0xFEBECE00 /end MEASUREMENT
/begin MEASUREMENT mStcPasCalcI_MaxMechTorsBarTorque_gau16 "Maximum mechanical torsion bar torque based on the maximum possible mechanical twist angle." UWORD TORQ_INT 1 100 0 26.25 ECU_ADDRESS 0xFEBECE04 MATRIX_DIM 2 1 1 /end MEASUREMENT
/begin MEASUREMENT mStcPasCalcI_MaxTorsBarTorque_gau16 "Maximun Range Limit for TorsionBarTorque" UWORD TORQ_INT 1 100 0 23.625 ECU_ADDRESS 0xFEBECE0C MATRIX_DIM 2 1 1 /end MEASUREMENT
/begin MEASUREMENT mStcPasCalcI_TorsionBarTorque_gas16 "" SWORD TORQ_INT 1 100 -10 10 ECU_ADDRESS 0xFEBECE14 MATRIX_DIM 2 1 1 /end MEASUREMENT
/begin MEASUREMENT sStcPasCalcI_Mode_gae "" UBYTE NO_UNIT 1 100 1 15 ECU_ADDRESS 0xFEBECE84 MATRIX_DIM 2 1 1 /end MEASUREMENT
/begin MEASUREMENT tStcPasCalcI_LocalTimestampOffset_gdu16 "local timestamp offset between the DMA sample time and 0th OS valley time" UWORD T_US 1 100 0 65535 ECU_ADDRESS 0xFEBEEDA8 /end MEASUREMENT
/begin MEASUREMENT tStcPasCalcI_SensDataTimestamp_gdu16 "sensor data timestamp of local SCU" UWORD T_US 1 100 0 65535 ECU_ADDRESS 0xFEBEEDAA /end MEASUREMENT
/begin MEASUREMENT wStcPasCalcI_TanAgOffset_gas16 "" SWORD ANG_RAD_REAL 1 100 -1024 1023 ECU_ADDRESS 0xFEBECE20 MATRIX_DIM 2 1 1 /end MEASUREMENT
/begin MEASUREMENT yStcPasCalc_CalcdChks_gau16 "Checksum calculated from received Raw data" UWORD NO_UNIT 1 100 0 65535 ECU_ADDRESS 0xFEBECE24 MATRIX_DIM 2 1 1 /end MEASUREMENT
/begin MEASUREMENT yStcPasCalc_FildTorqueRd_gau16 "Filtered Torque Radius" UWORD NO_UNIT 1 100 0 1650 ECU_ADDRESS 0xFEBECE28 MATRIX_DIM 2 1 1 /end MEASUREMENT
/begin MEASUREMENT yStcPasCalc_LogisticData_gau16 "Logistic data from the received init values" UWORD NO_UNIT 1 100 0 65535 ECU_ADDRESS 0xFEBECE2C MATRIX_DIM 2 1 1 /end MEASUREMENT
/begin MEASUREMENT yStcPasCalc_ProdDate_gau16 "Production date from the received init value" UWORD NO_UNIT 1 100 0 65535 ECU_ADDRESS 0xFEBECE30 MATRIX_DIM 2 1 1 /end MEASUREMENT
/begin MEASUREMENT yStcPasCalc_RxdChks_gau16 "Received Checksum value" UWORD NO_UNIT 1 100 0 65535 ECU_ADDRESS 0xFEBECE34 MATRIX_DIM 2 1 1 /end MEASUREMENT
/begin MEASUREMENT yStcPasCalc_SnsrCorrnFac_gas16 "Received sensor stiffness corection factor" SWORD NO_UNIT 1 100 -2048 2047 ECU_ADDRESS 0xFEBECE38 MATRIX_DIM 2 1 1 /end MEASUREMENT
/begin MEASUREMENT yStcPasCalcI_AmpRatio_gas16 "" SWORD NO_UNIT 1 100 896 1151 ECU_ADDRESS 0xFEBECE40 MATRIX_DIM 2 1 1 /end MEASUREMENT
/begin MEASUREMENT yStcPasCalcI_Calibration_gau8 "" UBYTE NO_UNIT 1 100 0 3 ECU_ADDRESS 0xFEBECE86 MATRIX_DIM 2 1 1 /end MEASUREMENT
/begin MEASUREMENT yStcPasCalcI_CosCentr_gas8 "" SBYTE NO_UNIT 1 100 -128 127 ECU_ADDRESS 0xFEBECE88 MATRIX_DIM 2 1 1 /end MEASUREMENT
/begin MEASUREMENT yStcPasCalcI_CosineValue_gas16 "" SWORD NO_UNIT 1 100 -2048 2047 ECU_ADDRESS 0xFEBECE48 MATRIX_DIM 2 1 1 /end MEASUREMENT
/begin MEASUREMENT yStcPasCalcI_CosOffset_gas16 "" SWORD NO_UNIT 1 100 -2048 2048 ECU_ADDRESS 0xFEBECE4C MATRIX_DIM 2 1 1 /end MEASUREMENT
/begin MEASUREMENT yStcPasCalcI_InitSnsrDataCrc_gau16 "Critical sensor data CRC calculated during Init mode" UWORD NO_UNIT 1 100 0 65535 ECU_ADDRESS 0xFEBECE50 MATRIX_DIM 2 1 1 /end MEASUREMENT
/begin MEASUREMENT yStcPasCalcI_MaxTorqueRd_gau16 "" UWORD NO_UNIT 1 100 0 1650 ECU_ADDRESS 0xFEBECE58 MATRIX_DIM 2 1 1 /end MEASUREMENT
/begin MEASUREMENT yStcPasCalcI_MinTorqueRd_gau16 "" UWORD NO_UNIT 1 100 0 1650 ECU_ADDRESS 0xFEBECE60 MATRIX_DIM 2 1 1 /end MEASUREMENT
/begin MEASUREMENT yStcPasCalcI_RcvdCosineValue_gas16 "" SWORD NO_UNIT 1 100 -1024 1024 ECU_ADDRESS 0xFEBECE68 MATRIX_DIM 2 1 1 /end MEASUREMENT
/begin MEASUREMENT yStcPasCalcI_RcvdSineValue_gas16 "" SWORD NO_UNIT 1 100 -1024 1024 ECU_ADDRESS 0xFEBECE6C MATRIX_DIM 2 1 1 /end MEASUREMENT
/begin MEASUREMENT yStcPasCalcI_SinCentr_gas8 "" SBYTE NO_UNIT 1 100 -128 127 ECU_ADDRESS 0xFEBECE8A MATRIX_DIM 2 1 1 /end MEASUREMENT
/begin MEASUREMENT yStcPasCalcI_SineValue_gas16 "" SWORD NO_UNIT 1 100 -2048 2047 ECU_ADDRESS 0xFEBECE70 MATRIX_DIM 2 1 1 /end MEASUREMENT
/begin MEASUREMENT yStcPasCalcI_SinOffset_gas16 "" SWORD NO_UNIT 1 100 -2048 2048 ECU_ADDRESS 0xFEBECE74 MATRIX_DIM 2 1 1 /end MEASUREMENT
/begin MEASUREMENT yStcPasCalcI_TorqueRadius_gau16 "" UWORD NO_UNIT 1 100 0 1650 ECU_ADDRESS 0xFEBECE78 MATRIX_DIM 2 1 1 /end MEASUREMENT
/begin MEASUREMENT yStcPasCalcI_TorsBarStfn_gau16 "torsionbar stiffness value" UWORD TORQ_STIFF_INT 1 100 1.5 3.5 ECU_ADDRESS 0xFEBECE7C MATRIX_DIM 2 1 1 /end MEASUREMENT
/begin MEASUREMENT mStcPasDiag_PrevTorsBarTorque_gas16 "contains previous cycle calculated torsionbar torque" SWORD TORQ_INT 1 100 -10 10 ECU_ADDRESS 0xFEBECEDC MATRIX_DIM 2 1 1 /end MEASUREMENT
/begin MEASUREMENT sStcPasDiag_AsicLowVoltState_gdu32 "ASIC Low Power Status" ULONG NO_UNIT 1 100 0 255 ECU_ADDRESS 0xFEBEEDAC /end MEASUREMENT
/begin MEASUREMENT sStcPasDiag_PtcolFltExecInfo_gau16 "protocol fault execution status" UWORD NO_UNIT 1 100 0 65535 ECU_ADDRESS 0xFEBECEE4 MATRIX_DIM 2 1 1 /end MEASUREMENT
/begin MEASUREMENT sStcPasDiag_PtcolFltInfo_gau16 "Contains the pas protocol fault information" UWORD NO_UNIT 1 100 0 2047 ECU_ADDRESS 0xFEBECEE8 MATRIX_DIM 2 1 1 /end MEASUREMENT
/begin MEASUREMENT sStcPasDiag_RadiusFltExecInfo_gau16 "radius fault execution status" UWORD NO_UNIT 1 100 0 65535 ECU_ADDRESS 0xFEBECEEC MATRIX_DIM 2 1 1 /end MEASUREMENT
/begin MEASUREMENT sStcPasDiag_RadiusFltInfo_gau16 "Contains the fault information about radius signal" UWORD NO_UNIT 1 100 0 64 ECU_ADDRESS 0xFEBECEF0 MATRIX_DIM 2 1 1 /end MEASUREMENT
/begin MEASUREMENT sStcPasDiag_ReleaseStartup_gdu8 "Release for STC PAS calculation from Startup coordinator" UBYTE NO_UNIT 1 100 0 1 ECU_ADDRESS 0xFEBECF34 /end MEASUREMENT
/begin MEASUREMENT sStcPasDiag_SkipSplyDiag_gau8 "The variable is used to skip the diagnosic for 1ms during VddPas supply ON" UBYTE NO_UNIT 1 100 0 255 ECU_ADDRESS 0xFEBECF14 MATRIX_DIM 2 1 1 /end MEASUREMENT
/begin MEASUREMENT sStcPasDiag_SnsrSplyFltExecInfo_gau16 "sensor supply fault execution status" UWORD NO_UNIT 1 100 0 65535 ECU_ADDRESS 0xFEBECEF8 MATRIX_DIM 2 1 1 /end MEASUREMENT
/begin MEASUREMENT sStcPasDiag_TorqueFltExecInfo_gau16 "torque fault execution status" UWORD NO_UNIT 1 100 0 65535 ECU_ADDRESS 0xFEBECEFC MATRIX_DIM 2 1 1 /end MEASUREMENT
/begin MEASUREMENT sStcPasDiag_TorqueFltInfo_gau16 "Contains torque diagnosis fault information" UWORD NO_UNIT 1 100 0 64 ECU_ADDRESS 0xFEBECF00 MATRIX_DIM 2 1 1 /end MEASUREMENT
/begin MEASUREMENT sStcPasDiag_VddPasDiagFlags_gae "Sensor supply diagnostic status " SLONG NO_UNIT 1 100 0 805306367 ECU_ADDRESS 0xFEBECED4 MATRIX_DIM 2 1 1 /end MEASUREMENT
/begin MEASUREMENT sStcPasDiagI_BattUnderVoltState_gde "Battery Voltage Range Information" UBYTE NO_UNIT 1 100 0 1 ECU_ADDRESS 0xFEBECF35 /end MEASUREMENT
/begin MEASUREMENT sStcPasDiagI_CheckDiagUnAssmSnsr_gau8 "" UBYTE NO_UNIT 1 100 0 1 ECU_ADDRESS 0xFEBECF16 MATRIX_DIM 2 1 1 /end MEASUREMENT
/begin MEASUREMENT sStcPasDiagI_OperationMode_gde "" UBYTE NO_UNIT 1 100 0 7 ECU_ADDRESS 0xFEBECF18 MATRIX_DIM 2 1 1 /end MEASUREMENT
/begin MEASUREMENT sStcPasDiagI_SnsrSplyFltInfo_gau16 "" UWORD NO_UNIT 1 100 0 1024 ECU_ADDRESS 0xFEBECF08 MATRIX_DIM 2 1 1 /end MEASUREMENT
/begin MEASUREMENT sStcPasDiagI_SnsrSplyState_gae "Contains the status of sensor supply status" UBYTE NO_UNIT 1 100 1 4 ECU_ADDRESS 0xFEBECF1A MATRIX_DIM 2 1 1 /end MEASUREMENT
/begin MEASUREMENT sStcPasDiagI_State_gae "" UBYTE NO_UNIT 1 100 0 3 ECU_ADDRESS 0xFEBECF1C MATRIX_DIM 2 1 1 /end MEASUREMENT
/begin MEASUREMENT tStcPasDiag_PtcolFltTime_gau8 "Time debounced for pas protocol error" UBYTE T_MS 1 100 0 36 ECU_ADDRESS 0xFEBECF1E MATRIX_DIM 2 1 1 /end MEASUREMENT
/begin MEASUREMENT tStcPasDiag_RadiusFltTime_gau8 "Debounced time for radius fault for torque sensor using pas protocol" UBYTE T_MS 1 100 0 36 ECU_ADDRESS 0xFEBECF20 MATRIX_DIM 2 1 1 /end MEASUREMENT
/begin MEASUREMENT tStcPasDiag_SnsrSplyFltTime_gau8 "Error filter time for sensor supply diagnosis in ms" UBYTE T_MS 1 100 0 36 ECU_ADDRESS 0xFEBECF22 MATRIX_DIM 2 1 1 /end MEASUREMENT
/begin MEASUREMENT tStcPasDiag_TorqueFltTime_gau8 "Time debounced for torque signal error" UBYTE T_MS 1 100 0 0 ECU_ADDRESS 0xFEBECF24 MATRIX_DIM 2 1 1 /end MEASUREMENT
/begin MEASUREMENT yStcPasDiag_FltUnit_gau8 "Tracks in which unit (SnsrSply, Torque, ...) an error occurred" UBYTE NO_UNIT 1 100 0 255 ECU_ADDRESS 0xFEBECF26 MATRIX_DIM 2 1 1 /end MEASUREMENT
/begin MEASUREMENT yStcPasDiag_FrameCalcChks_gau8 "Calculated check sum for the data received in all four sub frames" UBYTE NO_UNIT 1 100 0 255 ECU_ADDRESS 0xFEBECF28 MATRIX_DIM 2 1 1 /end MEASUREMENT
/begin MEASUREMENT yStcPasDiag_FrameRcvdChks_gau8 "Received Checksum for all four sub frames" UBYTE NO_UNIT 1 100 0 255 ECU_ADDRESS 0xFEBECF2A MATRIX_DIM 2 1 1 /end MEASUREMENT
/begin MEASUREMENT yStcPasDiag_SnsrOcHist_gau8 "Flag to keep track of healing for open circuit" UBYTE NO_UNIT 1 100 0 255 ECU_ADDRESS 0xFEBECF2C MATRIX_DIM 2 1 1 /end MEASUREMENT
/begin MEASUREMENT yStcPasDiag_UVOccur_gau8 "contains UBAT under voltage state" UBYTE NO_UNIT 1 100 0 1 ECU_ADDRESS 0xFEBECF2E MATRIX_DIM 2 1 1 /end MEASUREMENT
/begin MEASUREMENT zStcPasDiag_SkipSupplyDiagCnt_gau8 "Counter for skipping sensor supply diag at startup" UBYTE NO_UNIT 1 100 0 10 ECU_ADDRESS 0xFEBECF30 MATRIX_DIM 2 1 1 /end MEASUREMENT
/begin MEASUREMENT zStcPasDiag_UvClearCounter_gau8 "under voltage flag from asic clear status" UBYTE NO_UNIT 1 100 0 1 ECU_ADDRESS 0xFEBECF32 MATRIX_DIM 2 1 1 /end MEASUREMENT
/begin MEASUREMENT mHwlI_TorsionBarTorque_gds16 "Torsion bar torque" SWORD TORQ_INT 1 100 -25 25 ECU_ADDRESS 0xFEBEE1AC /end MEASUREMENT
/begin MEASUREMENT mHwlI_TorsionBarTorqueRed_gds16 "Torsion Bar Torque of the passive TBT sensor." SWORD TORQ_INT 1 100 -25 25 ECU_ADDRESS 0xFEBEE1AE /end MEASUREMENT
/begin MEASUREMENT mStcPasFsa_PrevTrq_gas16 "To hold the Previous Torsion Bar TRQ" SWORD TORQ_INT 1 100 -10 10 ECU_ADDRESS 0xFEBECFC8 MATRIX_DIM 2 1 1 /end MEASUREMENT
/begin MEASUREMENT mStcPasFsa_PrevTrqRed_gas16 "To hold the Previous Torsion BarRed TRQ" SWORD TORQ_INT 1 100 -10 10 ECU_ADDRESS 0xFEBECFD0 MATRIX_DIM 2 1 1 /end MEASUREMENT
/begin MEASUREMENT mStcPasFsa_StimTorsionBarTorque_gds16 "" SWORD TORQ_INT 1 100 -20 20 ECU_ADDRESS 0xFEBED004 /end MEASUREMENT
/begin MEASUREMENT sHwlI_TorsionBarTorqueState_gde "Validity state of the torsion bar torque" UWORD NO_UNIT 1 100 0 32895 ECU_ADDRESS 0xFEBEE1B0 /end MEASUREMENT
/begin MEASUREMENT sStcI_FaultIndicationState_gde "fault indication state of STC" UBYTE NO_UNIT 1 100 0 7 ECU_ADDRESS 0xFEBED006 /end MEASUREMENT
/begin MEASUREMENT sStcPasFsa_ActvChn_gde "" UBYTE NO_UNIT 1 100 0 255 ECU_ADDRESS 0xFEBED007 /end MEASUREMENT
/begin MEASUREMENT sStcPasFsaI_ReleaseDiag_gdu8 "Release Diag" UBYTE NO_UNIT 1 100 0 1 ECU_ADDRESS 0xFEBED008 /end MEASUREMENT
/begin MEASUREMENT sStcPasFsaI_StcSucooRelEnbl_gdu8 "" UBYTE NO_UNIT 1 100 0 1 ECU_ADDRESS 0xFEBED009 /end MEASUREMENT
/begin MEASUREMENT sStcPasFsaI_TbtPermInvalid_gde "Torsion bar torque permanaent invalid flag" UBYTE NO_UNIT 1 100 0 1 ECU_ADDRESS 0xFEBED00A /end MEASUREMENT
/begin MEASUREMENT sStcPasFsaI_TorsionBarTorqueStimState_gde "" UBYTE NO_UNIT 1 100 0 1 ECU_ADDRESS 0xFEBED00B /end MEASUREMENT
/begin MEASUREMENT tHwlI_TorsionBarTorqueSampleTime_gdu16 "time stamp when the raw data used for the torsion bar torque calculation are sampled" UWORD T_US 1 100 0 65535 ECU_ADDRESS 0xFEBEEE0C /end MEASUREMENT
/begin MEASUREMENT tHwlI_TorsionBarTorqueSampleTimeRed_gdu16 "Time stamp of the passive torsion bar torque sensor  value." UWORD T_US 1 100 0 65535 ECU_ADDRESS 0xFEBEEE0E /end MEASUREMENT
/begin MEASUREMENT tStcPasFsa_PrevLocalSampleTime_gau16 "To hold the Previous sensor data timestamp of local SCU" UWORD T_US 1 100 0 65535 ECU_ADDRESS 0xFEBEEDB0 MATRIX_DIM 2 1 1 /end MEASUREMENT
/begin MEASUREMENT tStcPasFsa_PrevRemoteSampleTime_gau16 "To hold the Previous sensor data timestamp of remote SCU" UWORD T_US 1 100 0 65535 ECU_ADDRESS 0xFEBEEDB4 MATRIX_DIM 2 1 1 /end MEASUREMENT
/begin MEASUREMENT wHwlI_TorsionBarTwist_gdf32 "Torsion Bar Twist Angle" FLOAT32_IEEE ANG_RAD_REAL 1 100 -0.55 0.55 ECU_ADDRESS 0xFEBEE1A8 /end MEASUREMENT
/begin MEASUREMENT yHwlI_TorqueSensorVariant_gde "Torsion bar torque sensor variant" SBYTE NO_UNIT 1 100 0 8 ECU_ADDRESS 0xFEBEE1B4 /end MEASUREMENT
/begin MEASUREMENT yHwlI_TorsionBarStiffness_gdu16 "Torsion bar stiffness" UWORD TORQ_STIFF_INT 1 100 0 4 ECU_ADDRESS 0xFEBEE1B2 /end MEASUREMENT
/begin MEASUREMENT yStcPasFsa_CyclicArrayIndex_gdu8 "Cyclic Array Index value" UBYTE NO_UNIT 1 100 0 1 ECU_ADDRESS 0xFEBED00C /end MEASUREMENT
/begin MEASUREMENT yStcPasFsa_PrevTorsionbarTwistRad_gaf32 "To hold the Previous Torsion Bar Twist Angle" FLOAT32_IEEE ANG_RAD_REAL 1 100 -0.55 0.55 ECU_ADDRESS 0xFEBECFB8 MATRIX_DIM 2 1 1 /end MEASUREMENT
/begin MEASUREMENT yStcPasFsa_PrevTrqOnetimeflag_gdu8 "one time flag for to hold previous TRQ" UBYTE NO_UNIT 1 100 0 1 ECU_ADDRESS 0xFEBED00D /end MEASUREMENT
/begin MEASUREMENT sStcPasPlausiI_EvalState_gde "Contains the details of different plausi evaluation result" UBYTE NO_UNIT 1 100 0 6 ECU_ADDRESS 0xFEBED038 /end MEASUREMENT
/begin MEASUREMENT sStcPasPlausiI_State_gde "" UBYTE NO_UNIT 1 100 0 3 ECU_ADDRESS 0xFEBED039 /end MEASUREMENT
/begin MEASUREMENT tStcPasPlausi_CurrFiltTime_gdu8 "Contains current filter time" UBYTE T_MS 1 100 0 255 ECU_ADDRESS 0xFEBED03A /end MEASUREMENT
/begin MEASUREMENT yStcPasPlausi_CosineValue_gas16 "variable contains StcPlausi consine value" SWORD NO_UNIT 1 100 -2048 2047 ECU_ADDRESS 0xFEBED020 MATRIX_DIM 2 1 1 /end MEASUREMENT
/begin MEASUREMENT yStcPasPlausi_CycSnsrDataCrc_gau16 "contains cyclic CRC data of sensor" UWORD NO_UNIT 1 100 0 65535 ECU_ADDRESS 0xFEBED024 MATRIX_DIM 2 1 1 /end MEASUREMENT
/begin MEASUREMENT yStcPasPlausi_FFData1_gas16 "freezeframe contains sine and cosine data of calc and plausi in freezeframe." SWORD NO_UNIT 1 100 -2048 2047 ECU_ADDRESS 0xFEBED010 MATRIX_DIM 4 1 1 /end MEASUREMENT
/begin MEASUREMENT yStcPasPlausi_FFData2_gau16 "freezeframe contains init and cyclic sensor data CRC" UWORD NO_UNIT 1 100 0 65535 ECU_ADDRESS 0xFEBED028 MATRIX_DIM 2 1 1 /end MEASUREMENT
/begin MEASUREMENT yStcPasPlausi_FFData3_gdu32 "contains freezeframe data of STC DMS" ULONG NO_UNIT 1 100 0 4294967295 ECU_ADDRESS 0xFEBED02C /end MEASUREMENT
/begin MEASUREMENT yStcPasPlausi_SineValue_gas16 "variable contains StcPlausi Sine value" SWORD NO_UNIT 1 100 -2048 2047 ECU_ADDRESS 0xFEBED030 MATRIX_DIM 2 1 1 /end MEASUREMENT
/begin MEASUREMENT yStcPasPlausi_TorqueRadius_gau16 "contains value of torque radius" UWORD NO_UNIT 1 100 350 1650 ECU_ADDRESS 0xFEBED034 MATRIX_DIM 2 1 1 /end MEASUREMENT
/begin MEASUREMENT uDcLinkVolt_DCLinkVoltageFilt_mdf32 "Filtered DC Link Voltage" FLOAT32_IEEE VOLT_REAL 1 100 0 1000 ECU_ADDRESS 0xFEBEAC98 /end MEASUREMENT
/begin MEASUREMENT uSvoI_DCLinkVoltage_gdf32 "DC Link Voltage" FLOAT32_IEEE VOLT_REAL 1 100 0 1000 ECU_ADDRESS 0xFEBEAC9C /end MEASUREMENT
/begin MEASUREMENT uDrvVolt_OutputDriverVoltageFilt_mdf32 "Output driver voltage" FLOAT32_IEEE VOLT_REAL 1 100 0 1000 ECU_ADDRESS 0xFEBEACA0 /end MEASUREMENT
/begin MEASUREMENT uSvoI_OutputDriverVoltage_gdf32 "Output driver voltage" FLOAT32_IEEE VOLT_REAL 1 100 0 1000 ECU_ADDRESS 0xFEBEACA4 /end MEASUREMENT
/begin MEASUREMENT uSvoI_OutputStageVoltage_gdf32 "DC-Link / Output stage voltage" FLOAT32_IEEE VOLT_REAL 1 100 0 1000 ECU_ADDRESS 0xFEBEACA8 /end MEASUREMENT
/begin MEASUREMENT uSvoI_OutputStageVoltageFilt_gdf32 "Filtered DC-Link / output stage voltage" FLOAT32_IEEE VOLT_REAL 1 100 0 1000 ECU_ADDRESS 0xFEBEACAC /end MEASUREMENT
/begin MEASUREMENT sSvoI_StartupVoltageState_gde "Startup voltage State" UBYTE NO_UNIT 1 100 0 2 ECU_ADDRESS 0xFEBEE11C /end MEASUREMENT
/begin MEASUREMENT sSupplyVoltI_SupplyVoltageStatus_gde "Status of voltage calculation (valid, uncompensated)" UWORD NO_UNIT 1 100 0 8 ECU_ADDRESS 0xFEBED0D8 /end MEASUREMENT
/begin MEASUREMENT uHwlI_SupplyVoltageFilt_gdf32 "Filtered Supply voltage" FLOAT32_IEEE VOLT_REAL 1 100 0 50 ECU_ADDRESS 0xFEBEE1B8 /end MEASUREMENT
/begin MEASUREMENT uHwlI_SupplyVoltageUnfilt_gdf32 "Unfiltered battery voltage" FLOAT32_IEEE VOLT_REAL 1 100 0 33 ECU_ADDRESS 0xFEBEE1BC /end MEASUREMENT
/begin MEASUREMENT sSvoCalc_State_mde "SVO Main Calc State" UBYTE NO_UNIT 1 100 0 1 ECU_ADDRESS 0xFEBED136 /end MEASUREMENT
/begin MEASUREMENT sSvoCalcI_OutputStageVoltStatus_gde "Status of voltage calculation (valid, uncompensated)" UWORD NO_UNIT 1 100 0 65535 ECU_ADDRESS 0xFEBED134 /end MEASUREMENT
/begin MEASUREMENT sSvoCalcI_VoltRangeStatus_gde "Status of voltage range check" UBYTE NO_UNIT 1 100 0 255 ECU_ADDRESS 0xFEBED137 /end MEASUREMENT
/begin MEASUREMENT uSvoCalcI_OffsetVBAT_C_gdf32 "Offset VBAT_C" FLOAT32_IEEE VOLT_REAL 1 100 -33 33 ECU_ADDRESS 0xFEBED0E4 /end MEASUREMENT
/begin MEASUREMENT uSvoCalcI_OffsetVBATP_FS_gdf32 "Offset VBATP_FS" FLOAT32_IEEE VOLT_REAL 1 100 -33 33 ECU_ADDRESS 0xFEBED0EC /end MEASUREMENT
/begin MEASUREMENT uSvoCalcI_OffsetVBATP_gdf32 "Offset VBATP" FLOAT32_IEEE VOLT_REAL 1 100 -33 33 ECU_ADDRESS 0xFEBED0F4 /end MEASUREMENT
/begin MEASUREMENT ySvoCalc_AdFinishNrBuffer_gdu32 "Buffer in the IsrCalc function" ULONG NO_UNIT 1 100 0 7 ECU_ADDRESS 0xFEBED104 /end MEASUREMENT
/begin MEASUREMENT ySvoCalc_AdFinishNrLocal_gdu32 "Buffer in the CopyIsrValues function" ULONG NO_UNIT 1 100 0 7 ECU_ADDRESS 0xFEBED10C /end MEASUREMENT
/begin MEASUREMENT ySvoCalcI_AdFinishNr_gdu32 "Adc finished number " ULONG NO_UNIT 1 100 0 7 ECU_ADDRESS 0xFEBED114 /end MEASUREMENT
/begin MEASUREMENT ySvoCalcI_SlopeVBAT_C_gdf32 "Slope VBAT_C" FLOAT32_IEEE NO_UNIT 1 100 0 100 ECU_ADDRESS 0xFEBED11C /end MEASUREMENT
/begin MEASUREMENT ySvoCalcI_SlopeVBATP_FS_gdf32 "Slope VBATP_FS" FLOAT32_IEEE NO_UNIT 1 100 0 100 ECU_ADDRESS 0xFEBED124 /end MEASUREMENT
/begin MEASUREMENT ySvoCalcI_SlopeVBATP_gdf32 "Slope VBATP" FLOAT32_IEEE NO_UNIT 1 100 0 100 ECU_ADDRESS 0xFEBED12C /end MEASUREMENT
/begin MEASUREMENT sSvoDiag_AsicVoltSelftestFlags_gde "ASIC Selftest flag variable" ULONG NO_UNIT 1 100 0 1073741823 ECU_ADDRESS 0xFEBED1A8 /end MEASUREMENT
/begin MEASUREMENT sSvoDiag_ReleaseStatus_mde "SVO ASIC flag monitoring release status" UBYTE NO_UNIT 1 100 0 1 ECU_ADDRESS 0xFEBED1F6 /end MEASUREMENT
/begin MEASUREMENT sSvoDiagI_AsicVoltDiagFlags_gde "ASIC voltage Diag flags" ULONG NO_UNIT 1 100 0 1073741823 ECU_ADDRESS 0xFEBED1B0 /end MEASUREMENT
/begin MEASUREMENT sSvoDiagI_DiagState_gde "SVO diagnosis status" UBYTE NO_UNIT 1 100 0 1 ECU_ADDRESS 0xFEBED1F7 /end MEASUREMENT
/begin MEASUREMENT sSvoDiagI_LowPowerResetRequest_gde "lowvolt reset in case of low power" UBYTE NO_UNIT 1 100 0 4 ECU_ADDRESS 0xFEBED1F8 /end MEASUREMENT
/begin MEASUREMENT ySvoDiag_GduVoltOnFirstEntry_gdu32 "First entry variable if VBATP1S1 switched on" ULONG NO_UNIT 1 100 0 65535 ECU_ADDRESS 0xFEBED1C0 /end MEASUREMENT
/begin MEASUREMENT ySvoDiag_IsFirstEntry_mdu32 "First entry flag" ULONG NO_UNIT 1 100 0 1 ECU_ADDRESS 0xFEBED1C8 /end MEASUREMENT
/begin MEASUREMENT ySvoDiag_LowVoltStatus_mdu32 "Holds the Low Volt reset state" ULONG NO_UNIT 1 100 0 3 ECU_ADDRESS 0xFEBED1D0 /end MEASUREMENT
/begin MEASUREMENT ySvoDiag_NormalVoltHistory_mdu32 "Normal voltage History" ULONG NO_UNIT 1 100 0 4294967295 ECU_ADDRESS 0xFEBED1D8 /end MEASUREMENT
/begin MEASUREMENT ySvoDiag_UnderVoltHistory_mdu32 "Undervoltage History" ULONG NO_UNIT 1 100 0 4294967295 ECU_ADDRESS 0xFEBED1E0 /end MEASUREMENT
/begin MEASUREMENT ySvoDiag_UnderVoltHistoryForReset_mdu32 "Undervoltage History for reset" ULONG NO_UNIT 1 100 0 4294967295 ECU_ADDRESS 0xFEBED1E8 /end MEASUREMENT
/begin MEASUREMENT ySvoDiagI_PreStoreData_gde "PreStore Data" UWORD NO_UNIT 1 100 0 1048575 ECU_ADDRESS 0xFEBED1F4 /end MEASUREMENT
/begin MEASUREMENT sHwlI_SystemVoltageState_gde "Validity state of all E/E-system voltages" UWORD NO_UNIT 1 100 0 32778 ECU_ADDRESS 0xFEBEE1C0 /end MEASUREMENT
/begin MEASUREMENT sSvoI_FaultIndicationState_gde "Functionality state of SVO" UBYTE NO_UNIT 1 100 0 7 ECU_ADDRESS 0xFEBED21A /end MEASUREMENT
/begin MEASUREMENT tSvoFsa_TimeStamp_mdu16 "Time stamp for debounce the error" UWORD NO_UNIT 1 100 0 65535 ECU_ADDRESS 0xFEBED218 /end MEASUREMENT
/begin MEASUREMENT ySvoFsa_DebounceVal_mdf32 "Debounce value for voltage comparision error" FLOAT32_IEEE NO_UNIT 1 100 0 100 ECU_ADDRESS 0xFEBED208 /end MEASUREMENT
/begin MEASUREMENT ySvoFsa_IsFirstFailEntry_mdu32 "First entry flag" ULONG NO_UNIT 1 100 0 1 ECU_ADDRESS 0xFEBED210 /end MEASUREMENT
/begin MEASUREMENT sSvoInit_AsicVoltFlagsMonitoring_mde "Trigger var for enabling ASIC voltage monitoring" UBYTE NO_UNIT 1 100 0 255 ECU_ADDRESS 0xFEBEB87D /end MEASUREMENT
/begin MEASUREMENT uSvoI_U1V25RefVoltageFilt_gaf32 "1V25 ADC reference voltages" FLOAT32_IEEE VOLT_REAL 1 100 0 33 ECU_ADDRESS 0xFEBEACB0 MATRIX_DIM 2 1 1 /end MEASUREMENT
/begin MEASUREMENT uU1V25I_U1V25RefVoltage_gaf32 "1V25 ADC reference voltage" FLOAT32_IEEE VOLT_REAL 1 100 0 33 ECU_ADDRESS 0xFEBEACB8 MATRIX_DIM 2 1 1 /end MEASUREMENT
/begin MEASUREMENT sLowVoltChk_CurrentVoltageRange_mde "Holds current intern voltage range status" UBYTE NO_UNIT 1 100 0 4 ECU_ADDRESS 0xFEBED0C0 /end MEASUREMENT
/begin MEASUREMENT tLowVoltChk_TimeStampLowVolt_mdu16 "Holds the time stamp of Low voltage occurance" UWORD NO_UNIT 1 100 0 65535 ECU_ADDRESS 0xFEBED0BC /end MEASUREMENT
/begin MEASUREMENT tLowVoltChk_TimeStampRecoverVolt_mdu16 "Holds the time stamp of Normal voltage occurance" UWORD NO_UNIT 1 100 0 65535 ECU_ADDRESS 0xFEBED0BE /end MEASUREMENT
/begin MEASUREMENT uLowVoltChk_VoltageThreshold_gdf32 "Current voltage  threshold for the low voltage check" FLOAT32_IEEE VOLT_REAL 1 100 0 50 ECU_ADDRESS 0xFEBED0A4 /end MEASUREMENT
/begin MEASUREMENT yLowVoltChk_IsFirstLowVoltEntry_gdu32 "First entry flag to set timestamp" ULONG NO_UNIT 1 100 0 1 ECU_ADDRESS 0xFEBED0AC /end MEASUREMENT
/begin MEASUREMENT yLowVoltChk_IsFirstNormalVoltEntry_mdu32 "First entry flag to set timestamp at Normal voltage" ULONG NO_UNIT 1 100 0 1 ECU_ADDRESS 0xFEBED0B4 /end MEASUREMENT
/begin MEASUREMENT cCoilCalc_CoilTempLast_gdf32 "Motor coil previous temperature" FLOAT32_IEEE TEMP_INT 1 100 -70 350 ECU_ADDRESS 0xFEBED224 /end MEASUREMENT
/begin MEASUREMENT cCoilCalc_EcuTemp_gdf32 "ECU temperature" FLOAT32_IEEE NO_UNIT 1 100 -100 350 ECU_ADDRESS 0xFEBED228 /end MEASUREMENT
/begin MEASUREMENT cCoilCalc_EcuTempLast_gdf32 "Previous ECU Temperature" FLOAT32_IEEE NO_UNIT 1 100 -100 350 ECU_ADDRESS 0xFEBED230 /end MEASUREMENT
/begin MEASUREMENT cCoilCalc_EstPsiTempLast_gdf32 "Psi last temperature" FLOAT32_IEEE NO_UNIT 1 100 0 10000 ECU_ADDRESS 0xFEBED234 /end MEASUREMENT
/begin MEASUREMENT cTecI_CoilTemp_gdu16 "Motor coil temperature" UWORD TEMP_INT 1 100 -70 350 ECU_ADDRESS 0xFEBED2A0 /end MEASUREMENT
/begin MEASUREMENT iCoilCalc_IBatt_gdf32 "Battery current" FLOAT32_IEEE NO_UNIT 1 100 -200 200 ECU_ADDRESS 0xFEBED240 /end MEASUREMENT
/begin MEASUREMENT iCoilCalc_IBattCorrected_gdf32 "Battery current, depending rotorspeed corrected" FLOAT32_IEEE NO_UNIT 1 100 0 200 ECU_ADDRESS 0xFEBED244 /end MEASUREMENT
/begin MEASUREMENT nCoilCalc_RotSpdIntFiltAbs_gdf32 "Absolute internal filtered rotorspeed" FLOAT32_IEEE NO_UNIT 1 100 0 13000 ECU_ADDRESS 0xFEBED248 /end MEASUREMENT
/begin MEASUREMENT pCoilCalc_PowerLoss_gdf32 "Power loss" FLOAT32_IEEE NO_UNIT 1 100 0 1000 ECU_ADDRESS 0xFEBED24C /end MEASUREMENT
/begin MEASUREMENT pCoilCalc_PowerMech_gdf32 "Mechanical power" FLOAT32_IEEE NO_UNIT 1 100 0 2000 ECU_ADDRESS 0xFEBED250 /end MEASUREMENT
/begin MEASUREMENT rCoilCalc_CoilResistance1ms_gdf32 "New Resistor out of Energyloss" FLOAT32_IEEE NO_UNIT 1 100 0.001 0.1 ECU_ADDRESS 0xFEBED254 /end MEASUREMENT
/begin MEASUREMENT rCoilCalc_CoilResistor_gdf32 "Coil resistor" FLOAT32_IEEE NO_UNIT 1 100 0.001 0.5 ECU_ADDRESS 0xFEBED25C /end MEASUREMENT
/begin MEASUREMENT rCoilCalc_CoilResLast_gdf32 "Motor coil previous resistance" FLOAT32_IEEE NO_UNIT 1 100 0.001 0.5 ECU_ADDRESS 0xFEBED260 /end MEASUREMENT
/begin MEASUREMENT sCoilCalc_CalcRestriction_gdu8 "Restrictions: B0-gen, B1 not equal stationary, B2-Ploss equal 0, B3-N2HIGH, B4-Is2=0, B5-Ploss less than 0" UBYTE NO_UNIT 1 100 0 255 ECU_ADDRESS 0xFEBED2A6 /end MEASUREMENT
/begin MEASUREMENT sCoilCalc_InitDone_gdu8 "Coil Temp calculation initialization state" UBYTE NO_UNIT 1 100 0 1 ECU_ADDRESS 0xFEBED2A7 /end MEASUREMENT
/begin MEASUREMENT sCoilCalcI_CoilTempState_gde "Motor coil temperature state" UWORD NO_UNIT 1 100 0 65535 ECU_ADDRESS 0xFEBED2A2 /end MEASUREMENT
/begin MEASUREMENT uCoilCalc_UbattCorr_gdf32 "Corrected outstage voltage" FLOAT32_IEEE NO_UNIT 1 100 0 60 ECU_ADDRESS 0xFEBED270 /end MEASUREMENT
/begin MEASUREMENT wCoilCalc_AngFreqFiltAbs_gdf32 "Absolute filtered rotorspeed" FLOAT32_IEEE NO_UNIT 1 100 0 13000 ECU_ADDRESS 0xFEBED274 /end MEASUREMENT
/begin MEASUREMENT xCoilCalc_nFactor_gdf32 "Factor at low rotorspeed" FLOAT32_IEEE NO_UNIT 1 100 0 31.99 ECU_ADDRESS 0xFEBED278 /end MEASUREMENT
/begin MEASUREMENT xCoilCalc_RsTempCoeff_gdf32 "Motor temperature coefficient" FLOAT32_IEEE NO_UNIT 1 100 0 0.9 ECU_ADDRESS 0xFEBED27C /end MEASUREMENT
/begin MEASUREMENT yCoilCalc_CurrentInteg_gdf32 "Integral of current integral at 25ms" FLOAT32_IEEE NO_UNIT 1 100 0 80000 ECU_ADDRESS 0xFEBED280 /end MEASUREMENT
/begin MEASUREMENT yCoilCalc_EnergyLossInteg_gdf32 "Integral of energy loss at 25ms" FLOAT32_IEEE NO_UNIT 1 100 0 80000 ECU_ADDRESS 0xFEBED284 /end MEASUREMENT
/begin MEASUREMENT yCoilCalc_FiltFacStartAgil_gdf32 "Filter factor start agile" FLOAT32_IEEE NO_UNIT 1 100 0 10000 ECU_ADDRESS 0xFEBED288 /end MEASUREMENT
/begin MEASUREMENT yCoilCalc_IsxSquaredSum_gdf32 "Squared Is" FLOAT32_IEEE NO_UNIT 1 100 0 10000 ECU_ADDRESS 0xFEBED290 /end MEASUREMENT
/begin MEASUREMENT yCoilCalc_MsCurrentInteg_gdf32 "Integral of squared current at 1ms" FLOAT32_IEEE NO_UNIT 1 100 0 5000 ECU_ADDRESS 0xFEBED294 /end MEASUREMENT
/begin MEASUREMENT yCoilCalc_MsCurrentIntegBuffer_gaf32 "Buffer squared current integ from 1ms samples" FLOAT32_IEEE NO_UNIT 1 100 0 5000 ECU_ADDRESS 0xFEBED2A8 MATRIX_DIM 40 1 1 /end MEASUREMENT
/begin MEASUREMENT yCoilCalc_MsEnergyLossInteg_gdf32 "energy loss integral at 1ms" FLOAT32_IEEE NO_UNIT 1 100 0 2000 ECU_ADDRESS 0xFEBED298 /end MEASUREMENT
/begin MEASUREMENT yCoilCalc_MsEnergyLossIntegBuffer_gaf32 "Buffer energyLoss integral calculated from 1ms samples" FLOAT32_IEEE NO_UNIT 1 100 0 2000 ECU_ADDRESS 0xFEBED348 MATRIX_DIM 40 1 1 /end MEASUREMENT
/begin MEASUREMENT zCoilCalc_CounterFiltFac_gdu16 "Filter factor counter" UWORD NO_UNIT 1 100 0 65535 ECU_ADDRESS 0xFEBED2A4 /end MEASUREMENT
/begin MEASUREMENT cCapCalc_DeltaToo_gdf32 "Dc link capacitor temperature rise" FLOAT32_IEEE NO_UNIT 1 100 0 150 ECU_ADDRESS 0xFEBED3E8 /end MEASUREMENT
/begin MEASUREMENT cTecI_DcLinkCapDeltaTemp_gdf32 "Dc link capacitor rise temperature" FLOAT32_IEEE NO_UNIT 1 100 0 255 ECU_ADDRESS 0xFEBED3EC /end MEASUREMENT
/begin MEASUREMENT cTecI_DcLinkCapTemp_gdu8 "DC-link temperature" UBYTE TEMP_INT 1 100 -70 185 ECU_ADDRESS 0xFEBED3F6 /end MEASUREMENT
/begin MEASUREMENT iCapCalc_DcBus_gdf32 "Dc link capacitor bus current" FLOAT32_IEEE NO_UNIT 1 100 0 150 ECU_ADDRESS 0xFEBED3F0 /end MEASUREMENT
/begin MEASUREMENT sCapCalcI_CapTempState_gde "Dc link capacitor temperature calculation state" UWORD NO_UNIT 1 100 0 65535 ECU_ADDRESS 0xFEBED3F4 /end MEASUREMENT
/begin MEASUREMENT sCapCalcI_StartupFinished_gdu8 "Startup finished indicator" UBYTE NO_UNIT 1 100 0 1 ECU_ADDRESS 0xFEBED3F7 /end MEASUREMENT
/begin MEASUREMENT cFetCalc_CoTemp_gas16 "Phase cut off FET temperatures all phases" SWORD NO_UNIT 1 100 -100 300 ECU_ADDRESS 0xFEBEAF28 MATRIX_DIM 3 1 1 /end MEASUREMENT
/begin MEASUREMENT cFetCalc_HsTemp_gas16 "High side FET temperatures all phases" SWORD NO_UNIT 1 100 -100 300 ECU_ADDRESS 0xFEBEAF30 MATRIX_DIM 3 1 1 /end MEASUREMENT
/begin MEASUREMENT cFetCalc_LsTemp_gas16 "Low side FET temperatures all phases" SWORD NO_UNIT 1 100 -100 300 ECU_ADDRESS 0xFEBEAF38 MATRIX_DIM 3 1 1 /end MEASUREMENT
/begin MEASUREMENT cFetCalc_RpTemp_gds16 "Reverse polarity FET temperature" SWORD NO_UNIT 1 100 -100 300 ECU_ADDRESS 0xFEBEAF40 /end MEASUREMENT
/begin MEASUREMENT cFetCalcI_DbcNtcDeltaTemp_gdu8 "Temperature between NTC and DBC" UBYTE TEMP_INT 1 100 -70 185 ECU_ADDRESS 0xFEBEAF44 /end MEASUREMENT
/begin MEASUREMENT cTecI_CurrFetTempMax_gds16 "Current maximum FET-temperature" SWORD NO_UNIT 1 100 -100 300 ECU_ADDRESS 0xFEBEAF42 /end MEASUREMENT
/begin MEASUREMENT pFetCalc_CoPowerLoss_gaf32 "Power loss cut off FET" FLOAT32_IEEE NO_UNIT 1 100 0 100 ECU_ADDRESS 0xFEBEAF48 MATRIX_DIM 3 1 1 /end MEASUREMENT
/begin MEASUREMENT pFetCalc_HsPowerLoss_gaf32 "Power loss high side FET" FLOAT32_IEEE NO_UNIT 1 100 0 100 ECU_ADDRESS 0xFEBEAF54 MATRIX_DIM 3 1 1 /end MEASUREMENT
/begin MEASUREMENT pFetCalc_LsPowerLoss_gaf32 "Power loss low side FET" FLOAT32_IEEE NO_UNIT 1 100 0 100 ECU_ADDRESS 0xFEBEAF60 MATRIX_DIM 3 1 1 /end MEASUREMENT
/begin MEASUREMENT pFetCalc_RpPowerLoss_gdf32 "Power loss reverse polarity FET" FLOAT32_IEEE NO_UNIT 1 100 0 100 ECU_ADDRESS 0xFEBEAF24 /end MEASUREMENT
/begin MEASUREMENT sFetCalcI_StartupFinished_gdu8 "Startup finished indicator" UBYTE NO_UNIT 1 100 0 1 ECU_ADDRESS 0xFEBEAF45 /end MEASUREMENT
/begin MEASUREMENT cGpCalc_NTCTemp_gdu8 "NTC temperature DBC unfiltered" UBYTE TEMP_INT 1 100 0 255 ECU_ADDRESS 0xFEBED3FC /end MEASUREMENT
/begin MEASUREMENT cHwlI_OutputStageTemp_gdu8 "NTC measured output stage temperature." UBYTE TEMP_INT 1 100 -70 185 ECU_ADDRESS 0xFEBEE1C2 /end MEASUREMENT
/begin MEASUREMENT cTecI_GroundPlateTemp_gdu8 "Ground plate temperature" UBYTE TEMP_INT 1 100 -70 185 ECU_ADDRESS 0xFEBED3FD /end MEASUREMENT
/begin MEASUREMENT cTecI_OutstageTemp_gdu8 "Output stage temperature" UBYTE TEMP_INT 1 100 -70 185 ECU_ADDRESS 0xFEBED3FE /end MEASUREMENT
/begin MEASUREMENT sGpCalcI_GpTempState_gde "Ground plate and output stage termperature calculation state" UWORD NO_UNIT 1 100 0 65535 ECU_ADDRESS 0xFEBED3F8 /end MEASUREMENT
/begin MEASUREMENT yGpCalc_NTCRawValue_gdu16 "ADC raw value temperature measurement" UWORD NO_UNIT 1 100 0 65535 ECU_ADDRESS 0xFEBED3FA /end MEASUREMENT
/begin MEASUREMENT cHwlI_BoardTemp_gdu8 "Filtered temperature PCB" UBYTE TEMP_INT 1 100 -70 185 ECU_ADDRESS 0xFEBEAF6E /end MEASUREMENT
/begin MEASUREMENT cPcbCalcI_PcbTemp_gdu8 "Unfiltered PCB temperature" UBYTE TEMP_INT 1 100 -70 185 ECU_ADDRESS 0xFEBEAF6F /end MEASUREMENT
/begin MEASUREMENT yPcbCalc_NTCRawValue_gdu16 "NTC raw value after adc conversion" UWORD NO_UNIT 1 100 0 65535 ECU_ADDRESS 0xFEBEAF6C /end MEASUREMENT
/begin MEASUREMENT sTecDiagI_CapTempState_gde "Dc link capacitor temperature calculation state" UWORD NO_UNIT 1 100 0 65535 ECU_ADDRESS 0xFEBED404 /end MEASUREMENT
/begin MEASUREMENT sTecDiagI_CoilTempState_gde "Motor coil temperature calculation state" UWORD NO_UNIT 1 100 0 65535 ECU_ADDRESS 0xFEBED406 /end MEASUREMENT
/begin MEASUREMENT sTecDiagI_FetTempState_gde "FET temperature calculation state" UWORD NO_UNIT 1 100 0 65535 ECU_ADDRESS 0xFEBED408 /end MEASUREMENT
/begin MEASUREMENT sTecDiagI_GpTempState_gde "Ground plate temperature calculation state" UWORD NO_UNIT 1 100 0 65535 ECU_ADDRESS 0xFEBED40A /end MEASUREMENT
/begin MEASUREMENT sTecDiagI_PcbTempState_gde "PCB temperature calculation state" UWORD NO_UNIT 1 100 0 65535 ECU_ADDRESS 0xFEBED40C /end MEASUREMENT
/begin MEASUREMENT sTecDiagI_StartupFinished_gdu8 "" UBYTE NO_UNIT 1 100 0 1 ECU_ADDRESS 0xFEBED410 /end MEASUREMENT
/begin MEASUREMENT sTecDiagI_UcTempState_gde "Processor temperature calculation state" UWORD NO_UNIT 1 100 0 65535 ECU_ADDRESS 0xFEBED40E /end MEASUREMENT
/begin MEASUREMENT sHwlI_BoardTempState_gde "Validity state of the filtered temperature PCB" UWORD NO_UNIT 1 100 0 65535 ECU_ADDRESS 0xFEBEAF70 /end MEASUREMENT
/begin MEASUREMENT sHwlI_UcTempState_gde "Validity state of the microcontroller temperature" UWORD NO_UNIT 1 100 0 65535 ECU_ADDRESS 0xFEBEAF72 /end MEASUREMENT
/begin MEASUREMENT sTecI_CoilTempState_gde "Validity state of the motor coil temperature" UWORD NO_UNIT 1 100 0 65535 ECU_ADDRESS 0xFEBEAF74 /end MEASUREMENT
/begin MEASUREMENT sTecI_DcLinkCapTempState_gde "Validity state of the DC-link temperature" UWORD NO_UNIT 1 100 0 65535 ECU_ADDRESS 0xFEBEAF76 /end MEASUREMENT
/begin MEASUREMENT sTecI_FaultIndicationState_gde "Functionality state of TEC" UBYTE NO_UNIT 1 100 0 255 ECU_ADDRESS 0xFEBEAF7C /end MEASUREMENT
/begin MEASUREMENT sTecI_FetTempState_gde "Validity state of the FET-temperatures" UWORD NO_UNIT 1 100 0 65535 ECU_ADDRESS 0xFEBEAF78 /end MEASUREMENT
/begin MEASUREMENT sTecI_GroundPlateTempState_gde "Validity state of the ground plate temperature" UWORD NO_UNIT 1 100 0 65535 ECU_ADDRESS 0xFEBEAF7A /end MEASUREMENT
/begin MEASUREMENT sTecPlausiI_PcbUcTempState_gde "PCB temperature and Uc temperature calculation plausi state" UWORD NO_UNIT 1 100 0 65535 ECU_ADDRESS 0xFEBEB900 /end MEASUREMENT
/begin MEASUREMENT sTecPlausiI_RedundancyErrorState_gdu8 "redundancy error state 0 = no error 1 = error" UBYTE NO_UNIT 1 100 0 1 ECU_ADDRESS 0xFEBEB902 /end MEASUREMENT
/begin MEASUREMENT yTecPlausi_RedErrAdress_gdu32 "Address of Redundant error variable" ULONG NO_UNIT 1 100 0 4294967295 ECU_ADDRESS 0xFEBEEBE4 /end MEASUREMENT
/begin MEASUREMENT cHwlI_UcTemp_gdu8 "Microcontroller temperature" UBYTE TEMP_INT 1 100 -70 185 ECU_ADDRESS 0xFEBEAF7D /end MEASUREMENT
/begin MEASUREMENT cUcCalcI_UcTemp_gdu8 "Unfiltered processor temperature" UBYTE TEMP_INT 1 100 -70 185 ECU_ADDRESS 0xFEBEAF7E /end MEASUREMENT
/begin MEASUREMENT yActComServ_BufferIndex_gdu8 "switches the two queue buffers" UBYTE NO_UNIT 1 100 0 1 ECU_ADDRESS 0xFEBED430 /end MEASUREMENT
/begin MEASUREMENT sActRegServ_ReadRequests_gau32 "saves the spi read requests" ULONG NO_UNIT 1 100 0 4294967295 ECU_ADDRESS 0xFEBED51C MATRIX_DIM 4 1 1 /end MEASUREMENT
/begin MEASUREMENT sActRegServ_WriteRequests_gau32 "saves the spi write requests" ULONG NO_UNIT 1 100 0 4294967295 ECU_ADDRESS 0xFEBED52C MATRIX_DIM 4 1 1 /end MEASUREMENT
/begin MEASUREMENT sDriverConf_GduGcrMode_gde "Gcr Mode for GDU" UBYTE NO_UNIT 1 100 0 3 ECU_ADDRESS 0xFEBED5BC /end MEASUREMENT
/begin MEASUREMENT sDriverConf_StartupConfigStates_gdu8 "shows the startup state" UBYTE NO_UNIT 1 100 0 11 ECU_ADDRESS 0xFEBEEDC4 /end MEASUREMENT
/begin MEASUREMENT yDriverConf_LastSetOutStageGain_gde "Save the last requested OutStageGain" UBYTE NO_UNIT 1 100 0 3 ECU_ADDRESS 0xFEBED5BD /end MEASUREMENT
/begin MEASUREMENT sDriverDiag_UpdateDiagFlagsState_gde "shows the update state" UBYTE NO_UNIT 1 100 0 2 ECU_ADDRESS 0xFEBED5BE /end MEASUREMENT
/begin MEASUREMENT yPmwServ_OutstageStatePins_gdu16 "Bit0-PSEN_MON, Bit1-PSD_EN, Bit2-PSD_ERR, Bit3-UC_PSD_GCR, Bit4-PSD_VCC_ON, Bit5-PSC_EN/PSC_1, Bit6-PSC_2, Bit7-PSC_3, Bit8-FSD_1, Bit9-FSD_2, Bit10-FSD_3. Shows the state of the enable pins for the PSD" UWORD NO_UNIT 1 100 0 65535 ECU_ADDRESS 0xFEBED5C0 /end MEASUREMENT
/begin MEASUREMENT sAscReg_IsSleepTriggered_gde "" UBYTE NO_UNIT 1 100 0 1 ECU_ADDRESS 0xFEBED5C6 /end MEASUREMENT
/begin MEASUREMENT sAsicReg_PostRunFlagMonitoringOn_gde "" UBYTE NO_UNIT 1 100 0 1 ECU_ADDRESS 0xFEBED5C7 /end MEASUREMENT
/begin MEASUREMENT yAscReg_AsicRegsInitialized_gde "" UBYTE NO_UNIT 1 100 0 1 ECU_ADDRESS 0xFEBEE1D4 /end MEASUREMENT
/begin MEASUREMENT yAscReg_AsicRevision_gdu16 "" UWORD NO_UNIT 1 100 0 65535 ECU_ADDRESS 0xFEBED5C4 /end MEASUREMENT
/begin MEASUREMENT yAscReg_AsicStartupRegsReady_gde "" UBYTE NO_UNIT 1 100 0 1 ECU_ADDRESS 0xFEBED5C8 /end MEASUREMENT
/begin MEASUREMENT sAsicComm_ErrSpiFlagSet_gde "Variable denotes Asic SPI communication Error state." UBYTE NO_UNIT 1 100 0 1 ECU_ADDRESS 0xFEBEE2D8 /end MEASUREMENT
/begin MEASUREMENT yAscCom_ComDiagFailureFlags_gde "Communication failure status" UWORD NO_UNIT 1 100 0 65535 ECU_ADDRESS 0xFEBEE2D6 /end MEASUREMENT
/begin MEASUREMENT yAscCom_SpiComMode_gde "SPI Communication Mode selection" UBYTE NO_UNIT 1 100 0 255 ECU_ADDRESS 0xFEBEE2D9 /end MEASUREMENT
/begin MEASUREMENT yAscCom_SpiInitialized_gde "SPI Register Initilization" UBYTE NO_UNIT 1 100 0 1 ECU_ADDRESS 0xFEBEE2DA /end MEASUREMENT
/begin MEASUREMENT yAsicComm_CrcTestDone_gde "To check the CRC test is done or not" UBYTE NO_UNIT 1 100 0 1 ECU_ADDRESS 0xFEBEE2DB /end MEASUREMENT
/begin MEASUREMENT zAsicComm_CrcTestRepetitionCounter_gdu32 "CRC test reptation counter" ULONG NO_UNIT 1 100 0 5 ECU_ADDRESS 0xFEBEE2D0 /end MEASUREMENT
/begin MEASUREMENT yAscSafety_EnLineDisableFlags_gde "Enable line disable flag" UBYTE NO_UNIT 1 100 0 128 ECU_ADDRESS 0xFEBEEDCC /end MEASUREMENT
/begin MEASUREMENT yAscSafety_MonitoringFailureFlag_gde "Buffer for ASIC monitoring flags to set and clear." UBYTE NO_UNIT 1 100 0 255 ECU_ADDRESS 0xFEBED630 /end MEASUREMENT
/begin MEASUREMENT yAscSafety_PersDataGetStatemachine_gde "State machine status for the reading of persistent data from the ASIC." UBYTE NO_UNIT 1 100 0 255 ECU_ADDRESS 0xFEBED631 /end MEASUREMENT
/begin MEASUREMENT yAscSafety_PersDataSetStatemachine_gde "State machine status for the writing of persistent data from the ASIC." UBYTE NO_UNIT 1 100 0 255 ECU_ADDRESS 0xFEBED632 /end MEASUREMENT
/begin MEASUREMENT sAsicSas_ActualWrongConfigDetails_gde "Stores SAS wrong config flags" UWORD NO_UNIT 1 100 0 65535 ECU_ADDRESS 0xFEBED634 /end MEASUREMENT
/begin MEASUREMENT sAsicSas_StartupWrongConfigDetails_gde "Stores SAS wrong config flags at startup" UWORD NO_UNIT 1 100 0 65535 ECU_ADDRESS 0xFEBED636 /end MEASUREMENT
/begin MEASUREMENT sAsicWd_ErrorPinTestStatus_gde "ErrorPin Initial test status" SBYTE NO_UNIT 1 100 0 3 ECU_ADDRESS 0xFEBED96A /end MEASUREMENT
/begin MEASUREMENT sAsicWd_McuTestState_gde "Indicates MCU test state" SBYTE NO_UNIT 1 100 0 7 ECU_ADDRESS 0xFEBED96B /end MEASUREMENT
/begin MEASUREMENT sAsicWd_SysAsicWdState_gde "Holds watchdog state" SBYTE NO_UNIT 1 100 0 4 ECU_ADDRESS 0xFEBED96C /end MEASUREMENT
/begin MEASUREMENT sAsicWd_WatchdogTestStatus_gde "Watchdog Initial test status" SBYTE NO_UNIT 1 100 0 3 ECU_ADDRESS 0xFEBED96D /end MEASUREMENT
/begin MEASUREMENT sAsicWd_WdTestState_gde "Holds watchdog test state" SBYTE NO_UNIT 1 100 0 8 ECU_ADDRESS 0xFEBED96E /end MEASUREMENT
/begin MEASUREMENT yAsicWd_ConfEhrRegValDuringErr_gdu16 "Holds ASIC ConfEhr register value during error" UWORD NO_UNIT 1 100 0 65535 ECU_ADDRESS 0xFEBED960 /end MEASUREMENT
/begin MEASUREMENT yAsicWd_DiaFsmRegValDuringErr_gdu16 "Holds ASIC DIaFsm register value during error" UWORD NO_UNIT 1 100 0 65535 ECU_ADDRESS 0xFEBED962 /end MEASUREMENT
/begin MEASUREMENT yAsicWd_DiaWdRegVal_gdu16 "Holds ASIC watchdog diagnosis register value" UWORD NO_UNIT 1 100 0 65535 ECU_ADDRESS 0xFEBED964 /end MEASUREMENT
/begin MEASUREMENT yAsicWd_DiaWdRegValDuringErr_gdu16 "Holds ASIC DiaWd register value during error" UWORD NO_UNIT 1 100 0 65535 ECU_ADDRESS 0xFEBED966 /end MEASUREMENT
/begin MEASUREMENT yAsicWd_EnWdMonFastStartup_gdu8 "Holds flag to enable watchdog error diagnosis" UBYTE NO_UNIT 1 100 0 255 ECU_ADDRESS 0xFEBED96F /end MEASUREMENT
/begin MEASUREMENT yAsicWd_TestActive_gde "Indicates whether watchdog test is active or not" SBYTE NO_UNIT 1 100 0 1 ECU_ADDRESS 0xFEBED970 /end MEASUREMENT
/begin MEASUREMENT yAsicWd_TestTargetThreshold_gdu8 "Specifies test target thrshold" UBYTE NO_UNIT 1 100 0 255 ECU_ADDRESS 0xFEBED971 /end MEASUREMENT
/begin MEASUREMENT yAsicWd_WdDiagFailureFlags_gde "This variables provides Watchdog failure status to functionality" UWORD NO_UNIT 1 100 0 1024 ECU_ADDRESS 0xFEBED968 /end MEASUREMENT
/begin MEASUREMENT yAsicWd_WdDisabledPermanently_gde "Indicates GDU state" SBYTE NO_UNIT 1 100 0 1 ECU_ADDRESS 0xFEBED972 /end MEASUREMENT
/begin MEASUREMENT zAsicWd_Threshold_gdu8 "ASIC watchdog error counter threshold" UBYTE NO_UNIT 1 100 0 15 ECU_ADDRESS 0xFEBED973 /end MEASUREMENT
/begin MEASUREMENT sAsicSelftest_ClkDriftFaultState_gde "Hold clock drift ASIC self test fault state" SBYTE NO_UNIT 1 100 0 7 ECU_ADDRESS 0xFEBED640 /end MEASUREMENT
/begin MEASUREMENT sAsicSelftest_ClkDriftFinalStatus_gde "Hold final status of clock drift ASIC self test" SBYTE NO_UNIT 1 100 0 3 ECU_ADDRESS 0xFEBED641 /end MEASUREMENT
/begin MEASUREMENT sAsicSelftest_ClkDriftStatus_gde "Holds status of clock drift ASIC self test" SBYTE NO_UNIT 1 100 0 3 ECU_ADDRESS 0xFEBED642 /end MEASUREMENT
/begin MEASUREMENT sAsicSelftest_ClockDriftTestState_gde "Holds clock drift ASIC self test test state" SBYTE NO_UNIT 1 100 0 7 ECU_ADDRESS 0xFEBED643 /end MEASUREMENT
/begin MEASUREMENT sAsicSelftest_CvmFaultState_gde "Holds CVM fault state" SBYTE NO_UNIT 1 100 0 4 ECU_ADDRESS 0xFEBED644 /end MEASUREMENT
/begin MEASUREMENT sAsicSelftest_CvmTestFinalStatus_gde "Holds the final status of clock drift ASIC self test" SBYTE NO_UNIT 1 100 0 3 ECU_ADDRESS 0xFEBED645 /end MEASUREMENT
/begin MEASUREMENT sAsicSelftest_CvmTestState_gde "Holds CVM test state" SBYTE NO_UNIT 1 100 0 4 ECU_ADDRESS 0xFEBED646 /end MEASUREMENT
/begin MEASUREMENT sAsicSelftest_CvmTestStatus_gde "Holds the status of CVM ASIC self test" SBYTE NO_UNIT 1 100 0 3 ECU_ADDRESS 0xFEBED647 /end MEASUREMENT
/begin MEASUREMENT sAsicSelftest_SelftestFinalStatus_gae "Holds the status of all ASIC self tests" SBYTE NO_UNIT 1 100 0 3 ECU_ADDRESS 0xFEBED760 MATRIX_DIM 15 1 1 /end MEASUREMENT
/begin MEASUREMENT sAsicSelftest_Vdd3xStatus_gde "Status of Vdd3x Selftest" SBYTE NO_UNIT 1 100 0 3 ECU_ADDRESS 0xFEBED648 /end MEASUREMENT
/begin MEASUREMENT yAsicSelftest_AreAscSelftestsDone_gde "Holds all ASIC self test status" SBYTE NO_UNIT 1 100 0 1 ECU_ADDRESS 0xFEBED649 /end MEASUREMENT
/begin MEASUREMENT yAsicSelftest_DependentFlag_gau16 "Holds self test dependent flags" UWORD NO_UNIT 1 100 0 65535 ECU_ADDRESS 0xFEBED650 MATRIX_DIM 16 1 1 /end MEASUREMENT
/begin MEASUREMENT yAsicSelftest_DisableOcSelftest_gde "Holds OC ASIC self test status" SBYTE NO_UNIT 1 100 0 1 ECU_ADDRESS 0xFEBED64A /end MEASUREMENT
/begin MEASUREMENT yAsicSelftest_IsDiagFlagFailedEval_gau16 "Holds failed diagnosis flag during evaluation check" UWORD NO_UNIT 1 100 0 65535 ECU_ADDRESS 0xFEBED6D0 MATRIX_DIM 15 1 1 /end MEASUREMENT
/begin MEASUREMENT yAsicSelftest_IsDiagFlagFailedFinal_gau16 "Holds failed diagnosis flags during final check" UWORD NO_UNIT 1 100 0 65535 ECU_ADDRESS 0xFEBED6F0 MATRIX_DIM 15 1 1 /end MEASUREMENT
/begin MEASUREMENT yAsicSelftest_IsDiagFlagFailedPreCond_gau16 "Holds failed diagnosis flag during precondition check" UWORD NO_UNIT 1 100 0 65535 ECU_ADDRESS 0xFEBED710 MATRIX_DIM 15 1 1 /end MEASUREMENT
/begin MEASUREMENT yAsicSelftest_SasCmpBackup_gau16 "Holds CONF_SAS_CMP asoc register backup data" UWORD NO_UNIT 1 100 0 65535 ECU_ADDRESS 0xFEBED730 MATRIX_DIM 15 1 1 /end MEASUREMENT
/begin MEASUREMENT yAsicSelftest_SasPeriodBackup_gdu8 "Holds SAS period backup" UBYTE NO_UNIT 1 100 0 255 ECU_ADDRESS 0xFEBED64B /end MEASUREMENT
/begin MEASUREMENT yAsicSelftest_SelftestPreFinishedStatus_gdu32 "Pre finished status for selftests" ULONG NO_UNIT 1 100 0 4294967295 ECU_ADDRESS 0xFEBEEDD0 /end MEASUREMENT
/begin MEASUREMENT yAsicSelftest_SwDepSelftest_gdu32 "Dependant selftests for switch" ULONG NO_UNIT 1 100 0 4294967295 ECU_ADDRESS 0xFEBEEDD4 /end MEASUREMENT
/begin MEASUREMENT yAsicSelfTest_SwitchVoltageMask_gau32 "Holds switch voltage mask value" ULONG NO_UNIT 1 100 0 4294967295 ECU_ADDRESS 0xFEBED694 MATRIX_DIM 15 1 1 /end MEASUREMENT
/begin MEASUREMENT yAsicSelftest_SysVoltInError_gdu8 "Indicates system voltage state" UBYTE NO_UNIT 1 100 0 255 ECU_ADDRESS 0xFEBED64C /end MEASUREMENT
/begin MEASUREMENT yAsicSelfTest_Vdd3xRelatedData_gdu32 "Holds VDD3x self test related data" ULONG NO_UNIT 1 100 0 4294967295 ECU_ADDRESS 0xFEBED638 /end MEASUREMENT
/begin MEASUREMENT yAsicSelftestI_UvSelftestDone_gde "Holds UV ASIC self test status" SBYTE NO_UNIT 1 100 0 1 ECU_ADDRESS 0xFEBED64D /end MEASUREMENT
/begin MEASUREMENT zAsicSelftest_ActSwVoltCtr_gau32 "ASIC SW volt counter" ULONG NO_UNIT 1 100 0 4294967295 ECU_ADDRESS 0xFEBED670 MATRIX_DIM 4 1 1 /end MEASUREMENT
/begin MEASUREMENT zAsicSelftest_ReptCnt_gau8 "ASIC self tests repetition counter" UBYTE NO_UNIT 1 100 0 254 ECU_ADDRESS 0xFEBED770 MATRIX_DIM 15 1 1 /end MEASUREMENT
/begin MEASUREMENT zAsicSelftest_SysVoltInRangeCounter_gdu32 "System voltage inrange counter" ULONG NO_UNIT 1 100 0 4294967295 ECU_ADDRESS 0xFEBED63C /end MEASUREMENT
/begin MEASUREMENT sCoreSafetyServ_EcmGuardErrActive_gde "ECM Gaurd Error Status" UBYTE NO_UNIT 1 100 0 2 ECU_ADDRESS 0xFEBED9E8 /end MEASUREMENT
/begin MEASUREMENT sCoreSafetyServ_EcmIsErrActive_gde "" UBYTE NO_UNIT 1 100 0 2 ECU_ADDRESS 0xFEBED9E9 /end MEASUREMENT
/begin MEASUREMENT y_EcmFailedSources_gau32 "Stores failed ECM error sources " ULONG NO_UNIT 1 100 0 4294967295 ECU_ADDRESS 0xFEBEEDE8 /end MEASUREMENT
/begin MEASUREMENT yCoreSafetyServ_ErrorStatus_gdu32 "" ULONG NO_UNIT 1 100 0 4294967295 ECU_ADDRESS 0xFEBED9E4 /end MEASUREMENT
/begin MEASUREMENT yInitServ_InitDiagFailureFlags_gde "" UWORD NO_UNIT 1 100 0 65535 ECU_ADDRESS 0xFEBEDBB8 /end MEASUREMENT
/begin MEASUREMENT yMuxServ_MuxSampledChIsrOffset_mde "Channel of ASIC multiplexer for phase current that has been sampled by the ADC in the offset calc ISR" UBYTE NO_UNIT 1 100 0 255 ECU_ADDRESS 0xFEBEDBBA /end MEASUREMENT
/begin MEASUREMENT yMuxServ_MuxSampledChIsrPwm_mde "Channel of ASIC multiplexor for phase current that has been sampled by the ADC in the PWM calc ISR" UBYTE NO_UNIT 1 100 0 255 ECU_ADDRESS 0xFEBEDBBB /end MEASUREMENT
/begin MEASUREMENT yMuxServ_MuxSchemeIndex_mdu8 "Current position in switching scheme of ASIC multiplexor for phase current measurement" UBYTE NO_UNIT 1 100 0 3 ECU_ADDRESS 0xFEBEDBBC /end MEASUREMENT
/begin MEASUREMENT yMuxServ_MuxSchemeMode_mde "Selected switching scheme (mode) of ASIC multiplexor for current measurement" UBYTE NO_UNIT 1 100 0 255 ECU_ADDRESS 0xFEBEDBBD /end MEASUREMENT
/begin MEASUREMENT yMuxServ_MuxSchemeModeOffs_mde "Selected switching scheme (mode) of ASIC multiplexor for offset measurement" UBYTE NO_UNIT 1 100 0 255 ECU_ADDRESS 0xFEBEDBBE /end MEASUREMENT
/begin MEASUREMENT yDtsServ_AdcTimingData_gau32 "" ULONG NO_UNIT 1 100 0 5200 ECU_ADDRESS 0xFEBE3038 MATRIX_DIM 8 1 1 /end MEASUREMENT
/begin MEASUREMENT yDtsServ_AdcTriggered_gdu16 "Stores the number of the current ADC sample trigger" UWORD NO_UNIT 1 100 0 65535 ECU_ADDRESS 0xFEBE3024 /end MEASUREMENT
/begin MEASUREMENT yDtsServ_BoostDisableData_gau32 "Boost disable start value for Current and CurrentOffset Measurement" ULONG NO_UNIT 1 100 0 10000 ECU_ADDRESS 0xFEBE3000 MATRIX_DIM 2 1 1 /end MEASUREMENT
/begin MEASUREMENT yDtsServ_BstDisCdrDataInitialVal_gau32 "" ULONG NO_UNIT 1 100 0 16777215 ECU_ADDRESS 0xFEBE3008 MATRIX_DIM 2 1 1 /end MEASUREMENT
/begin MEASUREMENT yDtsServ_DisPwmFeedback_gau32 "timer input channel, control register value for disabling PWM measurement (PWM Feedback)" ULONG NO_UNIT 1 100 0 4294967295 ECU_ADDRESS 0xFEBE3098 MATRIX_DIM 3 1 1 /end MEASUREMENT
/begin MEASUREMENT yDtsServ_DoOffsetMeasurement_gdu16 "Do Offset or Current Measurement in adfinishedIsr" UWORD NO_UNIT 1 100 0 2 ECU_ADDRESS 0xFEBE3026 /end MEASUREMENT
/begin MEASUREMENT yDtsServ_DtsPeakId_gdu16 "" UWORD NO_UNIT 1 100 0 100 ECU_ADDRESS 0xFEBE3028 /end MEASUREMENT
/begin MEASUREMENT yDtsServ_DtsPorts_gau16 "Port level storage element" UWORD NO_UNIT 1 100 0 65535 ECU_ADDRESS 0xFEBE30B0 MATRIX_DIM 21 1 1 /end MEASUREMENT
/begin MEASUREMENT yDtsServ_DtsValleyId_gdu16 "" UWORD NO_UNIT 1 100 0 100 ECU_ADDRESS 0xFEBE302A /end MEASUREMENT
/begin MEASUREMENT yDtsServ_EnPwmFeedback_gau32 "timer input channel, control register value for enabling PWM measurement (PWM Feedback)" ULONG NO_UNIT 1 100 0 4294967295 ECU_ADDRESS 0xFEBE30A4 MATRIX_DIM 3 1 1 /end MEASUREMENT
/begin MEASUREMENT yDtsServ_FocCycleOk_gau8 "Foc cycle Ok" UBYTE NO_UNIT 1 100 0 2 ECU_ADDRESS 0xFEBE3018 MATRIX_DIM 4 1 1 /end MEASUREMENT
/begin MEASUREMENT yDtsServ_FocDone_gdu8 "Foc done" UBYTE NO_UNIT 1 100 0 1 ECU_ADDRESS 0xFEBE3034 /end MEASUREMENT
/begin MEASUREMENT yDtsServ_OriginalFocPwm_gau32 "Pwm Data" ULONG NO_UNIT 1 100 0 5200 ECU_ADDRESS 0xFEBE30DC MATRIX_DIM 48 1 1 /end MEASUREMENT
/begin MEASUREMENT yDtsServ_OriginalPeriodData_gau32 "Period Data" ULONG NO_UNIT 1 100 0 10000 ECU_ADDRESS 0xFEBE3058 MATRIX_DIM 8 1 1 /end MEASUREMENT
/begin MEASUREMENT yDtsServ_OsTimerValue_gdu32 "Os timer value sampled in Valley0" ULONG NO_UNIT 1 100 0 85000 ECU_ADDRESS 0xFEBE301C /end MEASUREMENT
/begin MEASUREMENT yDtsServ_PeriodData_gau32 "" ULONG NO_UNIT 1 100 0 5200 ECU_ADDRESS 0xFEBE3078 MATRIX_DIM 8 1 1 /end MEASUREMENT
/begin MEASUREMENT yDtsServ_PwmFeeback_gau16 "Pwm Feedback storage element" UWORD NO_UNIT 1 100 0 65535 ECU_ADDRESS 0xFEBE302C MATRIX_DIM 3 1 1 /end MEASUREMENT
/begin MEASUREMENT yDtsServ_StorePortsDelay_gdu32 "" ULONG NO_UNIT 1 100 0 65535 ECU_ADDRESS 0xFEBE3020 /end MEASUREMENT
/begin MEASUREMENT yDtsServ_UsTimerValue_gau32 "Get US time stamp " ULONG NO_UNIT 1 100 0 65535 ECU_ADDRESS 0xFEBE3010 MATRIX_DIM 2 1 1 /end MEASUREMENT
/begin MEASUREMENT yAdcServ_AdcDiagRegData_gau32 "this variable has ADC register data" ULONG NO_UNIT 1 100 0 4294967295 ECU_ADDRESS 0xFEBED994 MATRIX_DIM 20 1 1 /end MEASUREMENT
/begin MEASUREMENT yAdcServ_AdcPhyChannelId_gau8 "ADC Physical channel ID" UBYTE NO_UNIT 1 100 0 255 ECU_ADDRESS 0xFEBED980 MATRIX_DIM 20 1 1 /end MEASUREMENT
/begin MEASUREMENT ySensServStcPas_MaxExpectedFrames_gau32 "Maximum Possible UART Frame Count" ULONG NO_UNIT 1 100 0 4294967295 ECU_ADDRESS 0xFEBEDBC0 MATRIX_DIM 2 1 1 /end MEASUREMENT
/begin MEASUREMENT zSensServStcPas_SubframeCountOnems_gau32 "Subframe counts in 1ms" ULONG NO_UNIT 1 100 0 4294967295 ECU_ADDRESS 0xFEBEDBC8 MATRIX_DIM 2 1 1 /end MEASUREMENT
/begin MEASUREMENT sHwaDma_DmaInitialised_gae "" UBYTE NO_UNIT 1 100 0 1 ECU_ADDRESS 0xFEBEE4F0 /end MEASUREMENT
/begin MEASUREMENT sCsih_InitStatus_gae "CSIH initt status" UBYTE NO_UNIT 1 100 0 255 ECU_ADDRESS 0xFEBEE508 MATRIX_DIM 4 1 1 /end MEASUREMENT
/begin MEASUREMENT tHwlI_TaskActSysTime_gdu16 "Us timer value at last task activation point of time. The us timer value corresponds to the us timer of the interface tHwlI_GetUsTick_u16()." UWORD T_US 1 100 0 65535 ECU_ADDRESS 0xFEBEE50C /end MEASUREMENT
/begin MEASUREMENT sHwlI_WakeUpCondition_gde "Wake up condition and current state of the wake up sources" UBYTE NO_UNIT 1 100 0 4 ECU_ADDRESS 0xFEBEEE10 /end MEASUREMENT
/begin MEASUREMENT sExtCom_CurrentDownloadStatus_gde "" UBYTE NO_UNIT 1 100 0 4 ECU_ADDRESS 0xFEBEDEB4 /end MEASUREMENT
/begin MEASUREMENT sExtCom_CurrentFactoryCmd_gde "" UBYTE NO_UNIT 1 100 0 11 ECU_ADDRESS 0xFEBEDEB5 /end MEASUREMENT
/begin MEASUREMENT sExtCom_CurrentSensorLockStatus_gde "" UBYTE NO_UNIT 1 100 0 4 ECU_ADDRESS 0xFEBEDEB6 /end MEASUREMENT
/begin MEASUREMENT sExtCom_CurrentUploadStatus_gde "" UBYTE NO_UNIT 1 100 0 4 ECU_ADDRESS 0xFEBEDEB7 /end MEASUREMENT
/begin MEASUREMENT sExtCom_SiciCurrentFactoryReturn_gde "" UBYTE NO_UNIT 1 100 0 6 ECU_ADDRESS 0xFEBEDEB8 /end MEASUREMENT
/begin MEASUREMENT sHwlI_EsbState_gde "ESB Status in the ASIL context" SBYTE NO_UNIT 1 100 0 1 ECU_ADDRESS 0xFEBEE518 /end MEASUREMENT
/begin MEASUREMENT yExtCom_LocalAswReadBackCopy_gau8 "" UBYTE NO_UNIT 1 100 0 86 ECU_ADDRESS 0xFEBEDEC0 /end MEASUREMENT
/begin MEASUREMENT yExtCom_LocalAswReadCopy_gau8 "" UBYTE NO_UNIT 1 100 0 86 ECU_ADDRESS 0xFEBEDEF8 /end MEASUREMENT
/begin MEASUREMENT yExtCom_LocalAswWriteCopy_gau8 "" UBYTE NO_UNIT 1 100 0 86 ECU_ADDRESS 0xFEBEDF30 /end MEASUREMENT
/begin MEASUREMENT yExtCom_LockSensorMemory_gdu8 "" UBYTE NO_UNIT 1 100 0 1 ECU_ADDRESS 0xFEBEDEB9 /end MEASUREMENT
/begin MEASUREMENT yExtCom_NewAswDownloadCall_gdu8 "" UBYTE NO_UNIT 1 100 0 1 ECU_ADDRESS 0xFEBEDEBA /end MEASUREMENT
/begin MEASUREMENT yExtCom_NewAswUploadCall_gdu8 "" UBYTE NO_UNIT 1 100 0 1 ECU_ADDRESS 0xFEBEDEBB /end MEASUREMENT
/begin MEASUREMENT yExtCom_SiciSequnceLocked_gdu8 "" UBYTE NO_UNIT 1 100 0 1 ECU_ADDRESS 0xFEBEDEBC /end MEASUREMENT
/begin MEASUREMENT sTrcvCtrl_TransceiverState_gde "" UBYTE NO_UNIT 1 100 0 3 ECU_ADDRESS 0xFEBEEE11 /end MEASUREMENT
/begin MEASUREMENT sHwlI_VehPowerSupplyTestResult_gde "Test result interface for power supply perdrive check." SBYTE NO_UNIT 1 100 0 4 ECU_ADDRESS 0xFEBEE519 /end MEASUREMENT
/begin MEASUREMENT sVpsTest_State_gde "" UBYTE NO_UNIT 1 100 0 4 ECU_ADDRESS 0xFEBEDF68 /end MEASUREMENT
/begin MEASUREMENT yDiagInt_CurrentIndex_mdu8 "Current local freeze frame buffer index" UBYTE NO_UNIT 1 100 0 4 ECU_ADDRESS 0xFEBEEBE8 /end MEASUREMENT
/begin MEASUREMENT yEvtHist_FFBuferUpdatesSinceLastCpy_gdu8 "Counts the number of FF entries written since last copy function call to ensure a rollover can be detected" UBYTE NO_UNIT 1 100 0 5 ECU_ADDRESS 0xFEBEE79C /end MEASUREMENT
/begin MEASUREMENT yEvtHist_FFBufferIndex_mdu8 "Freeze Frame Buffer Index" UBYTE NO_UNIT 1 100 0 4 ECU_ADDRESS 0xFEBEE79D /end MEASUREMENT
/begin MEASUREMENT yEvtHist_InitDone_mdu8 "Indication for Init state" UBYTE NO_UNIT 1 100 0 1 ECU_ADDRESS 0xFEBEE79E /end MEASUREMENT
/begin MEASUREMENT sFaStCalc_FaIndStateRedInfo_gdu32 "Info if any redundancy issue happened to a FaultIndicationState" ULONG NO_UNIT 1 100 0 1 ECU_ADDRESS 0xFEBEDF6C /end MEASUREMENT
/begin MEASUREMENT sFaStCalc_IntegrityState_gde "Sw data integrity of the HwLib functions" UWORD NO_UNIT 1 100 0 65535 ECU_ADDRESS 0xFEBEDF80 /end MEASUREMENT
/begin MEASUREMENT sFaStCalcI_LocalSafeState_gde "Local part machine safe state" UBYTE NO_UNIT 1 100 0 4 ECU_ADDRESS 0xFEBEDF82 /end MEASUREMENT
/begin MEASUREMENT sHwlI_ChipsetSafetyFault_gde "Status signal for chipset safety related fauts." UBYTE NO_UNIT 1 100 0 7 ECU_ADDRESS 0xFEBEE51A /end MEASUREMENT
/begin MEASUREMENT yFaStCalc_InternalFuncRequest_gae "Internal function requested safe state will be stored in this variable" UBYTE NO_UNIT 1 100 0 4 ECU_ADDRESS 0xFEBEDF84 /end MEASUREMENT
/begin MEASUREMENT sFaStDet_CalcState_gde "" UBYTE NO_UNIT 1 100 0 3 ECU_ADDRESS 0xFEBEDFA0 /end MEASUREMENT
/begin MEASUREMENT sFaStDet_InitialLocalSafeState_gde "Initial calculated local safe state" UBYTE NO_UNIT 1 100 0 1 ECU_ADDRESS 0xFEBEDFA1 /end MEASUREMENT
/begin MEASUREMENT sFaStDetI_FastResetTimeOut_gdu8 "Indication of output stage shutdown delay state for fast restart" UBYTE NO_UNIT 1 100 0 1 ECU_ADDRESS 0xFEBEE51B /end MEASUREMENT
/begin MEASUREMENT sHwlI_SafeState_gde "Accumulated HwLib safe state" UBYTE NO_UNIT 1 100 0 7 ECU_ADDRESS 0xFEBEE51C /end MEASUREMENT
/begin MEASUREMENT tFaStDet_FastResetWaitTime_gdu8 "Wait time for output stage shutdown delay after SW data error." UBYTE T_MS 1 100 0 255 ECU_ADDRESS 0xFEBEDFA2 /end MEASUREMENT
/begin MEASUREMENT sIfsNvShareI_FaultIndicationState_gde "Infrastructure component state of the Nv Share" UBYTE NO_UNIT 1 100 0 7 ECU_ADDRESS 0xFEBEDFD0 /end MEASUREMENT
/begin MEASUREMENT sNvsMng_IndexStates_gde "Result of index checks" SLONG NO_UNIT 1 100 0 8388607 ECU_ADDRESS 0xFEBEEDF4 /end MEASUREMENT
/begin MEASUREMENT xHwlI_GearSign_gds8 "Sign of the steering gear" SBYTE NO_UNIT 1 100 -1 1 ECU_ADDRESS 0xFEBEE520 /end MEASUREMENT
/begin MEASUREMENT yHwlI_FocDataSelector_gdu8 "FOC data selector value from NvShare." UBYTE NO_UNIT 1 100 0 255 ECU_ADDRESS 0xFEBEE521 /end MEASUREMENT
/begin MEASUREMENT yHwlI_RackType_gdu8 "Rack Type" UBYTE NO_UNIT 1 100 0 255 ECU_ADDRESS 0xFEBEE522 /end MEASUREMENT
/begin MEASUREMENT yNvsMng_FailureValue_gde "Failure value for NvShare" UBYTE NO_UNIT 1 100 0 5 ECU_ADDRESS 0xFEBEDFD1 /end MEASUREMENT
/begin MEASUREMENT yNvsMng_FindBlockInNvShare_gdu32 "Blocks found in NvShare" ULONG NO_UNIT 1 100 0 134021119 ECU_ADDRESS 0xFEBEDFB8 /end MEASUREMENT
/begin MEASUREMENT yNvsMng_FirstUnusedNVShareAddr_gdu32 "First unused adress in NvShare" ULONG NO_UNIT 1 100 8192 16384 ECU_ADDRESS 0xFEBEDFBC /end MEASUREMENT
/begin MEASUREMENT yNvsMng_InitialDataSafeCrc_gdu32 "" ULONG NO_UNIT 1 100 0 4294967295 ECU_ADDRESS 0xFEBEDFC0 /end MEASUREMENT
/begin MEASUREMENT yNvsMng_InitState_gde "State of NvShare initalisation" UBYTE NO_UNIT 1 100 0 2 ECU_ADDRESS 0xFEBEEDF8 /end MEASUREMENT
/begin MEASUREMENT yNvsMng_WrongValueInNvShare_gdu32 "Some values in NvShare are wrong" ULONG NO_UNIT 1 100 0 33554431 ECU_ADDRESS 0xFEBEDFC8 /end MEASUREMENT
/begin MEASUREMENT zNvsMng_CrcErrCnt_gdu8 "CRc Error Count" UBYTE NO_UNIT 1 100 0 255 ECU_ADDRESS 0xFEBEDFD2 /end MEASUREMENT
/begin MEASUREMENT sIfsSafetyMechI_FaultIndicationState_gde "Fault indication state of the SafeMech component" UBYTE NO_UNIT 1 100 0 7 ECU_ADDRESS 0xFEBEDFEC /end MEASUREMENT
/begin MEASUREMENT sIfsSuCooI_ShutdownPermission_gde "Shutdown allowed or blocked" UBYTE NO_UNIT 1 100 0 1 ECU_ADDRESS 0xFEBEDFF8 /end MEASUREMENT
/begin MEASUREMENT sSuCoo_ShutdownRequested_gde "Shutdown requested status" UBYTE NO_UNIT 1 100 0 1 ECU_ADDRESS 0xFEBEDFF9 /end MEASUREMENT
/begin MEASUREMENT ySuCooI_StartupCoordStateMachine_mde "" UBYTE NO_UNIT 1 100 0 2 ECU_ADDRESS 0xFEBEDFFA /end MEASUREMENT
/begin MEASUREMENT sStateCtrl_StartupInfo_gau8 "Array holding string Fast Restart as a Flag indicating fast restart mode" UBYTE NO_UNIT 1 100 0 255 ECU_ADDRESS 0xFEBFFC40 MATRIX_DIM 12 1 1 /end MEASUREMENT
/begin MEASUREMENT sStateCtrl_PostRunReleaseStatus_gde "Post Run Released from SuCoo" UBYTE NO_UNIT 1 100 0 2 ECU_ADDRESS 0xFEBEE0F4 /end MEASUREMENT
/begin MEASUREMENT sStateCtrl_StartupMode_gde "Internal HwLib Startup Mode" UBYTE NO_UNIT 1 100 0 1 ECU_ADDRESS 0xFEBEE588 /end MEASUREMENT
/begin MEASUREMENT sStateHandI_CurrActivityCommand_mde "Current activity command from external" UBYTE NO_UNIT 1 100 0 2 ECU_ADDRESS 0xFEBEEE12 /end MEASUREMENT
/begin MEASUREMENT sStateHandI_HwlState_gde "HwLib state" UBYTE NO_UNIT 1 100 0 3 ECU_ADDRESS 0xFEBEE589 /end MEASUREMENT
/begin MEASUREMENT yStateCtrl_OutStgShutdownFinished_gdu8 "Flag signal ouputsatge shutdown" UBYTE NO_UNIT 1 100 0 1 ECU_ADDRESS 0xFEBEE58A /end MEASUREMENT
/begin MEASUREMENT yStateCtrl_ShutdownFinished_gdu8 "Flag signal if shutdown done" UBYTE NO_UNIT 1 100 0 1 ECU_ADDRESS 0xFEBEE58B /end MEASUREMENT
/begin MEASUREMENT sIfsStateHandI_ActiveInterruptTypeIsr_gde "" UBYTE NO_UNIT 1 100 0 3 ECU_ADDRESS 0xFEBEE114 /end MEASUREMENT
/begin MEASUREMENT sIfsStateHandI_FaultIndicationState_gde "FaultIndicationState" UBYTE NO_UNIT 1 100 0 7 ECU_ADDRESS 0xFEBEE115 /end MEASUREMENT
/begin MEASUREMENT tIfsStateHandI_SystemTimeMs_gdu16 "System time in ms (task counter)" UWORD T_MS 1 100 0 65535 ECU_ADDRESS 0xFEBEE110 /end MEASUREMENT
/begin MEASUREMENT zTaskCtrl_10msValidCounter_gdu8 "Used to observe the occurence of the 10msEndTask" UBYTE NO_UNIT 1 100 0 255 ECU_ADDRESS 0xFEBEE116 /end MEASUREMENT
/begin MEASUREMENT zTaskCtrl_5msCounter_gdu16 "5ms counter" UWORD NO_UNIT 1 100 0 65535 ECU_ADDRESS 0xFEBEE112 /end MEASUREMENT
/begin MEASUREMENT zTaskCtrl_5msValidCounter_gdu8 "Used to observe the occurence of the 5msEndTask" UBYTE NO_UNIT 1 100 0 255 ECU_ADDRESS 0xFEBEE117 /end MEASUREMENT
/begin COMPU_METHOD ANG_RAD_REAL "angle in rad for float values" RAT_FUNC "%4.5" "rad" COEFFS 0 1 0 0 0 1 /end COMPU_METHOD
/begin COMPU_METHOD ANG_VEL_REAL "angular velocity in rad/s for float values" RAT_FUNC "%4.5" "rad/s" COEFFS 0 1 0 0 0 1 /end COMPU_METHOD
/begin COMPU_METHOD ANG_ACCEL_REAL "angular acceleration in rad/sÂ² for float values" RAT_FUNC "%4.5" "rad/sÂ²" COEFFS 0 1 0 0 0 1 /end COMPU_METHOD
/begin COMPU_METHOD CURR_REAL "current in A for float values" RAT_FUNC "%4.5" "A" COEFFS 0 1 0 0 0 1 /end COMPU_METHOD
/begin COMPU_METHOD CURR_INT "current in A for integer values" RAT_FUNC "%4.5" "A" COEFFS 0 16 0 0 0 1 /end COMPU_METHOD
/begin COMPU_METHOD CURR_GRAD_INT "current gradient" RAT_FUNC "%4.5" "A/ms" COEFFS 0 16 0 0 0 1 /end COMPU_METHOD
/begin COMPU_METHOD INDUCTANCE_REAL "inductance in ÂµH for float values" RAT_FUNC "%4.5" "ÂµH" COEFFS 0 1E-06 0 0 0 1 /end COMPU_METHOD
/begin COMPU_METHOD NO_UNIT "no physical assignment" RAT_FUNC "%4.5" "-" COEFFS 0 1 0 0 0 1 /end COMPU_METHOD
/begin COMPU_METHOD OHM_REAL "resistance in mâ„¦ for float values" RAT_FUNC "%4.5" "mâ„¦" COEFFS 0 0.001 0 0 0 1 /end COMPU_METHOD
/begin COMPU_METHOD PERCENT_INT "percentage in %  for integer values" RAT_FUNC "%4.5" "%" COEFFS 0 327.68 0 0 0 1 /end COMPU_METHOD
/begin COMPU_METHOD RPM_REAL "rotation frequency in rpm for float values" RAT_FUNC "%4.5" "rpm" COEFFS 0 1 0 0 0 1 /end COMPU_METHOD
/begin COMPU_METHOD T_S "time in s for integer values" RAT_FUNC "%4.5" "s" COEFFS 0 1 0 0 0 1 /end COMPU_METHOD
/begin COMPU_METHOD T_MS "time in ms for integer values" RAT_FUNC "%4.5" "ms" COEFFS 0 1 0 0 0 1 /end COMPU_METHOD
/begin COMPU_METHOD T_US "time in Âµs for integer values" RAT_FUNC "%4.5" "Âµs" COEFFS 0 1 0 0 0 1 /end COMPU_METHOD
/begin COMPU_METHOD TORQ_INT "torque in Nm for integer values" RAT_FUNC "%4.5" "Nm" COEFFS 0 1024 0 0 0 1 /end COMPU_METHOD
/begin COMPU_METHOD TORQ_REAL "torque in Nm  for float values" RAT_FUNC "%4.5" "Nm" COEFFS 0 1 0 0 0 1 /end COMPU_METHOD
/begin COMPU_METHOD TORQ_GRAD_INT "torque gradient in Nm/ms for integer values" RAT_FUNC "%4.5" "Nm/ms" COEFFS 0 1024 0 0 0 1 /end COMPU_METHOD
/begin COMPU_METHOD TORQ_GRAD_REAL "torque gradient in Nm/ms for float values" RAT_FUNC "%4.5" "Nm/ms" COEFFS 0 1 0 0 0 1 /end COMPU_METHOD
/begin COMPU_METHOD TORQ_STIFF_INT "torque stiffness in Nm/Â° for integer values" RAT_FUNC "%4.5" "Nm/Â°" COEFFS 0 1024 0 0 0 1 /end COMPU_METHOD
/begin COMPU_METHOD TEMP_INT "temperature in Â°C for integer values" RAT_FUNC "%4.5" "Â°C" COEFFS 0 1 70 0 0 1 /end COMPU_METHOD
/begin COMPU_METHOD VOLT_REAL "voltage in V for float values" RAT_FUNC "%4.5" "V" COEFFS 0 1 0 0 0 1 /end COMPU_METHOD
/begin RECORD_LAYOUT rlCurvesb FNC_VALUES 3 SBYTE COLUMN_DIR DIRECT AXIS_PTS_X 2 SBYTE INDEX_INCR DIRECT NO_AXIS_PTS_X 1 UBYTE /end RECORD_LAYOUT
/begin RECORD_LAYOUT rlCurvesl FNC_VALUES 3 SLONG COLUMN_DIR DIRECT AXIS_PTS_X 2 SLONG INDEX_INCR DIRECT NO_AXIS_PTS_X 1 UBYTE /end RECORD_LAYOUT
/begin RECORD_LAYOUT rlCurveub FNC_VALUES 3 UBYTE COLUMN_DIR DIRECT AXIS_PTS_X 2 UBYTE INDEX_INCR DIRECT NO_AXIS_PTS_X 1 UBYTE /end RECORD_LAYOUT
/begin RECORD_LAYOUT rlCurveul FNC_VALUES 3 ULONG COLUMN_DIR DIRECT AXIS_PTS_X 2 ULONG INDEX_INCR DIRECT NO_AXIS_PTS_X 1 UBYTE /end RECORD_LAYOUT
/begin RECORD_LAYOUT rlValuesb FNC_VALUES 1 SBYTE COLUMN_DIR DIRECT /end RECORD_LAYOUT
/begin RECORD_LAYOUT rlValuesl FNC_VALUES 1 SLONG COLUMN_DIR DIRECT /end RECORD_LAYOUT
/end MODULE
/end PROJECT
