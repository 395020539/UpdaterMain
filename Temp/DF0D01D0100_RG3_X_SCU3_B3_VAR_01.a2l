ASAP2_VERSION 1 70
/begin PROJECT _DF0_D01 "SCU3_B3_VAR_01"
/begin HEADER "" VERSION "DF0_D01_D_01_00" PROJECT_NO _DF0_D01 /end HEADER
/begin MODULE XCP_EPS_ECU "CMP"
/begin MOD_COMMON "" BYTE_ORDER MSB_LAST ALIGNMENT_BYTE 1 ALIGNMENT_WORD 2 ALIGNMENT_LONG 4 ALIGNMENT_FLOAT32_IEEE 4 ALIGNMENT_FLOAT64_IEEE 8 /end MOD_COMMON
/begin CHARACTERISTIC AZG_SecurityAccessDeliveredPublicKey "Array mit Public Key" VAL_BLK 0x148000 AblGLKWBub 255 ZU0 0 255 NUMBER 270 FORMAT "%5.1" /end CHARACTERISTIC
/begin CHARACTERISTIC AZG_SecurityAccessDevelopmentPublicKey "Array mit Public Key" VAL_BLK 0x148110 AblGLKWBub 255 ZU0 0 255 NUMBER 270 FORMAT "%5.1" /end CHARACTERISTIC
/begin CHARACTERISTIC AZG_SecurityAccessProductionPublicKey "Array mit Public Key" VAL_BLK 0x148220 AblGLKWBub 255 ZU0 0 255 NUMBER 270 FORMAT "%5.1" /end CHARACTERISTIC
/begin CHARACTERISTIC cBsd_TempratureLimit_XDU8 "Temprature border for PCB temprature" VALUE 0x150A94 AblGLKWub 210 TMPOUTS -70 140 FORMAT "%5.1" /end CHARACTERISTIC
/begin CHARACTERISTIC fatAllowAssistReduction_XDB "Erlaubt eine Reduzierung der Unterstuetzung aufgrund (mApplI_HWLMaxUsableTorque * xHwlWrapI_MinRedLevel)" VALUE 0x150A97 AblGLKWub 1 BIT 0 1 FORMAT "%5.3" /end CHARACTERISTIC
/begin CHARACTERISTIC fatAllowMaxReqMMotReduction_XDB "Erlaubt eine Reduzierung von MaxRequiredMotorTorque aufgrund (mApplI_HWLMaxUsableTorque * xHwlWrapI_MinRedLevel)" VALUE 0x150A98 AblGLKWub 1 BIT 0 1 FORMAT "%5.3" /end CHARACTERISTIC
/begin CHARACTERISTIC fAutParkCtrl_EnableDesRackPosFilt_XDU8 "enable filtering of the desired rack position due to an interpolation between the steps (macros shall be configured)" VALUE 0x150A99 AblGLKWub 1 ZU0 0 1 FORMAT "%5.3" /end CHARACTERISTIC
/begin CHARACTERISTIC fAutParkCtrl_EnableFeedForward_XDU8 "enable feed-forward controlled nominal rack position (formerly known as bypass)" VALUE 0x150A9A AblGLKWub 1 ZU0 0 1 FORMAT "%5.3" /end CHARACTERISTIC
/begin CHARACTERISTIC fAutParkCtrl_LtStCorrActive_XDB "" VALUE 0x150A9B AblGLKWub 1 ZU0 0 1 FORMAT "%5.3" /end CHARACTERISTIC
/begin CHARACTERISTIC lAutParkCtrl_MaxRackPosDiff_XDU16 "maximum allowed rack position difference of desired to real value" VALUE 0x15054C AblGLKWuw 400 RACKPOS128 0 400 FORMAT "%8.4" /end CHARACTERISTIC
/begin CHARACTERISTIC lAutParkCtrl_MaxRackPosGrad_XDU16 "maximum allowed gradient of desired rack position" VALUE 0x15054E AblGLKWuw 400 RACKPOS128 0 400 FORMAT "%8.4" /end CHARACTERISTIC
/begin CHARACTERISTIC mAutParkCtrl_CheckHandsOnTorqLim_XDU16 "threshold of driver's steering torque to detect HandsOn" VALUE 0x15058E AblGLKWuw 6.5 TBTHIGH 0.5 7 FORMAT "%8.6" /end CHARACTERISTIC
/begin CHARACTERISTIC mAutParkCtrl_ColumnTorqueLim_XDU16 "Tiefer Grenze fÃ¼r Fahrerhandmoment" VALUE 0x150590 AblGLKWuw 1.5 TBTHIGH 0 1.5 FORMAT "%8.6" /end CHARACTERISTIC
/begin CHARACTERISTIC mAutParkCtrl_DeadBandTBT_XDU16 "maximum allowed steering torque offset (formerly known as dead band)" VALUE 0x150592 AblGLKWuw 6.5 TBTHIGH 0 6.5 FORMAT "%8.6" /end CHARACTERISTIC
/begin CHARACTERISTIC mAutParkCtrl_HandsOffTorqLim_XDU16 "Tiefer Grenze fÃ¼r Fahrerhandmoment" VALUE 0x150594 AblGLKWuw 3 TBTHIGH 0 3 FORMAT "%8.6" /end CHARACTERISTIC
/begin CHARACTERISTIC mAutParkCtrl_HandsOnTorqLim_XDU16 "obere Grenze fÃ¼r Fahrerhandmoment" VALUE 0x150596 AblGLKWuw 2.5 TBTHIGH 0.5 3 FORMAT "%8.6" /end CHARACTERISTIC
/begin CHARACTERISTIC mBci_V0BaseTorque_XAS16_00___A "nominelles Handmoment abhängig von der Zahnstangenkraft bei Geschwindigkeit v0" CURVE 0x15891C AblGLKLsw 15 TBTHIGH 0 15 FORMAT "%8.5"
 /begin AXIS_DESCR STD_AXIS kApplI_AbsRackForce_xdu16 FRACK 9 0 30000 FORMAT "%8.2" DEPOSIT ABSOLUTE /end AXIS_DESCR
/end CHARACTERISTIC
/begin CHARACTERISTIC mBci_V0BaseTorque_XAS16_01___A "nominelles Handmoment abhängig von der Zahnstangenkraft bei Geschwindigkeit v0" CURVE 0x158944 AblGLKLsw 15 TBTHIGH 0 15 FORMAT "%8.5"
 /begin AXIS_DESCR STD_AXIS kApplI_AbsRackForce_xdu16 FRACK 9 0 30000 FORMAT "%8.2" DEPOSIT ABSOLUTE /end AXIS_DESCR
/end CHARACTERISTIC
/begin CHARACTERISTIC mBci_V0BaseTorque_XAS16_02___A "nominelles Handmoment abhängig von der Zahnstangenkraft bei Geschwindigkeit v0" CURVE 0x15896C AblGLKLsw 15 TBTHIGH 0 15 FORMAT "%8.5"
 /begin AXIS_DESCR STD_AXIS kApplI_AbsRackForce_xdu16 FRACK 9 0 30000 FORMAT "%8.2" DEPOSIT ABSOLUTE /end AXIS_DESCR
/end CHARACTERISTIC
/begin CHARACTERISTIC mBci_V0BaseTorque_XAS16_03___A "nominelles Handmoment abhängig von der Zahnstangenkraft bei Geschwindigkeit v0" CURVE 0x158994 AblGLKLsw 15 TBTHIGH 0 15 FORMAT "%8.5"
 /begin AXIS_DESCR STD_AXIS kApplI_AbsRackForce_xdu16 FRACK 9 0 30000 FORMAT "%8.2" DEPOSIT ABSOLUTE /end AXIS_DESCR
/end CHARACTERISTIC
/begin CHARACTERISTIC mBci_V0BaseTorque_XAS16_04___A "nominelles Handmoment abhängig von der Zahnstangenkraft bei Geschwindigkeit v0" CURVE 0x1589BC AblGLKLsw 15 TBTHIGH 0 15 FORMAT "%8.5"
 /begin AXIS_DESCR STD_AXIS kApplI_AbsRackForce_xdu16 FRACK 9 0 30000 FORMAT "%8.2" DEPOSIT ABSOLUTE /end AXIS_DESCR
/end CHARACTERISTIC
/begin CHARACTERISTIC mBci_V0BaseTorque_XAS16_05___A "nominelles Handmoment abhängig von der Zahnstangenkraft bei Geschwindigkeit v0" CURVE 0x1589E4 AblGLKLsw 15 TBTHIGH 0 15 FORMAT "%8.5"
 /begin AXIS_DESCR STD_AXIS kApplI_AbsRackForce_xdu16 FRACK 9 0 30000 FORMAT "%8.2" DEPOSIT ABSOLUTE /end AXIS_DESCR
/end CHARACTERISTIC
/begin CHARACTERISTIC mBci_V0BaseTorque_XAS16_06___A "nominelles Handmoment abhängig von der Zahnstangenkraft bei Geschwindigkeit v0" CURVE 0x158A0C AblGLKLsw 15 TBTHIGH 0 15 FORMAT "%8.5"
 /begin AXIS_DESCR STD_AXIS kApplI_AbsRackForce_xdu16 FRACK 9 0 30000 FORMAT "%8.2" DEPOSIT ABSOLUTE /end AXIS_DESCR
/end CHARACTERISTIC
/begin CHARACTERISTIC mBci_V0BaseTorque_XAS16_07___A "nominelles Handmoment abhängig von der Zahnstangenkraft bei Geschwindigkeit v0" CURVE 0x158A34 AblGLKLsw 15 TBTHIGH 0 15 FORMAT "%8.5"
 /begin AXIS_DESCR STD_AXIS kApplI_AbsRackForce_xdu16 FRACK 9 0 30000 FORMAT "%8.2" DEPOSIT ABSOLUTE /end AXIS_DESCR
/end CHARACTERISTIC
/begin CHARACTERISTIC mBci_V0BaseTorque_XAS16_08___A "nominelles Handmoment abhängig von der Zahnstangenkraft bei Geschwindigkeit v0" CURVE 0x158A5C AblGLKLsw 15 TBTHIGH 0 15 FORMAT "%8.5"
 /begin AXIS_DESCR STD_AXIS kApplI_AbsRackForce_xdu16 FRACK 9 0 30000 FORMAT "%8.2" DEPOSIT ABSOLUTE /end AXIS_DESCR
/end CHARACTERISTIC
/begin CHARACTERISTIC mBci_V0BaseTorque_XAS16_09___A "nominelles Handmoment abhängig von der Zahnstangenkraft bei Geschwindigkeit v0" CURVE 0x158A84 AblGLKLsw 15 TBTHIGH 0 15 FORMAT "%8.5"
 /begin AXIS_DESCR STD_AXIS kApplI_AbsRackForce_xdu16 FRACK 9 0 30000 FORMAT "%8.2" DEPOSIT ABSOLUTE /end AXIS_DESCR
/end CHARACTERISTIC
/begin CHARACTERISTIC mBci_V0BaseTorque_XAS16_10___A "nominelles Handmoment abhängig von der Zahnstangenkraft bei Geschwindigkeit v0" CURVE 0x158AAC AblGLKLsw 15 TBTHIGH 0 15 FORMAT "%8.5"
 /begin AXIS_DESCR STD_AXIS kApplI_AbsRackForce_xdu16 FRACK 9 0 30000 FORMAT "%8.2" DEPOSIT ABSOLUTE /end AXIS_DESCR
/end CHARACTERISTIC
/begin CHARACTERISTIC mBci_V0BaseTorque_XAS16_11___A "nominelles Handmoment abhängig von der Zahnstangenkraft bei Geschwindigkeit v0" CURVE 0x158AD4 AblGLKLsw 15 TBTHIGH 0 15 FORMAT "%8.5"
 /begin AXIS_DESCR STD_AXIS kApplI_AbsRackForce_xdu16 FRACK 9 0 30000 FORMAT "%8.2" DEPOSIT ABSOLUTE /end AXIS_DESCR
/end CHARACTERISTIC
/begin CHARACTERISTIC mBci_V0BaseTorque_XAS16_12___A "nominelles Handmoment abhängig von der Zahnstangenkraft bei Geschwindigkeit v0" CURVE 0x158AFC AblGLKLsw 15 TBTHIGH 0 15 FORMAT "%8.5"
 /begin AXIS_DESCR STD_AXIS kApplI_AbsRackForce_xdu16 FRACK 9 0 30000 FORMAT "%8.2" DEPOSIT ABSOLUTE /end AXIS_DESCR
/end CHARACTERISTIC
/begin CHARACTERISTIC mBci_V0BaseTorque_XAS16_13___A "nominelles Handmoment abhängig von der Zahnstangenkraft bei Geschwindigkeit v0" CURVE 0x158B24 AblGLKLsw 15 TBTHIGH 0 15 FORMAT "%8.5"
 /begin AXIS_DESCR STD_AXIS kApplI_AbsRackForce_xdu16 FRACK 9 0 30000 FORMAT "%8.2" DEPOSIT ABSOLUTE /end AXIS_DESCR
/end CHARACTERISTIC
/begin CHARACTERISTIC mBci_V0BaseTorque_XAS16_14___A "nominelles Handmoment abhängig von der Zahnstangenkraft bei Geschwindigkeit v0" CURVE 0x158B4C AblGLKLsw 15 TBTHIGH 0 15 FORMAT "%8.5"
 /begin AXIS_DESCR STD_AXIS kApplI_AbsRackForce_xdu16 FRACK 9 0 30000 FORMAT "%8.2" DEPOSIT ABSOLUTE /end AXIS_DESCR
/end CHARACTERISTIC
/begin CHARACTERISTIC mBci_V0BaseTorque_XAS16_15___A "nominelles Handmoment abhängig von der Zahnstangenkraft bei Geschwindigkeit v0" CURVE 0x158B74 AblGLKLsw 15 TBTHIGH 0 15 FORMAT "%8.5"
 /begin AXIS_DESCR STD_AXIS kApplI_AbsRackForce_xdu16 FRACK 9 0 30000 FORMAT "%8.2" DEPOSIT ABSOLUTE /end AXIS_DESCR
/end CHARACTERISTIC
/begin CHARACTERISTIC mBci_V0BaseTorque_XAS16_16___A "nominelles Handmoment abhängig von der Zahnstangenkraft bei Geschwindigkeit v0" CURVE 0x158B9C AblGLKLsw 15 TBTHIGH 0 15 FORMAT "%8.5"
 /begin AXIS_DESCR STD_AXIS kApplI_AbsRackForce_xdu16 FRACK 9 0 30000 FORMAT "%8.2" DEPOSIT ABSOLUTE /end AXIS_DESCR
/end CHARACTERISTIC
/begin CHARACTERISTIC mBci_V0BaseTorque_XAS16_17___A "nominelles Handmoment abhängig von der Zahnstangenkraft bei Geschwindigkeit v0" CURVE 0x158BC4 AblGLKLsw 15 TBTHIGH 0 15 FORMAT "%8.5"
 /begin AXIS_DESCR STD_AXIS kApplI_AbsRackForce_xdu16 FRACK 9 0 30000 FORMAT "%8.2" DEPOSIT ABSOLUTE /end AXIS_DESCR
/end CHARACTERISTIC
/begin CHARACTERISTIC mBci_V0BaseTorque_XAS16_18___A "nominelles Handmoment abhängig von der Zahnstangenkraft bei Geschwindigkeit v0" CURVE 0x158BEC AblGLKLsw 15 TBTHIGH 0 15 FORMAT "%8.5"
 /begin AXIS_DESCR STD_AXIS kApplI_AbsRackForce_xdu16 FRACK 9 0 30000 FORMAT "%8.2" DEPOSIT ABSOLUTE /end AXIS_DESCR
/end CHARACTERISTIC
/begin CHARACTERISTIC mBci_V0BaseTorque_XAS16_19___A "nominelles Handmoment abhängig von der Zahnstangenkraft bei Geschwindigkeit v0" CURVE 0x158C14 AblGLKLsw 15 TBTHIGH 0 15 FORMAT "%8.5"
 /begin AXIS_DESCR STD_AXIS kApplI_AbsRackForce_xdu16 FRACK 9 0 30000 FORMAT "%8.2" DEPOSIT ABSOLUTE /end AXIS_DESCR
/end CHARACTERISTIC
/begin CHARACTERISTIC mBci_V0BaseTorque_XAS16_20___A "nominelles Handmoment abhängig von der Zahnstangenkraft bei Geschwindigkeit v0" CURVE 0x158C3C AblGLKLsw 15 TBTHIGH 0 15 FORMAT "%8.5"
 /begin AXIS_DESCR STD_AXIS kApplI_AbsRackForce_xdu16 FRACK 9 0 30000 FORMAT "%8.2" DEPOSIT ABSOLUTE /end AXIS_DESCR
/end CHARACTERISTIC
/begin CHARACTERISTIC mBci_V0BaseTorque_XAS16_21___A "nominelles Handmoment abhängig von der Zahnstangenkraft bei Geschwindigkeit v0" CURVE 0x158C64 AblGLKLsw 15 TBTHIGH 0 15 FORMAT "%8.5"
 /begin AXIS_DESCR STD_AXIS kApplI_AbsRackForce_xdu16 FRACK 9 0 30000 FORMAT "%8.2" DEPOSIT ABSOLUTE /end AXIS_DESCR
/end CHARACTERISTIC
/begin CHARACTERISTIC mBci_V0BaseTorque_XAS16_22___A "nominelles Handmoment abhängig von der Zahnstangenkraft bei Geschwindigkeit v0" CURVE 0x158C8C AblGLKLsw 15 TBTHIGH 0 15 FORMAT "%8.5"
 /begin AXIS_DESCR STD_AXIS kApplI_AbsRackForce_xdu16 FRACK 9 0 30000 FORMAT "%8.2" DEPOSIT ABSOLUTE /end AXIS_DESCR
/end CHARACTERISTIC
/begin CHARACTERISTIC mBci_V0BaseTorque_XAS16_23___A "nominelles Handmoment abhängig von der Zahnstangenkraft bei Geschwindigkeit v0" CURVE 0x158CB4 AblGLKLsw 15 TBTHIGH 0 15 FORMAT "%8.5"
 /begin AXIS_DESCR STD_AXIS kApplI_AbsRackForce_xdu16 FRACK 9 0 30000 FORMAT "%8.2" DEPOSIT ABSOLUTE /end AXIS_DESCR
/end CHARACTERISTIC
/begin CHARACTERISTIC mBci_V0BaseTorque_XAS16_24___A "nominelles Handmoment abhängig von der Zahnstangenkraft bei Geschwindigkeit v0" CURVE 0x158CDC AblGLKLsw 15 TBTHIGH 0 15 FORMAT "%8.5"
 /begin AXIS_DESCR STD_AXIS kApplI_AbsRackForce_xdu16 FRACK 9 0 30000 FORMAT "%8.2" DEPOSIT ABSOLUTE /end AXIS_DESCR
/end CHARACTERISTIC
/begin CHARACTERISTIC mBci_V0BaseTorque_XAS16_25___A "nominelles Handmoment abhängig von der Zahnstangenkraft bei Geschwindigkeit v0" CURVE 0x158D04 AblGLKLsw 15 TBTHIGH 0 15 FORMAT "%8.5"
 /begin AXIS_DESCR STD_AXIS kApplI_AbsRackForce_xdu16 FRACK 9 0 30000 FORMAT "%8.2" DEPOSIT ABSOLUTE /end AXIS_DESCR
/end CHARACTERISTIC
/begin CHARACTERISTIC mBci_V0BaseTorque_XAS16_26___A "nominelles Handmoment abhängig von der Zahnstangenkraft bei Geschwindigkeit v0" CURVE 0x158D2C AblGLKLsw 15 TBTHIGH 0 15 FORMAT "%8.5"
 /begin AXIS_DESCR STD_AXIS kApplI_AbsRackForce_xdu16 FRACK 9 0 30000 FORMAT "%8.2" DEPOSIT ABSOLUTE /end AXIS_DESCR
/end CHARACTERISTIC
/begin CHARACTERISTIC mBci_V0BaseTorque_XAS16_27___A "nominelles Handmoment abhängig von der Zahnstangenkraft bei Geschwindigkeit v0" CURVE 0x158D54 AblGLKLsw 15 TBTHIGH 0 15 FORMAT "%8.5"
 /begin AXIS_DESCR STD_AXIS kApplI_AbsRackForce_xdu16 FRACK 9 0 30000 FORMAT "%8.2" DEPOSIT ABSOLUTE /end AXIS_DESCR
/end CHARACTERISTIC
/begin CHARACTERISTIC mBci_V0BaseTorque_XAS16_28___A "nominelles Handmoment abhängig von der Zahnstangenkraft bei Geschwindigkeit v0" CURVE 0x158D7C AblGLKLsw 15 TBTHIGH 0 15 FORMAT "%8.5"
 /begin AXIS_DESCR STD_AXIS kApplI_AbsRackForce_xdu16 FRACK 9 0 30000 FORMAT "%8.2" DEPOSIT ABSOLUTE /end AXIS_DESCR
/end CHARACTERISTIC
/begin CHARACTERISTIC mBci_V0BaseTorque_XAS16_29___A "nominelles Handmoment abhängig von der Zahnstangenkraft bei Geschwindigkeit v0" CURVE 0x158DA4 AblGLKLsw 15 TBTHIGH 0 15 FORMAT "%8.5"
 /begin AXIS_DESCR STD_AXIS kApplI_AbsRackForce_xdu16 FRACK 9 0 30000 FORMAT "%8.2" DEPOSIT ABSOLUTE /end AXIS_DESCR
/end CHARACTERISTIC
/begin CHARACTERISTIC mBci_V0BaseTorque_XAS16_30___A "nominelles Handmoment abhängig von der Zahnstangenkraft bei Geschwindigkeit v0" CURVE 0x158DCC AblGLKLsw 15 TBTHIGH 0 15 FORMAT "%8.5"
 /begin AXIS_DESCR STD_AXIS kApplI_AbsRackForce_xdu16 FRACK 9 0 30000 FORMAT "%8.2" DEPOSIT ABSOLUTE /end AXIS_DESCR
/end CHARACTERISTIC
/begin CHARACTERISTIC mBci_V0BaseTorque_XAS16_31___A "nominelles Handmoment abhängig von der Zahnstangenkraft bei Geschwindigkeit v0" CURVE 0x158DF4 AblGLKLsw 15 TBTHIGH 0 15 FORMAT "%8.5"
 /begin AXIS_DESCR STD_AXIS kApplI_AbsRackForce_xdu16 FRACK 9 0 30000 FORMAT "%8.2" DEPOSIT ABSOLUTE /end AXIS_DESCR
/end CHARACTERISTIC
/begin CHARACTERISTIC mBci_V0BaseTorque_XAS16_32___A "nominelles Handmoment abhängig von der Zahnstangenkraft bei Geschwindigkeit v0" CURVE 0x158E1C AblGLKLsw 15 TBTHIGH 0 15 FORMAT "%8.5"
 /begin AXIS_DESCR STD_AXIS kApplI_AbsRackForce_xdu16 FRACK 9 0 30000 FORMAT "%8.2" DEPOSIT ABSOLUTE /end AXIS_DESCR
/end CHARACTERISTIC
/begin CHARACTERISTIC mBci_V0BaseTorque_XAS16_33___A "nominelles Handmoment abhängig von der Zahnstangenkraft bei Geschwindigkeit v0" CURVE 0x158E44 AblGLKLsw 15 TBTHIGH 0 15 FORMAT "%8.5"
 /begin AXIS_DESCR STD_AXIS kApplI_AbsRackForce_xdu16 FRACK 9 0 30000 FORMAT "%8.2" DEPOSIT ABSOLUTE /end AXIS_DESCR
/end CHARACTERISTIC
/begin CHARACTERISTIC mBci_V0BaseTorque_XAS16_34___A "nominelles Handmoment abhängig von der Zahnstangenkraft bei Geschwindigkeit v0" CURVE 0x158E6C AblGLKLsw 15 TBTHIGH 0 15 FORMAT "%8.5"
 /begin AXIS_DESCR STD_AXIS kApplI_AbsRackForce_xdu16 FRACK 9 0 30000 FORMAT "%8.2" DEPOSIT ABSOLUTE /end AXIS_DESCR
/end CHARACTERISTIC
/begin CHARACTERISTIC mBci_V0BaseTorque_XAS16_35___A "nominelles Handmoment abhängig von der Zahnstangenkraft bei Geschwindigkeit v0" CURVE 0x158E94 AblGLKLsw 15 TBTHIGH 0 15 FORMAT "%8.5"
 /begin AXIS_DESCR STD_AXIS kApplI_AbsRackForce_xdu16 FRACK 9 0 30000 FORMAT "%8.2" DEPOSIT ABSOLUTE /end AXIS_DESCR
/end CHARACTERISTIC
/begin CHARACTERISTIC mBci_V1BaseTorque_XAS16_00___A "nominelles Handmoment abhängig von der Zahnstangenkraft bei Geschwindigkeit v1" CURVE 0x158EBC AblGLKLsw 15 TBTHIGH 0 15 FORMAT "%8.5"
 /begin AXIS_DESCR STD_AXIS kApplI_AbsRackForce_xdu16 FRACK 9 0 30000 FORMAT "%8.2" DEPOSIT ABSOLUTE /end AXIS_DESCR
/end CHARACTERISTIC
/begin CHARACTERISTIC mBci_V1BaseTorque_XAS16_01___A "nominelles Handmoment abhängig von der Zahnstangenkraft bei Geschwindigkeit v1" CURVE 0x158EE4 AblGLKLsw 15 TBTHIGH 0 15 FORMAT "%8.5"
 /begin AXIS_DESCR STD_AXIS kApplI_AbsRackForce_xdu16 FRACK 9 0 30000 FORMAT "%8.2" DEPOSIT ABSOLUTE /end AXIS_DESCR
/end CHARACTERISTIC
/begin CHARACTERISTIC mBci_V1BaseTorque_XAS16_02___A "nominelles Handmoment abhängig von der Zahnstangenkraft bei Geschwindigkeit v1" CURVE 0x158F0C AblGLKLsw 15 TBTHIGH 0 15 FORMAT "%8.5"
 /begin AXIS_DESCR STD_AXIS kApplI_AbsRackForce_xdu16 FRACK 9 0 30000 FORMAT "%8.2" DEPOSIT ABSOLUTE /end AXIS_DESCR
/end CHARACTERISTIC
/begin CHARACTERISTIC mBci_V1BaseTorque_XAS16_03___A "nominelles Handmoment abhängig von der Zahnstangenkraft bei Geschwindigkeit v1" CURVE 0x158F34 AblGLKLsw 15 TBTHIGH 0 15 FORMAT "%8.5"
 /begin AXIS_DESCR STD_AXIS kApplI_AbsRackForce_xdu16 FRACK 9 0 30000 FORMAT "%8.2" DEPOSIT ABSOLUTE /end AXIS_DESCR
/end CHARACTERISTIC
/begin CHARACTERISTIC mBci_V1BaseTorque_XAS16_04___A "nominelles Handmoment abhängig von der Zahnstangenkraft bei Geschwindigkeit v1" CURVE 0x158F5C AblGLKLsw 15 TBTHIGH 0 15 FORMAT "%8.5"
 /begin AXIS_DESCR STD_AXIS kApplI_AbsRackForce_xdu16 FRACK 9 0 30000 FORMAT "%8.2" DEPOSIT ABSOLUTE /end AXIS_DESCR
/end CHARACTERISTIC
/begin CHARACTERISTIC mBci_V1BaseTorque_XAS16_05___A "nominelles Handmoment abhängig von der Zahnstangenkraft bei Geschwindigkeit v1" CURVE 0x158F84 AblGLKLsw 15 TBTHIGH 0 15 FORMAT "%8.5"
 /begin AXIS_DESCR STD_AXIS kApplI_AbsRackForce_xdu16 FRACK 9 0 30000 FORMAT "%8.2" DEPOSIT ABSOLUTE /end AXIS_DESCR
/end CHARACTERISTIC
/begin CHARACTERISTIC mBci_V1BaseTorque_XAS16_06___A "nominelles Handmoment abhängig von der Zahnstangenkraft bei Geschwindigkeit v1" CURVE 0x158FAC AblGLKLsw 15 TBTHIGH 0 15 FORMAT "%8.5"
 /begin AXIS_DESCR STD_AXIS kApplI_AbsRackForce_xdu16 FRACK 9 0 30000 FORMAT "%8.2" DEPOSIT ABSOLUTE /end AXIS_DESCR
/end CHARACTERISTIC
/begin CHARACTERISTIC mBci_V1BaseTorque_XAS16_07___A "nominelles Handmoment abhängig von der Zahnstangenkraft bei Geschwindigkeit v1" CURVE 0x158FD4 AblGLKLsw 15 TBTHIGH 0 15 FORMAT "%8.5"
 /begin AXIS_DESCR STD_AXIS kApplI_AbsRackForce_xdu16 FRACK 9 0 30000 FORMAT "%8.2" DEPOSIT ABSOLUTE /end AXIS_DESCR
/end CHARACTERISTIC
/begin CHARACTERISTIC mBci_V1BaseTorque_XAS16_08___A "nominelles Handmoment abhängig von der Zahnstangenkraft bei Geschwindigkeit v1" CURVE 0x158FFC AblGLKLsw 15 TBTHIGH 0 15 FORMAT "%8.5"
 /begin AXIS_DESCR STD_AXIS kApplI_AbsRackForce_xdu16 FRACK 9 0 30000 FORMAT "%8.2" DEPOSIT ABSOLUTE /end AXIS_DESCR
/end CHARACTERISTIC
/begin CHARACTERISTIC mBci_V1BaseTorque_XAS16_09___A "nominelles Handmoment abhängig von der Zahnstangenkraft bei Geschwindigkeit v1" CURVE 0x159024 AblGLKLsw 15 TBTHIGH 0 15 FORMAT "%8.5"
 /begin AXIS_DESCR STD_AXIS kApplI_AbsRackForce_xdu16 FRACK 9 0 30000 FORMAT "%8.2" DEPOSIT ABSOLUTE /end AXIS_DESCR
/end CHARACTERISTIC
/begin CHARACTERISTIC mBci_V1BaseTorque_XAS16_10___A "nominelles Handmoment abhängig von der Zahnstangenkraft bei Geschwindigkeit v1" CURVE 0x15904C AblGLKLsw 15 TBTHIGH 0 15 FORMAT "%8.5"
 /begin AXIS_DESCR STD_AXIS kApplI_AbsRackForce_xdu16 FRACK 9 0 30000 FORMAT "%8.2" DEPOSIT ABSOLUTE /end AXIS_DESCR
/end CHARACTERISTIC
/begin CHARACTERISTIC mBci_V1BaseTorque_XAS16_11___A "nominelles Handmoment abhängig von der Zahnstangenkraft bei Geschwindigkeit v1" CURVE 0x159074 AblGLKLsw 15 TBTHIGH 0 15 FORMAT "%8.5"
 /begin AXIS_DESCR STD_AXIS kApplI_AbsRackForce_xdu16 FRACK 9 0 30000 FORMAT "%8.2" DEPOSIT ABSOLUTE /end AXIS_DESCR
/end CHARACTERISTIC
/begin CHARACTERISTIC mBci_V1BaseTorque_XAS16_12___A "nominelles Handmoment abhängig von der Zahnstangenkraft bei Geschwindigkeit v1" CURVE 0x15909C AblGLKLsw 15 TBTHIGH 0 15 FORMAT "%8.5"
 /begin AXIS_DESCR STD_AXIS kApplI_AbsRackForce_xdu16 FRACK 9 0 30000 FORMAT "%8.2" DEPOSIT ABSOLUTE /end AXIS_DESCR
/end CHARACTERISTIC
/begin CHARACTERISTIC mBci_V1BaseTorque_XAS16_13___A "nominelles Handmoment abhängig von der Zahnstangenkraft bei Geschwindigkeit v1" CURVE 0x1590C4 AblGLKLsw 15 TBTHIGH 0 15 FORMAT "%8.5"
 /begin AXIS_DESCR STD_AXIS kApplI_AbsRackForce_xdu16 FRACK 9 0 30000 FORMAT "%8.2" DEPOSIT ABSOLUTE /end AXIS_DESCR
/end CHARACTERISTIC
/begin CHARACTERISTIC mBci_V1BaseTorque_XAS16_14___A "nominelles Handmoment abhängig von der Zahnstangenkraft bei Geschwindigkeit v1" CURVE 0x1590EC AblGLKLsw 15 TBTHIGH 0 15 FORMAT "%8.5"
 /begin AXIS_DESCR STD_AXIS kApplI_AbsRackForce_xdu16 FRACK 9 0 30000 FORMAT "%8.2" DEPOSIT ABSOLUTE /end AXIS_DESCR
/end CHARACTERISTIC
/begin CHARACTERISTIC mBci_V1BaseTorque_XAS16_15___A "nominelles Handmoment abhängig von der Zahnstangenkraft bei Geschwindigkeit v1" CURVE 0x159114 AblGLKLsw 15 TBTHIGH 0 15 FORMAT "%8.5"
 /begin AXIS_DESCR STD_AXIS kApplI_AbsRackForce_xdu16 FRACK 9 0 30000 FORMAT "%8.2" DEPOSIT ABSOLUTE /end AXIS_DESCR
/end CHARACTERISTIC
/begin CHARACTERISTIC mBci_V1BaseTorque_XAS16_16___A "nominelles Handmoment abhängig von der Zahnstangenkraft bei Geschwindigkeit v1" CURVE 0x15913C AblGLKLsw 15 TBTHIGH 0 15 FORMAT "%8.5"
 /begin AXIS_DESCR STD_AXIS kApplI_AbsRackForce_xdu16 FRACK 9 0 30000 FORMAT "%8.2" DEPOSIT ABSOLUTE /end AXIS_DESCR
/end CHARACTERISTIC
/begin CHARACTERISTIC mBci_V1BaseTorque_XAS16_17___A "nominelles Handmoment abhängig von der Zahnstangenkraft bei Geschwindigkeit v1" CURVE 0x159164 AblGLKLsw 15 TBTHIGH 0 15 FORMAT "%8.5"
 /begin AXIS_DESCR STD_AXIS kApplI_AbsRackForce_xdu16 FRACK 9 0 30000 FORMAT "%8.2" DEPOSIT ABSOLUTE /end AXIS_DESCR
/end CHARACTERISTIC
/begin CHARACTERISTIC mBci_V1BaseTorque_XAS16_18___A "nominelles Handmoment abhängig von der Zahnstangenkraft bei Geschwindigkeit v1" CURVE 0x15918C AblGLKLsw 15 TBTHIGH 0 15 FORMAT "%8.5"
 /begin AXIS_DESCR STD_AXIS kApplI_AbsRackForce_xdu16 FRACK 9 0 30000 FORMAT "%8.2" DEPOSIT ABSOLUTE /end AXIS_DESCR
/end CHARACTERISTIC
/begin CHARACTERISTIC mBci_V1BaseTorque_XAS16_19___A "nominelles Handmoment abhängig von der Zahnstangenkraft bei Geschwindigkeit v1" CURVE 0x1591B4 AblGLKLsw 15 TBTHIGH 0 15 FORMAT "%8.5"
 /begin AXIS_DESCR STD_AXIS kApplI_AbsRackForce_xdu16 FRACK 9 0 30000 FORMAT "%8.2" DEPOSIT ABSOLUTE /end AXIS_DESCR
/end CHARACTERISTIC
/begin CHARACTERISTIC mBci_V1BaseTorque_XAS16_20___A "nominelles Handmoment abhängig von der Zahnstangenkraft bei Geschwindigkeit v1" CURVE 0x1591DC AblGLKLsw 15 TBTHIGH 0 15 FORMAT "%8.5"
 /begin AXIS_DESCR STD_AXIS kApplI_AbsRackForce_xdu16 FRACK 9 0 30000 FORMAT "%8.2" DEPOSIT ABSOLUTE /end AXIS_DESCR
/end CHARACTERISTIC
/begin CHARACTERISTIC mBci_V1BaseTorque_XAS16_21___A "nominelles Handmoment abhängig von der Zahnstangenkraft bei Geschwindigkeit v1" CURVE 0x159204 AblGLKLsw 15 TBTHIGH 0 15 FORMAT "%8.5"
 /begin AXIS_DESCR STD_AXIS kApplI_AbsRackForce_xdu16 FRACK 9 0 30000 FORMAT "%8.2" DEPOSIT ABSOLUTE /end AXIS_DESCR
/end CHARACTERISTIC
/begin CHARACTERISTIC mBci_V1BaseTorque_XAS16_22___A "nominelles Handmoment abhängig von der Zahnstangenkraft bei Geschwindigkeit v1" CURVE 0x15922C AblGLKLsw 15 TBTHIGH 0 15 FORMAT "%8.5"
 /begin AXIS_DESCR STD_AXIS kApplI_AbsRackForce_xdu16 FRACK 9 0 30000 FORMAT "%8.2" DEPOSIT ABSOLUTE /end AXIS_DESCR
/end CHARACTERISTIC
/begin CHARACTERISTIC mBci_V1BaseTorque_XAS16_23___A "nominelles Handmoment abhängig von der Zahnstangenkraft bei Geschwindigkeit v1" CURVE 0x159254 AblGLKLsw 15 TBTHIGH 0 15 FORMAT "%8.5"
 /begin AXIS_DESCR STD_AXIS kApplI_AbsRackForce_xdu16 FRACK 9 0 30000 FORMAT "%8.2" DEPOSIT ABSOLUTE /end AXIS_DESCR
/end CHARACTERISTIC
/begin CHARACTERISTIC mBci_V1BaseTorque_XAS16_24___A "nominelles Handmoment abhängig von der Zahnstangenkraft bei Geschwindigkeit v1" CURVE 0x15927C AblGLKLsw 15 TBTHIGH 0 15 FORMAT "%8.5"
 /begin AXIS_DESCR STD_AXIS kApplI_AbsRackForce_xdu16 FRACK 9 0 30000 FORMAT "%8.2" DEPOSIT ABSOLUTE /end AXIS_DESCR
/end CHARACTERISTIC
/begin CHARACTERISTIC mBci_V1BaseTorque_XAS16_25___A "nominelles Handmoment abhängig von der Zahnstangenkraft bei Geschwindigkeit v1" CURVE 0x1592A4 AblGLKLsw 15 TBTHIGH 0 15 FORMAT "%8.5"
 /begin AXIS_DESCR STD_AXIS kApplI_AbsRackForce_xdu16 FRACK 9 0 30000 FORMAT "%8.2" DEPOSIT ABSOLUTE /end AXIS_DESCR
/end CHARACTERISTIC
/begin CHARACTERISTIC mBci_V1BaseTorque_XAS16_26___A "nominelles Handmoment abhängig von der Zahnstangenkraft bei Geschwindigkeit v1" CURVE 0x1592CC AblGLKLsw 15 TBTHIGH 0 15 FORMAT "%8.5"
 /begin AXIS_DESCR STD_AXIS kApplI_AbsRackForce_xdu16 FRACK 9 0 30000 FORMAT "%8.2" DEPOSIT ABSOLUTE /end AXIS_DESCR
/end CHARACTERISTIC
/begin CHARACTERISTIC mBci_V1BaseTorque_XAS16_27___A "nominelles Handmoment abhängig von der Zahnstangenkraft bei Geschwindigkeit v1" CURVE 0x1592F4 AblGLKLsw 15 TBTHIGH 0 15 FORMAT "%8.5"
 /begin AXIS_DESCR STD_AXIS kApplI_AbsRackForce_xdu16 FRACK 9 0 30000 FORMAT "%8.2" DEPOSIT ABSOLUTE /end AXIS_DESCR
/end CHARACTERISTIC
/begin CHARACTERISTIC mBci_V1BaseTorque_XAS16_28___A "nominelles Handmoment abhängig von der Zahnstangenkraft bei Geschwindigkeit v1" CURVE 0x15931C AblGLKLsw 15 TBTHIGH 0 15 FORMAT "%8.5"
 /begin AXIS_DESCR STD_AXIS kApplI_AbsRackForce_xdu16 FRACK 9 0 30000 FORMAT "%8.2" DEPOSIT ABSOLUTE /end AXIS_DESCR
/end CHARACTERISTIC
/begin CHARACTERISTIC mBci_V1BaseTorque_XAS16_29___A "nominelles Handmoment abhängig von der Zahnstangenkraft bei Geschwindigkeit v1" CURVE 0x159344 AblGLKLsw 15 TBTHIGH 0 15 FORMAT "%8.5"
 /begin AXIS_DESCR STD_AXIS kApplI_AbsRackForce_xdu16 FRACK 9 0 30000 FORMAT "%8.2" DEPOSIT ABSOLUTE /end AXIS_DESCR
/end CHARACTERISTIC
/begin CHARACTERISTIC mBci_V1BaseTorque_XAS16_30___A "nominelles Handmoment abhängig von der Zahnstangenkraft bei Geschwindigkeit v1" CURVE 0x15936C AblGLKLsw 15 TBTHIGH 0 15 FORMAT "%8.5"
 /begin AXIS_DESCR STD_AXIS kApplI_AbsRackForce_xdu16 FRACK 9 0 30000 FORMAT "%8.2" DEPOSIT ABSOLUTE /end AXIS_DESCR
/end CHARACTERISTIC
/begin CHARACTERISTIC mBci_V1BaseTorque_XAS16_31___A "nominelles Handmoment abhängig von der Zahnstangenkraft bei Geschwindigkeit v1" CURVE 0x159394 AblGLKLsw 15 TBTHIGH 0 15 FORMAT "%8.5"
 /begin AXIS_DESCR STD_AXIS kApplI_AbsRackForce_xdu16 FRACK 9 0 30000 FORMAT "%8.2" DEPOSIT ABSOLUTE /end AXIS_DESCR
/end CHARACTERISTIC
/begin CHARACTERISTIC mBci_V1BaseTorque_XAS16_32___A "nominelles Handmoment abhängig von der Zahnstangenkraft bei Geschwindigkeit v1" CURVE 0x1593BC AblGLKLsw 15 TBTHIGH 0 15 FORMAT "%8.5"
 /begin AXIS_DESCR STD_AXIS kApplI_AbsRackForce_xdu16 FRACK 9 0 30000 FORMAT "%8.2" DEPOSIT ABSOLUTE /end AXIS_DESCR
/end CHARACTERISTIC
/begin CHARACTERISTIC mBci_V1BaseTorque_XAS16_33___A "nominelles Handmoment abhängig von der Zahnstangenkraft bei Geschwindigkeit v1" CURVE 0x1593E4 AblGLKLsw 15 TBTHIGH 0 15 FORMAT "%8.5"
 /begin AXIS_DESCR STD_AXIS kApplI_AbsRackForce_xdu16 FRACK 9 0 30000 FORMAT "%8.2" DEPOSIT ABSOLUTE /end AXIS_DESCR
/end CHARACTERISTIC
/begin CHARACTERISTIC mBci_V1BaseTorque_XAS16_34___A "nominelles Handmoment abhängig von der Zahnstangenkraft bei Geschwindigkeit v1" CURVE 0x15940C AblGLKLsw 15 TBTHIGH 0 15 FORMAT "%8.5"
 /begin AXIS_DESCR STD_AXIS kApplI_AbsRackForce_xdu16 FRACK 9 0 30000 FORMAT "%8.2" DEPOSIT ABSOLUTE /end AXIS_DESCR
/end CHARACTERISTIC
/begin CHARACTERISTIC mBci_V1BaseTorque_XAS16_35___A "nominelles Handmoment abhängig von der Zahnstangenkraft bei Geschwindigkeit v1" CURVE 0x159434 AblGLKLsw 15 TBTHIGH 0 15 FORMAT "%8.5"
 /begin AXIS_DESCR STD_AXIS kApplI_AbsRackForce_xdu16 FRACK 9 0 30000 FORMAT "%8.2" DEPOSIT ABSOLUTE /end AXIS_DESCR
/end CHARACTERISTIC
/begin CHARACTERISTIC mBci_V2BaseTorque_XAS16_00___A "nominelles Handmoment abhängig von der Zahnstangenkraft bei Geschwindigkeit v2" CURVE 0x15945C AblGLKLsw 15 TBTHIGH 0 15 FORMAT "%8.5"
 /begin AXIS_DESCR STD_AXIS kApplI_AbsRackForce_xdu16 FRACK 9 0 30000 FORMAT "%8.2" DEPOSIT ABSOLUTE /end AXIS_DESCR
/end CHARACTERISTIC
/begin CHARACTERISTIC mBci_V2BaseTorque_XAS16_01___A "nominelles Handmoment abhängig von der Zahnstangenkraft bei Geschwindigkeit v2" CURVE 0x159484 AblGLKLsw 15 TBTHIGH 0 15 FORMAT "%8.5"
 /begin AXIS_DESCR STD_AXIS kApplI_AbsRackForce_xdu16 FRACK 9 0 30000 FORMAT "%8.2" DEPOSIT ABSOLUTE /end AXIS_DESCR
/end CHARACTERISTIC
/begin CHARACTERISTIC mBci_V2BaseTorque_XAS16_02___A "nominelles Handmoment abhängig von der Zahnstangenkraft bei Geschwindigkeit v2" CURVE 0x1594AC AblGLKLsw 15 TBTHIGH 0 15 FORMAT "%8.5"
 /begin AXIS_DESCR STD_AXIS kApplI_AbsRackForce_xdu16 FRACK 9 0 30000 FORMAT "%8.2" DEPOSIT ABSOLUTE /end AXIS_DESCR
/end CHARACTERISTIC
/begin CHARACTERISTIC mBci_V2BaseTorque_XAS16_03___A "nominelles Handmoment abhängig von der Zahnstangenkraft bei Geschwindigkeit v2" CURVE 0x1594D4 AblGLKLsw 15 TBTHIGH 0 15 FORMAT "%8.5"
 /begin AXIS_DESCR STD_AXIS kApplI_AbsRackForce_xdu16 FRACK 9 0 30000 FORMAT "%8.2" DEPOSIT ABSOLUTE /end AXIS_DESCR
/end CHARACTERISTIC
/begin CHARACTERISTIC mBci_V2BaseTorque_XAS16_04___A "nominelles Handmoment abhängig von der Zahnstangenkraft bei Geschwindigkeit v2" CURVE 0x1594FC AblGLKLsw 15 TBTHIGH 0 15 FORMAT "%8.5"
 /begin AXIS_DESCR STD_AXIS kApplI_AbsRackForce_xdu16 FRACK 9 0 30000 FORMAT "%8.2" DEPOSIT ABSOLUTE /end AXIS_DESCR
/end CHARACTERISTIC
/begin CHARACTERISTIC mBci_V2BaseTorque_XAS16_05___A "nominelles Handmoment abhängig von der Zahnstangenkraft bei Geschwindigkeit v2" CURVE 0x159524 AblGLKLsw 15 TBTHIGH 0 15 FORMAT "%8.5"
 /begin AXIS_DESCR STD_AXIS kApplI_AbsRackForce_xdu16 FRACK 9 0 30000 FORMAT "%8.2" DEPOSIT ABSOLUTE /end AXIS_DESCR
/end CHARACTERISTIC
/begin CHARACTERISTIC mBci_V2BaseTorque_XAS16_06___A "nominelles Handmoment abhängig von der Zahnstangenkraft bei Geschwindigkeit v2" CURVE 0x15954C AblGLKLsw 15 TBTHIGH 0 15 FORMAT "%8.5"
 /begin AXIS_DESCR STD_AXIS kApplI_AbsRackForce_xdu16 FRACK 9 0 30000 FORMAT "%8.2" DEPOSIT ABSOLUTE /end AXIS_DESCR
/end CHARACTERISTIC
/begin CHARACTERISTIC mBci_V2BaseTorque_XAS16_07___A "nominelles Handmoment abhängig von der Zahnstangenkraft bei Geschwindigkeit v2" CURVE 0x159574 AblGLKLsw 15 TBTHIGH 0 15 FORMAT "%8.5"
 /begin AXIS_DESCR STD_AXIS kApplI_AbsRackForce_xdu16 FRACK 9 0 30000 FORMAT "%8.2" DEPOSIT ABSOLUTE /end AXIS_DESCR
/end CHARACTERISTIC
/begin CHARACTERISTIC mBci_V2BaseTorque_XAS16_08___A "nominelles Handmoment abhängig von der Zahnstangenkraft bei Geschwindigkeit v2" CURVE 0x15959C AblGLKLsw 15 TBTHIGH 0 15 FORMAT "%8.5"
 /begin AXIS_DESCR STD_AXIS kApplI_AbsRackForce_xdu16 FRACK 9 0 30000 FORMAT "%8.2" DEPOSIT ABSOLUTE /end AXIS_DESCR
/end CHARACTERISTIC
/begin CHARACTERISTIC mBci_V2BaseTorque_XAS16_09___A "nominelles Handmoment abhängig von der Zahnstangenkraft bei Geschwindigkeit v2" CURVE 0x1595C4 AblGLKLsw 15 TBTHIGH 0 15 FORMAT "%8.5"
 /begin AXIS_DESCR STD_AXIS kApplI_AbsRackForce_xdu16 FRACK 9 0 30000 FORMAT "%8.2" DEPOSIT ABSOLUTE /end AXIS_DESCR
/end CHARACTERISTIC
/begin CHARACTERISTIC mBci_V2BaseTorque_XAS16_10___A "nominelles Handmoment abhängig von der Zahnstangenkraft bei Geschwindigkeit v2" CURVE 0x1595EC AblGLKLsw 15 TBTHIGH 0 15 FORMAT "%8.5"
 /begin AXIS_DESCR STD_AXIS kApplI_AbsRackForce_xdu16 FRACK 9 0 30000 FORMAT "%8.2" DEPOSIT ABSOLUTE /end AXIS_DESCR
/end CHARACTERISTIC
/begin CHARACTERISTIC mBci_V2BaseTorque_XAS16_11___A "nominelles Handmoment abhängig von der Zahnstangenkraft bei Geschwindigkeit v2" CURVE 0x159614 AblGLKLsw 15 TBTHIGH 0 15 FORMAT "%8.5"
 /begin AXIS_DESCR STD_AXIS kApplI_AbsRackForce_xdu16 FRACK 9 0 30000 FORMAT "%8.2" DEPOSIT ABSOLUTE /end AXIS_DESCR
/end CHARACTERISTIC
/begin CHARACTERISTIC mBci_V2BaseTorque_XAS16_12___A "nominelles Handmoment abhängig von der Zahnstangenkraft bei Geschwindigkeit v2" CURVE 0x15963C AblGLKLsw 15 TBTHIGH 0 15 FORMAT "%8.5"
 /begin AXIS_DESCR STD_AXIS kApplI_AbsRackForce_xdu16 FRACK 9 0 30000 FORMAT "%8.2" DEPOSIT ABSOLUTE /end AXIS_DESCR
/end CHARACTERISTIC
/begin CHARACTERISTIC mBci_V2BaseTorque_XAS16_13___A "nominelles Handmoment abhängig von der Zahnstangenkraft bei Geschwindigkeit v2" CURVE 0x159664 AblGLKLsw 15 TBTHIGH 0 15 FORMAT "%8.5"
 /begin AXIS_DESCR STD_AXIS kApplI_AbsRackForce_xdu16 FRACK 9 0 30000 FORMAT "%8.2" DEPOSIT ABSOLUTE /end AXIS_DESCR
/end CHARACTERISTIC
/begin CHARACTERISTIC mBci_V2BaseTorque_XAS16_14___A "nominelles Handmoment abhängig von der Zahnstangenkraft bei Geschwindigkeit v2" CURVE 0x15968C AblGLKLsw 15 TBTHIGH 0 15 FORMAT "%8.5"
 /begin AXIS_DESCR STD_AXIS kApplI_AbsRackForce_xdu16 FRACK 9 0 30000 FORMAT "%8.2" DEPOSIT ABSOLUTE /end AXIS_DESCR
/end CHARACTERISTIC
/begin CHARACTERISTIC mBci_V2BaseTorque_XAS16_15___A "nominelles Handmoment abhängig von der Zahnstangenkraft bei Geschwindigkeit v2" CURVE 0x1596B4 AblGLKLsw 15 TBTHIGH 0 15 FORMAT "%8.5"
 /begin AXIS_DESCR STD_AXIS kApplI_AbsRackForce_xdu16 FRACK 9 0 30000 FORMAT "%8.2" DEPOSIT ABSOLUTE /end AXIS_DESCR
/end CHARACTERISTIC
/begin CHARACTERISTIC mBci_V2BaseTorque_XAS16_16___A "nominelles Handmoment abhängig von der Zahnstangenkraft bei Geschwindigkeit v2" CURVE 0x1596DC AblGLKLsw 15 TBTHIGH 0 15 FORMAT "%8.5"
 /begin AXIS_DESCR STD_AXIS kApplI_AbsRackForce_xdu16 FRACK 9 0 30000 FORMAT "%8.2" DEPOSIT ABSOLUTE /end AXIS_DESCR
/end CHARACTERISTIC
/begin CHARACTERISTIC mBci_V2BaseTorque_XAS16_17___A "nominelles Handmoment abhängig von der Zahnstangenkraft bei Geschwindigkeit v2" CURVE 0x159704 AblGLKLsw 15 TBTHIGH 0 15 FORMAT "%8.5"
 /begin AXIS_DESCR STD_AXIS kApplI_AbsRackForce_xdu16 FRACK 9 0 30000 FORMAT "%8.2" DEPOSIT ABSOLUTE /end AXIS_DESCR
/end CHARACTERISTIC
/begin CHARACTERISTIC mBci_V2BaseTorque_XAS16_18___A "nominelles Handmoment abhängig von der Zahnstangenkraft bei Geschwindigkeit v2" CURVE 0x15972C AblGLKLsw 15 TBTHIGH 0 15 FORMAT "%8.5"
 /begin AXIS_DESCR STD_AXIS kApplI_AbsRackForce_xdu16 FRACK 9 0 30000 FORMAT "%8.2" DEPOSIT ABSOLUTE /end AXIS_DESCR
/end CHARACTERISTIC
/begin CHARACTERISTIC mBci_V2BaseTorque_XAS16_19___A "nominelles Handmoment abhängig von der Zahnstangenkraft bei Geschwindigkeit v2" CURVE 0x159754 AblGLKLsw 15 TBTHIGH 0 15 FORMAT "%8.5"
 /begin AXIS_DESCR STD_AXIS kApplI_AbsRackForce_xdu16 FRACK 9 0 30000 FORMAT "%8.2" DEPOSIT ABSOLUTE /end AXIS_DESCR
/end CHARACTERISTIC
/begin CHARACTERISTIC mBci_V2BaseTorque_XAS16_20___A "nominelles Handmoment abhängig von der Zahnstangenkraft bei Geschwindigkeit v2" CURVE 0x15977C AblGLKLsw 15 TBTHIGH 0 15 FORMAT "%8.5"
 /begin AXIS_DESCR STD_AXIS kApplI_AbsRackForce_xdu16 FRACK 9 0 30000 FORMAT "%8.2" DEPOSIT ABSOLUTE /end AXIS_DESCR
/end CHARACTERISTIC
/begin CHARACTERISTIC mBci_V2BaseTorque_XAS16_21___A "nominelles Handmoment abhängig von der Zahnstangenkraft bei Geschwindigkeit v2" CURVE 0x1597A4 AblGLKLsw 15 TBTHIGH 0 15 FORMAT "%8.5"
 /begin AXIS_DESCR STD_AXIS kApplI_AbsRackForce_xdu16 FRACK 9 0 30000 FORMAT "%8.2" DEPOSIT ABSOLUTE /end AXIS_DESCR
/end CHARACTERISTIC
/begin CHARACTERISTIC mBci_V2BaseTorque_XAS16_22___A "nominelles Handmoment abhängig von der Zahnstangenkraft bei Geschwindigkeit v2" CURVE 0x1597CC AblGLKLsw 15 TBTHIGH 0 15 FORMAT "%8.5"
 /begin AXIS_DESCR STD_AXIS kApplI_AbsRackForce_xdu16 FRACK 9 0 30000 FORMAT "%8.2" DEPOSIT ABSOLUTE /end AXIS_DESCR
/end CHARACTERISTIC
/begin CHARACTERISTIC mBci_V2BaseTorque_XAS16_23___A "nominelles Handmoment abhängig von der Zahnstangenkraft bei Geschwindigkeit v2" CURVE 0x1597F4 AblGLKLsw 15 TBTHIGH 0 15 FORMAT "%8.5"
 /begin AXIS_DESCR STD_AXIS kApplI_AbsRackForce_xdu16 FRACK 9 0 30000 FORMAT "%8.2" DEPOSIT ABSOLUTE /end AXIS_DESCR
/end CHARACTERISTIC
/begin CHARACTERISTIC mBci_V2BaseTorque_XAS16_24___A "nominelles Handmoment abhängig von der Zahnstangenkraft bei Geschwindigkeit v2" CURVE 0x15981C AblGLKLsw 15 TBTHIGH 0 15 FORMAT "%8.5"
 /begin AXIS_DESCR STD_AXIS kApplI_AbsRackForce_xdu16 FRACK 9 0 30000 FORMAT "%8.2" DEPOSIT ABSOLUTE /end AXIS_DESCR
/end CHARACTERISTIC
/begin CHARACTERISTIC mBci_V2BaseTorque_XAS16_25___A "nominelles Handmoment abhängig von der Zahnstangenkraft bei Geschwindigkeit v2" CURVE 0x159844 AblGLKLsw 15 TBTHIGH 0 15 FORMAT "%8.5"
 /begin AXIS_DESCR STD_AXIS kApplI_AbsRackForce_xdu16 FRACK 9 0 30000 FORMAT "%8.2" DEPOSIT ABSOLUTE /end AXIS_DESCR
/end CHARACTERISTIC
/begin CHARACTERISTIC mBci_V2BaseTorque_XAS16_26___A "nominelles Handmoment abhängig von der Zahnstangenkraft bei Geschwindigkeit v2" CURVE 0x15986C AblGLKLsw 15 TBTHIGH 0 15 FORMAT "%8.5"
 /begin AXIS_DESCR STD_AXIS kApplI_AbsRackForce_xdu16 FRACK 9 0 30000 FORMAT "%8.2" DEPOSIT ABSOLUTE /end AXIS_DESCR
/end CHARACTERISTIC
/begin CHARACTERISTIC mBci_V2BaseTorque_XAS16_27___A "nominelles Handmoment abhängig von der Zahnstangenkraft bei Geschwindigkeit v2" CURVE 0x159894 AblGLKLsw 15 TBTHIGH 0 15 FORMAT "%8.5"
 /begin AXIS_DESCR STD_AXIS kApplI_AbsRackForce_xdu16 FRACK 9 0 30000 FORMAT "%8.2" DEPOSIT ABSOLUTE /end AXIS_DESCR
/end CHARACTERISTIC
/begin CHARACTERISTIC mBci_V2BaseTorque_XAS16_28___A "nominelles Handmoment abhängig von der Zahnstangenkraft bei Geschwindigkeit v2" CURVE 0x1598BC AblGLKLsw 15 TBTHIGH 0 15 FORMAT "%8.5"
 /begin AXIS_DESCR STD_AXIS kApplI_AbsRackForce_xdu16 FRACK 9 0 30000 FORMAT "%8.2" DEPOSIT ABSOLUTE /end AXIS_DESCR
/end CHARACTERISTIC
/begin CHARACTERISTIC mBci_V2BaseTorque_XAS16_29___A "nominelles Handmoment abhängig von der Zahnstangenkraft bei Geschwindigkeit v2" CURVE 0x1598E4 AblGLKLsw 15 TBTHIGH 0 15 FORMAT "%8.5"
 /begin AXIS_DESCR STD_AXIS kApplI_AbsRackForce_xdu16 FRACK 9 0 30000 FORMAT "%8.2" DEPOSIT ABSOLUTE /end AXIS_DESCR
/end CHARACTERISTIC
/begin CHARACTERISTIC mBci_V2BaseTorque_XAS16_30___A "nominelles Handmoment abhängig von der Zahnstangenkraft bei Geschwindigkeit v2" CURVE 0x15990C AblGLKLsw 15 TBTHIGH 0 15 FORMAT "%8.5"
 /begin AXIS_DESCR STD_AXIS kApplI_AbsRackForce_xdu16 FRACK 9 0 30000 FORMAT "%8.2" DEPOSIT ABSOLUTE /end AXIS_DESCR
/end CHARACTERISTIC
/begin CHARACTERISTIC mBci_V2BaseTorque_XAS16_31___A "nominelles Handmoment abhängig von der Zahnstangenkraft bei Geschwindigkeit v2" CURVE 0x159934 AblGLKLsw 15 TBTHIGH 0 15 FORMAT "%8.5"
 /begin AXIS_DESCR STD_AXIS kApplI_AbsRackForce_xdu16 FRACK 9 0 30000 FORMAT "%8.2" DEPOSIT ABSOLUTE /end AXIS_DESCR
/end CHARACTERISTIC
/begin CHARACTERISTIC mBci_V2BaseTorque_XAS16_32___A "nominelles Handmoment abhängig von der Zahnstangenkraft bei Geschwindigkeit v2" CURVE 0x15995C AblGLKLsw 15 TBTHIGH 0 15 FORMAT "%8.5"
 /begin AXIS_DESCR STD_AXIS kApplI_AbsRackForce_xdu16 FRACK 9 0 30000 FORMAT "%8.2" DEPOSIT ABSOLUTE /end AXIS_DESCR
/end CHARACTERISTIC
/begin CHARACTERISTIC mBci_V2BaseTorque_XAS16_33___A "nominelles Handmoment abhängig von der Zahnstangenkraft bei Geschwindigkeit v2" CURVE 0x159984 AblGLKLsw 15 TBTHIGH 0 15 FORMAT "%8.5"
 /begin AXIS_DESCR STD_AXIS kApplI_AbsRackForce_xdu16 FRACK 9 0 30000 FORMAT "%8.2" DEPOSIT ABSOLUTE /end AXIS_DESCR
/end CHARACTERISTIC
/begin CHARACTERISTIC mBci_V2BaseTorque_XAS16_34___A "nominelles Handmoment abhängig von der Zahnstangenkraft bei Geschwindigkeit v2" CURVE 0x1599AC AblGLKLsw 15 TBTHIGH 0 15 FORMAT "%8.5"
 /begin AXIS_DESCR STD_AXIS kApplI_AbsRackForce_xdu16 FRACK 9 0 30000 FORMAT "%8.2" DEPOSIT ABSOLUTE /end AXIS_DESCR
/end CHARACTERISTIC
/begin CHARACTERISTIC mBci_V2BaseTorque_XAS16_35___A "nominelles Handmoment abhängig von der Zahnstangenkraft bei Geschwindigkeit v2" CURVE 0x1599D4 AblGLKLsw 15 TBTHIGH 0 15 FORMAT "%8.5"
 /begin AXIS_DESCR STD_AXIS kApplI_AbsRackForce_xdu16 FRACK 9 0 30000 FORMAT "%8.2" DEPOSIT ABSOLUTE /end AXIS_DESCR
/end CHARACTERISTIC
/begin CHARACTERISTIC mBci_V3BaseTorque_XAS16_00___A "nominelles Handmoment abhängig von der Zahnstangenkraft bei Geschwindigkeit v3" CURVE 0x1599FC AblGLKLsw 15 TBTHIGH 0 15 FORMAT "%8.5"
 /begin AXIS_DESCR STD_AXIS kApplI_AbsRackForce_xdu16 FRACK 9 0 30000 FORMAT "%8.2" DEPOSIT ABSOLUTE /end AXIS_DESCR
/end CHARACTERISTIC
/begin CHARACTERISTIC mBci_V3BaseTorque_XAS16_01___A "nominelles Handmoment abhängig von der Zahnstangenkraft bei Geschwindigkeit v3" CURVE 0x159A24 AblGLKLsw 15 TBTHIGH 0 15 FORMAT "%8.5"
 /begin AXIS_DESCR STD_AXIS kApplI_AbsRackForce_xdu16 FRACK 9 0 30000 FORMAT "%8.2" DEPOSIT ABSOLUTE /end AXIS_DESCR
/end CHARACTERISTIC
/begin CHARACTERISTIC mBci_V3BaseTorque_XAS16_02___A "nominelles Handmoment abhängig von der Zahnstangenkraft bei Geschwindigkeit v3" CURVE 0x159A4C AblGLKLsw 15 TBTHIGH 0 15 FORMAT "%8.5"
 /begin AXIS_DESCR STD_AXIS kApplI_AbsRackForce_xdu16 FRACK 9 0 30000 FORMAT "%8.2" DEPOSIT ABSOLUTE /end AXIS_DESCR
/end CHARACTERISTIC
/begin CHARACTERISTIC mBci_V3BaseTorque_XAS16_03___A "nominelles Handmoment abhängig von der Zahnstangenkraft bei Geschwindigkeit v3" CURVE 0x159A74 AblGLKLsw 15 TBTHIGH 0 15 FORMAT "%8.5"
 /begin AXIS_DESCR STD_AXIS kApplI_AbsRackForce_xdu16 FRACK 9 0 30000 FORMAT "%8.2" DEPOSIT ABSOLUTE /end AXIS_DESCR
/end CHARACTERISTIC
/begin CHARACTERISTIC mBci_V3BaseTorque_XAS16_04___A "nominelles Handmoment abhängig von der Zahnstangenkraft bei Geschwindigkeit v3" CURVE 0x159A9C AblGLKLsw 15 TBTHIGH 0 15 FORMAT "%8.5"
 /begin AXIS_DESCR STD_AXIS kApplI_AbsRackForce_xdu16 FRACK 9 0 30000 FORMAT "%8.2" DEPOSIT ABSOLUTE /end AXIS_DESCR
/end CHARACTERISTIC
/begin CHARACTERISTIC mBci_V3BaseTorque_XAS16_05___A "nominelles Handmoment abhängig von der Zahnstangenkraft bei Geschwindigkeit v3" CURVE 0x159AC4 AblGLKLsw 15 TBTHIGH 0 15 FORMAT "%8.5"
 /begin AXIS_DESCR STD_AXIS kApplI_AbsRackForce_xdu16 FRACK 9 0 30000 FORMAT "%8.2" DEPOSIT ABSOLUTE /end AXIS_DESCR
/end CHARACTERISTIC
/begin CHARACTERISTIC mBci_V3BaseTorque_XAS16_06___A "nominelles Handmoment abhängig von der Zahnstangenkraft bei Geschwindigkeit v3" CURVE 0x159AEC AblGLKLsw 15 TBTHIGH 0 15 FORMAT "%8.5"
 /begin AXIS_DESCR STD_AXIS kApplI_AbsRackForce_xdu16 FRACK 9 0 30000 FORMAT "%8.2" DEPOSIT ABSOLUTE /end AXIS_DESCR
/end CHARACTERISTIC
/begin CHARACTERISTIC mBci_V3BaseTorque_XAS16_07___A "nominelles Handmoment abhängig von der Zahnstangenkraft bei Geschwindigkeit v3" CURVE 0x159B14 AblGLKLsw 15 TBTHIGH 0 15 FORMAT "%8.5"
 /begin AXIS_DESCR STD_AXIS kApplI_AbsRackForce_xdu16 FRACK 9 0 30000 FORMAT "%8.2" DEPOSIT ABSOLUTE /end AXIS_DESCR
/end CHARACTERISTIC
/begin CHARACTERISTIC mBci_V3BaseTorque_XAS16_08___A "nominelles Handmoment abhängig von der Zahnstangenkraft bei Geschwindigkeit v3" CURVE 0x159B3C AblGLKLsw 15 TBTHIGH 0 15 FORMAT "%8.5"
 /begin AXIS_DESCR STD_AXIS kApplI_AbsRackForce_xdu16 FRACK 9 0 30000 FORMAT "%8.2" DEPOSIT ABSOLUTE /end AXIS_DESCR
/end CHARACTERISTIC
/begin CHARACTERISTIC mBci_V3BaseTorque_XAS16_09___A "nominelles Handmoment abhängig von der Zahnstangenkraft bei Geschwindigkeit v3" CURVE 0x159B64 AblGLKLsw 15 TBTHIGH 0 15 FORMAT "%8.5"
 /begin AXIS_DESCR STD_AXIS kApplI_AbsRackForce_xdu16 FRACK 9 0 30000 FORMAT "%8.2" DEPOSIT ABSOLUTE /end AXIS_DESCR
/end CHARACTERISTIC
/begin CHARACTERISTIC mBci_V3BaseTorque_XAS16_10___A "nominelles Handmoment abhängig von der Zahnstangenkraft bei Geschwindigkeit v3" CURVE 0x159B8C AblGLKLsw 15 TBTHIGH 0 15 FORMAT "%8.5"
 /begin AXIS_DESCR STD_AXIS kApplI_AbsRackForce_xdu16 FRACK 9 0 30000 FORMAT "%8.2" DEPOSIT ABSOLUTE /end AXIS_DESCR
/end CHARACTERISTIC
/begin CHARACTERISTIC mBci_V3BaseTorque_XAS16_11___A "nominelles Handmoment abhängig von der Zahnstangenkraft bei Geschwindigkeit v3" CURVE 0x159BB4 AblGLKLsw 15 TBTHIGH 0 15 FORMAT "%8.5"
 /begin AXIS_DESCR STD_AXIS kApplI_AbsRackForce_xdu16 FRACK 9 0 30000 FORMAT "%8.2" DEPOSIT ABSOLUTE /end AXIS_DESCR
/end CHARACTERISTIC
/begin CHARACTERISTIC mBci_V3BaseTorque_XAS16_12___A "nominelles Handmoment abhängig von der Zahnstangenkraft bei Geschwindigkeit v3" CURVE 0x159BDC AblGLKLsw 15 TBTHIGH 0 15 FORMAT "%8.5"
 /begin AXIS_DESCR STD_AXIS kApplI_AbsRackForce_xdu16 FRACK 9 0 30000 FORMAT "%8.2" DEPOSIT ABSOLUTE /end AXIS_DESCR
/end CHARACTERISTIC
/begin CHARACTERISTIC mBci_V3BaseTorque_XAS16_13___A "nominelles Handmoment abhängig von der Zahnstangenkraft bei Geschwindigkeit v3" CURVE 0x159C04 AblGLKLsw 15 TBTHIGH 0 15 FORMAT "%8.5"
 /begin AXIS_DESCR STD_AXIS kApplI_AbsRackForce_xdu16 FRACK 9 0 30000 FORMAT "%8.2" DEPOSIT ABSOLUTE /end AXIS_DESCR
/end CHARACTERISTIC
/begin CHARACTERISTIC mBci_V3BaseTorque_XAS16_14___A "nominelles Handmoment abhängig von der Zahnstangenkraft bei Geschwindigkeit v3" CURVE 0x159C2C AblGLKLsw 15 TBTHIGH 0 15 FORMAT "%8.5"
 /begin AXIS_DESCR STD_AXIS kApplI_AbsRackForce_xdu16 FRACK 9 0 30000 FORMAT "%8.2" DEPOSIT ABSOLUTE /end AXIS_DESCR
/end CHARACTERISTIC
/begin CHARACTERISTIC mBci_V3BaseTorque_XAS16_15___A "nominelles Handmoment abhängig von der Zahnstangenkraft bei Geschwindigkeit v3" CURVE 0x159C54 AblGLKLsw 15 TBTHIGH 0 15 FORMAT "%8.5"
 /begin AXIS_DESCR STD_AXIS kApplI_AbsRackForce_xdu16 FRACK 9 0 30000 FORMAT "%8.2" DEPOSIT ABSOLUTE /end AXIS_DESCR
/end CHARACTERISTIC
/begin CHARACTERISTIC mBci_V3BaseTorque_XAS16_16___A "nominelles Handmoment abhängig von der Zahnstangenkraft bei Geschwindigkeit v3" CURVE 0x159C7C AblGLKLsw 15 TBTHIGH 0 15 FORMAT "%8.5"
 /begin AXIS_DESCR STD_AXIS kApplI_AbsRackForce_xdu16 FRACK 9 0 30000 FORMAT "%8.2" DEPOSIT ABSOLUTE /end AXIS_DESCR
/end CHARACTERISTIC
/begin CHARACTERISTIC mBci_V3BaseTorque_XAS16_17___A "nominelles Handmoment abhängig von der Zahnstangenkraft bei Geschwindigkeit v3" CURVE 0x159CA4 AblGLKLsw 15 TBTHIGH 0 15 FORMAT "%8.5"
 /begin AXIS_DESCR STD_AXIS kApplI_AbsRackForce_xdu16 FRACK 9 0 30000 FORMAT "%8.2" DEPOSIT ABSOLUTE /end AXIS_DESCR
/end CHARACTERISTIC
/begin CHARACTERISTIC mBci_V3BaseTorque_XAS16_18___A "nominelles Handmoment abhängig von der Zahnstangenkraft bei Geschwindigkeit v3" CURVE 0x159CCC AblGLKLsw 15 TBTHIGH 0 15 FORMAT "%8.5"
 /begin AXIS_DESCR STD_AXIS kApplI_AbsRackForce_xdu16 FRACK 9 0 30000 FORMAT "%8.2" DEPOSIT ABSOLUTE /end AXIS_DESCR
/end CHARACTERISTIC
/begin CHARACTERISTIC mBci_V3BaseTorque_XAS16_19___A "nominelles Handmoment abhängig von der Zahnstangenkraft bei Geschwindigkeit v3" CURVE 0x159CF4 AblGLKLsw 15 TBTHIGH 0 15 FORMAT "%8.5"
 /begin AXIS_DESCR STD_AXIS kApplI_AbsRackForce_xdu16 FRACK 9 0 30000 FORMAT "%8.2" DEPOSIT ABSOLUTE /end AXIS_DESCR
/end CHARACTERISTIC
/begin CHARACTERISTIC mBci_V3BaseTorque_XAS16_20___A "nominelles Handmoment abhängig von der Zahnstangenkraft bei Geschwindigkeit v3" CURVE 0x159D1C AblGLKLsw 15 TBTHIGH 0 15 FORMAT "%8.5"
 /begin AXIS_DESCR STD_AXIS kApplI_AbsRackForce_xdu16 FRACK 9 0 30000 FORMAT "%8.2" DEPOSIT ABSOLUTE /end AXIS_DESCR
/end CHARACTERISTIC
/begin CHARACTERISTIC mBci_V3BaseTorque_XAS16_21___A "nominelles Handmoment abhängig von der Zahnstangenkraft bei Geschwindigkeit v3" CURVE 0x159D44 AblGLKLsw 15 TBTHIGH 0 15 FORMAT "%8.5"
 /begin AXIS_DESCR STD_AXIS kApplI_AbsRackForce_xdu16 FRACK 9 0 30000 FORMAT "%8.2" DEPOSIT ABSOLUTE /end AXIS_DESCR
/end CHARACTERISTIC
/begin CHARACTERISTIC mBci_V3BaseTorque_XAS16_22___A "nominelles Handmoment abhängig von der Zahnstangenkraft bei Geschwindigkeit v3" CURVE 0x159D6C AblGLKLsw 15 TBTHIGH 0 15 FORMAT "%8.5"
 /begin AXIS_DESCR STD_AXIS kApplI_AbsRackForce_xdu16 FRACK 9 0 30000 FORMAT "%8.2" DEPOSIT ABSOLUTE /end AXIS_DESCR
/end CHARACTERISTIC
/begin CHARACTERISTIC mBci_V3BaseTorque_XAS16_23___A "nominelles Handmoment abhängig von der Zahnstangenkraft bei Geschwindigkeit v3" CURVE 0x159D94 AblGLKLsw 15 TBTHIGH 0 15 FORMAT "%8.5"
 /begin AXIS_DESCR STD_AXIS kApplI_AbsRackForce_xdu16 FRACK 9 0 30000 FORMAT "%8.2" DEPOSIT ABSOLUTE /end AXIS_DESCR
/end CHARACTERISTIC
/begin CHARACTERISTIC mBci_V3BaseTorque_XAS16_24___A "nominelles Handmoment abhängig von der Zahnstangenkraft bei Geschwindigkeit v3" CURVE 0x159DBC AblGLKLsw 15 TBTHIGH 0 15 FORMAT "%8.5"
 /begin AXIS_DESCR STD_AXIS kApplI_AbsRackForce_xdu16 FRACK 9 0 30000 FORMAT "%8.2" DEPOSIT ABSOLUTE /end AXIS_DESCR
/end CHARACTERISTIC
/begin CHARACTERISTIC mBci_V3BaseTorque_XAS16_25___A "nominelles Handmoment abhängig von der Zahnstangenkraft bei Geschwindigkeit v3" CURVE 0x159DE4 AblGLKLsw 15 TBTHIGH 0 15 FORMAT "%8.5"
 /begin AXIS_DESCR STD_AXIS kApplI_AbsRackForce_xdu16 FRACK 9 0 30000 FORMAT "%8.2" DEPOSIT ABSOLUTE /end AXIS_DESCR
/end CHARACTERISTIC
/begin CHARACTERISTIC mBci_V3BaseTorque_XAS16_26___A "nominelles Handmoment abhängig von der Zahnstangenkraft bei Geschwindigkeit v3" CURVE 0x159E0C AblGLKLsw 15 TBTHIGH 0 15 FORMAT "%8.5"
 /begin AXIS_DESCR STD_AXIS kApplI_AbsRackForce_xdu16 FRACK 9 0 30000 FORMAT "%8.2" DEPOSIT ABSOLUTE /end AXIS_DESCR
/end CHARACTERISTIC
/begin CHARACTERISTIC mBci_V3BaseTorque_XAS16_27___A "nominelles Handmoment abhängig von der Zahnstangenkraft bei Geschwindigkeit v3" CURVE 0x159E34 AblGLKLsw 15 TBTHIGH 0 15 FORMAT "%8.5"
 /begin AXIS_DESCR STD_AXIS kApplI_AbsRackForce_xdu16 FRACK 9 0 30000 FORMAT "%8.2" DEPOSIT ABSOLUTE /end AXIS_DESCR
/end CHARACTERISTIC
/begin CHARACTERISTIC mBci_V3BaseTorque_XAS16_28___A "nominelles Handmoment abhängig von der Zahnstangenkraft bei Geschwindigkeit v3" CURVE 0x159E5C AblGLKLsw 15 TBTHIGH 0 15 FORMAT "%8.5"
 /begin AXIS_DESCR STD_AXIS kApplI_AbsRackForce_xdu16 FRACK 9 0 30000 FORMAT "%8.2" DEPOSIT ABSOLUTE /end AXIS_DESCR
/end CHARACTERISTIC
/begin CHARACTERISTIC mBci_V3BaseTorque_XAS16_29___A "nominelles Handmoment abhängig von der Zahnstangenkraft bei Geschwindigkeit v3" CURVE 0x159E84 AblGLKLsw 15 TBTHIGH 0 15 FORMAT "%8.5"
 /begin AXIS_DESCR STD_AXIS kApplI_AbsRackForce_xdu16 FRACK 9 0 30000 FORMAT "%8.2" DEPOSIT ABSOLUTE /end AXIS_DESCR
/end CHARACTERISTIC
/begin CHARACTERISTIC mBci_V3BaseTorque_XAS16_30___A "nominelles Handmoment abhängig von der Zahnstangenkraft bei Geschwindigkeit v3" CURVE 0x159EAC AblGLKLsw 15 TBTHIGH 0 15 FORMAT "%8.5"
 /begin AXIS_DESCR STD_AXIS kApplI_AbsRackForce_xdu16 FRACK 9 0 30000 FORMAT "%8.2" DEPOSIT ABSOLUTE /end AXIS_DESCR
/end CHARACTERISTIC
/begin CHARACTERISTIC mBci_V3BaseTorque_XAS16_31___A "nominelles Handmoment abhängig von der Zahnstangenkraft bei Geschwindigkeit v3" CURVE 0x159ED4 AblGLKLsw 15 TBTHIGH 0 15 FORMAT "%8.5"
 /begin AXIS_DESCR STD_AXIS kApplI_AbsRackForce_xdu16 FRACK 9 0 30000 FORMAT "%8.2" DEPOSIT ABSOLUTE /end AXIS_DESCR
/end CHARACTERISTIC
/begin CHARACTERISTIC mBci_V3BaseTorque_XAS16_32___A "nominelles Handmoment abhängig von der Zahnstangenkraft bei Geschwindigkeit v3" CURVE 0x159EFC AblGLKLsw 15 TBTHIGH 0 15 FORMAT "%8.5"
 /begin AXIS_DESCR STD_AXIS kApplI_AbsRackForce_xdu16 FRACK 9 0 30000 FORMAT "%8.2" DEPOSIT ABSOLUTE /end AXIS_DESCR
/end CHARACTERISTIC
/begin CHARACTERISTIC mBci_V3BaseTorque_XAS16_33___A "nominelles Handmoment abhängig von der Zahnstangenkraft bei Geschwindigkeit v3" CURVE 0x159F24 AblGLKLsw 15 TBTHIGH 0 15 FORMAT "%8.5"
 /begin AXIS_DESCR STD_AXIS kApplI_AbsRackForce_xdu16 FRACK 9 0 30000 FORMAT "%8.2" DEPOSIT ABSOLUTE /end AXIS_DESCR
/end CHARACTERISTIC
/begin CHARACTERISTIC mBci_V3BaseTorque_XAS16_34___A "nominelles Handmoment abhängig von der Zahnstangenkraft bei Geschwindigkeit v3" CURVE 0x159F4C AblGLKLsw 15 TBTHIGH 0 15 FORMAT "%8.5"
 /begin AXIS_DESCR STD_AXIS kApplI_AbsRackForce_xdu16 FRACK 9 0 30000 FORMAT "%8.2" DEPOSIT ABSOLUTE /end AXIS_DESCR
/end CHARACTERISTIC
/begin CHARACTERISTIC mBci_V3BaseTorque_XAS16_35___A "nominelles Handmoment abhängig von der Zahnstangenkraft bei Geschwindigkeit v3" CURVE 0x159F74 AblGLKLsw 15 TBTHIGH 0 15 FORMAT "%8.5"
 /begin AXIS_DESCR STD_AXIS kApplI_AbsRackForce_xdu16 FRACK 9 0 30000 FORMAT "%8.2" DEPOSIT ABSOLUTE /end AXIS_DESCR
/end CHARACTERISTIC
/begin CHARACTERISTIC mBci_V4BaseTorque_XAS16_00___A "nominelles Handmoment abhängig von der Zahnstangenkraft bei Geschwindigkeit v4" CURVE 0x159F9C AblGLKLsw 15 TBTHIGH 0 15 FORMAT "%8.5"
 /begin AXIS_DESCR STD_AXIS kApplI_AbsRackForce_xdu16 FRACK 9 0 30000 FORMAT "%8.2" DEPOSIT ABSOLUTE /end AXIS_DESCR
/end CHARACTERISTIC
/begin CHARACTERISTIC mBci_V4BaseTorque_XAS16_01___A "nominelles Handmoment abhängig von der Zahnstangenkraft bei Geschwindigkeit v4" CURVE 0x159FC4 AblGLKLsw 15 TBTHIGH 0 15 FORMAT "%8.5"
 /begin AXIS_DESCR STD_AXIS kApplI_AbsRackForce_xdu16 FRACK 9 0 30000 FORMAT "%8.2" DEPOSIT ABSOLUTE /end AXIS_DESCR
/end CHARACTERISTIC
/begin CHARACTERISTIC mBci_V4BaseTorque_XAS16_02___A "nominelles Handmoment abhängig von der Zahnstangenkraft bei Geschwindigkeit v4" CURVE 0x159FEC AblGLKLsw 15 TBTHIGH 0 15 FORMAT "%8.5"
 /begin AXIS_DESCR STD_AXIS kApplI_AbsRackForce_xdu16 FRACK 9 0 30000 FORMAT "%8.2" DEPOSIT ABSOLUTE /end AXIS_DESCR
/end CHARACTERISTIC
/begin CHARACTERISTIC mBci_V4BaseTorque_XAS16_03___A "nominelles Handmoment abhängig von der Zahnstangenkraft bei Geschwindigkeit v4" CURVE 0x15A014 AblGLKLsw 15 TBTHIGH 0 15 FORMAT "%8.5"
 /begin AXIS_DESCR STD_AXIS kApplI_AbsRackForce_xdu16 FRACK 9 0 30000 FORMAT "%8.2" DEPOSIT ABSOLUTE /end AXIS_DESCR
/end CHARACTERISTIC
/begin CHARACTERISTIC mBci_V4BaseTorque_XAS16_04___A "nominelles Handmoment abhängig von der Zahnstangenkraft bei Geschwindigkeit v4" CURVE 0x15A03C AblGLKLsw 15 TBTHIGH 0 15 FORMAT "%8.5"
 /begin AXIS_DESCR STD_AXIS kApplI_AbsRackForce_xdu16 FRACK 9 0 30000 FORMAT "%8.2" DEPOSIT ABSOLUTE /end AXIS_DESCR
/end CHARACTERISTIC
/begin CHARACTERISTIC mBci_V4BaseTorque_XAS16_05___A "nominelles Handmoment abhängig von der Zahnstangenkraft bei Geschwindigkeit v4" CURVE 0x15A064 AblGLKLsw 15 TBTHIGH 0 15 FORMAT "%8.5"
 /begin AXIS_DESCR STD_AXIS kApplI_AbsRackForce_xdu16 FRACK 9 0 30000 FORMAT "%8.2" DEPOSIT ABSOLUTE /end AXIS_DESCR
/end CHARACTERISTIC
/begin CHARACTERISTIC mBci_V4BaseTorque_XAS16_06___A "nominelles Handmoment abhängig von der Zahnstangenkraft bei Geschwindigkeit v4" CURVE 0x15A08C AblGLKLsw 15 TBTHIGH 0 15 FORMAT "%8.5"
 /begin AXIS_DESCR STD_AXIS kApplI_AbsRackForce_xdu16 FRACK 9 0 30000 FORMAT "%8.2" DEPOSIT ABSOLUTE /end AXIS_DESCR
/end CHARACTERISTIC
/begin CHARACTERISTIC mBci_V4BaseTorque_XAS16_07___A "nominelles Handmoment abhängig von der Zahnstangenkraft bei Geschwindigkeit v4" CURVE 0x15A0B4 AblGLKLsw 15 TBTHIGH 0 15 FORMAT "%8.5"
 /begin AXIS_DESCR STD_AXIS kApplI_AbsRackForce_xdu16 FRACK 9 0 30000 FORMAT "%8.2" DEPOSIT ABSOLUTE /end AXIS_DESCR
/end CHARACTERISTIC
/begin CHARACTERISTIC mBci_V4BaseTorque_XAS16_08___A "nominelles Handmoment abhängig von der Zahnstangenkraft bei Geschwindigkeit v4" CURVE 0x15A0DC AblGLKLsw 15 TBTHIGH 0 15 FORMAT "%8.5"
 /begin AXIS_DESCR STD_AXIS kApplI_AbsRackForce_xdu16 FRACK 9 0 30000 FORMAT "%8.2" DEPOSIT ABSOLUTE /end AXIS_DESCR
/end CHARACTERISTIC
/begin CHARACTERISTIC mBci_V4BaseTorque_XAS16_09___A "nominelles Handmoment abhängig von der Zahnstangenkraft bei Geschwindigkeit v4" CURVE 0x15A104 AblGLKLsw 15 TBTHIGH 0 15 FORMAT "%8.5"
 /begin AXIS_DESCR STD_AXIS kApplI_AbsRackForce_xdu16 FRACK 9 0 30000 FORMAT "%8.2" DEPOSIT ABSOLUTE /end AXIS_DESCR
/end CHARACTERISTIC
/begin CHARACTERISTIC mBci_V4BaseTorque_XAS16_10___A "nominelles Handmoment abhängig von der Zahnstangenkraft bei Geschwindigkeit v4" CURVE 0x15A12C AblGLKLsw 15 TBTHIGH 0 15 FORMAT "%8.5"
 /begin AXIS_DESCR STD_AXIS kApplI_AbsRackForce_xdu16 FRACK 9 0 30000 FORMAT "%8.2" DEPOSIT ABSOLUTE /end AXIS_DESCR
/end CHARACTERISTIC
/begin CHARACTERISTIC mBci_V4BaseTorque_XAS16_11___A "nominelles Handmoment abhängig von der Zahnstangenkraft bei Geschwindigkeit v4" CURVE 0x15A154 AblGLKLsw 15 TBTHIGH 0 15 FORMAT "%8.5"
 /begin AXIS_DESCR STD_AXIS kApplI_AbsRackForce_xdu16 FRACK 9 0 30000 FORMAT "%8.2" DEPOSIT ABSOLUTE /end AXIS_DESCR
/end CHARACTERISTIC
/begin CHARACTERISTIC mBci_V4BaseTorque_XAS16_12___A "nominelles Handmoment abhängig von der Zahnstangenkraft bei Geschwindigkeit v4" CURVE 0x15A17C AblGLKLsw 15 TBTHIGH 0 15 FORMAT "%8.5"
 /begin AXIS_DESCR STD_AXIS kApplI_AbsRackForce_xdu16 FRACK 9 0 30000 FORMAT "%8.2" DEPOSIT ABSOLUTE /end AXIS_DESCR
/end CHARACTERISTIC
/begin CHARACTERISTIC mBci_V4BaseTorque_XAS16_13___A "nominelles Handmoment abhängig von der Zahnstangenkraft bei Geschwindigkeit v4" CURVE 0x15A1A4 AblGLKLsw 15 TBTHIGH 0 15 FORMAT "%8.5"
 /begin AXIS_DESCR STD_AXIS kApplI_AbsRackForce_xdu16 FRACK 9 0 30000 FORMAT "%8.2" DEPOSIT ABSOLUTE /end AXIS_DESCR
/end CHARACTERISTIC
/begin CHARACTERISTIC mBci_V4BaseTorque_XAS16_14___A "nominelles Handmoment abhängig von der Zahnstangenkraft bei Geschwindigkeit v4" CURVE 0x15A1CC AblGLKLsw 15 TBTHIGH 0 15 FORMAT "%8.5"
 /begin AXIS_DESCR STD_AXIS kApplI_AbsRackForce_xdu16 FRACK 9 0 30000 FORMAT "%8.2" DEPOSIT ABSOLUTE /end AXIS_DESCR
/end CHARACTERISTIC
/begin CHARACTERISTIC mBci_V4BaseTorque_XAS16_15___A "nominelles Handmoment abhängig von der Zahnstangenkraft bei Geschwindigkeit v4" CURVE 0x15A1F4 AblGLKLsw 15 TBTHIGH 0 15 FORMAT "%8.5"
 /begin AXIS_DESCR STD_AXIS kApplI_AbsRackForce_xdu16 FRACK 9 0 30000 FORMAT "%8.2" DEPOSIT ABSOLUTE /end AXIS_DESCR
/end CHARACTERISTIC
/begin CHARACTERISTIC mBci_V4BaseTorque_XAS16_16___A "nominelles Handmoment abhängig von der Zahnstangenkraft bei Geschwindigkeit v4" CURVE 0x15A21C AblGLKLsw 15 TBTHIGH 0 15 FORMAT "%8.5"
 /begin AXIS_DESCR STD_AXIS kApplI_AbsRackForce_xdu16 FRACK 9 0 30000 FORMAT "%8.2" DEPOSIT ABSOLUTE /end AXIS_DESCR
/end CHARACTERISTIC
/begin CHARACTERISTIC mBci_V4BaseTorque_XAS16_17___A "nominelles Handmoment abhängig von der Zahnstangenkraft bei Geschwindigkeit v4" CURVE 0x15A244 AblGLKLsw 15 TBTHIGH 0 15 FORMAT "%8.5"
 /begin AXIS_DESCR STD_AXIS kApplI_AbsRackForce_xdu16 FRACK 9 0 30000 FORMAT "%8.2" DEPOSIT ABSOLUTE /end AXIS_DESCR
/end CHARACTERISTIC
/begin CHARACTERISTIC mBci_V4BaseTorque_XAS16_18___A "nominelles Handmoment abhängig von der Zahnstangenkraft bei Geschwindigkeit v4" CURVE 0x15A26C AblGLKLsw 15 TBTHIGH 0 15 FORMAT "%8.5"
 /begin AXIS_DESCR STD_AXIS kApplI_AbsRackForce_xdu16 FRACK 9 0 30000 FORMAT "%8.2" DEPOSIT ABSOLUTE /end AXIS_DESCR
/end CHARACTERISTIC
/begin CHARACTERISTIC mBci_V4BaseTorque_XAS16_19___A "nominelles Handmoment abhängig von der Zahnstangenkraft bei Geschwindigkeit v4" CURVE 0x15A294 AblGLKLsw 15 TBTHIGH 0 15 FORMAT "%8.5"
 /begin AXIS_DESCR STD_AXIS kApplI_AbsRackForce_xdu16 FRACK 9 0 30000 FORMAT "%8.2" DEPOSIT ABSOLUTE /end AXIS_DESCR
/end CHARACTERISTIC
/begin CHARACTERISTIC mBci_V4BaseTorque_XAS16_20___A "nominelles Handmoment abhängig von der Zahnstangenkraft bei Geschwindigkeit v4" CURVE 0x15A2BC AblGLKLsw 15 TBTHIGH 0 15 FORMAT "%8.5"
 /begin AXIS_DESCR STD_AXIS kApplI_AbsRackForce_xdu16 FRACK 9 0 30000 FORMAT "%8.2" DEPOSIT ABSOLUTE /end AXIS_DESCR
/end CHARACTERISTIC
/begin CHARACTERISTIC mBci_V4BaseTorque_XAS16_21___A "nominelles Handmoment abhängig von der Zahnstangenkraft bei Geschwindigkeit v4" CURVE 0x15A2E4 AblGLKLsw 15 TBTHIGH 0 15 FORMAT "%8.5"
 /begin AXIS_DESCR STD_AXIS kApplI_AbsRackForce_xdu16 FRACK 9 0 30000 FORMAT "%8.2" DEPOSIT ABSOLUTE /end AXIS_DESCR
/end CHARACTERISTIC
/begin CHARACTERISTIC mBci_V4BaseTorque_XAS16_22___A "nominelles Handmoment abhängig von der Zahnstangenkraft bei Geschwindigkeit v4" CURVE 0x15A30C AblGLKLsw 15 TBTHIGH 0 15 FORMAT "%8.5"
 /begin AXIS_DESCR STD_AXIS kApplI_AbsRackForce_xdu16 FRACK 9 0 30000 FORMAT "%8.2" DEPOSIT ABSOLUTE /end AXIS_DESCR
/end CHARACTERISTIC
/begin CHARACTERISTIC mBci_V4BaseTorque_XAS16_23___A "nominelles Handmoment abhängig von der Zahnstangenkraft bei Geschwindigkeit v4" CURVE 0x15A334 AblGLKLsw 15 TBTHIGH 0 15 FORMAT "%8.5"
 /begin AXIS_DESCR STD_AXIS kApplI_AbsRackForce_xdu16 FRACK 9 0 30000 FORMAT "%8.2" DEPOSIT ABSOLUTE /end AXIS_DESCR
/end CHARACTERISTIC
/begin CHARACTERISTIC mBci_V4BaseTorque_XAS16_24___A "nominelles Handmoment abhängig von der Zahnstangenkraft bei Geschwindigkeit v4" CURVE 0x15A35C AblGLKLsw 15 TBTHIGH 0 15 FORMAT "%8.5"
 /begin AXIS_DESCR STD_AXIS kApplI_AbsRackForce_xdu16 FRACK 9 0 30000 FORMAT "%8.2" DEPOSIT ABSOLUTE /end AXIS_DESCR
/end CHARACTERISTIC
/begin CHARACTERISTIC mBci_V4BaseTorque_XAS16_25___A "nominelles Handmoment abhängig von der Zahnstangenkraft bei Geschwindigkeit v4" CURVE 0x15A384 AblGLKLsw 15 TBTHIGH 0 15 FORMAT "%8.5"
 /begin AXIS_DESCR STD_AXIS kApplI_AbsRackForce_xdu16 FRACK 9 0 30000 FORMAT "%8.2" DEPOSIT ABSOLUTE /end AXIS_DESCR
/end CHARACTERISTIC
/begin CHARACTERISTIC mBci_V4BaseTorque_XAS16_26___A "nominelles Handmoment abhängig von der Zahnstangenkraft bei Geschwindigkeit v4" CURVE 0x15A3AC AblGLKLsw 15 TBTHIGH 0 15 FORMAT "%8.5"
 /begin AXIS_DESCR STD_AXIS kApplI_AbsRackForce_xdu16 FRACK 9 0 30000 FORMAT "%8.2" DEPOSIT ABSOLUTE /end AXIS_DESCR
/end CHARACTERISTIC
/begin CHARACTERISTIC mBci_V4BaseTorque_XAS16_27___A "nominelles Handmoment abhängig von der Zahnstangenkraft bei Geschwindigkeit v4" CURVE 0x15A3D4 AblGLKLsw 15 TBTHIGH 0 15 FORMAT "%8.5"
 /begin AXIS_DESCR STD_AXIS kApplI_AbsRackForce_xdu16 FRACK 9 0 30000 FORMAT "%8.2" DEPOSIT ABSOLUTE /end AXIS_DESCR
/end CHARACTERISTIC
/begin CHARACTERISTIC mBci_V4BaseTorque_XAS16_28___A "nominelles Handmoment abhängig von der Zahnstangenkraft bei Geschwindigkeit v4" CURVE 0x15A3FC AblGLKLsw 15 TBTHIGH 0 15 FORMAT "%8.5"
 /begin AXIS_DESCR STD_AXIS kApplI_AbsRackForce_xdu16 FRACK 9 0 30000 FORMAT "%8.2" DEPOSIT ABSOLUTE /end AXIS_DESCR
/end CHARACTERISTIC
/begin CHARACTERISTIC mBci_V4BaseTorque_XAS16_29___A "nominelles Handmoment abhängig von der Zahnstangenkraft bei Geschwindigkeit v4" CURVE 0x15A424 AblGLKLsw 15 TBTHIGH 0 15 FORMAT "%8.5"
 /begin AXIS_DESCR STD_AXIS kApplI_AbsRackForce_xdu16 FRACK 9 0 30000 FORMAT "%8.2" DEPOSIT ABSOLUTE /end AXIS_DESCR
/end CHARACTERISTIC
/begin CHARACTERISTIC mBci_V4BaseTorque_XAS16_30___A "nominelles Handmoment abhängig von der Zahnstangenkraft bei Geschwindigkeit v4" CURVE 0x15A44C AblGLKLsw 15 TBTHIGH 0 15 FORMAT "%8.5"
 /begin AXIS_DESCR STD_AXIS kApplI_AbsRackForce_xdu16 FRACK 9 0 30000 FORMAT "%8.2" DEPOSIT ABSOLUTE /end AXIS_DESCR
/end CHARACTERISTIC
/begin CHARACTERISTIC mBci_V4BaseTorque_XAS16_31___A "nominelles Handmoment abhängig von der Zahnstangenkraft bei Geschwindigkeit v4" CURVE 0x15A474 AblGLKLsw 15 TBTHIGH 0 15 FORMAT "%8.5"
 /begin AXIS_DESCR STD_AXIS kApplI_AbsRackForce_xdu16 FRACK 9 0 30000 FORMAT "%8.2" DEPOSIT ABSOLUTE /end AXIS_DESCR
/end CHARACTERISTIC
/begin CHARACTERISTIC mBci_V4BaseTorque_XAS16_32___A "nominelles Handmoment abhängig von der Zahnstangenkraft bei Geschwindigkeit v4" CURVE 0x15A49C AblGLKLsw 15 TBTHIGH 0 15 FORMAT "%8.5"
 /begin AXIS_DESCR STD_AXIS kApplI_AbsRackForce_xdu16 FRACK 9 0 30000 FORMAT "%8.2" DEPOSIT ABSOLUTE /end AXIS_DESCR
/end CHARACTERISTIC
/begin CHARACTERISTIC mBci_V4BaseTorque_XAS16_33___A "nominelles Handmoment abhängig von der Zahnstangenkraft bei Geschwindigkeit v4" CURVE 0x15A4C4 AblGLKLsw 15 TBTHIGH 0 15 FORMAT "%8.5"
 /begin AXIS_DESCR STD_AXIS kApplI_AbsRackForce_xdu16 FRACK 9 0 30000 FORMAT "%8.2" DEPOSIT ABSOLUTE /end AXIS_DESCR
/end CHARACTERISTIC
/begin CHARACTERISTIC mBci_V4BaseTorque_XAS16_34___A "nominelles Handmoment abhängig von der Zahnstangenkraft bei Geschwindigkeit v4" CURVE 0x15A4EC AblGLKLsw 15 TBTHIGH 0 15 FORMAT "%8.5"
 /begin AXIS_DESCR STD_AXIS kApplI_AbsRackForce_xdu16 FRACK 9 0 30000 FORMAT "%8.2" DEPOSIT ABSOLUTE /end AXIS_DESCR
/end CHARACTERISTIC
/begin CHARACTERISTIC mBci_V4BaseTorque_XAS16_35___A "nominelles Handmoment abhängig von der Zahnstangenkraft bei Geschwindigkeit v4" CURVE 0x15A514 AblGLKLsw 15 TBTHIGH 0 15 FORMAT "%8.5"
 /begin AXIS_DESCR STD_AXIS kApplI_AbsRackForce_xdu16 FRACK 9 0 30000 FORMAT "%8.2" DEPOSIT ABSOLUTE /end AXIS_DESCR
/end CHARACTERISTIC
/begin CHARACTERISTIC mBci_V5BaseTorque_XAS16_00___A "nominelles Handmoment abhängig von der Zahnstangenkraft bei Geschwindigkeit v5" CURVE 0x15A53C AblGLKLsw 15 TBTHIGH 0 15 FORMAT "%8.5"
 /begin AXIS_DESCR STD_AXIS kApplI_AbsRackForce_xdu16 FRACK 9 0 30000 FORMAT "%8.2" DEPOSIT ABSOLUTE /end AXIS_DESCR
/end CHARACTERISTIC
/begin CHARACTERISTIC mBci_V5BaseTorque_XAS16_01___A "nominelles Handmoment abhängig von der Zahnstangenkraft bei Geschwindigkeit v5" CURVE 0x15A564 AblGLKLsw 15 TBTHIGH 0 15 FORMAT "%8.5"
 /begin AXIS_DESCR STD_AXIS kApplI_AbsRackForce_xdu16 FRACK 9 0 30000 FORMAT "%8.2" DEPOSIT ABSOLUTE /end AXIS_DESCR
/end CHARACTERISTIC
/begin CHARACTERISTIC mBci_V5BaseTorque_XAS16_02___A "nominelles Handmoment abhängig von der Zahnstangenkraft bei Geschwindigkeit v5" CURVE 0x15A58C AblGLKLsw 15 TBTHIGH 0 15 FORMAT "%8.5"
 /begin AXIS_DESCR STD_AXIS kApplI_AbsRackForce_xdu16 FRACK 9 0 30000 FORMAT "%8.2" DEPOSIT ABSOLUTE /end AXIS_DESCR
/end CHARACTERISTIC
/begin CHARACTERISTIC mBci_V5BaseTorque_XAS16_03___A "nominelles Handmoment abhängig von der Zahnstangenkraft bei Geschwindigkeit v5" CURVE 0x15A5B4 AblGLKLsw 15 TBTHIGH 0 15 FORMAT "%8.5"
 /begin AXIS_DESCR STD_AXIS kApplI_AbsRackForce_xdu16 FRACK 9 0 30000 FORMAT "%8.2" DEPOSIT ABSOLUTE /end AXIS_DESCR
/end CHARACTERISTIC
/begin CHARACTERISTIC mBci_V5BaseTorque_XAS16_04___A "nominelles Handmoment abhängig von der Zahnstangenkraft bei Geschwindigkeit v5" CURVE 0x15A5DC AblGLKLsw 15 TBTHIGH 0 15 FORMAT "%8.5"
 /begin AXIS_DESCR STD_AXIS kApplI_AbsRackForce_xdu16 FRACK 9 0 30000 FORMAT "%8.2" DEPOSIT ABSOLUTE /end AXIS_DESCR
/end CHARACTERISTIC
/begin CHARACTERISTIC mBci_V5BaseTorque_XAS16_05___A "nominelles Handmoment abhängig von der Zahnstangenkraft bei Geschwindigkeit v5" CURVE 0x15A604 AblGLKLsw 15 TBTHIGH 0 15 FORMAT "%8.5"
 /begin AXIS_DESCR STD_AXIS kApplI_AbsRackForce_xdu16 FRACK 9 0 30000 FORMAT "%8.2" DEPOSIT ABSOLUTE /end AXIS_DESCR
/end CHARACTERISTIC
/begin CHARACTERISTIC mBci_V5BaseTorque_XAS16_06___A "nominelles Handmoment abhängig von der Zahnstangenkraft bei Geschwindigkeit v5" CURVE 0x15A62C AblGLKLsw 15 TBTHIGH 0 15 FORMAT "%8.5"
 /begin AXIS_DESCR STD_AXIS kApplI_AbsRackForce_xdu16 FRACK 9 0 30000 FORMAT "%8.2" DEPOSIT ABSOLUTE /end AXIS_DESCR
/end CHARACTERISTIC
/begin CHARACTERISTIC mBci_V5BaseTorque_XAS16_07___A "nominelles Handmoment abhängig von der Zahnstangenkraft bei Geschwindigkeit v5" CURVE 0x15A654 AblGLKLsw 15 TBTHIGH 0 15 FORMAT "%8.5"
 /begin AXIS_DESCR STD_AXIS kApplI_AbsRackForce_xdu16 FRACK 9 0 30000 FORMAT "%8.2" DEPOSIT ABSOLUTE /end AXIS_DESCR
/end CHARACTERISTIC
/begin CHARACTERISTIC mBci_V5BaseTorque_XAS16_08___A "nominelles Handmoment abhängig von der Zahnstangenkraft bei Geschwindigkeit v5" CURVE 0x15A67C AblGLKLsw 15 TBTHIGH 0 15 FORMAT "%8.5"
 /begin AXIS_DESCR STD_AXIS kApplI_AbsRackForce_xdu16 FRACK 9 0 30000 FORMAT "%8.2" DEPOSIT ABSOLUTE /end AXIS_DESCR
/end CHARACTERISTIC
/begin CHARACTERISTIC mBci_V5BaseTorque_XAS16_09___A "nominelles Handmoment abhängig von der Zahnstangenkraft bei Geschwindigkeit v5" CURVE 0x15A6A4 AblGLKLsw 15 TBTHIGH 0 15 FORMAT "%8.5"
 /begin AXIS_DESCR STD_AXIS kApplI_AbsRackForce_xdu16 FRACK 9 0 30000 FORMAT "%8.2" DEPOSIT ABSOLUTE /end AXIS_DESCR
/end CHARACTERISTIC
/begin CHARACTERISTIC mBci_V5BaseTorque_XAS16_10___A "nominelles Handmoment abhängig von der Zahnstangenkraft bei Geschwindigkeit v5" CURVE 0x15A6CC AblGLKLsw 15 TBTHIGH 0 15 FORMAT "%8.5"
 /begin AXIS_DESCR STD_AXIS kApplI_AbsRackForce_xdu16 FRACK 9 0 30000 FORMAT "%8.2" DEPOSIT ABSOLUTE /end AXIS_DESCR
/end CHARACTERISTIC
/begin CHARACTERISTIC mBci_V5BaseTorque_XAS16_11___A "nominelles Handmoment abhängig von der Zahnstangenkraft bei Geschwindigkeit v5" CURVE 0x15A6F4 AblGLKLsw 15 TBTHIGH 0 15 FORMAT "%8.5"
 /begin AXIS_DESCR STD_AXIS kApplI_AbsRackForce_xdu16 FRACK 9 0 30000 FORMAT "%8.2" DEPOSIT ABSOLUTE /end AXIS_DESCR
/end CHARACTERISTIC
/begin CHARACTERISTIC mBci_V5BaseTorque_XAS16_12___A "nominelles Handmoment abhängig von der Zahnstangenkraft bei Geschwindigkeit v5" CURVE 0x15A71C AblGLKLsw 15 TBTHIGH 0 15 FORMAT "%8.5"
 /begin AXIS_DESCR STD_AXIS kApplI_AbsRackForce_xdu16 FRACK 9 0 30000 FORMAT "%8.2" DEPOSIT ABSOLUTE /end AXIS_DESCR
/end CHARACTERISTIC
/begin CHARACTERISTIC mBci_V5BaseTorque_XAS16_13___A "nominelles Handmoment abhängig von der Zahnstangenkraft bei Geschwindigkeit v5" CURVE 0x15A744 AblGLKLsw 15 TBTHIGH 0 15 FORMAT "%8.5"
 /begin AXIS_DESCR STD_AXIS kApplI_AbsRackForce_xdu16 FRACK 9 0 30000 FORMAT "%8.2" DEPOSIT ABSOLUTE /end AXIS_DESCR
/end CHARACTERISTIC
/begin CHARACTERISTIC mBci_V5BaseTorque_XAS16_14___A "nominelles Handmoment abhängig von der Zahnstangenkraft bei Geschwindigkeit v5" CURVE 0x15A76C AblGLKLsw 15 TBTHIGH 0 15 FORMAT "%8.5"
 /begin AXIS_DESCR STD_AXIS kApplI_AbsRackForce_xdu16 FRACK 9 0 30000 FORMAT "%8.2" DEPOSIT ABSOLUTE /end AXIS_DESCR
/end CHARACTERISTIC
/begin CHARACTERISTIC mBci_V5BaseTorque_XAS16_15___A "nominelles Handmoment abhängig von der Zahnstangenkraft bei Geschwindigkeit v5" CURVE 0x15A794 AblGLKLsw 15 TBTHIGH 0 15 FORMAT "%8.5"
 /begin AXIS_DESCR STD_AXIS kApplI_AbsRackForce_xdu16 FRACK 9 0 30000 FORMAT "%8.2" DEPOSIT ABSOLUTE /end AXIS_DESCR
/end CHARACTERISTIC
/begin CHARACTERISTIC mBci_V5BaseTorque_XAS16_16___A "nominelles Handmoment abhängig von der Zahnstangenkraft bei Geschwindigkeit v5" CURVE 0x15A7BC AblGLKLsw 15 TBTHIGH 0 15 FORMAT "%8.5"
 /begin AXIS_DESCR STD_AXIS kApplI_AbsRackForce_xdu16 FRACK 9 0 30000 FORMAT "%8.2" DEPOSIT ABSOLUTE /end AXIS_DESCR
/end CHARACTERISTIC
/begin CHARACTERISTIC mBci_V5BaseTorque_XAS16_17___A "nominelles Handmoment abhängig von der Zahnstangenkraft bei Geschwindigkeit v5" CURVE 0x15A7E4 AblGLKLsw 15 TBTHIGH 0 15 FORMAT "%8.5"
 /begin AXIS_DESCR STD_AXIS kApplI_AbsRackForce_xdu16 FRACK 9 0 30000 FORMAT "%8.2" DEPOSIT ABSOLUTE /end AXIS_DESCR
/end CHARACTERISTIC
/begin CHARACTERISTIC mBci_V5BaseTorque_XAS16_18___A "nominelles Handmoment abhängig von der Zahnstangenkraft bei Geschwindigkeit v5" CURVE 0x15A80C AblGLKLsw 15 TBTHIGH 0 15 FORMAT "%8.5"
 /begin AXIS_DESCR STD_AXIS kApplI_AbsRackForce_xdu16 FRACK 9 0 30000 FORMAT "%8.2" DEPOSIT ABSOLUTE /end AXIS_DESCR
/end CHARACTERISTIC
/begin CHARACTERISTIC mBci_V5BaseTorque_XAS16_19___A "nominelles Handmoment abhängig von der Zahnstangenkraft bei Geschwindigkeit v5" CURVE 0x15A834 AblGLKLsw 15 TBTHIGH 0 15 FORMAT "%8.5"
 /begin AXIS_DESCR STD_AXIS kApplI_AbsRackForce_xdu16 FRACK 9 0 30000 FORMAT "%8.2" DEPOSIT ABSOLUTE /end AXIS_DESCR
/end CHARACTERISTIC
/begin CHARACTERISTIC mBci_V5BaseTorque_XAS16_20___A "nominelles Handmoment abhängig von der Zahnstangenkraft bei Geschwindigkeit v5" CURVE 0x15A85C AblGLKLsw 15 TBTHIGH 0 15 FORMAT "%8.5"
 /begin AXIS_DESCR STD_AXIS kApplI_AbsRackForce_xdu16 FRACK 9 0 30000 FORMAT "%8.2" DEPOSIT ABSOLUTE /end AXIS_DESCR
/end CHARACTERISTIC
/begin CHARACTERISTIC mBci_V5BaseTorque_XAS16_21___A "nominelles Handmoment abhängig von der Zahnstangenkraft bei Geschwindigkeit v5" CURVE 0x15A884 AblGLKLsw 15 TBTHIGH 0 15 FORMAT "%8.5"
 /begin AXIS_DESCR STD_AXIS kApplI_AbsRackForce_xdu16 FRACK 9 0 30000 FORMAT "%8.2" DEPOSIT ABSOLUTE /end AXIS_DESCR
/end CHARACTERISTIC
/begin CHARACTERISTIC mBci_V5BaseTorque_XAS16_22___A "nominelles Handmoment abhängig von der Zahnstangenkraft bei Geschwindigkeit v5" CURVE 0x15A8AC AblGLKLsw 15 TBTHIGH 0 15 FORMAT "%8.5"
 /begin AXIS_DESCR STD_AXIS kApplI_AbsRackForce_xdu16 FRACK 9 0 30000 FORMAT "%8.2" DEPOSIT ABSOLUTE /end AXIS_DESCR
/end CHARACTERISTIC
/begin CHARACTERISTIC mBci_V5BaseTorque_XAS16_23___A "nominelles Handmoment abhängig von der Zahnstangenkraft bei Geschwindigkeit v5" CURVE 0x15A8D4 AblGLKLsw 15 TBTHIGH 0 15 FORMAT "%8.5"
 /begin AXIS_DESCR STD_AXIS kApplI_AbsRackForce_xdu16 FRACK 9 0 30000 FORMAT "%8.2" DEPOSIT ABSOLUTE /end AXIS_DESCR
/end CHARACTERISTIC
/begin CHARACTERISTIC mBci_V5BaseTorque_XAS16_24___A "nominelles Handmoment abhängig von der Zahnstangenkraft bei Geschwindigkeit v5" CURVE 0x15A8FC AblGLKLsw 15 TBTHIGH 0 15 FORMAT "%8.5"
 /begin AXIS_DESCR STD_AXIS kApplI_AbsRackForce_xdu16 FRACK 9 0 30000 FORMAT "%8.2" DEPOSIT ABSOLUTE /end AXIS_DESCR
/end CHARACTERISTIC
/begin CHARACTERISTIC mBci_V5BaseTorque_XAS16_25___A "nominelles Handmoment abhängig von der Zahnstangenkraft bei Geschwindigkeit v5" CURVE 0x15A924 AblGLKLsw 15 TBTHIGH 0 15 FORMAT "%8.5"
 /begin AXIS_DESCR STD_AXIS kApplI_AbsRackForce_xdu16 FRACK 9 0 30000 FORMAT "%8.2" DEPOSIT ABSOLUTE /end AXIS_DESCR
/end CHARACTERISTIC
/begin CHARACTERISTIC mBci_V5BaseTorque_XAS16_26___A "nominelles Handmoment abhängig von der Zahnstangenkraft bei Geschwindigkeit v5" CURVE 0x15A94C AblGLKLsw 15 TBTHIGH 0 15 FORMAT "%8.5"
 /begin AXIS_DESCR STD_AXIS kApplI_AbsRackForce_xdu16 FRACK 9 0 30000 FORMAT "%8.2" DEPOSIT ABSOLUTE /end AXIS_DESCR
/end CHARACTERISTIC
/begin CHARACTERISTIC mBci_V5BaseTorque_XAS16_27___A "nominelles Handmoment abhängig von der Zahnstangenkraft bei Geschwindigkeit v5" CURVE 0x15A974 AblGLKLsw 15 TBTHIGH 0 15 FORMAT "%8.5"
 /begin AXIS_DESCR STD_AXIS kApplI_AbsRackForce_xdu16 FRACK 9 0 30000 FORMAT "%8.2" DEPOSIT ABSOLUTE /end AXIS_DESCR
/end CHARACTERISTIC
/begin CHARACTERISTIC mBci_V5BaseTorque_XAS16_28___A "nominelles Handmoment abhängig von der Zahnstangenkraft bei Geschwindigkeit v5" CURVE 0x15A99C AblGLKLsw 15 TBTHIGH 0 15 FORMAT "%8.5"
 /begin AXIS_DESCR STD_AXIS kApplI_AbsRackForce_xdu16 FRACK 9 0 30000 FORMAT "%8.2" DEPOSIT ABSOLUTE /end AXIS_DESCR
/end CHARACTERISTIC
/begin CHARACTERISTIC mBci_V5BaseTorque_XAS16_29___A "nominelles Handmoment abhängig von der Zahnstangenkraft bei Geschwindigkeit v5" CURVE 0x15A9C4 AblGLKLsw 15 TBTHIGH 0 15 FORMAT "%8.5"
 /begin AXIS_DESCR STD_AXIS kApplI_AbsRackForce_xdu16 FRACK 9 0 30000 FORMAT "%8.2" DEPOSIT ABSOLUTE /end AXIS_DESCR
/end CHARACTERISTIC
/begin CHARACTERISTIC mBci_V5BaseTorque_XAS16_30___A "nominelles Handmoment abhängig von der Zahnstangenkraft bei Geschwindigkeit v5" CURVE 0x15A9EC AblGLKLsw 15 TBTHIGH 0 15 FORMAT "%8.5"
 /begin AXIS_DESCR STD_AXIS kApplI_AbsRackForce_xdu16 FRACK 9 0 30000 FORMAT "%8.2" DEPOSIT ABSOLUTE /end AXIS_DESCR
/end CHARACTERISTIC
/begin CHARACTERISTIC mBci_V5BaseTorque_XAS16_31___A "nominelles Handmoment abhängig von der Zahnstangenkraft bei Geschwindigkeit v5" CURVE 0x15AA14 AblGLKLsw 15 TBTHIGH 0 15 FORMAT "%8.5"
 /begin AXIS_DESCR STD_AXIS kApplI_AbsRackForce_xdu16 FRACK 9 0 30000 FORMAT "%8.2" DEPOSIT ABSOLUTE /end AXIS_DESCR
/end CHARACTERISTIC
/begin CHARACTERISTIC mBci_V5BaseTorque_XAS16_32___A "nominelles Handmoment abhängig von der Zahnstangenkraft bei Geschwindigkeit v5" CURVE 0x15AA3C AblGLKLsw 15 TBTHIGH 0 15 FORMAT "%8.5"
 /begin AXIS_DESCR STD_AXIS kApplI_AbsRackForce_xdu16 FRACK 9 0 30000 FORMAT "%8.2" DEPOSIT ABSOLUTE /end AXIS_DESCR
/end CHARACTERISTIC
/begin CHARACTERISTIC mBci_V5BaseTorque_XAS16_33___A "nominelles Handmoment abhängig von der Zahnstangenkraft bei Geschwindigkeit v5" CURVE 0x15AA64 AblGLKLsw 15 TBTHIGH 0 15 FORMAT "%8.5"
 /begin AXIS_DESCR STD_AXIS kApplI_AbsRackForce_xdu16 FRACK 9 0 30000 FORMAT "%8.2" DEPOSIT ABSOLUTE /end AXIS_DESCR
/end CHARACTERISTIC
/begin CHARACTERISTIC mBci_V5BaseTorque_XAS16_34___A "nominelles Handmoment abhängig von der Zahnstangenkraft bei Geschwindigkeit v5" CURVE 0x15AA8C AblGLKLsw 15 TBTHIGH 0 15 FORMAT "%8.5"
 /begin AXIS_DESCR STD_AXIS kApplI_AbsRackForce_xdu16 FRACK 9 0 30000 FORMAT "%8.2" DEPOSIT ABSOLUTE /end AXIS_DESCR
/end CHARACTERISTIC
/begin CHARACTERISTIC mBci_V5BaseTorque_XAS16_35___A "nominelles Handmoment abhängig von der Zahnstangenkraft bei Geschwindigkeit v5" CURVE 0x15AAB4 AblGLKLsw 15 TBTHIGH 0 15 FORMAT "%8.5"
 /begin AXIS_DESCR STD_AXIS kApplI_AbsRackForce_xdu16 FRACK 9 0 30000 FORMAT "%8.2" DEPOSIT ABSOLUTE /end AXIS_DESCR
/end CHARACTERISTIC
/begin CHARACTERISTIC mBci_V6BaseTorque_XAS16_00___A "nominelles Handmoment abhängig von der Zahnstangenkraft bei Geschwindigkeit v6" CURVE 0x15AADC AblGLKLsw 15 TBTHIGH 0 15 FORMAT "%8.5"
 /begin AXIS_DESCR STD_AXIS kApplI_AbsRackForce_xdu16 FRACK 9 0 30000 FORMAT "%8.2" DEPOSIT ABSOLUTE /end AXIS_DESCR
/end CHARACTERISTIC
/begin CHARACTERISTIC mBci_V6BaseTorque_XAS16_01___A "nominelles Handmoment abhängig von der Zahnstangenkraft bei Geschwindigkeit v6" CURVE 0x15AB04 AblGLKLsw 15 TBTHIGH 0 15 FORMAT "%8.5"
 /begin AXIS_DESCR STD_AXIS kApplI_AbsRackForce_xdu16 FRACK 9 0 30000 FORMAT "%8.2" DEPOSIT ABSOLUTE /end AXIS_DESCR
/end CHARACTERISTIC
/begin CHARACTERISTIC mBci_V6BaseTorque_XAS16_02___A "nominelles Handmoment abhängig von der Zahnstangenkraft bei Geschwindigkeit v6" CURVE 0x15AB2C AblGLKLsw 15 TBTHIGH 0 15 FORMAT "%8.5"
 /begin AXIS_DESCR STD_AXIS kApplI_AbsRackForce_xdu16 FRACK 9 0 30000 FORMAT "%8.2" DEPOSIT ABSOLUTE /end AXIS_DESCR
/end CHARACTERISTIC
/begin CHARACTERISTIC mBci_V6BaseTorque_XAS16_03___A "nominelles Handmoment abhängig von der Zahnstangenkraft bei Geschwindigkeit v6" CURVE 0x15AB54 AblGLKLsw 15 TBTHIGH 0 15 FORMAT "%8.5"
 /begin AXIS_DESCR STD_AXIS kApplI_AbsRackForce_xdu16 FRACK 9 0 30000 FORMAT "%8.2" DEPOSIT ABSOLUTE /end AXIS_DESCR
/end CHARACTERISTIC
/begin CHARACTERISTIC mBci_V6BaseTorque_XAS16_04___A "nominelles Handmoment abhängig von der Zahnstangenkraft bei Geschwindigkeit v6" CURVE 0x15AB7C AblGLKLsw 15 TBTHIGH 0 15 FORMAT "%8.5"
 /begin AXIS_DESCR STD_AXIS kApplI_AbsRackForce_xdu16 FRACK 9 0 30000 FORMAT "%8.2" DEPOSIT ABSOLUTE /end AXIS_DESCR
/end CHARACTERISTIC
/begin CHARACTERISTIC mBci_V6BaseTorque_XAS16_05___A "nominelles Handmoment abhängig von der Zahnstangenkraft bei Geschwindigkeit v6" CURVE 0x15ABA4 AblGLKLsw 15 TBTHIGH 0 15 FORMAT "%8.5"
 /begin AXIS_DESCR STD_AXIS kApplI_AbsRackForce_xdu16 FRACK 9 0 30000 FORMAT "%8.2" DEPOSIT ABSOLUTE /end AXIS_DESCR
/end CHARACTERISTIC
/begin CHARACTERISTIC mBci_V6BaseTorque_XAS16_06___A "nominelles Handmoment abhängig von der Zahnstangenkraft bei Geschwindigkeit v6" CURVE 0x15ABCC AblGLKLsw 15 TBTHIGH 0 15 FORMAT "%8.5"
 /begin AXIS_DESCR STD_AXIS kApplI_AbsRackForce_xdu16 FRACK 9 0 30000 FORMAT "%8.2" DEPOSIT ABSOLUTE /end AXIS_DESCR
/end CHARACTERISTIC
/begin CHARACTERISTIC mBci_V6BaseTorque_XAS16_07___A "nominelles Handmoment abhängig von der Zahnstangenkraft bei Geschwindigkeit v6" CURVE 0x15ABF4 AblGLKLsw 15 TBTHIGH 0 15 FORMAT "%8.5"
 /begin AXIS_DESCR STD_AXIS kApplI_AbsRackForce_xdu16 FRACK 9 0 30000 FORMAT "%8.2" DEPOSIT ABSOLUTE /end AXIS_DESCR
/end CHARACTERISTIC
/begin CHARACTERISTIC mBci_V6BaseTorque_XAS16_08___A "nominelles Handmoment abhängig von der Zahnstangenkraft bei Geschwindigkeit v6" CURVE 0x15AC1C AblGLKLsw 15 TBTHIGH 0 15 FORMAT "%8.5"
 /begin AXIS_DESCR STD_AXIS kApplI_AbsRackForce_xdu16 FRACK 9 0 30000 FORMAT "%8.2" DEPOSIT ABSOLUTE /end AXIS_DESCR
/end CHARACTERISTIC
/begin CHARACTERISTIC mBci_V6BaseTorque_XAS16_09___A "nominelles Handmoment abhängig von der Zahnstangenkraft bei Geschwindigkeit v6" CURVE 0x15AC44 AblGLKLsw 15 TBTHIGH 0 15 FORMAT "%8.5"
 /begin AXIS_DESCR STD_AXIS kApplI_AbsRackForce_xdu16 FRACK 9 0 30000 FORMAT "%8.2" DEPOSIT ABSOLUTE /end AXIS_DESCR
/end CHARACTERISTIC
/begin CHARACTERISTIC mBci_V6BaseTorque_XAS16_10___A "nominelles Handmoment abhängig von der Zahnstangenkraft bei Geschwindigkeit v6" CURVE 0x15AC6C AblGLKLsw 15 TBTHIGH 0 15 FORMAT "%8.5"
 /begin AXIS_DESCR STD_AXIS kApplI_AbsRackForce_xdu16 FRACK 9 0 30000 FORMAT "%8.2" DEPOSIT ABSOLUTE /end AXIS_DESCR
/end CHARACTERISTIC
/begin CHARACTERISTIC mBci_V6BaseTorque_XAS16_11___A "nominelles Handmoment abhängig von der Zahnstangenkraft bei Geschwindigkeit v6" CURVE 0x15AC94 AblGLKLsw 15 TBTHIGH 0 15 FORMAT "%8.5"
 /begin AXIS_DESCR STD_AXIS kApplI_AbsRackForce_xdu16 FRACK 9 0 30000 FORMAT "%8.2" DEPOSIT ABSOLUTE /end AXIS_DESCR
/end CHARACTERISTIC
/begin CHARACTERISTIC mBci_V6BaseTorque_XAS16_12___A "nominelles Handmoment abhängig von der Zahnstangenkraft bei Geschwindigkeit v6" CURVE 0x15ACBC AblGLKLsw 15 TBTHIGH 0 15 FORMAT "%8.5"
 /begin AXIS_DESCR STD_AXIS kApplI_AbsRackForce_xdu16 FRACK 9 0 30000 FORMAT "%8.2" DEPOSIT ABSOLUTE /end AXIS_DESCR
/end CHARACTERISTIC
/begin CHARACTERISTIC mBci_V6BaseTorque_XAS16_13___A "nominelles Handmoment abhängig von der Zahnstangenkraft bei Geschwindigkeit v6" CURVE 0x15ACE4 AblGLKLsw 15 TBTHIGH 0 15 FORMAT "%8.5"
 /begin AXIS_DESCR STD_AXIS kApplI_AbsRackForce_xdu16 FRACK 9 0 30000 FORMAT "%8.2" DEPOSIT ABSOLUTE /end AXIS_DESCR
/end CHARACTERISTIC
/begin CHARACTERISTIC mBci_V6BaseTorque_XAS16_14___A "nominelles Handmoment abhängig von der Zahnstangenkraft bei Geschwindigkeit v6" CURVE 0x15AD0C AblGLKLsw 15 TBTHIGH 0 15 FORMAT "%8.5"
 /begin AXIS_DESCR STD_AXIS kApplI_AbsRackForce_xdu16 FRACK 9 0 30000 FORMAT "%8.2" DEPOSIT ABSOLUTE /end AXIS_DESCR
/end CHARACTERISTIC
/begin CHARACTERISTIC mBci_V6BaseTorque_XAS16_15___A "nominelles Handmoment abhängig von der Zahnstangenkraft bei Geschwindigkeit v6" CURVE 0x15AD34 AblGLKLsw 15 TBTHIGH 0 15 FORMAT "%8.5"
 /begin AXIS_DESCR STD_AXIS kApplI_AbsRackForce_xdu16 FRACK 9 0 30000 FORMAT "%8.2" DEPOSIT ABSOLUTE /end AXIS_DESCR
/end CHARACTERISTIC
/begin CHARACTERISTIC mBci_V6BaseTorque_XAS16_16___A "nominelles Handmoment abhängig von der Zahnstangenkraft bei Geschwindigkeit v6" CURVE 0x15AD5C AblGLKLsw 15 TBTHIGH 0 15 FORMAT "%8.5"
 /begin AXIS_DESCR STD_AXIS kApplI_AbsRackForce_xdu16 FRACK 9 0 30000 FORMAT "%8.2" DEPOSIT ABSOLUTE /end AXIS_DESCR
/end CHARACTERISTIC
/begin CHARACTERISTIC mBci_V6BaseTorque_XAS16_17___A "nominelles Handmoment abhängig von der Zahnstangenkraft bei Geschwindigkeit v6" CURVE 0x15AD84 AblGLKLsw 15 TBTHIGH 0 15 FORMAT "%8.5"
 /begin AXIS_DESCR STD_AXIS kApplI_AbsRackForce_xdu16 FRACK 9 0 30000 FORMAT "%8.2" DEPOSIT ABSOLUTE /end AXIS_DESCR
/end CHARACTERISTIC
/begin CHARACTERISTIC mBci_V6BaseTorque_XAS16_18___A "nominelles Handmoment abhängig von der Zahnstangenkraft bei Geschwindigkeit v6" CURVE 0x15ADAC AblGLKLsw 15 TBTHIGH 0 15 FORMAT "%8.5"
 /begin AXIS_DESCR STD_AXIS kApplI_AbsRackForce_xdu16 FRACK 9 0 30000 FORMAT "%8.2" DEPOSIT ABSOLUTE /end AXIS_DESCR
/end CHARACTERISTIC
/begin CHARACTERISTIC mBci_V6BaseTorque_XAS16_19___A "nominelles Handmoment abhängig von der Zahnstangenkraft bei Geschwindigkeit v6" CURVE 0x15ADD4 AblGLKLsw 15 TBTHIGH 0 15 FORMAT "%8.5"
 /begin AXIS_DESCR STD_AXIS kApplI_AbsRackForce_xdu16 FRACK 9 0 30000 FORMAT "%8.2" DEPOSIT ABSOLUTE /end AXIS_DESCR
/end CHARACTERISTIC
/begin CHARACTERISTIC mBci_V6BaseTorque_XAS16_20___A "nominelles Handmoment abhängig von der Zahnstangenkraft bei Geschwindigkeit v6" CURVE 0x15ADFC AblGLKLsw 15 TBTHIGH 0 15 FORMAT "%8.5"
 /begin AXIS_DESCR STD_AXIS kApplI_AbsRackForce_xdu16 FRACK 9 0 30000 FORMAT "%8.2" DEPOSIT ABSOLUTE /end AXIS_DESCR
/end CHARACTERISTIC
/begin CHARACTERISTIC mBci_V6BaseTorque_XAS16_21___A "nominelles Handmoment abhängig von der Zahnstangenkraft bei Geschwindigkeit v6" CURVE 0x15AE24 AblGLKLsw 15 TBTHIGH 0 15 FORMAT "%8.5"
 /begin AXIS_DESCR STD_AXIS kApplI_AbsRackForce_xdu16 FRACK 9 0 30000 FORMAT "%8.2" DEPOSIT ABSOLUTE /end AXIS_DESCR
/end CHARACTERISTIC
/begin CHARACTERISTIC mBci_V6BaseTorque_XAS16_22___A "nominelles Handmoment abhängig von der Zahnstangenkraft bei Geschwindigkeit v6" CURVE 0x15AE4C AblGLKLsw 15 TBTHIGH 0 15 FORMAT "%8.5"
 /begin AXIS_DESCR STD_AXIS kApplI_AbsRackForce_xdu16 FRACK 9 0 30000 FORMAT "%8.2" DEPOSIT ABSOLUTE /end AXIS_DESCR
/end CHARACTERISTIC
/begin CHARACTERISTIC mBci_V6BaseTorque_XAS16_23___A "nominelles Handmoment abhängig von der Zahnstangenkraft bei Geschwindigkeit v6" CURVE 0x15AE74 AblGLKLsw 15 TBTHIGH 0 15 FORMAT "%8.5"
 /begin AXIS_DESCR STD_AXIS kApplI_AbsRackForce_xdu16 FRACK 9 0 30000 FORMAT "%8.2" DEPOSIT ABSOLUTE /end AXIS_DESCR
/end CHARACTERISTIC
/begin CHARACTERISTIC mBci_V6BaseTorque_XAS16_24___A "nominelles Handmoment abhängig von der Zahnstangenkraft bei Geschwindigkeit v6" CURVE 0x15AE9C AblGLKLsw 15 TBTHIGH 0 15 FORMAT "%8.5"
 /begin AXIS_DESCR STD_AXIS kApplI_AbsRackForce_xdu16 FRACK 9 0 30000 FORMAT "%8.2" DEPOSIT ABSOLUTE /end AXIS_DESCR
/end CHARACTERISTIC
/begin CHARACTERISTIC mBci_V6BaseTorque_XAS16_25___A "nominelles Handmoment abhängig von der Zahnstangenkraft bei Geschwindigkeit v6" CURVE 0x15AEC4 AblGLKLsw 15 TBTHIGH 0 15 FORMAT "%8.5"
 /begin AXIS_DESCR STD_AXIS kApplI_AbsRackForce_xdu16 FRACK 9 0 30000 FORMAT "%8.2" DEPOSIT ABSOLUTE /end AXIS_DESCR
/end CHARACTERISTIC
/begin CHARACTERISTIC mBci_V6BaseTorque_XAS16_26___A "nominelles Handmoment abhängig von der Zahnstangenkraft bei Geschwindigkeit v6" CURVE 0x15AEEC AblGLKLsw 15 TBTHIGH 0 15 FORMAT "%8.5"
 /begin AXIS_DESCR STD_AXIS kApplI_AbsRackForce_xdu16 FRACK 9 0 30000 FORMAT "%8.2" DEPOSIT ABSOLUTE /end AXIS_DESCR
/end CHARACTERISTIC
/begin CHARACTERISTIC mBci_V6BaseTorque_XAS16_27___A "nominelles Handmoment abhängig von der Zahnstangenkraft bei Geschwindigkeit v6" CURVE 0x15AF14 AblGLKLsw 15 TBTHIGH 0 15 FORMAT "%8.5"
 /begin AXIS_DESCR STD_AXIS kApplI_AbsRackForce_xdu16 FRACK 9 0 30000 FORMAT "%8.2" DEPOSIT ABSOLUTE /end AXIS_DESCR
/end CHARACTERISTIC
/begin CHARACTERISTIC mBci_V6BaseTorque_XAS16_28___A "nominelles Handmoment abhängig von der Zahnstangenkraft bei Geschwindigkeit v6" CURVE 0x15AF3C AblGLKLsw 15 TBTHIGH 0 15 FORMAT "%8.5"
 /begin AXIS_DESCR STD_AXIS kApplI_AbsRackForce_xdu16 FRACK 9 0 30000 FORMAT "%8.2" DEPOSIT ABSOLUTE /end AXIS_DESCR
/end CHARACTERISTIC
/begin CHARACTERISTIC mBci_V6BaseTorque_XAS16_29___A "nominelles Handmoment abhängig von der Zahnstangenkraft bei Geschwindigkeit v6" CURVE 0x15AF64 AblGLKLsw 15 TBTHIGH 0 15 FORMAT "%8.5"
 /begin AXIS_DESCR STD_AXIS kApplI_AbsRackForce_xdu16 FRACK 9 0 30000 FORMAT "%8.2" DEPOSIT ABSOLUTE /end AXIS_DESCR
/end CHARACTERISTIC
/begin CHARACTERISTIC mBci_V6BaseTorque_XAS16_30___A "nominelles Handmoment abhängig von der Zahnstangenkraft bei Geschwindigkeit v6" CURVE 0x15AF8C AblGLKLsw 15 TBTHIGH 0 15 FORMAT "%8.5"
 /begin AXIS_DESCR STD_AXIS kApplI_AbsRackForce_xdu16 FRACK 9 0 30000 FORMAT "%8.2" DEPOSIT ABSOLUTE /end AXIS_DESCR
/end CHARACTERISTIC
/begin CHARACTERISTIC mBci_V6BaseTorque_XAS16_31___A "nominelles Handmoment abhängig von der Zahnstangenkraft bei Geschwindigkeit v6" CURVE 0x15AFB4 AblGLKLsw 15 TBTHIGH 0 15 FORMAT "%8.5"
 /begin AXIS_DESCR STD_AXIS kApplI_AbsRackForce_xdu16 FRACK 9 0 30000 FORMAT "%8.2" DEPOSIT ABSOLUTE /end AXIS_DESCR
/end CHARACTERISTIC
/begin CHARACTERISTIC mBci_V6BaseTorque_XAS16_32___A "nominelles Handmoment abhängig von der Zahnstangenkraft bei Geschwindigkeit v6" CURVE 0x15AFDC AblGLKLsw 15 TBTHIGH 0 15 FORMAT "%8.5"
 /begin AXIS_DESCR STD_AXIS kApplI_AbsRackForce_xdu16 FRACK 9 0 30000 FORMAT "%8.2" DEPOSIT ABSOLUTE /end AXIS_DESCR
/end CHARACTERISTIC
/begin CHARACTERISTIC mBci_V6BaseTorque_XAS16_33___A "nominelles Handmoment abhängig von der Zahnstangenkraft bei Geschwindigkeit v6" CURVE 0x15B004 AblGLKLsw 15 TBTHIGH 0 15 FORMAT "%8.5"
 /begin AXIS_DESCR STD_AXIS kApplI_AbsRackForce_xdu16 FRACK 9 0 30000 FORMAT "%8.2" DEPOSIT ABSOLUTE /end AXIS_DESCR
/end CHARACTERISTIC
/begin CHARACTERISTIC mBci_V6BaseTorque_XAS16_34___A "nominelles Handmoment abhängig von der Zahnstangenkraft bei Geschwindigkeit v6" CURVE 0x15B02C AblGLKLsw 15 TBTHIGH 0 15 FORMAT "%8.5"
 /begin AXIS_DESCR STD_AXIS kApplI_AbsRackForce_xdu16 FRACK 9 0 30000 FORMAT "%8.2" DEPOSIT ABSOLUTE /end AXIS_DESCR
/end CHARACTERISTIC
/begin CHARACTERISTIC mBci_V6BaseTorque_XAS16_35___A "nominelles Handmoment abhängig von der Zahnstangenkraft bei Geschwindigkeit v6" CURVE 0x15B054 AblGLKLsw 15 TBTHIGH 0 15 FORMAT "%8.5"
 /begin AXIS_DESCR STD_AXIS kApplI_AbsRackForce_xdu16 FRACK 9 0 30000 FORMAT "%8.2" DEPOSIT ABSOLUTE /end AXIS_DESCR
/end CHARACTERISTIC
/begin CHARACTERISTIC mBsd_MaxSafetyMotorTorq_XDU16 "Max. Motormoment von Seiten Sicherheit" VALUE 0x15059E AblGLKWuw 1 MMOT 0 1 FORMAT "%8.6" /end CHARACTERISTIC
/begin CHARACTERISTIC mBsd_TBTDeadband_XDU16 "Totband für Richtungsänderung für Motor Drehmoment" VALUE 0x1505A0 AblGLKWuw 0.5 MMOT 0 0.5 FORMAT "%9.7" /end CHARACTERISTIC
/begin CHARACTERISTIC mBsd_VibrationTorque_XDU16 "Motormoment zum Vibrieren" VALUE 0x1505A2 AblGLKWuw 1 MMOT 0 1 FORMAT "%8.6" /end CHARACTERISTIC
/begin CHARACTERISTIC tArmI_ComSyncTimeout_XDU16 "" VALUE 0x1506FA AblGLKWuw 300 TIMMS 0 300 FORMAT "%8.4" /end CHARACTERISTIC
/begin CHARACTERISTIC tArmI_HwLibFinishedTimeout_XDU16 "" VALUE 0x1506FC AblGLKWuw 6000 TIMMS 0 6000 FORMAT "%8.3" /end CHARACTERISTIC
/begin CHARACTERISTIC tArmI_PollToOffTimeout_XDU16 "" VALUE 0x1506FE AblGLKWuw 6000 TIMMS 0 6000 FORMAT "%8.3" /end CHARACTERISTIC
/begin CHARACTERISTIC tArmI_ProductionProcessingTimeout_XDU16 "" VALUE 0x150700 AblGLKWuw 6000 TIMMS 0 6000 FORMAT "%8.3" /end CHARACTERISTIC
/begin CHARACTERISTIC tArmI_ShutdownResyncTimeout_XDU16 "" VALUE 0x150702 AblGLKWuw 300 TIMMS 0 300 FORMAT "%8.4" /end CHARACTERISTIC
/begin CHARACTERISTIC tArmI_UartComSyncTimeout_XDU16 "" VALUE 0x150704 AblGLKWuw 3000 TIMMS 0 3000 FORMAT "%8.3" /end CHARACTERISTIC
/begin CHARACTERISTIC tArmI_WriteAllTimeout_XDU16 "" VALUE 0x150706 AblGLKWuw 1000 TIMMS 0 1000 FORMAT "%8.3" /end CHARACTERISTIC
/begin CHARACTERISTIC tAsmI_ApplicationInit_TimeOut_XDU16 "Time-out zeit für ApplicationInit state" VALUE 0x150708 AblGLKWuw 600 TIMS 0 600 /end CHARACTERISTIC
/begin CHARACTERISTIC tAsmI_OscillationMeasureTime_XDU16 "Messzeit in der die Heilungen gezählt werden sollen um eine Oszillation zu erkennen. Wichtig zur Vermeidung von Oscillating Assist." VALUE 0x15070A AblGLKWuw 5000 TIMMS 0 5000 FORMAT "%8.3" /end CHARACTERISTIC
/begin CHARACTERISTIC tAssCtrl_NoAssist_TimeOut_XDU16 "Time-out Zeit für Transition nach ReadyForPostRun" VALUE 0x15070C AblGLKWuw 600 TIMS 0 600 /end CHARACTERISTIC
/begin CHARACTERISTIC tAutParkCtrl_Angle_Diff_APC_XDU16 " Max allowed time of steeringangle and desiredangle" VALUE 0x15070E AblGLKWuw 90 SAS_8 10 100 FORMAT "%8.4" /end CHARACTERISTIC
/begin CHARACTERISTIC tAutParkCtrl_ApaReqTime_XDU16 "Erkennungszeit fÂ¨Â¹r Apa-Anfrage" VALUE 0x150710 AblGLKWuw 2980 TIMMS 20 3000 FORMAT "%8.3" /end CHARACTERISTIC
/begin CHARACTERISTIC tAutParkCtrl_CheckHandsOnSwOffTime_XDU16 "detection time for HandsOn" VALUE 0x150712 AblGLKWuw 980 TIMMS 20 1000 FORMAT "%8.3" /end CHARACTERISTIC
/begin CHARACTERISTIC tAutParkCtrl_CycleTimeController_XDU8 "Cycle time of controller function call" VALUE 0x150B08 AblGLKWub 9 TIMMS 1 10 FORMAT "%5.2" /end CHARACTERISTIC
/begin CHARACTERISTIC tAutParkCtrl_CycleTimeControlVariable_XDU8 "Cycle time of updating control variable (from bus) (shall be greater or equal than tAutParkCtrl_CycleTimeController_XDU8)" VALUE 0x150B09 AblGLKWub 240 TIMMS 10 250 FORMAT "%5.1" /end CHARACTERISTIC
/begin CHARACTERISTIC tAutParkCtrl_CycleTime_XDU8 "APC Zykluszeit [ms] (fÃ¼r Hands-On-Ãœberwachung)" VALUE 0x150B0A AblGLKWub 99 TIMMS 1 100 FORMAT "%5.1" /end CHARACTERISTIC
/begin CHARACTERISTIC tAutParkCtrl_HandsOffSwOffTime_XDU16 "Erkennungzeit fÃ¼r Hands-Off-Ãœberwachung" VALUE 0x150714 AblGLKWuw 980 TIMMS 20 1000 FORMAT "%8.3" /end CHARACTERISTIC
/begin CHARACTERISTIC tAutParkCtrl_HandsOnSwOffTime_XDU16 "Erkennungzeit fÃ¼r Hands-On-Ãœberwachung" VALUE 0x150716 AblGLKWuw 980 TIMMS 20 1000 FORMAT "%8.3" /end CHARACTERISTIC
/begin CHARACTERISTIC tAutParkCtrl_MAXsteeringAngleSpeedInActive_XDU16 " Max allowed time of SteeringAngleSpeed" VALUE 0x150718 AblGLKWuw 90 SAS_8 10 100 FORMAT "%8.4" /end CHARACTERISTIC
/begin CHARACTERISTIC tAutParkCtrl_OverAgGridCheckTime_XDU16 " Max allowed time of  over desiered angle gradient" VALUE 0x15071A AblGLKWuw 90 SAS_8 10 100 FORMAT "%8.4" /end CHARACTERISTIC
/begin CHARACTERISTIC tBatVoltMon_HighVoltageValueLeft_XDU16 "Zeitbedingung bis Überspannung nicht mehr aktiv" VALUE 0x15071C AblGLKWuw 60 TIMS 0 60 FORMAT "%6.3" /end CHARACTERISTIC
/begin CHARACTERISTIC tBatVoltMon_HighVoltageValueReached_XDU16 "Zeitbedingung bis Überspannung aktiv" VALUE 0x15071E AblGLKWuw 60 TIMS 0 60 FORMAT "%6.3" /end CHARACTERISTIC
/begin CHARACTERISTIC tBatVoltMon_LowVoltageValueLeft_XDU16 "Zeitbedingung bis Unterspannung nicht mehr aktiv" VALUE 0x150720 AblGLKWuw 60 TIMS 0 60 FORMAT "%6.3" /end CHARACTERISTIC
/begin CHARACTERISTIC tBatVoltMon_LowVoltageValueReached_XDU16 "Zeitbedingung bis Unterspannung aktiv" VALUE 0x150722 AblGLKWuw 100 TIMS 0 100 /end CHARACTERISTIC
/begin CHARACTERISTIC tBatVoltMon_NormalVoltageThreshold_XDU16 "" VALUE 0x150724 AblGLKWuw 60 TIMS 0 60 FORMAT "%6.3" /end CHARACTERISTIC
/begin CHARACTERISTIC tBsd_MaxTimeTorqueActive_XDU16 "max time torque active:this time period is for a single wave, and depending on the value of zBsd_MaxRampUpCycles_XDU8, the number of waves will change" VALUE 0x150726 AblGLKWuw 5998 TIMMS 2 6000 FORMAT "%8.3" /end CHARACTERISTIC
/begin CHARACTERISTIC tBsd_StateCycletimer_XDU8 "Cycle Time of server call" VALUE 0x150B0B AblGLKWub 99 ZU0 1 100 FORMAT "%5.1" /end CHARACTERISTIC
/begin CHARACTERISTIC uBatVoltMon_HighVoltageValueLeft_XDU16 "Grenzwert Überspannungsschwelle verlassen" VALUE 0x1507EA AblGLKWuw 30 U64V 0 30 FORMAT "%8.5" /end CHARACTERISTIC
/begin CHARACTERISTIC uBatVoltMon_HighVoltageValueReached_XDU16 "Grenzwert Überspannungsschwelle erreicht" VALUE 0x1507EC AblGLKWuw 30 U64V 0 30 FORMAT "%8.5" /end CHARACTERISTIC
/begin CHARACTERISTIC uBatVoltMon_LowVoltageValueLeft_XDU16 "Grenzwert Unterspannungsschwelle verlassen" VALUE 0x1507EE AblGLKWuw 30 U64V 0 30 FORMAT "%8.5" /end CHARACTERISTIC
/begin CHARACTERISTIC uBatVoltMon_LowVoltageValueReached_XDU16 "Grenzwert Unterspannungsschwelle erreicht" VALUE 0x1507F0 AblGLKWuw 30 U64V 0 30 FORMAT "%8.5" /end CHARACTERISTIC
/begin CHARACTERISTIC vAutParkCtrl_DeadBandRackSpeed_XDU16 "dead band threshold of nominal rack speed" VALUE 0x150810 AblGLKWuw 100 RACKSPEED128 0 100 FORMAT "%8.4" /end CHARACTERISTIC
/begin CHARACTERISTIC vAutParkCtrl_MaxAPAVehicleSpeed_XDU16 "maximale Geschwindigkeit fÃ¼r APA" VALUE 0x150812 AblGLKWuw 15 VFZHIGH 0 15 FORMAT "%8.5" /end CHARACTERISTIC
/begin CHARACTERISTIC vAutParkCtrl_MaxGradRackSpeed_XDU16 "maximum allowed desired rack speed gradient" VALUE 0x150814 AblGLKWuw 10 RACKSPEED128 0 10 FORMAT "%8.5" /end CHARACTERISTIC
/begin CHARACTERISTIC vAutParkCtrl_MaxRackSpeed_XDU16 "maximum allowed desired rack speed" VALUE 0x150816 AblGLKWuw 200 RACKSPEED128 0 200 FORMAT "%8.4" /end CHARACTERISTIC
/begin CHARACTERISTIC vAutParkCtrl_MaxRequestAngleGradient_XDU16 " Max allowed steering angle gradient in active state" VALUE 0x150818 AblGLKWuw 1490 SA_10 10 1500 FORMAT "%8.3" /end CHARACTERISTIC
/begin CHARACTERISTIC vAutParkCtrl_MaxSteeringAngleSpeedInActive_XDU16 "Max SteerAngleSpeed " VALUE 0x15081A AblGLKWuw 1920 SA_10 80 2000 FORMAT "%8.3" /end CHARACTERISTIC
/begin CHARACTERISTIC vAutParkCtrl_MaxVehicleSpeed_XDU16 "maximum allowed vehicle speed for enable rack position controller" VALUE 0x15081C AblGLKWuw 10 VFZHIGH 0 10 FORMAT "%8.5" /end CHARACTERISTIC
/begin CHARACTERISTIC vAutParkCtrl_SafetyLimitMaxVehicleSpeed_XDU16 "safety limit of maximum allowed vehicle speed" VALUE 0x15081E AblGLKWuw 12.5 VFZHIGH 0 12.5 FORMAT "%8.5" /end CHARACTERISTIC
/begin CHARACTERISTIC vAutParkCtrl_StandStillVehicleSpeed_XDU16 "Max allowed Vehicle speed to active state" VALUE 0x150820 AblGLKWuw 12 VFZHIGH 0 12 FORMAT "%8.5" /end CHARACTERISTIC
/begin CHARACTERISTIC vBsd_LowVehSpeed_XDU16 "Low vehicle speed for stopping TorqueGeneration" VALUE 0x150824 AblGLKWuw 10 VFZHIGH 0 10 FORMAT "%8.5" /end CHARACTERISTIC
/begin CHARACTERISTIC vBsd_VehicleSpeedForBSDActivation_XDU16 "min Vehicle Speed to start detectiont" VALUE 0x150826 AblGLKWuw 100 VFZHIGH 0 100 FORMAT "%8.4" /end CHARACTERISTIC
/begin CHARACTERISTIC wAutParkCtrl_MaxAngleDiff_XDU16 "maximal erlaubte Differenz Soll-/Istlenkwinkel" VALUE 0x1508C2 AblGLKWuw 220 SA_10 80 300 FORMAT "%8.4" /end CHARACTERISTIC
/begin CHARACTERISTIC wAutParkCtrl_MaxRequestAngle_XDU16 "Maximum erlaubte gewÃ¼nschten Winkelantrag(Winkelwunsch) von APA" VALUE 0x1508C4 AblGLKWuw 500 SA_10 100 600 FORMAT "%8.4" /end CHARACTERISTIC
/begin CHARACTERISTIC wBsd_MinRotPosChange_XDU16 "Minimale Änderung der Rotorlage, damit keine blockierte Lenkung vorliegt" VALUE 0x1508C6 AblGLKWuw 50.0098 ROTPOS 0 50.00977 FORMAT "%8.5" /end CHARACTERISTIC
/begin CHARACTERISTIC wBsd_MinSafetyRotPosChange_XDU16 "Min change in Rotpos to shutdown BSD" VALUE 0x1508C8 AblGLKWuw 50.0098 ROTPOS 0 50.00977 FORMAT "%8.5" /end CHARACTERISTIC
/begin CHARACTERISTIC wBsd_SteeringAngleLimit_XDU16 "steering angle border for Activation of BSD" VALUE 0x1508CA AblGLKWuw 600 SA_10 0 600 FORMAT "%8.4" /end CHARACTERISTIC
/begin CHARACTERISTIC xatAssistFilterFrequFast_XDU16 "Grenzfrequenz in kHz fuer AssistFilter fuer schnelles Zurueckfiltern" VALUE 0x150946 AblGLKWuw 0.0986328 RIGHTSH11NP 0.0009765625 0.09960938 FORMAT "%10.8" /end CHARACTERISTIC
/begin CHARACTERISTIC xatAssistFilterFrequ_XAU16 "Grenzfrequenz in kHz fuer AssistFilter, abhaengig von der Reduzierung durch Spannung" CURVE 0x151690 AblGLKLuw 0.0986328 RIGHTSH11NP 0.0009765625 0.09960938 FORMAT "%10.8"
 /begin AXIS_DESCR STD_AXIS xatActTorGradFact_xdu16 RSH15 4 0 100 FORMAT "%8.4" DEPOSIT ABSOLUTE /end AXIS_DESCR
/end CHARACTERISTIC
/begin CHARACTERISTIC xatBSTMaxgrad_XDU16 "Maximaler Kennliniengradient fuer AssistBerechnung" VALUE 0x150948 AblGLKWuw 4 TORGAINHIGH 1 5 FORMAT "%8.6" /end CHARACTERISTIC
/begin CHARACTERISTIC xatMaxGradChatterActive_XAU16 "Maximler Gradient wenn Rattern erkannt, abhaengig von v Fahrzeug " CURVE 0x1516A4 AblGLKLuw 1.99902 TORGAINHIGH 0.0009765625 2 FORMAT "%8.6"
 /begin AXIS_DESCR STD_AXIS vApplI_AbsSafeNssVehicleSpeed_xdu16 VFZHIGH 4 0 300 FORMAT "%8.4" DEPOSIT ABSOLUTE /end AXIS_DESCR
/end CHARACTERISTIC
/begin CHARACTERISTIC xatMaxGradGradDown_XDU16 "Maximale Aenderung der Gradientenbegrenzung in 1s in neg. Richtung" VALUE 0x15094A AblGLKWuw 1.99902 TORGAINHIGH 0.0009765625 2 FORMAT "%8.6" /end CHARACTERISTIC
/begin CHARACTERISTIC xatMaxGradGradUp_XDU16 "Maximale Aenderung der Gradientenbegrenzung in 1s in pos. Richtung" VALUE 0x15094C AblGLKWuw 1.99902 TORGAINHIGH 0.0009765625 2 FORMAT "%8.6" /end CHARACTERISTIC
/begin CHARACTERISTIC xatMaxGradTorGrad_XAU16 "Max Gradient fuer Steigungsbgrenzung DAC abhaengig vom Reduktionsfaktor" CURVE 0x1516B8 AblGLKLuw 5 TORGAINHIGH 0 5 FORMAT "%8.6"
 /begin AXIS_DESCR STD_AXIS xatActTorGradFact_xdu16 RSH15 3 0 100 FORMAT "%8.4" DEPOSIT ABSOLUTE /end AXIS_DESCR
/end CHARACTERISTIC
/begin CHARACTERISTIC xatMaxGradvVehicleReverse_XAU16 "Max Gradient fuer Steigungsbgrenzung DAC abhaengig von v Fahrzeug bei Rueckwaertsfahrt" CURVE 0x1516C8 AblGLKLuw 5 TORGAINHIGH 0 5 FORMAT "%8.6"
 /begin AXIS_DESCR STD_AXIS vApplI_AbsSafeNssVehicleSpeed_xdu16 VFZHIGH 4 0 300 FORMAT "%8.4" DEPOSIT ABSOLUTE /end AXIS_DESCR
/end CHARACTERISTIC
/begin CHARACTERISTIC xatMaxGradvVehicle_XAU16_00__A "Max Gradient fuer Steigungsbgrenzung DAC abhaengig von v Fahrzeug" CURVE 0x15D794 AblGLKLuw 5 TORGAINHIGH 0 5 FORMAT "%8.6"
 /begin AXIS_DESCR STD_AXIS vApplI_AbsSafeNssVehicleSpeed_xdu16 VFZHIGH 4 0 300 FORMAT "%8.4" DEPOSIT ABSOLUTE /end AXIS_DESCR
/end CHARACTERISTIC
/begin CHARACTERISTIC xatMaxGradvVehicle_XAU16_01__A "Max Gradient fuer Steigungsbgrenzung DAC abhaengig von v Fahrzeug" CURVE 0x15D7A8 AblGLKLuw 5 TORGAINHIGH 0 5 FORMAT "%8.6"
 /begin AXIS_DESCR STD_AXIS vApplI_AbsSafeNssVehicleSpeed_xdu16 VFZHIGH 4 0 300 FORMAT "%8.4" DEPOSIT ABSOLUTE /end AXIS_DESCR
/end CHARACTERISTIC
/begin CHARACTERISTIC xatMaxGradvVehicle_XAU16_02__A "Max Gradient fuer Steigungsbgrenzung DAC abhaengig von v Fahrzeug" CURVE 0x15D7BC AblGLKLuw 5 TORGAINHIGH 0 5 FORMAT "%8.6"
 /begin AXIS_DESCR STD_AXIS vApplI_AbsSafeNssVehicleSpeed_xdu16 VFZHIGH 4 0 300 FORMAT "%8.4" DEPOSIT ABSOLUTE /end AXIS_DESCR
/end CHARACTERISTIC
/begin CHARACTERISTIC xatMaxGradvVehicle_XAU16_03__A "Max Gradient fuer Steigungsbgrenzung DAC abhaengig von v Fahrzeug" CURVE 0x15D7D0 AblGLKLuw 5 TORGAINHIGH 0 5 FORMAT "%8.6"
 /begin AXIS_DESCR STD_AXIS vApplI_AbsSafeNssVehicleSpeed_xdu16 VFZHIGH 4 0 300 FORMAT "%8.4" DEPOSIT ABSOLUTE /end AXIS_DESCR
/end CHARACTERISTIC
/begin CHARACTERISTIC xatMaxGradvVehicle_XAU16_04__A "Max Gradient fuer Steigungsbgrenzung DAC abhaengig von v Fahrzeug" CURVE 0x15D7E4 AblGLKLuw 5 TORGAINHIGH 0 5 FORMAT "%8.6"
 /begin AXIS_DESCR STD_AXIS vApplI_AbsSafeNssVehicleSpeed_xdu16 VFZHIGH 4 0 300 FORMAT "%8.4" DEPOSIT ABSOLUTE /end AXIS_DESCR
/end CHARACTERISTIC
/begin CHARACTERISTIC xatMaxGradvVehicle_XAU16_05__A "Max Gradient fuer Steigungsbgrenzung DAC abhaengig von v Fahrzeug" CURVE 0x15D7F8 AblGLKLuw 5 TORGAINHIGH 0 5 FORMAT "%8.6"
 /begin AXIS_DESCR STD_AXIS vApplI_AbsSafeNssVehicleSpeed_xdu16 VFZHIGH 4 0 300 FORMAT "%8.4" DEPOSIT ABSOLUTE /end AXIS_DESCR
/end CHARACTERISTIC
/begin CHARACTERISTIC xatMaxGradvVehicle_XAU16_06__A "Max Gradient fuer Steigungsbgrenzung DAC abhaengig von v Fahrzeug" CURVE 0x15D80C AblGLKLuw 5 TORGAINHIGH 0 5 FORMAT "%8.6"
 /begin AXIS_DESCR STD_AXIS vApplI_AbsSafeNssVehicleSpeed_xdu16 VFZHIGH 4 0 300 FORMAT "%8.4" DEPOSIT ABSOLUTE /end AXIS_DESCR
/end CHARACTERISTIC
/begin CHARACTERISTIC xatMaxGradvVehicle_XAU16_07__A "Max Gradient fuer Steigungsbgrenzung DAC abhaengig von v Fahrzeug" CURVE 0x15D820 AblGLKLuw 5 TORGAINHIGH 0 5 FORMAT "%8.6"
 /begin AXIS_DESCR STD_AXIS vApplI_AbsSafeNssVehicleSpeed_xdu16 VFZHIGH 4 0 300 FORMAT "%8.4" DEPOSIT ABSOLUTE /end AXIS_DESCR
/end CHARACTERISTIC
/begin CHARACTERISTIC xatMaxGradvVehicle_XAU16_08__A "Max Gradient fuer Steigungsbgrenzung DAC abhaengig von v Fahrzeug" CURVE 0x15D834 AblGLKLuw 5 TORGAINHIGH 0 5 FORMAT "%8.6"
 /begin AXIS_DESCR STD_AXIS vApplI_AbsSafeNssVehicleSpeed_xdu16 VFZHIGH 4 0 300 FORMAT "%8.4" DEPOSIT ABSOLUTE /end AXIS_DESCR
/end CHARACTERISTIC
/begin CHARACTERISTIC xatMaxGradvVehicle_XAU16_09__A "Max Gradient fuer Steigungsbgrenzung DAC abhaengig von v Fahrzeug" CURVE 0x15D848 AblGLKLuw 5 TORGAINHIGH 0 5 FORMAT "%8.6"
 /begin AXIS_DESCR STD_AXIS vApplI_AbsSafeNssVehicleSpeed_xdu16 VFZHIGH 4 0 300 FORMAT "%8.4" DEPOSIT ABSOLUTE /end AXIS_DESCR
/end CHARACTERISTIC
/begin CHARACTERISTIC xatMaxGradvVehicle_XAU16_10__A "Max Gradient fuer Steigungsbgrenzung DAC abhaengig von v Fahrzeug" CURVE 0x15D85C AblGLKLuw 5 TORGAINHIGH 0 5 FORMAT "%8.6"
 /begin AXIS_DESCR STD_AXIS vApplI_AbsSafeNssVehicleSpeed_xdu16 VFZHIGH 4 0 300 FORMAT "%8.4" DEPOSIT ABSOLUTE /end AXIS_DESCR
/end CHARACTERISTIC
/begin CHARACTERISTIC xatMaxGradvVehicle_XAU16_11__A "Max Gradient fuer Steigungsbgrenzung DAC abhaengig von v Fahrzeug" CURVE 0x15D870 AblGLKLuw 5 TORGAINHIGH 0 5 FORMAT "%8.6"
 /begin AXIS_DESCR STD_AXIS vApplI_AbsSafeNssVehicleSpeed_xdu16 VFZHIGH 4 0 300 FORMAT "%8.4" DEPOSIT ABSOLUTE /end AXIS_DESCR
/end CHARACTERISTIC
/begin CHARACTERISTIC xatMaxGradvVehicle_XAU16_12__A "Max Gradient fuer Steigungsbgrenzung DAC abhaengig von v Fahrzeug" CURVE 0x15D884 AblGLKLuw 5 TORGAINHIGH 0 5 FORMAT "%8.6"
 /begin AXIS_DESCR STD_AXIS vApplI_AbsSafeNssVehicleSpeed_xdu16 VFZHIGH 4 0 300 FORMAT "%8.4" DEPOSIT ABSOLUTE /end AXIS_DESCR
/end CHARACTERISTIC
/begin CHARACTERISTIC xatMaxGradvVehicle_XAU16_13__A "Max Gradient fuer Steigungsbgrenzung DAC abhaengig von v Fahrzeug" CURVE 0x15D898 AblGLKLuw 5 TORGAINHIGH 0 5 FORMAT "%8.6"
 /begin AXIS_DESCR STD_AXIS vApplI_AbsSafeNssVehicleSpeed_xdu16 VFZHIGH 4 0 300 FORMAT "%8.4" DEPOSIT ABSOLUTE /end AXIS_DESCR
/end CHARACTERISTIC
/begin CHARACTERISTIC xatMaxGradvVehicle_XAU16_14__A "Max Gradient fuer Steigungsbgrenzung DAC abhaengig von v Fahrzeug" CURVE 0x15D8AC AblGLKLuw 5 TORGAINHIGH 0 5 FORMAT "%8.6"
 /begin AXIS_DESCR STD_AXIS vApplI_AbsSafeNssVehicleSpeed_xdu16 VFZHIGH 4 0 300 FORMAT "%8.4" DEPOSIT ABSOLUTE /end AXIS_DESCR
/end CHARACTERISTIC
/begin CHARACTERISTIC xatMaxGradvVehicle_XAU16_15__A "Max Gradient fuer Steigungsbgrenzung DAC abhaengig von v Fahrzeug" CURVE 0x15D8C0 AblGLKLuw 5 TORGAINHIGH 0 5 FORMAT "%8.6"
 /begin AXIS_DESCR STD_AXIS vApplI_AbsSafeNssVehicleSpeed_xdu16 VFZHIGH 4 0 300 FORMAT "%8.4" DEPOSIT ABSOLUTE /end AXIS_DESCR
/end CHARACTERISTIC
/begin CHARACTERISTIC xatMaxGradvVehicle_XAU16_16__A "Max Gradient fuer Steigungsbgrenzung DAC abhaengig von v Fahrzeug" CURVE 0x15D8D4 AblGLKLuw 5 TORGAINHIGH 0 5 FORMAT "%8.6"
 /begin AXIS_DESCR STD_AXIS vApplI_AbsSafeNssVehicleSpeed_xdu16 VFZHIGH 4 0 300 FORMAT "%8.4" DEPOSIT ABSOLUTE /end AXIS_DESCR
/end CHARACTERISTIC
/begin CHARACTERISTIC xatMaxGradvVehicle_XAU16_17__A "Max Gradient fuer Steigungsbgrenzung DAC abhaengig von v Fahrzeug" CURVE 0x15D8E8 AblGLKLuw 5 TORGAINHIGH 0 5 FORMAT "%8.6"
 /begin AXIS_DESCR STD_AXIS vApplI_AbsSafeNssVehicleSpeed_xdu16 VFZHIGH 4 0 300 FORMAT "%8.4" DEPOSIT ABSOLUTE /end AXIS_DESCR
/end CHARACTERISTIC
/begin CHARACTERISTIC xatMaxGradvVehicle_XAU16_18__A "Max Gradient fuer Steigungsbgrenzung DAC abhaengig von v Fahrzeug" CURVE 0x15D8FC AblGLKLuw 5 TORGAINHIGH 0 5 FORMAT "%8.6"
 /begin AXIS_DESCR STD_AXIS vApplI_AbsSafeNssVehicleSpeed_xdu16 VFZHIGH 4 0 300 FORMAT "%8.4" DEPOSIT ABSOLUTE /end AXIS_DESCR
/end CHARACTERISTIC
/begin CHARACTERISTIC xatMaxGradvVehicle_XAU16_19__A "Max Gradient fuer Steigungsbgrenzung DAC abhaengig von v Fahrzeug" CURVE 0x15D910 AblGLKLuw 5 TORGAINHIGH 0 5 FORMAT "%8.6"
 /begin AXIS_DESCR STD_AXIS vApplI_AbsSafeNssVehicleSpeed_xdu16 VFZHIGH 4 0 300 FORMAT "%8.4" DEPOSIT ABSOLUTE /end AXIS_DESCR
/end CHARACTERISTIC
/begin CHARACTERISTIC xatMaxGradvVehicle_XAU16_20__A "Max Gradient fuer Steigungsbgrenzung DAC abhaengig von v Fahrzeug" CURVE 0x15D924 AblGLKLuw 5 TORGAINHIGH 0 5 FORMAT "%8.6"
 /begin AXIS_DESCR STD_AXIS vApplI_AbsSafeNssVehicleSpeed_xdu16 VFZHIGH 4 0 300 FORMAT "%8.4" DEPOSIT ABSOLUTE /end AXIS_DESCR
/end CHARACTERISTIC
/begin CHARACTERISTIC xatMaxGradvVehicle_XAU16_21__A "Max Gradient fuer Steigungsbgrenzung DAC abhaengig von v Fahrzeug" CURVE 0x15D938 AblGLKLuw 5 TORGAINHIGH 0 5 FORMAT "%8.6"
 /begin AXIS_DESCR STD_AXIS vApplI_AbsSafeNssVehicleSpeed_xdu16 VFZHIGH 4 0 300 FORMAT "%8.4" DEPOSIT ABSOLUTE /end AXIS_DESCR
/end CHARACTERISTIC
/begin CHARACTERISTIC xatMaxGradvVehicle_XAU16_22__A "Max Gradient fuer Steigungsbgrenzung DAC abhaengig von v Fahrzeug" CURVE 0x15D94C AblGLKLuw 5 TORGAINHIGH 0 5 FORMAT "%8.6"
 /begin AXIS_DESCR STD_AXIS vApplI_AbsSafeNssVehicleSpeed_xdu16 VFZHIGH 4 0 300 FORMAT "%8.4" DEPOSIT ABSOLUTE /end AXIS_DESCR
/end CHARACTERISTIC
/begin CHARACTERISTIC xatMaxGradvVehicle_XAU16_23__A "Max Gradient fuer Steigungsbgrenzung DAC abhaengig von v Fahrzeug" CURVE 0x15D960 AblGLKLuw 5 TORGAINHIGH 0 5 FORMAT "%8.6"
 /begin AXIS_DESCR STD_AXIS vApplI_AbsSafeNssVehicleSpeed_xdu16 VFZHIGH 4 0 300 FORMAT "%8.4" DEPOSIT ABSOLUTE /end AXIS_DESCR
/end CHARACTERISTIC
/begin CHARACTERISTIC xatMaxGradvVehicle_XAU16_24__A "Max Gradient fuer Steigungsbgrenzung DAC abhaengig von v Fahrzeug" CURVE 0x15D974 AblGLKLuw 5 TORGAINHIGH 0 5 FORMAT "%8.6"
 /begin AXIS_DESCR STD_AXIS vApplI_AbsSafeNssVehicleSpeed_xdu16 VFZHIGH 4 0 300 FORMAT "%8.4" DEPOSIT ABSOLUTE /end AXIS_DESCR
/end CHARACTERISTIC
/begin CHARACTERISTIC xatMaxGradvVehicle_XAU16_25__A "Max Gradient fuer Steigungsbgrenzung DAC abhaengig von v Fahrzeug" CURVE 0x15D988 AblGLKLuw 5 TORGAINHIGH 0 5 FORMAT "%8.6"
 /begin AXIS_DESCR STD_AXIS vApplI_AbsSafeNssVehicleSpeed_xdu16 VFZHIGH 4 0 300 FORMAT "%8.4" DEPOSIT ABSOLUTE /end AXIS_DESCR
/end CHARACTERISTIC
/begin CHARACTERISTIC xatMaxGradvVehicle_XAU16_26__A "Max Gradient fuer Steigungsbgrenzung DAC abhaengig von v Fahrzeug" CURVE 0x15D99C AblGLKLuw 5 TORGAINHIGH 0 5 FORMAT "%8.6"
 /begin AXIS_DESCR STD_AXIS vApplI_AbsSafeNssVehicleSpeed_xdu16 VFZHIGH 4 0 300 FORMAT "%8.4" DEPOSIT ABSOLUTE /end AXIS_DESCR
/end CHARACTERISTIC
/begin CHARACTERISTIC xatMaxGradvVehicle_XAU16_27__A "Max Gradient fuer Steigungsbgrenzung DAC abhaengig von v Fahrzeug" CURVE 0x15D9B0 AblGLKLuw 5 TORGAINHIGH 0 5 FORMAT "%8.6"
 /begin AXIS_DESCR STD_AXIS vApplI_AbsSafeNssVehicleSpeed_xdu16 VFZHIGH 4 0 300 FORMAT "%8.4" DEPOSIT ABSOLUTE /end AXIS_DESCR
/end CHARACTERISTIC
/begin CHARACTERISTIC xatMaxGradvVehicle_XAU16_28__A "Max Gradient fuer Steigungsbgrenzung DAC abhaengig von v Fahrzeug" CURVE 0x15D9C4 AblGLKLuw 5 TORGAINHIGH 0 5 FORMAT "%8.6"
 /begin AXIS_DESCR STD_AXIS vApplI_AbsSafeNssVehicleSpeed_xdu16 VFZHIGH 4 0 300 FORMAT "%8.4" DEPOSIT ABSOLUTE /end AXIS_DESCR
/end CHARACTERISTIC
/begin CHARACTERISTIC xatMaxGradvVehicle_XAU16_29__A "Max Gradient fuer Steigungsbgrenzung DAC abhaengig von v Fahrzeug" CURVE 0x15D9D8 AblGLKLuw 5 TORGAINHIGH 0 5 FORMAT "%8.6"
 /begin AXIS_DESCR STD_AXIS vApplI_AbsSafeNssVehicleSpeed_xdu16 VFZHIGH 4 0 300 FORMAT "%8.4" DEPOSIT ABSOLUTE /end AXIS_DESCR
/end CHARACTERISTIC
/begin CHARACTERISTIC xatMaxGradvVehicle_XAU16_30__A "Max Gradient fuer Steigungsbgrenzung DAC abhaengig von v Fahrzeug" CURVE 0x15D9EC AblGLKLuw 5 TORGAINHIGH 0 5 FORMAT "%8.6"
 /begin AXIS_DESCR STD_AXIS vApplI_AbsSafeNssVehicleSpeed_xdu16 VFZHIGH 4 0 300 FORMAT "%8.4" DEPOSIT ABSOLUTE /end AXIS_DESCR
/end CHARACTERISTIC
/begin CHARACTERISTIC xatMaxGradvVehicle_XAU16_31__A "Max Gradient fuer Steigungsbgrenzung DAC abhaengig von v Fahrzeug" CURVE 0x15DA00 AblGLKLuw 5 TORGAINHIGH 0 5 FORMAT "%8.6"
 /begin AXIS_DESCR STD_AXIS vApplI_AbsSafeNssVehicleSpeed_xdu16 VFZHIGH 4 0 300 FORMAT "%8.4" DEPOSIT ABSOLUTE /end AXIS_DESCR
/end CHARACTERISTIC
/begin CHARACTERISTIC xatMaxGradvVehicle_XAU16_32__A "Max Gradient fuer Steigungsbgrenzung DAC abhaengig von v Fahrzeug" CURVE 0x15DA14 AblGLKLuw 5 TORGAINHIGH 0 5 FORMAT "%8.6"
 /begin AXIS_DESCR STD_AXIS vApplI_AbsSafeNssVehicleSpeed_xdu16 VFZHIGH 4 0 300 FORMAT "%8.4" DEPOSIT ABSOLUTE /end AXIS_DESCR
/end CHARACTERISTIC
/begin CHARACTERISTIC xatMaxGradvVehicle_XAU16_33__A "Max Gradient fuer Steigungsbgrenzung DAC abhaengig von v Fahrzeug" CURVE 0x15DA28 AblGLKLuw 5 TORGAINHIGH 0 5 FORMAT "%8.6"
 /begin AXIS_DESCR STD_AXIS vApplI_AbsSafeNssVehicleSpeed_xdu16 VFZHIGH 4 0 300 FORMAT "%8.4" DEPOSIT ABSOLUTE /end AXIS_DESCR
/end CHARACTERISTIC
/begin CHARACTERISTIC xatMaxGradvVehicle_XAU16_34__A "Max Gradient fuer Steigungsbgrenzung DAC abhaengig von v Fahrzeug" CURVE 0x15DA3C AblGLKLuw 5 TORGAINHIGH 0 5 FORMAT "%8.6"
 /begin AXIS_DESCR STD_AXIS vApplI_AbsSafeNssVehicleSpeed_xdu16 VFZHIGH 4 0 300 FORMAT "%8.4" DEPOSIT ABSOLUTE /end AXIS_DESCR
/end CHARACTERISTIC
/begin CHARACTERISTIC xatMaxGradvVehicle_XAU16_35__A "Max Gradient fuer Steigungsbgrenzung DAC abhaengig von v Fahrzeug" CURVE 0x15DA50 AblGLKLuw 5 TORGAINHIGH 0 5 FORMAT "%8.6"
 /begin AXIS_DESCR STD_AXIS vApplI_AbsSafeNssVehicleSpeed_xdu16 VFZHIGH 4 0 300 FORMAT "%8.4" DEPOSIT ABSOLUTE /end AXIS_DESCR
/end CHARACTERISTIC
/begin CHARACTERISTIC xAutParkCtrl_FeedForwardFiltFact_XDU16 "filter factor feed-forward controlled nominal rack position" VALUE 0x15094E AblGLKWuw 1 RIGHTSH10NP 0 1 FORMAT "%8.6" /end CHARACTERISTIC
/begin CHARACTERISTIC xAutParkCtrl_InterruptTorqueFactor_XDU16 "minimaler UnterstÃ¼tzungsfaktor fÃ¼r Abbruch" VALUE 0x150950 AblGLKWuw 100 RSH15 0 100 FORMAT "%8.4" /end CHARACTERISTIC
/begin CHARACTERISTIC xAutParkCtrl_PositionDPart_XDF32 "D-part position controller" VALUE 0x150468 AblGLKWfl4 100 ZU0 0 100 FORMAT "%10.6" /end CHARACTERISTIC
/begin CHARACTERISTIC xAutParkCtrl_PositionIMax_XDF32 "maximum allowed I-part position controller" VALUE 0x15046C AblGLKWfl4 2000 ZU0 0 2000 FORMAT "%10.5" /end CHARACTERISTIC
/begin CHARACTERISTIC xAutParkCtrl_PositionIPart_XDF32_0___A "I-part position controller" VALUE 0x158000 AblGLKWfl4 100 ZU0 0 100 FORMAT "%10.6" /end CHARACTERISTIC
/begin CHARACTERISTIC xAutParkCtrl_PositionIPart_XDF32_1___A "I-part position controller" VALUE 0x158004 AblGLKWfl4 100 ZU0 0 100 FORMAT "%10.6" /end CHARACTERISTIC
/begin CHARACTERISTIC xAutParkCtrl_PositionIPart_XDF32_2___A "I-part position controller" VALUE 0x158008 AblGLKWfl4 100 ZU0 0 100 FORMAT "%10.6" /end CHARACTERISTIC
/begin CHARACTERISTIC xAutParkCtrl_PositionIPart_XDF32_3___A "I-part position controller" VALUE 0x15800C AblGLKWfl4 100 ZU0 0 100 FORMAT "%10.6" /end CHARACTERISTIC
/begin CHARACTERISTIC xAutParkCtrl_PositionIPart_XDF32_4___A "I-part position controller" VALUE 0x158010 AblGLKWfl4 100 ZU0 0 100 FORMAT "%10.6" /end CHARACTERISTIC
/begin CHARACTERISTIC xAutParkCtrl_PositionIPart_XDF32_5___A "I-part position controller" VALUE 0x158014 AblGLKWfl4 100 ZU0 0 100 FORMAT "%10.6" /end CHARACTERISTIC
/begin CHARACTERISTIC xAutParkCtrl_PositionPPart_XDF32_0___A "P-part position controller" VALUE 0x158018 AblGLKWfl4 2000 ZU0 0 2000 FORMAT "%10.5" /end CHARACTERISTIC
/begin CHARACTERISTIC xAutParkCtrl_PositionPPart_XDF32_1___A "P-part position controller" VALUE 0x15801C AblGLKWfl4 2000 ZU0 0 2000 FORMAT "%10.5" /end CHARACTERISTIC
/begin CHARACTERISTIC xAutParkCtrl_PositionPPart_XDF32_2___A "P-part position controller" VALUE 0x158020 AblGLKWfl4 2000 ZU0 0 2000 FORMAT "%10.5" /end CHARACTERISTIC
/begin CHARACTERISTIC xAutParkCtrl_PositionPPart_XDF32_3___A "P-part position controller" VALUE 0x158024 AblGLKWfl4 2000 ZU0 0 2000 FORMAT "%10.5" /end CHARACTERISTIC
/begin CHARACTERISTIC xAutParkCtrl_PositionPPart_XDF32_4___A "P-part position controller" VALUE 0x158028 AblGLKWfl4 2000 ZU0 0 2000 FORMAT "%10.5" /end CHARACTERISTIC
/begin CHARACTERISTIC xAutParkCtrl_PositionPPart_XDF32_5___A "P-part position controller" VALUE 0x15802C AblGLKWfl4 2000 ZU0 0 2000 FORMAT "%10.5" /end CHARACTERISTIC
/begin CHARACTERISTIC xAutParkCtrl_RackSpeedDPart_XDF32 "D-part speed controller" VALUE 0x150470 AblGLKWfl4 2 ZU0 0 2 FORMAT "%10.8" /end CHARACTERISTIC
/begin CHARACTERISTIC xAutParkCtrl_RackSpeedIMax_XDF32 "maximum allowed I-part speed controller" VALUE 0x150474 AblGLKWfl4 8 ZU0 0 8 FORMAT "%10.8" /end CHARACTERISTIC
/begin CHARACTERISTIC xAutParkCtrl_RackSpeedIPart_XDF32_0___A "I-part speed controller" VALUE 0x158030 AblGLKWfl4 1 ZU0 0 1 FORMAT "%10.8" /end CHARACTERISTIC
/begin CHARACTERISTIC xAutParkCtrl_RackSpeedIPart_XDF32_1___A "I-part speed controller" VALUE 0x158034 AblGLKWfl4 1 ZU0 0 1 FORMAT "%10.8" /end CHARACTERISTIC
/begin CHARACTERISTIC xAutParkCtrl_RackSpeedIPart_XDF32_2___A "I-part speed controller" VALUE 0x158038 AblGLKWfl4 1 ZU0 0 1 FORMAT "%10.8" /end CHARACTERISTIC
/begin CHARACTERISTIC xAutParkCtrl_RackSpeedIPart_XDF32_3___A "I-part speed controller" VALUE 0x15803C AblGLKWfl4 1 ZU0 0 1 FORMAT "%10.8" /end CHARACTERISTIC
/begin CHARACTERISTIC xAutParkCtrl_RackSpeedIPart_XDF32_4___A "I-part speed controller" VALUE 0x158040 AblGLKWfl4 1 ZU0 0 1 FORMAT "%10.8" /end CHARACTERISTIC
/begin CHARACTERISTIC xAutParkCtrl_RackSpeedIPart_XDF32_5___A "I-part speed controller" VALUE 0x158044 AblGLKWfl4 1 ZU0 0 1 FORMAT "%10.8" /end CHARACTERISTIC
/begin CHARACTERISTIC xAutParkCtrl_RackSpeedPPart_XDF32_0___A "P-part speed controller" VALUE 0x158048 AblGLKWfl4 2 ZU0 0 2 FORMAT "%10.8" /end CHARACTERISTIC
/begin CHARACTERISTIC xAutParkCtrl_RackSpeedPPart_XDF32_1___A "P-part speed controller" VALUE 0x15804C AblGLKWfl4 2 ZU0 0 2 FORMAT "%10.8" /end CHARACTERISTIC
/begin CHARACTERISTIC xAutParkCtrl_RackSpeedPPart_XDF32_2___A "P-part speed controller" VALUE 0x158050 AblGLKWfl4 2 ZU0 0 2 FORMAT "%10.8" /end CHARACTERISTIC
/begin CHARACTERISTIC xAutParkCtrl_RackSpeedPPart_XDF32_3___A "P-part speed controller" VALUE 0x158054 AblGLKWfl4 2 ZU0 0 2 FORMAT "%10.8" /end CHARACTERISTIC
/begin CHARACTERISTIC xAutParkCtrl_RackSpeedPPart_XDF32_4___A "P-part speed controller" VALUE 0x158058 AblGLKWfl4 2 ZU0 0 2 FORMAT "%10.8" /end CHARACTERISTIC
/begin CHARACTERISTIC xAutParkCtrl_RackSpeedPPart_XDF32_5___A "P-part speed controller" VALUE 0x15805C AblGLKWfl4 2 ZU0 0 2 FORMAT "%10.8" /end CHARACTERISTIC
/begin CHARACTERISTIC xAutParkCtrl_RecoverTorqueFactor_XDU16 "minimaler UnterstÃ¼tzungsfaktor fÃ¼r Erholung" VALUE 0x150952 AblGLKWuw 4.99878 RSH15 95.00122 100 FORMAT "%8.4" /end CHARACTERISTIC
/begin CHARACTERISTIC xAutParkCtrl_RefuseTorqueFactor_XDU16 "minimaler UnterstÃ¼tzungsfaktor fÃ¼r Abweisung" VALUE 0x150954 AblGLKWuw 10.0006 RSH15 75 85.00061 FORMAT "%8.5" /end CHARACTERISTIC
/begin CHARACTERISTIC xBST_PT1FilterFactor_XDU16 "filter factor of disturbance torque (RG1-torques)" VALUE 0x150966 AblGLKWuw 1 RIGHTSH5NP 0 1 FORMAT "%8.6" /end CHARACTERISTIC
/begin CHARACTERISTIC xBST_RackForceScaleFact_XDU16 "rack force scaling factor" VALUE 0x150968 AblGLKWuw 1.79981 RIGHTSH10NP 0.2001953 2 FORMAT "%8.6" /end CHARACTERISTIC
/begin CHARACTERISTIC yAssCtrl_RampDownGradient_XDU16 "Reduktiongradient beim Ausschalten" VALUE 0x150A74 AblGLKWuw 0.00201416 RIGHTSH15NP 0 0.00201416 FORMAT "%11.9" /end CHARACTERISTIC
/begin CHARACTERISTIC yAssCtrl_VehicleNotRunningGradient_XDU16 "Reduktionsgradient während das Fahrzeug steht" VALUE 0x150A76 AblGLKWuw 0.00201416 RIGHTSH15NP 0 0.00201416 FORMAT "%11.9" /end CHARACTERISTIC
/begin CHARACTERISTIC yAssCtrl_VehicleRunningGradient_XDU16 "Reduktiongradient während das Fahrzeug fährt" VALUE 0x150A78 AblGLKWuw 0.00100708 RIGHTSH15NP 0 0.00100708 FORMAT "%11.9" /end CHARACTERISTIC
/begin CHARACTERISTIC zAsmI_MaxHealingPerIgnitionCycle_XDU8 "Maximalanzahl der erlaubten Heilungen (von FailOp nach Normal) in diesem Klemmenzyklus." VALUE 0x150B46 AblGLKWub 255 ZU0 0 255 FORMAT "%5.1" /end CHARACTERISTIC
/begin CHARACTERISTIC zAsmI_MaxHealingPerOscillation_XDU8 "Maximalanzahl der erlaubten Heilungen (von FailOp nach Normal) innerhalb der Zeit tAsmI_OscillationMeasureTime_XDU16. Wichtig zur Vermeidung von Oscillating Assist." VALUE 0x150B47 AblGLKWub 255 ZU0 0 255 FORMAT "%5.1" /end CHARACTERISTIC
/begin CHARACTERISTIC zBci_BaseTorqueCharSelect_XAS16_00___A "geschwindigkeitsabhängige BasicSteerTorque-Kennlinienauswahl" VAL_BLK 0x15FE94 AblGLKWBsw 500 VFZHIGH 0 500 NUMBER 7 FORMAT "%8.4" /end CHARACTERISTIC
/begin CHARACTERISTIC zBci_BaseTorqueCharSelect_XAS16_01___A "geschwindigkeitsabhängige BasicSteerTorque-Kennlinienauswahl" VAL_BLK 0x15FEA4 AblGLKWBsw 500 VFZHIGH 0 500 NUMBER 7 FORMAT "%8.4" /end CHARACTERISTIC
/begin CHARACTERISTIC zBci_BaseTorqueCharSelect_XAS16_02___A "geschwindigkeitsabhängige BasicSteerTorque-Kennlinienauswahl" VAL_BLK 0x15FEB4 AblGLKWBsw 500 VFZHIGH 0 500 NUMBER 7 FORMAT "%8.4" /end CHARACTERISTIC
/begin CHARACTERISTIC zBci_BaseTorqueCharSelect_XAS16_03___A "geschwindigkeitsabhängige BasicSteerTorque-Kennlinienauswahl" VAL_BLK 0x15FEC4 AblGLKWBsw 500 VFZHIGH 0 500 NUMBER 7 FORMAT "%8.4" /end CHARACTERISTIC
/begin CHARACTERISTIC zBci_BaseTorqueCharSelect_XAS16_04___A "geschwindigkeitsabhängige BasicSteerTorque-Kennlinienauswahl" VAL_BLK 0x15FED4 AblGLKWBsw 500 VFZHIGH 0 500 NUMBER 7 FORMAT "%8.4" /end CHARACTERISTIC
/begin CHARACTERISTIC zBci_BaseTorqueCharSelect_XAS16_05___A "geschwindigkeitsabhängige BasicSteerTorque-Kennlinienauswahl" VAL_BLK 0x15FEE4 AblGLKWBsw 500 VFZHIGH 0 500 NUMBER 7 FORMAT "%8.4" /end CHARACTERISTIC
/begin CHARACTERISTIC zBci_BaseTorqueCharSelect_XAS16_06___A "geschwindigkeitsabhängige BasicSteerTorque-Kennlinienauswahl" VAL_BLK 0x15FEF4 AblGLKWBsw 500 VFZHIGH 0 500 NUMBER 7 FORMAT "%8.4" /end CHARACTERISTIC
/begin CHARACTERISTIC zBci_BaseTorqueCharSelect_XAS16_07___A "geschwindigkeitsabhängige BasicSteerTorque-Kennlinienauswahl" VAL_BLK 0x15FF04 AblGLKWBsw 500 VFZHIGH 0 500 NUMBER 7 FORMAT "%8.4" /end CHARACTERISTIC
/begin CHARACTERISTIC zBci_BaseTorqueCharSelect_XAS16_08___A "geschwindigkeitsabhängige BasicSteerTorque-Kennlinienauswahl" VAL_BLK 0x15FF14 AblGLKWBsw 500 VFZHIGH 0 500 NUMBER 7 FORMAT "%8.4" /end CHARACTERISTIC
/begin CHARACTERISTIC zBci_BaseTorqueCharSelect_XAS16_09___A "geschwindigkeitsabhängige BasicSteerTorque-Kennlinienauswahl" VAL_BLK 0x15FF24 AblGLKWBsw 500 VFZHIGH 0 500 NUMBER 7 FORMAT "%8.4" /end CHARACTERISTIC
/begin CHARACTERISTIC zBci_BaseTorqueCharSelect_XAS16_10___A "geschwindigkeitsabhängige BasicSteerTorque-Kennlinienauswahl" VAL_BLK 0x15FF34 AblGLKWBsw 500 VFZHIGH 0 500 NUMBER 7 FORMAT "%8.4" /end CHARACTERISTIC
/begin CHARACTERISTIC zBci_BaseTorqueCharSelect_XAS16_11___A "geschwindigkeitsabhängige BasicSteerTorque-Kennlinienauswahl" VAL_BLK 0x15FF44 AblGLKWBsw 500 VFZHIGH 0 500 NUMBER 7 FORMAT "%8.4" /end CHARACTERISTIC
/begin CHARACTERISTIC zBci_BaseTorqueCharSelect_XAS16_12___A "geschwindigkeitsabhängige BasicSteerTorque-Kennlinienauswahl" VAL_BLK 0x15FF54 AblGLKWBsw 500 VFZHIGH 0 500 NUMBER 7 FORMAT "%8.4" /end CHARACTERISTIC
/begin CHARACTERISTIC zBci_BaseTorqueCharSelect_XAS16_13___A "geschwindigkeitsabhängige BasicSteerTorque-Kennlinienauswahl" VAL_BLK 0x15FF64 AblGLKWBsw 500 VFZHIGH 0 500 NUMBER 7 FORMAT "%8.4" /end CHARACTERISTIC
/begin CHARACTERISTIC zBci_BaseTorqueCharSelect_XAS16_14___A "geschwindigkeitsabhängige BasicSteerTorque-Kennlinienauswahl" VAL_BLK 0x15FF74 AblGLKWBsw 500 VFZHIGH 0 500 NUMBER 7 FORMAT "%8.4" /end CHARACTERISTIC
/begin CHARACTERISTIC zBci_BaseTorqueCharSelect_XAS16_15___A "geschwindigkeitsabhängige BasicSteerTorque-Kennlinienauswahl" VAL_BLK 0x15FF84 AblGLKWBsw 500 VFZHIGH 0 500 NUMBER 7 FORMAT "%8.4" /end CHARACTERISTIC
/begin CHARACTERISTIC zBci_BaseTorqueCharSelect_XAS16_16___A "geschwindigkeitsabhängige BasicSteerTorque-Kennlinienauswahl" VAL_BLK 0x15FF94 AblGLKWBsw 500 VFZHIGH 0 500 NUMBER 7 FORMAT "%8.4" /end CHARACTERISTIC
/begin CHARACTERISTIC zBci_BaseTorqueCharSelect_XAS16_17___A "geschwindigkeitsabhängige BasicSteerTorque-Kennlinienauswahl" VAL_BLK 0x15FFA4 AblGLKWBsw 500 VFZHIGH 0 500 NUMBER 7 FORMAT "%8.4" /end CHARACTERISTIC
/begin CHARACTERISTIC zBci_BaseTorqueCharSelect_XAS16_18___A "geschwindigkeitsabhängige BasicSteerTorque-Kennlinienauswahl" VAL_BLK 0x15FFB4 AblGLKWBsw 500 VFZHIGH 0 500 NUMBER 7 FORMAT "%8.4" /end CHARACTERISTIC
/begin CHARACTERISTIC zBci_BaseTorqueCharSelect_XAS16_19___A "geschwindigkeitsabhängige BasicSteerTorque-Kennlinienauswahl" VAL_BLK 0x15FFC4 AblGLKWBsw 500 VFZHIGH 0 500 NUMBER 7 FORMAT "%8.4" /end CHARACTERISTIC
/begin CHARACTERISTIC zBci_BaseTorqueCharSelect_XAS16_20___A "geschwindigkeitsabhängige BasicSteerTorque-Kennlinienauswahl" VAL_BLK 0x15FFD4 AblGLKWBsw 500 VFZHIGH 0 500 NUMBER 7 FORMAT "%8.4" /end CHARACTERISTIC
/begin CHARACTERISTIC zBci_BaseTorqueCharSelect_XAS16_21___A "geschwindigkeitsabhängige BasicSteerTorque-Kennlinienauswahl" VAL_BLK 0x15FFE4 AblGLKWBsw 500 VFZHIGH 0 500 NUMBER 7 FORMAT "%8.4" /end CHARACTERISTIC
/begin CHARACTERISTIC zBci_BaseTorqueCharSelect_XAS16_22___A "geschwindigkeitsabhängige BasicSteerTorque-Kennlinienauswahl" VAL_BLK 0x15FFF4 AblGLKWBsw 500 VFZHIGH 0 500 NUMBER 7 FORMAT "%8.4" /end CHARACTERISTIC
/begin CHARACTERISTIC zBci_BaseTorqueCharSelect_XAS16_23___A "geschwindigkeitsabhängige BasicSteerTorque-Kennlinienauswahl" VAL_BLK 0x160004 AblGLKWBsw 500 VFZHIGH 0 500 NUMBER 7 FORMAT "%8.4" /end CHARACTERISTIC
/begin CHARACTERISTIC zBci_BaseTorqueCharSelect_XAS16_24___A "geschwindigkeitsabhängige BasicSteerTorque-Kennlinienauswahl" VAL_BLK 0x160014 AblGLKWBsw 500 VFZHIGH 0 500 NUMBER 7 FORMAT "%8.4" /end CHARACTERISTIC
/begin CHARACTERISTIC zBci_BaseTorqueCharSelect_XAS16_25___A "geschwindigkeitsabhängige BasicSteerTorque-Kennlinienauswahl" VAL_BLK 0x160024 AblGLKWBsw 500 VFZHIGH 0 500 NUMBER 7 FORMAT "%8.4" /end CHARACTERISTIC
/begin CHARACTERISTIC zBci_BaseTorqueCharSelect_XAS16_26___A "geschwindigkeitsabhängige BasicSteerTorque-Kennlinienauswahl" VAL_BLK 0x160034 AblGLKWBsw 500 VFZHIGH 0 500 NUMBER 7 FORMAT "%8.4" /end CHARACTERISTIC
/begin CHARACTERISTIC zBci_BaseTorqueCharSelect_XAS16_27___A "geschwindigkeitsabhängige BasicSteerTorque-Kennlinienauswahl" VAL_BLK 0x160044 AblGLKWBsw 500 VFZHIGH 0 500 NUMBER 7 FORMAT "%8.4" /end CHARACTERISTIC
/begin CHARACTERISTIC zBci_BaseTorqueCharSelect_XAS16_28___A "geschwindigkeitsabhängige BasicSteerTorque-Kennlinienauswahl" VAL_BLK 0x160054 AblGLKWBsw 500 VFZHIGH 0 500 NUMBER 7 FORMAT "%8.4" /end CHARACTERISTIC
/begin CHARACTERISTIC zBci_BaseTorqueCharSelect_XAS16_29___A "geschwindigkeitsabhängige BasicSteerTorque-Kennlinienauswahl" VAL_BLK 0x160064 AblGLKWBsw 500 VFZHIGH 0 500 NUMBER 7 FORMAT "%8.4" /end CHARACTERISTIC
/begin CHARACTERISTIC zBci_BaseTorqueCharSelect_XAS16_30___A "geschwindigkeitsabhängige BasicSteerTorque-Kennlinienauswahl" VAL_BLK 0x160074 AblGLKWBsw 500 VFZHIGH 0 500 NUMBER 7 FORMAT "%8.4" /end CHARACTERISTIC
/begin CHARACTERISTIC zBci_BaseTorqueCharSelect_XAS16_31___A "geschwindigkeitsabhängige BasicSteerTorque-Kennlinienauswahl" VAL_BLK 0x160084 AblGLKWBsw 500 VFZHIGH 0 500 NUMBER 7 FORMAT "%8.4" /end CHARACTERISTIC
/begin CHARACTERISTIC zBci_BaseTorqueCharSelect_XAS16_32___A "geschwindigkeitsabhängige BasicSteerTorque-Kennlinienauswahl" VAL_BLK 0x160094 AblGLKWBsw 500 VFZHIGH 0 500 NUMBER 7 FORMAT "%8.4" /end CHARACTERISTIC
/begin CHARACTERISTIC zBci_BaseTorqueCharSelect_XAS16_33___A "geschwindigkeitsabhängige BasicSteerTorque-Kennlinienauswahl" VAL_BLK 0x1600A4 AblGLKWBsw 500 VFZHIGH 0 500 NUMBER 7 FORMAT "%8.4" /end CHARACTERISTIC
/begin CHARACTERISTIC zBci_BaseTorqueCharSelect_XAS16_34___A "geschwindigkeitsabhängige BasicSteerTorque-Kennlinienauswahl" VAL_BLK 0x1600B4 AblGLKWBsw 500 VFZHIGH 0 500 NUMBER 7 FORMAT "%8.4" /end CHARACTERISTIC
/begin CHARACTERISTIC zBci_BaseTorqueCharSelect_XAS16_35___A "geschwindigkeitsabhängige BasicSteerTorque-Kennlinienauswahl" VAL_BLK 0x1600C4 AblGLKWBsw 500 VFZHIGH 0 500 NUMBER 7 FORMAT "%8.4" /end CHARACTERISTIC
/begin CHARACTERISTIC zBsd_MaxRampUpCycles_XDU8 "Max. Drehmoment generation für Rotor bewegung" VALUE 0x150B48 AblGLKWub 2 ZU0 1 3 FORMAT "%5.3" /end CHARACTERISTIC
/begin MEASUREMENT aApplI_AbsLatAccel_xdu16 "Abs. Querbeschleunigung aus Fahrzeugmodell" UWORD AFZ 1 100 0 60 FORMAT "%8.5" ECU_ADDRESS 0xFEBE8F7C /end MEASUREMENT
/begin MEASUREMENT aApplI_LateralAcceleration_xds16 "Querbeschleunigung" SWORD AFZ 1 100 -30 30 FORMAT "%8.5" ECU_ADDRESS 0xFEBE8F7E /end MEASUREMENT
/begin MEASUREMENT aApplI_LongitudeAcceleration_xds16 "Lï¿½ngsbeschleunigung" SWORD AFZ 1 100 -30 30 FORMAT "%8.5" ECU_ADDRESS 0xFEBE8F80 /end MEASUREMENT
/begin MEASUREMENT aApplI_RotAccelerationFilt_xds16 "gefilterte Rotorbeschleunigung" SWORD ROTACC 1 100 -500 500 FORMAT "%8.4" ECU_ADDRESS 0xFEBE8F82 /end MEASUREMENT
/begin MEASUREMENT aApplI_RotAcceleration_xds16 "Rotorbeschleunigung" SWORD ROTACC 1 100 -500 500 FORMAT "%8.4" ECU_ADDRESS 0xFEBE8F84 /end MEASUREMENT
/begin MEASUREMENT fApplI_ImproperShutdown_xdb "Flag will be set when Improper shutdown occurs" UWORD ZU0 1 100 0 1 BIT_MASK 0x1 FORMAT "%5.3" ECU_ADDRESS 0xFEBE9421 /end MEASUREMENT
/begin MEASUREMENT fApplI_LaErrorMode_xdb "Flag ob diverse CAN Eingangsignale gueltig sind" UWORD ZU0 1 100 0 1 BIT_MASK 0x1 FORMAT "%5.3" ECU_ADDRESS 0xFEBE9422 /end MEASUREMENT
/begin MEASUREMENT fApplI_LdwErrorMode_xdb "Flag ob diverse CAN Eingangsignale gueltig sind" UWORD ZU0 1 100 0 1 BIT_MASK 0x1 FORMAT "%5.3" ECU_ADDRESS 0xFEBE9423 /end MEASUREMENT
/begin MEASUREMENT fApplI_RscEpsFault_xdb "Flag will be set when exit rsc occurs" UWORD ZU0 1 100 0 1 BIT_MASK 0x1 FORMAT "%5.3" ECU_ADDRESS 0xFEBE9424 /end MEASUREMENT
/begin MEASUREMENT fAsm_MaxHealingsReached_gdb "Maximale Heilungszahl erreicht, keine weiteren Heilungen erlaubt." UBYTE BIT 1 100 0 1 BIT_MASK 0x1 FORMAT "%5.3" ECU_ADDRESS 0xFEBE9425 /end MEASUREMENT
/begin MEASUREMENT fAutParkCtrl_MonSafeOk_xdb "Indicates whether the MonitorSafe checks report OK (1) or if they have detected a problem (0)" UWORD ZU0 1 100 0 1 BIT_MASK 0x1 FORMAT "%5.3" ECU_ADDRESS 0xFEBE9426 /end MEASUREMENT
/begin MEASUREMENT fBatVolt_StartTimer_gdb "So stellen Sie den Timer basierend auf dem Batteriespannungsstatus ein und setzen ihn zurück." UBYTE BIT 1 100 0 1 BIT_MASK 0x1 FORMAT "%5.3" ECU_ADDRESS 0xFEBE9427 /end MEASUREMENT
/begin MEASUREMENT fBsdI_MonSafeOk_xdb "Indicates whether the MonitorSafe checks report OK (true) or if they have detected a problem (false)" UWORD ZU0 1 100 0 1 BIT_MASK 0x1 FORMAT "%5.3" ECU_ADDRESS 0xFEBE9428 /end MEASUREMENT
/begin MEASUREMENT fBsd_ActivateTorqueGen_xdb "Flag for Activating BSD torque" UWORD ZU0 1 100 0 1 BIT_MASK 0x1 FORMAT "%5.3" ECU_ADDRESS 0xFEBE9429 /end MEASUREMENT
/begin MEASUREMENT fBsd_EnableMonitoring_xdb " flag to enable the detection of Blocked steering Statemachine" UWORD ZU0 1 100 0 1 BIT_MASK 0x1 FORMAT "%5.3" ECU_ADDRESS 0xFEBE942A /end MEASUREMENT
/begin MEASUREMENT fBsd_FirstRunMonitorSafe_xdb "Initializing min-max values for deltaRotPos calculation in MonitorSafe" UWORD BIT 1 100 0 1 BIT_MASK 0x1 FORMAT "%5.3" ECU_ADDRESS 0xFEBE942B /end MEASUREMENT
/begin MEASUREMENT fBsd_JobResultOK_xdb " Flag to indicate the status of NvM Call Back" UWORD ZU0 1 100 0 1 BIT_MASK 0x1 FORMAT "%5.3" ECU_ADDRESS 0xFEBE942C /end MEASUREMENT
/begin MEASUREMENT fBswI_IsInitialized_gdb "fBswI_IsInitialized_gdb" UWORD ZU0 1 100 0 1 BIT_MASK 0x1 FORMAT "%5.3" ECU_ADDRESS 0xFEBE942E /end MEASUREMENT
/begin MEASUREMENT iApplI_AllowedBattCurr_xdu16 " Externer Vorgabewert fï¿½r maximalen Batteriestrom " UWORD SM_I 1 100 0 150 FORMAT "%8.4" ECU_ADDRESS 0xFEBE8F8C /end MEASUREMENT
/begin MEASUREMENT iApplI_MaxBattCurr_xdu16 " maximal erlaubter Batteriestrom " UWORD SM_I 1 100 0 200 FORMAT "%8.4" ECU_ADDRESS 0xFEBE4AB8 /end MEASUREMENT
/begin MEASUREMENT kApplI_AbsRackForce_xdu16 "Zahnstangenkraft" UWORD FRACK 1 100 0 20000 FORMAT "%8.2" ECU_ADDRESS 0xFEBE8F8E /end MEASUREMENT
/begin MEASUREMENT kApplI_RackForceComfortRaw_xds16 "Komfort-Zahnstangenkraft roh" SWORD FRACK 1 100 -20000 20000 FORMAT "%8.2" ECU_ADDRESS 0xFEBE8F90 /end MEASUREMENT
/begin MEASUREMENT kApplI_RackForceComfort_xds16 "Komfort-Zahnstangenkraft" SWORD FRACK 1 100 -20000 20000 FORMAT "%8.2" ECU_ADDRESS 0xFEBE8F92 /end MEASUREMENT
/begin MEASUREMENT kApplI_RackForceMerge_xds16 "Gemergte Zahnstangenkraft" SWORD FRACK 1 100 -20000 20000 FORMAT "%8.2" ECU_ADDRESS 0xFEBE8F94 /end MEASUREMENT
/begin MEASUREMENT kApplI_RackForceSimple_xds16 "Einfache Zahnstangenkraft" SWORD FRACK 1 100 -20000 20000 FORMAT "%8.2" ECU_ADDRESS 0xFEBE8F96 /end MEASUREMENT
/begin MEASUREMENT kApplI_RackForce_xds16 "Zahnstangenkraft" SWORD FRACK 1 100 -20000 20000 FORMAT "%8.2" ECU_ADDRESS 0xFEBE8F98 /end MEASUREMENT
/begin MEASUREMENT kBciI_BSTCurveRackForceXAxis_xau16 "x-Achsenwerte der interpolierten und umskalierten BasicSteerTorque-Kennlinie (Zahnstangenkraft)" UWORD FRACK 1 100 0 30000 FORMAT "%8.2" ECU_ADDRESS 0xFEBE9884 MATRIX_DIM 10 1 1 /end MEASUREMENT
/begin MEASUREMENT kBci_BSTCurveRackForceXAxisRawL2_xaf32 "x-Achsenwerte der level2 interpolierten BasicSteerTorque-Kennlinie (Zahnstangenkraft)" FLOAT32_IEEE ZU0 1 100 0 30000 FORMAT "%10.4" ECU_ADDRESS 0xFEBE9898 MATRIX_DIM 9 1 1 /end MEASUREMENT
/begin MEASUREMENT kBci_BSTCurveRackForceXAxisRaw_xas16 "x-Achsenwerte der level1 interpolierten BasicSteerTorque-Kennlinie (Zahnstangenkraft)" SWORD FRACK 1 100 0 30000 FORMAT "%8.2" ECU_ADDRESS 0xFEBE9AC4 MATRIX_DIM 9 1 1 /end MEASUREMENT
/begin MEASUREMENT lApplI_AbsRackPosition_xdu16 "BetragZahnstangenposition [mm]" UWORD RACKPOS128 1 100 0 200 FORMAT "%8.4" ECU_ADDRESS 0xFEBE8FA4 /end MEASUREMENT
/begin MEASUREMENT lApplI_RackPositionLtCorr_xds16 "langzeitkorrigierte Zahnstangenposition [mm]" SWORD RACKPOS128 1 100 -200 200 FORMAT "%8.4" ECU_ADDRESS 0xFEBE8FA6 /end MEASUREMENT
/begin MEASUREMENT lApplI_RackPosition_xds16 "Zahnstangenposition [mm]" SWORD RACKPOS128 1 100 -200 200 FORMAT "%8.4" ECU_ADDRESS 0xFEBE8FA8 /end MEASUREMENT
/begin MEASUREMENT lApplI_VehCentRackPos_xds16 "Zahnstangenposition bezogen auf Fahrzeugmitte [mm]" SWORD RACKPOS128 1 100 -200 200 FORMAT "%8.4" ECU_ADDRESS 0xFEBE8FAA /end MEASUREMENT
/begin MEASUREMENT lAutParkCtrlI_DesiredRackPosition_xds16 "desired rack position" SWORD RACKPOS128 1 100 -200 200 FORMAT "%8.4" ECU_ADDRESS 0xFEBE8FAC /end MEASUREMENT
/begin MEASUREMENT lAutParkCtrl_DesiredRackPosFilt_xds16 "filtrated desired rack position" SWORD RACKPOS128 1 100 -200 200 FORMAT "%8.4" ECU_ADDRESS 0xFEBE8FAE /end MEASUREMENT
/begin MEASUREMENT mApplI_AbsDriverTorque_xdu16 "Betrag berechnetes Fahrerhandmoment" UWORD TBTHIGH 1 100 0 25 FORMAT "%8.5" ECU_ADDRESS 0xFEBE9000 /end MEASUREMENT
/begin MEASUREMENT mApplI_DriverTorque_xds16 "Berechnetes Fahrerhandmoment" SWORD TBTHIGH 1 100 -25 25 FORMAT "%8.5" ECU_ADDRESS 0xFEBE9004 /end MEASUREMENT
/begin MEASUREMENT mApplI_DriveShaftTorque_xds16 "Antriebswellenmomoment" SWORD MDRVSHAFT 1 100 -32000 32000 FORMAT "%8.2" ECU_ADDRESS 0xFEBE9006 /end MEASUREMENT
/begin MEASUREMENT mApplI_LkaTorqueRequest_xds16 "LKA: Torque Request from CAN" SWORD TBTHIGH 1 100 -10.24023 10.23047 FORMAT "%8.5" ECU_ADDRESS 0xFEBE900A /end MEASUREMENT
/begin MEASUREMENT mApplI_MaxRequiredMotorTorque_xdu16 "max angefordertes Motormoment" UWORD MMOT 1 100 0 12 FORMAT "%8.5" ECU_ADDRESS 0xFEBE900E /end MEASUREMENT
/begin MEASUREMENT mApplI_NominalMotorTorque_xds16 "summation of all power assist motor torques including AddOnFunctions" SWORD MMOT 1 100 -12 12 FORMAT "%8.5" ECU_ADDRESS 0xFEBE9010 /end MEASUREMENT
/begin MEASUREMENT mApplI_SSWarnTorque_xds16 "StickSlipWarning Moment das nach den Limitierungen aufgerechnet wird" SWORD MMOT 1 100 -12 12 FORMAT "%8.5" ECU_ADDRESS 0xFEBE4AC2 /end MEASUREMENT
/begin MEASUREMENT matAbsTorsionBarTorque_xdu16 "Absolutes Drehstabmoment" UWORD TBTHIGH 1 100 0 25 FORMAT "%8.5" ECU_ADDRESS 0xFEBE9016 /end MEASUREMENT
/begin MEASUREMENT matAssistanceLimitedY_xau16 "Y-Werte der begrenzten Unterstuetzungskennlinie" UWORD MMOT 1 100 0 63.99902 FORMAT "%8.5" ECU_ADDRESS 0xFEBE98BC MATRIX_DIM 10 1 1 /end MEASUREMENT
/begin MEASUREMENT matAssistanceX_xau16 "X-Stuetzstellen der interpolierten Unterstuetzungskennlinie" UWORD TBTHIGH 1 100 0 63.99902 FORMAT "%8.5" ECU_ADDRESS 0xFEBE98D0 MATRIX_DIM 10 1 1 /end MEASUREMENT
/begin MEASUREMENT matAssistanceY_xau16 "Y-Werte der interpolierten Unterstuetzungskennlinie" UWORD MMOT 1 100 0 63.99902 FORMAT "%8.5" ECU_ADDRESS 0xFEBE98E4 MATRIX_DIM 10 1 1 /end MEASUREMENT
/begin MEASUREMENT matAssistantTorque_xds16 "Unterstuetzungsmoment" SWORD MMOT 1 100 -12 12 FORMAT "%8.5" ECU_ADDRESS 0xFEBE9018 /end MEASUREMENT
/begin MEASUREMENT matFactRedAssistTrq_xds16 "Unterstuetzungsmoment vor DAC, limitiert auf Produkt aus MinRedLevel und MaxUseableTorque" SWORD MMOT 1 100 -12 12 FORMAT "%8.5" ECU_ADDRESS 0xFEBE901A /end MEASUREMENT
/begin MEASUREMENT matLimitationDiff_xds16 "DAC Eingang PT1 Offset" SWORD MMOT 1 100 -12 12 FORMAT "%8.5" ECU_ADDRESS 0xFEBE901C /end MEASUREMENT
/begin MEASUREMENT matLimitation_xds16 "Steigungsbegrenztes Unterstuetzungsmoment ohne PT1 Offset" SWORD MMOT 1 100 -12 12 FORMAT "%8.5" ECU_ADDRESS 0xFEBE901E /end MEASUREMENT
/begin MEASUREMENT matMaxXLimitedAssistance_xdu16 "max x-Wert steigungsbegrenten Unterstuetzungskennlinie" UWORD TBTHIGH 1 100 0 15 FORMAT "%8.5" ECU_ADDRESS 0xFEBE9020 /end MEASUREMENT
/begin MEASUREMENT matPT1Offset_xds16 "Ausgang PT1 Offset" SWORD MMOT 1 100 -12 12 FORMAT "%8.5" ECU_ADDRESS 0xFEBE9022 /end MEASUREMENT
/begin MEASUREMENT matTorsionBarTorque_xds16 "Drehstabmoment mit Servofaktor und Offset fuer Assist Berechnung" SWORD TBTHIGH 1 100 -25 25 FORMAT "%8.5" ECU_ADDRESS 0xFEBE9024 /end MEASUREMENT
/begin MEASUREMENT matUnlimitedAssistantTorque_xds16 "urspruengliches Unterstuetzungsmoment (nicht steigungsbegrenzt)" SWORD MMOT 1 100 -12 12 FORMAT "%8.5" ECU_ADDRESS 0xFEBE9026 /end MEASUREMENT
/begin MEASUREMENT mAutParkCtrlI_DesMotTrqOffset4Check_xds16 "Desired motor torque offset of Automatic Parking Control to be read by Check component only" SWORD MMOT 1 100 -16 16 FORMAT "%8.5" ECU_ADDRESS 0xFEBE9028 /end MEASUREMENT
/begin MEASUREMENT mAutParkCtrlI_DesMotTrqOffset_xds16 "Desired motor torque offset of Automatic Parking Control" SWORD MMOT 1 100 -16 16 FORMAT "%8.5" ECU_ADDRESS 0xFEBE8F4C /end MEASUREMENT
/begin MEASUREMENT mAutParkCtrlI_DesSteerTrqOffset4Check_xds16 "Desired steering torque offset of Automatic Parking Control to be read by Check component only" SWORD TBTHIGH 1 100 -10 10 FORMAT "%8.5" ECU_ADDRESS 0xFEBE902A /end MEASUREMENT
/begin MEASUREMENT mAutParkCtrlI_DesSteerTrqOffset_xds16 "Desired steer torque offset of Automatic Parking Control" SWORD TBTHIGH 1 100 -10 10 FORMAT "%8.5" ECU_ADDRESS 0xFEBE8F4E /end MEASUREMENT
/begin MEASUREMENT mAutParkCtrl_DesMotTrqOffsetChecked_xds16 "Steer torque offset which has been subjected to the MakeSafe measures" SWORD MMOT 1 100 -16 16 FORMAT "%8.5" ECU_ADDRESS 0xFEBE8F50 /end MEASUREMENT
/begin MEASUREMENT mAutParkCtrl_DesSteerTrqOffsetChecked_xds16 "Steer torque offset which has been subjected to the MakeSafe measures" SWORD TBTHIGH 1 100 -10 10 FORMAT "%8.5" ECU_ADDRESS 0xFEBE8F52 /end MEASUREMENT
/begin MEASUREMENT mBciI_AssistCurveMMotYAxis_xau16 "y-Achsenwerte der berechneten Unterstützungs-Kennlinie (nominelles Unterstützungsmoment)" UWORD MMOT 1 100 0 12 FORMAT "%8.5" ECU_ADDRESS 0xFEBE98F8 MATRIX_DIM 10 1 1 /end MEASUREMENT
/begin MEASUREMENT mBciI_AssistCurveTBTXAxis_xau16 "x-Achsenwerte der berechneten Unterstützungs-Kennlinie (Handmoment)" UWORD TBTHIGH 1 100 0 15 FORMAT "%8.5" ECU_ADDRESS 0xFEBE990C MATRIX_DIM 10 1 1 /end MEASUREMENT
/begin MEASUREMENT mBciI_BSTCurveSteerTorqueYAxis_xau16 "y-Achsenwerte der interpolierten und umskalierten BasicSteerTorque-Kennlinie (nominales Handmoment)" UWORD TBTHIGH 1 100 0 15 FORMAT "%8.5" ECU_ADDRESS 0xFEBE9920 MATRIX_DIM 10 1 1 /end MEASUREMENT
/begin MEASUREMENT mBci_BSTCurveSteerTorqueYAxisRawL2_xaf32 "y-Achsenwerte der level2 interpolierten BasicSteerTorque-Kennlinie (nominales Handmoment)" FLOAT32_IEEE ZU0 1 100 0 15 FORMAT "%10.7" ECU_ADDRESS 0xFEBE9934 MATRIX_DIM 9 1 1 /end MEASUREMENT
/begin MEASUREMENT mBci_BSTCurveSteerTorqueYAxisRaw_xas16 "y-Achsenwerte der level1 interpolierten BasicSteerTorque-Kennlinie (nominales Handmoment)" SWORD TBTHIGH 1 100 0 15 FORMAT "%8.5" ECU_ADDRESS 0xFEBE9AD8 MATRIX_DIM 9 1 1 /end MEASUREMENT
/begin MEASUREMENT mBsdI_MotorTorque4Check_xds16 "blocked steering detection motor torque offset to be read by BSD Check component only" SWORD MMOT 1 100 -1 1 FORMAT "%8.6" ECU_ADDRESS 0xFEBE902C /end MEASUREMENT
/begin MEASUREMENT mBsdI_MotorTorqueOffset_xds16 "Motormomentenoffset blocked steering detection" SWORD MMOT 1 100 -1 1 FORMAT "%8.6" ECU_ADDRESS 0xFEBE902E /end MEASUREMENT
/begin MEASUREMENT mBsd_MotorTorqueSaturated_xds16 "Steer torque offset which has been subjected to the MakeSafe measures" SWORD MMOT 1 100 -1 1 FORMAT "%8.6" ECU_ADDRESS 0xFEBE8F54 /end MEASUREMENT
/begin MEASUREMENT mBSTI_NominalSteerTorque_xds16 "Basislenkmoment" SWORD TBTHIGH 1 100 -10 10 FORMAT "%8.5" ECU_ADDRESS 0xFEBE9030 /end MEASUREMENT
/begin MEASUREMENT nApplI_AbsGeneratoricRotorSpeed_xdu16 "Generatorische Geschwindigkeit" UWORD VROT 1 100 0 13000 FORMAT "%3.0" ECU_ADDRESS 0xFEBE919E /end MEASUREMENT
/begin MEASUREMENT nApplI_AbsRotorSpeedFilt_xdu16 "absolute, gefilterte Rotorgeschwindigkeit" UWORD VROT 1 100 0 13000 FORMAT "%3.0" ECU_ADDRESS 0xFEBE91A0 /end MEASUREMENT
/begin MEASUREMENT nApplI_RotorSpeedFilt_xds16 "gefilterte Rotorgeschwindigkeit" SWORD VROT 1 100 -13000 13000 FORMAT "%3.0" ECU_ADDRESS 0xFEBE91A2 /end MEASUREMENT
/begin MEASUREMENT nApplI_RotorSpeed_xds16 "ungefilterte Rotorgeschwindigkeit" SWORD VROT 1 100 -13000 13000 FORMAT "%3.0" ECU_ADDRESS 0xFEBE4ACA /end MEASUREMENT
/begin MEASUREMENT qApplI_WheelFrequencyFL_xds16 "Rad Frequenz vorne links" SWORD FREQHZ 1 100 -20 80 FORMAT "%8.5" ECU_ADDRESS 0xFEBE91C0 /end MEASUREMENT
/begin MEASUREMENT qApplI_WheelFrequencyFR_xds16 "Rad Frequenz vorne rechts" SWORD FREQHZ 1 100 -20 80 FORMAT "%8.5" ECU_ADDRESS 0xFEBE91C2 /end MEASUREMENT
/begin MEASUREMENT qApplI_WheelFrequencyRL_xds16 "Rad Frequenz hinten links" SWORD FREQHZ 1 100 -20 80 FORMAT "%8.5" ECU_ADDRESS 0xFEBE91C4 /end MEASUREMENT
/begin MEASUREMENT qApplI_WheelFrequencyRR_xds16 "Rad Frequenz hinten rechts" SWORD FREQHZ 1 100 -20 80 FORMAT "%8.5" ECU_ADDRESS 0xFEBE91C6 /end MEASUREMENT
/begin MEASUREMENT sApplI_ABSActive_xdu8 " " UBYTE ZU0 1 100 0 1 FORMAT "%5.3" ECU_ADDRESS 0xFEBE94E1 /end MEASUREMENT
/begin MEASUREMENT sApplI_ABSFailed_xdu8 " " UBYTE ZU0 1 100 0 1 FORMAT "%5.3" ECU_ADDRESS 0xFEBE94E2 /end MEASUREMENT
/begin MEASUREMENT sApplI_ApcState_xdu8 "APC: state from external ECU: 0=inactive, 1=request rack position control" UBYTE ZU0 1 100 0 2 FORMAT "%5.3" ECU_ADDRESS 0xFEBE94E3 /end MEASUREMENT
/begin MEASUREMENT sApplI_BoostModeRequest_xdu8 "Flag die vom Kundenprojekt genutzt werden kann um der HwLib mitzuteilen, wann es ok ist den boost mode zu aktivieren" UBYTE ZU0 1 100 0 1 FORMAT "%5.3" ECU_ADDRESS 0xFEBE4B15 /end MEASUREMENT
/begin MEASUREMENT sApplI_CommBusTml50_xdu8 "Status Klemme 50" UBYTE ZU0 1 100 0 254 FORMAT "%5.1" ECU_ADDRESS 0xFEBE94E5 /end MEASUREMENT
/begin MEASUREMENT sApplI_DesVoltRedState_xdu8 "Spannungs reduktions Faktor" UBYTE ZU0 1 100 0 1 FORMAT "%5.3" ECU_ADDRESS 0xFEBE94E6 /end MEASUREMENT
/begin MEASUREMENT sApplI_displayindicatorstate_xdu8 "display Status" UBYTE ZU0 1 100 0 4 FORMAT "%5.3" ECU_ADDRESS 0xFEBE94E7 /end MEASUREMENT
/begin MEASUREMENT sApplI_EcuState_xdu8 " Sicherer Status der Ecu " UBYTE ECU_STATE 1 100 0 8 FORMAT "%13.11" ECU_ADDRESS 0xFEBE94EC /end MEASUREMENT
/begin MEASUREMENT sApplI_EngineRunning_xdu8 "Status des Verbrennungsmotors (0 == EngineNotRunning, 1 == EngineRunning, 2 == EngineRunningStable)" UBYTE ZU0 1 100 0 2 FORMAT "%5.3" ECU_ADDRESS 0xFEBE94EE /end MEASUREMENT
/begin MEASUREMENT sApplI_EpsApcState_xdu8 "APC: internal state for external ECU: 0=inactive, 1=EPS error, 2=available, 3=temporary error, 4=request rejected, 5=active rack position control, 6=ramp out" UBYTE ZU0 1 100 0 6 FORMAT "%5.3" ECU_ADDRESS 0xFEBE94EF /end MEASUREMENT
/begin MEASUREMENT sApplI_EpsCharismaState_xdu8 "Current State of Charisma Mode (DMS State): 0 - DEFAULT, 1 - INITIAL, 2 - AVAILABLE, 3 - TEMPORARY_ERROR, 4 - PERMANENT_ERROR" UBYTE ZU0 1 100 0 4 FORMAT "%5.3" ECU_ADDRESS 0xFEBE94F0 /end MEASUREMENT
/begin MEASUREMENT sApplI_EssMode_xdu8 "ESS Mode Request" UBYTE ZU0 1 100 0 1 FORMAT "%5.3" ECU_ADDRESS 0xFEBE94F2 /end MEASUREMENT
/begin MEASUREMENT sApplI_FootBrakeState_xdu8 "Status Fuï¿½bremse 0=Fahrer bremst nicht/1=Fahrer bremst" UBYTE ZU0 1 100 0 1 FORMAT "%5.3" ECU_ADDRESS 0xFEBE94F3 /end MEASUREMENT
/begin MEASUREMENT sApplI_HWAEnabled_xdu8 "HWA Enable" UBYTE ZU0 1 100 0 255 FORMAT "%5.1" ECU_ADDRESS 0xFEBE94F4 /end MEASUREMENT
/begin MEASUREMENT sApplI_LdwVibrationRequest_xdu8 "Anforderung haptische Fahrerrückmeldung von LDW/LKA(0 = Haptic warning not requested, 1 = Haptic warning requested, 2..255 = SNA)" UBYTE ZU0 1 100 0 1 FORMAT "%5.3" ECU_ADDRESS 0xFEBE94F7 /end MEASUREMENT
/begin MEASUREMENT sApplI_LkaActivationRequest_xdu8 "LKA Activation request from CAN" UBYTE ZU0 1 100 0 3 FORMAT "%5.3" ECU_ADDRESS 0xFEBE94F8 /end MEASUREMENT
/begin MEASUREMENT sApplI_LkaActive_xdu8 "LKA Status 1= Aktiv" UBYTE STATUS 1 100 0 1 FORMAT "%5.3" ECU_ADDRESS 0xFEBE94F9 /end MEASUREMENT
/begin MEASUREMENT sApplI_LkaEnabled_xdu8 "LKA enabled flag" UBYTE STATUS 1 100 0 1 FORMAT "%5.3" ECU_ADDRESS 0xFEBE94FA /end MEASUREMENT
/begin MEASUREMENT sApplI_LkaMode_xdu8 "" UBYTE ZU0 1 100 0 1 FORMAT "%5.3" ECU_ADDRESS 0xFEBE94FB /end MEASUREMENT
/begin MEASUREMENT sApplI_RackPosQualifier_xdu8 "Qualifier for RackPosition / RampedRotorAngle; includes results of Plausis" UBYTE ZU0 1 100 0 11 FORMAT "%5.2" ECU_ADDRESS 0xFEBE94FE /end MEASUREMENT
/begin MEASUREMENT sApplI_remotecontrolstate_xdu8 "RSH Status" UBYTE STATUS 1 100 0 1 FORMAT "%5.3" ECU_ADDRESS 0xFEBE94FF /end MEASUREMENT
/begin MEASUREMENT sApplI_RemoteSteerVehDirection_xdu16 "Remote steering and holding request" UBYTE ZU0 1 100 0 15 FORMAT "%5.2" ECU_ADDRESS 0xFEBE9500 /end MEASUREMENT
/begin MEASUREMENT sApplI_SteeringAngleLinState_xdu8 "Status LW aus RW nicht korrigiert" UBYTE ZU0 1 100 0 2 FORMAT "%5.3" ECU_ADDRESS 0xFEBE9501 /end MEASUREMENT
/begin MEASUREMENT sApplI_SteeringAngleState_xdu8 "steering angle status (0=Error, 1=RawInit, 2=ExactlyInit, 3=NotInit)" UBYTE ZU0 1 100 0 3 FORMAT "%5.3" ECU_ADDRESS 0xFEBE9502 /end MEASUREMENT
/begin MEASUREMENT sApplI_TjaEnabled_xdu8 "Traffic jam assist enable" UBYTE ZU0 1 100 0 255 FORMAT "%5.1" ECU_ADDRESS 0xFEBE9504 /end MEASUREMENT
/begin MEASUREMENT sApplI_TjaMode_xdu8 "Traffic jam assist Mode Request from CAN" UBYTE ZU0 1 100 0 1 FORMAT "%5.3" ECU_ADDRESS 0xFEBE9505 /end MEASUREMENT
/begin MEASUREMENT sApplI_VehicleRunning_xdu8 "Status Fahrzeug fï¿½hrt (0 Fahrzeug steht, 1 Fahrzeug fï¿½hrt)" UBYTE ZU0 1 100 0 1 FORMAT "%5.3" ECU_ADDRESS 0xFEBE9506 /end MEASUREMENT
/begin MEASUREMENT sApplI_VehicleSpeedState_xdu8 "Gï¿½ltigkeitsflag fï¿½r die Fahrzeuggeschw. vApplI_AbsVehicleSpeedFilt_xdu16 (1 = gï¿½ltig; 0 = ungï¿½ltig oder Ersatzgeschw.)" UBYTE ZU0 1 100 0 1 FORMAT "%5.3" ECU_ADDRESS 0xFEBE9507 /end MEASUREMENT
/begin MEASUREMENT sApplI_VSEActive_xdu8 " " UBYTE ZU0 1 100 0 1 FORMAT "%5.3" ECU_ADDRESS 0xFEBE9508 /end MEASUREMENT
/begin MEASUREMENT sApplI_VSEStatus_xdu8 " " UBYTE ZU0 1 100 0 7 FORMAT "%5.3" ECU_ADDRESS 0xFEBE9509 /end MEASUREMENT
/begin MEASUREMENT sArmI_LocalShutdownSync_xdu8 "Flag um die Shutdownszustand im dual uC System zu synchronisieren." UBYTE ZU0 1 100 0 2 FORMAT "%5.3" ECU_ADDRESS 0xFEBE950A /end MEASUREMENT
/begin MEASUREMENT sArmI_ShutdownMode_xdu8 "Aktueller Shutdownszustand des AR Mode Manager" UBYTE ZU0 1 100 0 6 FORMAT "%5.3" ECU_ADDRESS 0xFEBE950B /end MEASUREMENT
/begin MEASUREMENT sAsmI_ErrLvl_Red_xdu8 "Fehlerstufe der ApplicationStateMachinePlausi" UBYTE ZU0 1 100 0 2 FORMAT "%5.3" ECU_ADDRESS 0xFEBE950C /end MEASUREMENT
/begin MEASUREMENT sAsmI_ErrLvl_xdu8 "Fehlerstufe der ApplicationStateMachinePlausi" UBYTE ZU0 1 100 0 2 FORMAT "%5.3" ECU_ADDRESS 0xFEBE950D /end MEASUREMENT
/begin MEASUREMENT sAsmI_LocalUcSync_xdu8 "Flag um die Statusmaschinen im dual uC System zu synchronisieren." UBYTE ZU0 1 100 0 2 FORMAT "%5.3" ECU_ADDRESS 0xFEBE950E /end MEASUREMENT
/begin MEASUREMENT sAsmI_MaxHealings_ErrLvl_Red_xdu8 "ErrorLevel falls die Maximalanzahl an Heilungen erreicht wurde." UBYTE ZU0 1 100 0 2 FORMAT "%5.3" ECU_ADDRESS 0xFEBE950F /end MEASUREMENT
/begin MEASUREMENT sAsmI_MaxHealings_ErrLvl_xdu8 "ErrorLevel falls die Maximalanzahl an Heilungen erreicht wurde." UBYTE ZU0 1 100 0 2 FORMAT "%5.3" ECU_ADDRESS 0xFEBE9510 /end MEASUREMENT
/begin MEASUREMENT sAsmI_RequestBswShutdown_xdb "Flag für Bsw Shutdown Anfrage" UBYTE BIT 1 100 0 1 BIT_MASK 0x1 FORMAT "%5.3" ECU_ADDRESS 0xFEBE9511 /end MEASUREMENT
/begin MEASUREMENT sAsmPlausi_EcuState_xdu8 "Application State Machine Plausi - ECU Zustand" UBYTE ZU0 1 100 0 7 FORMAT "%5.3" ECU_ADDRESS 0xFEBE9512 /end MEASUREMENT
/begin MEASUREMENT sAsm_StoredEcuState_xdu8 "EcuState des letzten Aufrufs um zu prüfen, ob eine Heilung aufgetreten ist." UBYTE ZU0 1 100 0 255 FORMAT "%5.1" ECU_ADDRESS 0xFEBE9513 /end MEASUREMENT
/begin MEASUREMENT sAssCtrlI_AssistMode_xdu8 "Aktueller Unterstuetzungszustand des AssistanceController" UBYTE ZU0 1 100 0 4 FORMAT "%5.3" ECU_ADDRESS 0xFEBE9514 /end MEASUREMENT
/begin MEASUREMENT sAssCtrl_InternalAssistState_xdu8 "Aktueller Status der internen AssistanceController Statusmaschine" UBYTE ZU0 1 100 0 7 FORMAT "%5.3" ECU_ADDRESS 0xFEBE9515 /end MEASUREMENT
/begin MEASUREMENT sAutParkCtrlI_Activate_xdu8 "Indicates whether APC shall actively calculate and request a torque (1 means active)." UBYTE ZU0 1 100 0 1 FORMAT "%5.3" ECU_ADDRESS 0xFEBE9516 /end MEASUREMENT
/begin MEASUREMENT sAutParkCtrlI_MakeSafeAndMonState_xdu8 "Indicates whether the MakeSafe and MonitorSafe checks report OK (0) or if they have detected a problem (1) or if HandsOn was detected (2) or if invalid arbitration was detected (3)." UBYTE ZU0 1 100 0 3 FORMAT "%5.3" ECU_ADDRESS 0xFEBE9517 /end MEASUREMENT
/begin MEASUREMENT sAutParkCtrl_CancelState_xdu16 "flags are set when EpsApcState changes to REQUEST_REJECTED: Bit0=EPS-Error, Bit1=SignalsInvalid, Bit2=ApcSignalsInvalid, Bit3=VehSpeedRangeInvalid, Bit4=RackPosRequestInvalid, Bit5=MakeSafeAndMonNotOk, Bit6=ArbitrationFailed, Bit7=HandsOn, Bit8=FctCoRetur" UWORD ZU0 1 100 0 511 FORMAT "%8.4" ECU_ADDRESS 0xFEBE91D0 /end MEASUREMENT
/begin MEASUREMENT sAutParkCtrl_FctCoCtrlState_xdu8 "return value of the FunctionCoordinator" UBYTE ZU0 1 100 0 99 FORMAT "%5.2" ECU_ADDRESS 0xFEBE9518 /end MEASUREMENT
/begin MEASUREMENT sAutParkCtrl_FeatureState_xdu8 "internal feature state for FunctionCoordinator" UBYTE ZU0 1 100 0 5 FORMAT "%5.3" ECU_ADDRESS 0xFEBE9519 /end MEASUREMENT
/begin MEASUREMENT sAutParkCtrl_MakeSafeState_xdu8 "Indicates whether the MakeSafe checks report OK (0), if they have detected a problem (1) or if HandsOn was detected (2)." UBYTE ZU0 1 100 0 2 FORMAT "%5.3" ECU_ADDRESS 0xFEBE951A /end MEASUREMENT
/begin MEASUREMENT sBsdI_BlockedSteeringDetection_xdu8 "Status Blockiererkennung 0: nicht blockiert, 1: Verdacht einer Blockierung 2: blockiert" UBYTE ZU0 1 100 0 2 FORMAT "%5.3" ECU_ADDRESS 0xFEBE951B /end MEASUREMENT
/begin MEASUREMENT sBsd_CtrlState_xdu8 "Return value of the FunctionCoordinator" UBYTE ZU0 1 100 0 99 FORMAT "%5.2" ECU_ADDRESS 0xFEBE951C /end MEASUREMENT
/begin MEASUREMENT sBsd_CurrentInternalState_xdu8 "BSD: Internal state of state machine : 0=CHECK, 1=DetectionInactive, 2=Active, 3=BlockSuspicon,4=TorqueActive, 5=BlockDetected" UBYTE ZU0 1 100 0 6 FORMAT "%5.3" ECU_ADDRESS 0xFEBE951D /end MEASUREMENT
/begin MEASUREMENT sBsd_FailureCause_xdu8 "Cause of failure (0= no failure, 1=requested MotorTorque too high,2=Arbitration Error,4=Rotpos and Torque not in sync)" UBYTE ZU0 1 100 0 4 FORMAT "%5.3" ECU_ADDRESS 0xFEBE951E /end MEASUREMENT
/begin MEASUREMENT sBsd_FeatureState_xdu8 "Funktionskoordinator status fuer BlockedSteeringDetection" UBYTE ZU0 1 100 0 99 FORMAT "%5.2" ECU_ADDRESS 0xFEBE951F /end MEASUREMENT
/begin MEASUREMENT sEpsInI_ADActiveReq_xdu8 "Hands Free Active Request:0x0=NoRequest;0x2=NOP Active Request" UBYTE ZU0 1 100 0 2 FORMAT "%5.3" ECU_ADDRESS 0xFEBE9557 /end MEASUREMENT
/begin MEASUREMENT sEpsInI_ADDeactiveReq_xdu8 "Hands Free Deactive Request" UBYTE ZU0 1 100 0 1 FORMAT "%5.3" ECU_ADDRESS 0xFEBE9558 /end MEASUREMENT
/begin MEASUREMENT sEpsInI_ADModeReq_xdu8 "Hands Free Mode Request:0x0=No AD;0x2=AD NOP" UBYTE ZU0 1 100 0 2 FORMAT "%5.3" ECU_ADDRESS 0xFEBE9559 /end MEASUREMENT
/begin MEASUREMENT sEpsIn_GearSt_xdu8 "Level identification state" UBYTE STATUS 1 100 0 4 FORMAT "%5.3" ECU_ADDRESS 0xFEBE9560 /end MEASUREMENT
/begin MEASUREMENT sHLIpcI_RemoteBoschASDiagnostics_xdu8 "RemoteBoschASDiagnostics" UBYTE ZU0 1 100 0 1 FORMAT "%5.3" ECU_ADDRESS 0xFEBE956D /end MEASUREMENT
/begin MEASUREMENT tAsm_StartTimeHealingsOscillation_xdu16 "Zeitstempel um einen oszillierenden Fehler zu erkennen." UWORD TIMMS 1 100 0 65535 FORMAT "%8.2" ECU_ADDRESS 0xFEBE91EC /end MEASUREMENT
/begin MEASUREMENT tBatVolt_StartTimeStamp_xdu16 "Holen Sie sich die aktuelle Uhrzeit des Systems." UWORD TIMS 1 100 0 65535 FORMAT "%6.0" ECU_ADDRESS 0xFEBE91EE /end MEASUREMENT
/begin MEASUREMENT tBatVolt_TimeElapsed_xdu32 "Zeitstempel zum Verstreichen des Batteriespannungswarnstatus." ULONG TIMS 1 100 0 4294967295 FORMAT "%6.0" ECU_ADDRESS 0xFEBE8D08 /end MEASUREMENT
/begin MEASUREMENT vApplI_AbsRackSpeed_xdu16 "Abs. Zahnstangengeschwindigkeit [mm/s]" UWORD RACKSPEED128 1 100 0 250 FORMAT "%8.4" ECU_ADDRESS 0xFEBE922C /end MEASUREMENT
/begin MEASUREMENT vApplI_AbsSafeNssVehicleSpeed_xdu16 "Abs. Fahrzeuggeschwindigkeit: Abgesichert im stillstandsnahen Bereich" UWORD VFZHIGH 1 100 0 500 FORMAT "%8.4" ECU_ADDRESS 0xFEBE922E /end MEASUREMENT
/begin MEASUREMENT vApplI_AbsSafeVehicleSpeed_xdu16 "Abs. Fahrzeuggeschwindigkeit: Abgesichert ï¿½ber den kompletten Geschwindigkeitsbereich" UWORD VFZHIGH 1 100 0 500 FORMAT "%8.4" ECU_ADDRESS 0xFEBE4AF8 /end MEASUREMENT
/begin MEASUREMENT vApplI_AbsSteeringAngleSpeed_xdu16 "Abs. Lenkwinkelgeschwindigkeit" UWORD SAS_8 1 100 0 1500 FORMAT "%8.3" ECU_ADDRESS 0xFEBE9230 /end MEASUREMENT
/begin MEASUREMENT vApplI_AbsVehicleSpeedFilt_xdu16 "Abs. Fahrzeuggeschwindigkeit: aufbereitet" UWORD VFZHIGH 1 100 0 500 FORMAT "%8.4" ECU_ADDRESS 0xFEBE9232 /end MEASUREMENT
/begin MEASUREMENT vApplI_RackSpeed_xds16 "Zahnstangengeschwindigkeit [mm/s]" SWORD RACKSPEED128 1 100 -250 250 FORMAT "%8.4" ECU_ADDRESS 0xFEBE9234 /end MEASUREMENT
/begin MEASUREMENT vApplI_SteeringAngleSpeed_xds16 "Lenkwinkelgeschwindigkeit" SWORD SAS_8 1 100 -1500 1500 FORMAT "%8.3" ECU_ADDRESS 0xFEBE9236 /end MEASUREMENT
/begin MEASUREMENT vApplI_WindUpAdaption_xds32 "ï¿½nderungsrate der Kraft aus Zahnstangenkraft-Adaptionen" SLONG FRACK 1 100 -20000000 20000000 FORMAT "%13.4" ECU_ADDRESS 0xFEBE8D5C /end MEASUREMENT
/begin MEASUREMENT vApplI_YawRateRaw_xds16 "Gierrate" SWORD VGIER 1 100 -150 150 FORMAT "%8.4" ECU_ADDRESS 0xFEBE9238 /end MEASUREMENT
/begin MEASUREMENT vApplI_YawVelocity_xds16 "Gierrate" SWORD VGIER 1 100 -150 150 FORMAT "%8.4" ECU_ADDRESS 0xFEBE923A /end MEASUREMENT
/begin MEASUREMENT vAutParkCtrl_DesiredRackSpeed_xds16 "desired rack speed incl. feed-forward controlled part" SWORD RACKSPEED128 1 100 -250 250 FORMAT "%8.4" ECU_ADDRESS 0xFEBE923C /end MEASUREMENT
/begin MEASUREMENT vAutParkCtrl_LimitedDesiredRackSpeed_xds16 "gradient limited desired rack speed" SWORD RACKSPEED128 1 100 -250 250 FORMAT "%8.4" ECU_ADDRESS 0xFEBE923E /end MEASUREMENT
/begin MEASUREMENT vazReqVehSpeed_xdu8 "Anzahl der Werte im Residuum" UBYTE ZU0 1 100 0 255 FORMAT "%5.1" ECU_ADDRESS 0xFEBE960F /end MEASUREMENT
/begin MEASUREMENT vYROC_compvalue_xdf32 "Gierrate" FLOAT32_IEEE ZU0 1 100 -150 150 FORMAT "%10.6" ECU_ADDRESS 0xFEBE8DB0 /end MEASUREMENT
/begin MEASUREMENT wApplI_AbsDynSteerAngle_xdu16 "Absoluter dyn Lenkwinkel (Summe aus Schwimmwinkel und Lenkradwinkel)" UWORD SA_10 1 100 0 1000 FORMAT "%8.3" ECU_ADDRESS 0xFEBE9288 /end MEASUREMENT
/begin MEASUREMENT wApplI_AbsPinionAngle_xdu16 "Absoluter Ritzel Winkel" UWORD SA_10 1 100 0 1000 FORMAT "%8.3" ECU_ADDRESS 0xFEBE928A /end MEASUREMENT
/begin MEASUREMENT wApplI_AbsSteeringAngleSafe_xdu16 "Abs. sicherer korrigierter Lenkwinkel" UWORD SA_10 1 100 0 1000 FORMAT "%8.3" ECU_ADDRESS 0xFEBE928C /end MEASUREMENT
/begin MEASUREMENT wApplI_AbsSteeringAngle_xdu16 "Abs. korrigierter Lenkwinkel" UWORD SA_10 1 100 0 1000 FORMAT "%8.3" ECU_ADDRESS 0xFEBE928E /end MEASUREMENT
/begin MEASUREMENT wApplI_ApcDesiredAngle_xds16 "APC: desired steering angle" SWORD SA_10 1 100 -1000 1000 FORMAT "%8.3" ECU_ADDRESS 0xFEBE9290 /end MEASUREMENT
/begin MEASUREMENT wApplI_DynSteerAngle_xds16 "Dyn Lenkwinkel (Summe aus Schwimmwinkel und Lenkradwinkel)" SWORD SA_10 1 100 -1000 1000 FORMAT "%8.3" ECU_ADDRESS 0xFEBE9292 /end MEASUREMENT
/begin MEASUREMENT wApplI_PinionAngle_xds16 "Ritzel Winkel" SWORD SA_10 1 100 -1000 1000 FORMAT "%8.3" ECU_ADDRESS 0xFEBE9298 /end MEASUREMENT
/begin MEASUREMENT wApplI_SteeringAngleLtCorr_xds16 "langzeitkorrigierter Lenkwinkel [ï¿½]" SWORD SA_10 1 100 -1000 1000 FORMAT "%8.3" ECU_ADDRESS 0xFEBE929A /end MEASUREMENT
/begin MEASUREMENT wApplI_SteeringAngle_xds16 "korrigierter Lenkwinkel" SWORD SA_10 1 100 -1000 1000 FORMAT "%8.3" ECU_ADDRESS 0xFEBE929C /end MEASUREMENT
/begin MEASUREMENT wBsd_DeltaRotPosMakeSafe_xds32 "Delta Rotor position for BsdI_MakeSafe server" SLONG ROTPOS 1 100 -32000.0097656 32000.0097656 FORMAT "%13.7" ECU_ADDRESS 0xFEBE8DB8 /end MEASUREMENT
/begin MEASUREMENT wBsd_DeltaRotPosMonitor_xds32 "Delta Rotor position for BsdI_MonitorSafe server" SLONG ROTPOS 1 100 -32000.0097656 32000.0097656 FORMAT "%13.7" ECU_ADDRESS 0xFEBE8DBC /end MEASUREMENT
/begin MEASUREMENT wBsd_DeltaRotPos_xds32 "Calculated Delta Rotor Position threshold" SLONG ROTPOS 1 100 -32000.0097656 32000.0097656 FORMAT "%13.7" ECU_ADDRESS 0xFEBE8DC0 /end MEASUREMENT
/begin MEASUREMENT wBsd_MaxRotPosMakeSafe_xds32 "Max Rotor Position for BsdI_MakeSafe server" SLONG ROTPOS 1 100 -32000.0097656 32000.0097656 FORMAT "%13.7" ECU_ADDRESS 0xFEBE8DC4 /end MEASUREMENT
/begin MEASUREMENT wBsd_MaxRotPosMonitor_xds32 "Max Rotor Position for BsdI_MonitorSafe server" SLONG ROTPOS 1 100 -32000.0097656 32000.0097656 FORMAT "%13.7" ECU_ADDRESS 0xFEBE8DC8 /end MEASUREMENT
/begin MEASUREMENT wBsd_MinRotPosMakeSafe_xds32 "Min Rotor Position for BsdI_MakeSafe server" SLONG ROTPOS 1 100 -32000.0097656 32000.0097656 FORMAT "%13.7" ECU_ADDRESS 0xFEBE8DCC /end MEASUREMENT
/begin MEASUREMENT wBsd_MinRotPosMonitor_xds32 "Min Rotor Position for BsdI_MonitorSafe server" SLONG ROTPOS 1 100 -32000.0097656 32000.0097656 FORMAT "%13.7" ECU_ADDRESS 0xFEBE8DD0 /end MEASUREMENT
/begin MEASUREMENT wBsd_RotPosMax_xds32 "Calculated Rotor Position Maximum threshold" SLONG ROTPOS 1 100 -32000.0097656 32000.0097656 FORMAT "%13.7" ECU_ADDRESS 0xFEBE8DD4 /end MEASUREMENT
/begin MEASUREMENT wBsd_RotPosMin_xds32 "Calculated Rotor Position Minimum threshold" SLONG ROTPOS 1 100 -32000.0097656 32000.0097656 FORMAT "%13.7" ECU_ADDRESS 0xFEBE8DD8 /end MEASUREMENT
/begin MEASUREMENT xApplI_ActCharFact_xdu16 "Faktor fï¿½r die Gewichtung des aktuellen Fahrprogramms" UWORD RIGHTSH13NP 1 100 0 1 FORMAT "%8.6" ECU_ADDRESS 0xFEBE9300 /end MEASUREMENT
/begin MEASUREMENT xApplI_DegreeOfOversteer_xdu16 "Grad des ï¿½bersteuerns" UWORD RIGHTSH10NP 1 100 0 1 FORMAT "%8.6" ECU_ADDRESS 0xFEBE9302 /end MEASUREMENT
/begin MEASUREMENT xApplI_DegreeOfUndersteer_xdu16 "Grad des Untersteuerns" UWORD RIGHTSH10NP 1 100 0 1 FORMAT "%8.6" ECU_ADDRESS 0xFEBE9304 /end MEASUREMENT
/begin MEASUREMENT xApplI_HLCharCurveBuckleFact_xdu16 "Gesamtfaktor der Kennlinienstauchung" UWORD RIGHTSH15NP 1 100 0 1 FORMAT "%8.6" ECU_ADDRESS 0xFEBE4AFE /end MEASUREMENT
/begin MEASUREMENT xApplI_HLReductionFactor_xdu16 "Der niedrigste von allen im HighLevel angeforderten Reduktionsfaktoren" UWORD RIGHTSH15NP 1 100 0 1 FORMAT "%8.6" ECU_ADDRESS 0xFEBE4B00 /end MEASUREMENT
/begin MEASUREMENT xApplI_NewCharFact_xdu16 "Faktor fï¿½r die Gewichtung des neuen Fahrprogramms" UWORD RIGHTSH13NP 1 100 0 1 FORMAT "%8.6" ECU_ADDRESS 0xFEBE9306 /end MEASUREMENT
/begin MEASUREMENT xApplI_RatioD2C_xdu16 "Verhï¿½ltnis der gemergten Zahnstangekraft (1=100% Dynamic, 0=100% Comfort)" UWORD RIGHTSH10NP 1 100 0 1 FORMAT "%8.6" ECU_ADDRESS 0xFEBE9308 /end MEASUREMENT
/begin MEASUREMENT xApplI_TotalMotTorLim_xdu16 "Gesamtreduktion des Torque Reduction Coordinators" UWORD RIGHTSH15NP 1 100 0 1 FORMAT "%8.6" ECU_ADDRESS 0xFEBE4B02 /end MEASUREMENT
/begin MEASUREMENT xApplI_VehDirection_xds8 "Vorzeichen Fahrzeuggeschwindigkeit vorwï¿½rts (1)/ rï¿½ckwï¿½rts (-1)" SBYTE ZU0 1 100 -1 1 FORMAT "%5.3" ECU_ADDRESS 0xFEBE9610 /end MEASUREMENT
/begin MEASUREMENT xatActTorGradFact_xdu16 "aktuelle Gradientenbegrenzung Unterspannungsueberwachung" UWORD RSH15 1 100 0 100 FORMAT "%8.4" ECU_ADDRESS 0xFEBE930C /end MEASUREMENT
/begin MEASUREMENT xatAssistanceGradMax_xdu16 "Maximaler Gradient der Unterstuetzungskennlinie" UWORD TORGAINHIGH 1 100 0 5 FORMAT "%8.6" ECU_ADDRESS 0xFEBE930E /end MEASUREMENT
/begin MEASUREMENT xatAssistanceGrad_xau16 "Steigungen der aktuellen Unterstuetzungskennlinie" UWORD TORGAINHIGH 1 100 0 63.99902 FORMAT "%8.5" ECU_ADDRESS 0xFEBE9B58 MATRIX_DIM 9 1 1 /end MEASUREMENT
/begin MEASUREMENT xatAssistanceGrad_xdu16 "aktuelle Steigung der Unterstuetzungskennlinie" UWORD TORGAINHIGH 1 100 0 10 FORMAT "%8.5" ECU_ADDRESS 0xFEBE9310 /end MEASUREMENT
/begin MEASUREMENT xatAssistFilterFrequ_xdu16 "aktuelle Filterzeitkonstante fuer PT1 Limitierung" UWORD RIGHTSH11NP 1 100 0.0004882813 0.1499023 FORMAT "%9.7" ECU_ADDRESS 0xFEBE9312 /end MEASUREMENT
/begin MEASUREMENT xatMaxGrad_xdu16 "aktuell berechneter maximaler Gradient fuer DAC" UWORD TORGAINHIGH 1 100 0 5 FORMAT "%8.6" ECU_ADDRESS 0xFEBE9314 /end MEASUREMENT
/begin MEASUREMENT xAutParkCtrlI_DesActRetFuncFact4Check_xdu16 "Desired ActiveReturn function factor of AutomaticParkingControl to be read by Check component only" UWORD RIGHTSH10NP 1 100 0 1 FORMAT "%8.6" ECU_ADDRESS 0xFEBE9316 /end MEASUREMENT
/begin MEASUREMENT xAutParkCtrlI_DesActRetFuncFact_xdu16 "Desired ActiveReturn function factor of AutomaticParkingControl" UWORD RIGHTSH10NP 1 100 0 1 FORMAT "%8.6" ECU_ADDRESS 0xFEBE9318 /end MEASUREMENT
/begin MEASUREMENT xAutParkCtrl_DesActRetFuncFactChecked_xdu16 "ActiveReturn function factor which has been subjected to the MakeSafe measures" UWORD RIGHTSH10NP 1 100 0 1 FORMAT "%8.6" ECU_ADDRESS 0xFEBE931A /end MEASUREMENT
/begin MEASUREMENT xEpsInI_VehDirection_xds8 "vehicle direction from EPS Input" SBYTE ZU0 1 100 -1 1 FORMAT "%5.3" ECU_ADDRESS 0xFEBE9611 /end MEASUREMENT
/begin MEASUREMENT yApplI_ActCharacteristic_xdu8 "Aktuelles Fahrprogramm" UBYTE ZU0 1 100 0 2 FORMAT "%5.3" ECU_ADDRESS 0xFEBE9619 /end MEASUREMENT
/begin MEASUREMENT yApplI_CharismaSelected_xdu8 "Charisma selected: 0-Normal Mode, 1-Comfort Mode, 2-Sport Mode, 3-Reserved1, 4-Reserved2, 255-Unavailable" UBYTE ZU0 1 100 0 4 FORMAT "%5.3" ECU_ADDRESS 0xFEBE961A /end MEASUREMENT
/begin MEASUREMENT yApplI_DMSActCharacteristic_xdu8 "Actual characteristic Selected through DMS: 0-Normal Mode, 1-Comfort Mode, 2-Sport Mode, 3-Reserved1, 4-Reserved2, 5-Special Mode" UBYTE ZU0 1 100 0 5 FORMAT "%5.3" ECU_ADDRESS 0xFEBE961B /end MEASUREMENT
/begin MEASUREMENT yApplI_EstimatedGear_xdu8 " " UBYTE ZU0 1 100 0 1 FORMAT "%5.3" ECU_ADDRESS 0xFEBE961C /end MEASUREMENT
/begin MEASUREMENT yApplI_HLMaxTorqueGradient_xdu16 "Der niedrigste von allen Momentengradienten" UWORD TORGRAD 1 100 0 12 FORMAT "%8.5" ECU_ADDRESS 0xFEBE4B0A /end MEASUREMENT
/begin MEASUREMENT yApplI_NewCharacteristic_xdu8 "Neues Fahrprogramm" UBYTE ZU0 1 100 0 2 FORMAT "%5.3" ECU_ADDRESS 0xFEBE961E /end MEASUREMENT
/begin MEASUREMENT yApplI_ReverseGearEngaged_xdu8 "Ist R?ckw?rtsgang eingelegt" UBYTE ZU0 1 100 0 3 FORMAT "%5.3" ECU_ADDRESS 0xFEBE9620 /end MEASUREMENT
/begin MEASUREMENT yeeResetInfo_xdu32 "reset information" ULONG ZU0 1 100 0 4294967295 FORMAT "%13.2" ECU_ADDRESS 0xFEBE8E90 /end MEASUREMENT
/begin MEASUREMENT zApplI_SlippingClutchActivations_xdu8 "Zï¿½hler fï¿½r Rutschkupplungsauslï¿½ser" UBYTE ZU0 1 100 0 255 FORMAT "%5.1" ECU_ADDRESS 0xFEBE963A /end MEASUREMENT
/begin MEASUREMENT zAsm_HealingsPerIgnition_xdu8 "Zähler der Heilungen innerhalb dieses Klemmenzyklus." UBYTE ZU0 1 100 0 255 FORMAT "%5.1" ECU_ADDRESS 0xFEBE963B /end MEASUREMENT
/begin MEASUREMENT zAsm_HealingsPerOscillation_xdu8 "Zähler der Heilungen innerhalb tAsmI_OscillationMeasureTime_XDU16." UBYTE ZU0 1 100 0 255 FORMAT "%5.1" ECU_ADDRESS 0xFEBE963C /end MEASUREMENT
/begin MEASUREMENT zAutParkCtrl_HandsOnCounter_xdu16 "Diverse stored counter value of HandsOnDetection" UWORD TIMMS 1 100 0 1000 FORMAT "%8.3" ECU_ADDRESS 0xFEBE93DC /end MEASUREMENT
/begin MEASUREMENT zBsd_BlockDetectedCnt_xdu16 "Bsd Counter when Blocked steering is detected" UWORD ZU0 1 100 0 65535 FORMAT "%8.2" ECU_ADDRESS 0xFEBE93DE /end MEASUREMENT
/begin MEASUREMENT zBsd_BlockSuspicionCnt_xdu16 "Bsd Counter when BSD enters SUSPICION state of statemachine" UWORD ZU0 1 100 0 65535 FORMAT "%8.2" ECU_ADDRESS 0xFEBE93E0 /end MEASUREMENT
/begin MEASUREMENT zBsd_CycleCount_xdu8 "Internal Counter of Statemachine to generate the torque Cycles" UBYTE ZU0 1 100 0 3 FORMAT "%5.3" ECU_ADDRESS 0xFEBE963F /end MEASUREMENT
/begin COMPU_METHOD AFZ "" RAT_FUNC "%6.5" "m/s^2" COEFFS 0 1024 0 0 0 1 /end COMPU_METHOD
/begin COMPU_METHOD BIT "" RAT_FUNC "%6.2" "Bitanzeige" COEFFS 0 1 0 0 0 1 /end COMPU_METHOD
/begin COMPU_METHOD ECU_STATE "" TAB_VERB "%6.3" "Status" COMPU_TAB_REF ECU_STATE /end COMPU_METHOD
/begin COMPU_METHOD FRACK "" RAT_FUNC "%6.2" "N" COEFFS 0 1 0 0 0 1 /end COMPU_METHOD
/begin COMPU_METHOD FREQHZ "" RAT_FUNC "%6.3" "Hz" COEFFS 0 8 0 0 0 1 /end COMPU_METHOD
/begin COMPU_METHOD MDRVSHAFT "" RAT_FUNC "%6.2" "Nm" COEFFS 0 1 0 0 0 1 /end COMPU_METHOD
/begin COMPU_METHOD MMOT "" RAT_FUNC "%6.5" "Nm" COEFFS 0 1024 0 0 0 1 /end COMPU_METHOD
/begin COMPU_METHOD RACKPOS128 "" RAT_FUNC "%6.4" "mm" COEFFS 0 128 0 0 0 1 /end COMPU_METHOD
/begin COMPU_METHOD RACKSPEED128 "" RAT_FUNC "%6.4" "mm/s" COEFFS 0 128 0 0 0 1 /end COMPU_METHOD
/begin COMPU_METHOD RIGHTSH10NP "" RAT_FUNC "%6.5" "" COEFFS 0 1024 0 0 0 1 /end COMPU_METHOD
/begin COMPU_METHOD RIGHTSH11NP "" RAT_FUNC "%6.5" "" COEFFS 0 2048 0 0 0 1 /end COMPU_METHOD
/begin COMPU_METHOD RIGHTSH13NP "" RAT_FUNC "%6.5" "1" COEFFS 0 8192 0 0 0 1 /end COMPU_METHOD
/begin COMPU_METHOD RIGHTSH15NP "" RAT_FUNC "%7.6" "" COEFFS 0 32768 0 0 0 1 /end COMPU_METHOD
/begin COMPU_METHOD RIGHTSH5NP "" RAT_FUNC "%6.4" "" COEFFS 0 32 0 0 0 1 /end COMPU_METHOD
/begin COMPU_METHOD ROTACC "" RAT_FUNC "%6.4" "1/min/ms" COEFFS 0 64 0 0 0 1 /end COMPU_METHOD
/begin COMPU_METHOD ROTPOS "" RAT_FUNC "%6.3" "Â°" COEFFS 0 11.3777777778 0 0 0 1 /end COMPU_METHOD
/begin COMPU_METHOD RSH15 "" RAT_FUNC "%6.4" "%" COEFFS 0 327.68 0 0 0 1 /end COMPU_METHOD
/begin COMPU_METHOD SAS_8 "" RAT_FUNC "%6.3" "Â°/s" COEFFS 0 8 0 0 0 1 /end COMPU_METHOD
/begin COMPU_METHOD SA_10 "" RAT_FUNC "%6.3" "Â°" COEFFS 0 10 0 0 0 1 /end COMPU_METHOD
/begin COMPU_METHOD SM_I "" RAT_FUNC "%6.4" "A" COEFFS 0 16 0 0 0 1 /end COMPU_METHOD
/begin COMPU_METHOD STATUS "" RAT_FUNC "%6.2" "Status" COEFFS 0 1 0 0 0 1 /end COMPU_METHOD
/begin COMPU_METHOD TBTHIGH "" RAT_FUNC "%6.5" "Nm" COEFFS 0 1024 0 0 0 1 /end COMPU_METHOD
/begin COMPU_METHOD TIMMS "" RAT_FUNC "%6.2" "ms" COEFFS 0 1 0 0 0 1 /end COMPU_METHOD
/begin COMPU_METHOD TIMS "" RAT_FUNC "%6.2" "s" COEFFS 0 1 0 0 0 1 /end COMPU_METHOD
/begin COMPU_METHOD TMPOUTS "" RAT_FUNC "%6.2" "Â°C" COEFFS 0 1 70 0 0 1 /end COMPU_METHOD
/begin COMPU_METHOD TORGAINHIGH "" RAT_FUNC "%6.5" "Nm/Nm" COEFFS 0 1024 0 0 0 1 /end COMPU_METHOD
/begin COMPU_METHOD TORGRAD "" RAT_FUNC "%6.5" "Nm/ms" COEFFS 0 1024 0 0 0 1 /end COMPU_METHOD
/begin COMPU_METHOD U64V "" RAT_FUNC "%6.4" "V" COEFFS 0 64 0 0 0 1 /end COMPU_METHOD
/begin COMPU_METHOD VFZHIGH "" RAT_FUNC "%6.4" "km/h" COEFFS 0 64 0 0 0 1 /end COMPU_METHOD
/begin COMPU_METHOD VGIER "" RAT_FUNC "%6.4" "Â°/s" COEFFS 0 200 0 0 0 1 /end COMPU_METHOD
/begin COMPU_METHOD VROT "" RAT_FUNC "%3.1" "1/min" COEFFS 0 1 0 0 0 1 /end COMPU_METHOD
/begin COMPU_METHOD ZU0 "" RAT_FUNC "%6.2" "" COEFFS 0 1 0 0 0 1 /end COMPU_METHOD
/begin COMPU_VTAB ECU_STATE "" TAB_VERB 9 0 "undefined" 1 "EcuInit" 2 "ApplicationInit" 3 "Normal" 4 "Production" 5 "FailOp" 6 "PostRun" 7 "Error" 8 "ApplicationOff" /end COMPU_VTAB
/begin FUNCTION ApplicationInterfaceI "Applikations Schnittsstelle"
 /begin OUT_MEASUREMENT aApplI_AbsLatAccel_xdu16 aApplI_LateralAcceleration_xds16 aApplI_LongitudeAcceleration_xds16 aApplI_RotAccelerationFilt_xds16 aApplI_RotAcceleration_xds16 iApplI_AllowedBattCurr_xdu16 iApplI_MaxBattCurr_xdu16 kApplI_AbsRackForce_xdu16 kApplI_RackForceComfortRaw_xds16 kApplI_RackForceComfort_xds16 kApplI_RackForceMerge_xds16 kApplI_RackForceSimple_xds16 kApplI_RackForce_xds16 lApplI_AbsRackPosition_xdu16 lApplI_RackPositionLtCorr_xds16 lApplI_RackPosition_xds16 lApplI_VehCentRackPos_xds16 mApplI_AbsDriverTorque_xdu16 mApplI_DriverTorque_xds16 mApplI_MaxRequiredMotorTorque_xdu16 mApplI_NominalMotorTorque_xds16 mApplI_SSWarnTorque_xds16 nApplI_AbsGeneratoricRotorSpeed_xdu16 nApplI_AbsRotorSpeedFilt_xdu16 nApplI_RotorSpeedFilt_xds16 nApplI_RotorSpeed_xds16 qApplI_WheelFrequencyFL_xds16 qApplI_WheelFrequencyFR_xds16 qApplI_WheelFrequencyRL_xds16 qApplI_WheelFrequencyRR_xds16 sApplI_BoostModeRequest_xdu8 sApplI_CommBusTml50_xdu8 sApplI_DesVoltRedState_xdu8 sApplI_EcuState_xdu8 sApplI_EngineRunning_xdu8 sApplI_FootBrakeState_xdu8 sApplI_RackPosQualifier_xdu8 sApplI_SteeringAngleLinState_xdu8 sApplI_SteeringAngleState_xdu8 sApplI_VehicleRunning_xdu8 sApplI_VehicleSpeedState_xdu8 vApplI_AbsRackSpeed_xdu16 vApplI_AbsSafeNssVehicleSpeed_xdu16 vApplI_AbsSafeVehicleSpeed_xdu16 vApplI_AbsSteeringAngleSpeed_xdu16 vApplI_AbsVehicleSpeedFilt_xdu16 vApplI_RackSpeed_xds16 vApplI_SteeringAngleSpeed_xds16 vApplI_WindUpAdaption_xds32 vApplI_YawVelocity_xds16 wApplI_AbsDynSteerAngle_xdu16 wApplI_AbsPinionAngle_xdu16 wApplI_AbsSteeringAngleSafe_xdu16 wApplI_AbsSteeringAngle_xdu16 wApplI_DynSteerAngle_xds16 wApplI_PinionAngle_xds16 wApplI_SteeringAngleLtCorr_xds16 wApplI_SteeringAngle_xds16 xApplI_ActCharFact_xdu16 xApplI_DegreeOfOversteer_xdu16 xApplI_DegreeOfUndersteer_xdu16 xApplI_HLCharCurveBuckleFact_xdu16 xApplI_HLReductionFactor_xdu16 xApplI_NewCharFact_xdu16 xApplI_RatioD2C_xdu16 xApplI_TotalMotTorLim_xdu16 xApplI_VehDirection_xds8 yApplI_ActCharacteristic_xdu8 yApplI_HLMaxTorqueGradient_xdu16 yApplI_NewCharacteristic_xdu8 zApplI_SlippingClutchActivations_xdu8 /end OUT_MEASUREMENT
/end FUNCTION
/begin FUNCTION ApplicationInterfaceSuppI "ApplicationInterfaceSupp - interfaces"
 /begin OUT_MEASUREMENT fApplI_ImproperShutdown_xdb fApplI_LaErrorMode_xdb fApplI_LdwErrorMode_xdb fApplI_RscEpsFault_xdb mApplI_DriveShaftTorque_xds16 mApplI_LkaTorqueRequest_xds16 sApplI_ABSActive_xdu8 sApplI_ABSFailed_xdu8 sApplI_ApcState_xdu8 sApplI_displayindicatorstate_xdu8 sApplI_EpsApcState_xdu8 sApplI_EpsCharismaState_xdu8 sApplI_EssMode_xdu8 sApplI_HWAEnabled_xdu8 sApplI_LdwVibrationRequest_xdu8 sApplI_LkaActivationRequest_xdu8 sApplI_LkaActive_xdu8 sApplI_LkaEnabled_xdu8 sApplI_LkaMode_xdu8 sApplI_remotecontrolstate_xdu8 sApplI_RemoteSteerVehDirection_xdu16 sApplI_TjaEnabled_xdu8 sApplI_TjaMode_xdu8 sApplI_VSEActive_xdu8 sApplI_VSEStatus_xdu8 sEpsInI_ADActiveReq_xdu8 sEpsInI_ADDeactiveReq_xdu8 sEpsInI_ADModeReq_xdu8 sEpsIn_GearSt_xdu8 vApplI_YawRateRaw_xds16 vYROC_compvalue_xdf32 wApplI_ApcDesiredAngle_xds16 xEpsInI_VehDirection_xds8 yApplI_CharismaSelected_xdu8 yApplI_DMSActCharacteristic_xdu8 yApplI_EstimatedGear_xdu8 yApplI_ReverseGearEngaged_xdu8 /end OUT_MEASUREMENT
/end FUNCTION
/begin FUNCTION ApplicationStateMachine "Statusmaschine, die Ã¼ber den kompletten Klemmenzyklus arbeitet" /begin DEF_CHARACTERISTIC tAsmI_ApplicationInit_TimeOut_XDU16 /end DEF_CHARACTERISTIC /begin OUT_MEASUREMENT sAsmI_LocalUcSync_xdu8 sAsmI_RequestBswShutdown_xdb /end OUT_MEASUREMENT /end FUNCTION
/begin FUNCTION ApplicationStateMachinePlausi "ApplicationStateMachinePlausi" /begin OUT_MEASUREMENT sAsmPlausi_EcuState_xdu8 /end OUT_MEASUREMENT /end FUNCTION
/begin FUNCTION ApplicationStateMachinePlausiI "Applikation State Machine Verifikation" /begin OUT_MEASUREMENT sAsmI_ErrLvl_Red_xdu8 sAsmI_ErrLvl_xdu8 /end OUT_MEASUREMENT /end FUNCTION
/begin FUNCTION ApplicationStateMachineSupp "ApplicationStateMachineSupp" /begin OUT_MEASUREMENT yeeResetInfo_xdu32 /end OUT_MEASUREMENT /end FUNCTION
/begin FUNCTION ApplicationStateMachine_DetectionOscillation "Statusmaschine, die Ã¼ber den kompletten Klemmenzyklus arbeitet"
 /begin DEF_CHARACTERISTIC tAsmI_OscillationMeasureTime_XDU16 zAsmI_MaxHealingPerIgnitionCycle_XDU8 zAsmI_MaxHealingPerOscillation_XDU8 /end DEF_CHARACTERISTIC
 /begin OUT_MEASUREMENT fAsm_MaxHealingsReached_gdb sAsmI_MaxHealings_ErrLvl_Red_xdu8 sAsmI_MaxHealings_ErrLvl_xdu8 sAsm_StoredEcuState_xdu8 tAsm_StartTimeHealingsOscillation_xdu16 zAsm_HealingsPerIgnition_xdu8 zAsm_HealingsPerOscillation_xdu8 /end OUT_MEASUREMENT
/end FUNCTION
/begin FUNCTION ArModeManAbstraction ""
 /begin DEF_CHARACTERISTIC tArmI_ComSyncTimeout_XDU16 tArmI_HwLibFinishedTimeout_XDU16 tArmI_PollToOffTimeout_XDU16 tArmI_ProductionProcessingTimeout_XDU16 tArmI_ShutdownResyncTimeout_XDU16 tArmI_UartComSyncTimeout_XDU16 tArmI_WriteAllTimeout_XDU16 /end DEF_CHARACTERISTIC
 /begin OUT_MEASUREMENT sArmI_LocalShutdownSync_xdu8 sArmI_ShutdownMode_xdu8 /end OUT_MEASUREMENT
/end FUNCTION
/begin FUNCTION AssistanceController "Erweiterung für den Assistance Controller"
 /begin DEF_CHARACTERISTIC tAssCtrl_NoAssist_TimeOut_XDU16 yAssCtrl_RampDownGradient_XDU16 yAssCtrl_VehicleNotRunningGradient_XDU16 yAssCtrl_VehicleRunningGradient_XDU16 /end DEF_CHARACTERISTIC
 /begin OUT_MEASUREMENT sAssCtrlI_AssistMode_xdu8 sAssCtrl_InternalAssistState_xdu8 /end OUT_MEASUREMENT
/end FUNCTION
/begin FUNCTION AssistanceI "Interface Unterstuetzungsmoment" /begin OUT_MEASUREMENT matAssistantTorque_xds16 xatAssistanceGrad_xdu16 /end OUT_MEASUREMENT /end FUNCTION
/begin FUNCTION AssistanceV3 "Unterstuetzungsmoment V3"
 /begin DEF_CHARACTERISTIC fatAllowAssistReduction_XDB fatAllowMaxReqMMotReduction_XDB xatAssistFilterFrequFast_XDU16 xatAssistFilterFrequ_XAU16 xatBSTMaxgrad_XDU16 xatMaxGradChatterActive_XAU16 xatMaxGradGradDown_XDU16 xatMaxGradGradUp_XDU16 xatMaxGradTorGrad_XAU16 xatMaxGradvVehicleReverse_XAU16 xatMaxGradvVehicle_XAU16_00__A xatMaxGradvVehicle_XAU16_01__A xatMaxGradvVehicle_XAU16_02__A xatMaxGradvVehicle_XAU16_03__A xatMaxGradvVehicle_XAU16_04__A xatMaxGradvVehicle_XAU16_05__A xatMaxGradvVehicle_XAU16_06__A xatMaxGradvVehicle_XAU16_07__A xatMaxGradvVehicle_XAU16_08__A xatMaxGradvVehicle_XAU16_09__A xatMaxGradvVehicle_XAU16_10__A xatMaxGradvVehicle_XAU16_11__A xatMaxGradvVehicle_XAU16_12__A xatMaxGradvVehicle_XAU16_13__A xatMaxGradvVehicle_XAU16_14__A xatMaxGradvVehicle_XAU16_15__A xatMaxGradvVehicle_XAU16_16__A xatMaxGradvVehicle_XAU16_17__A xatMaxGradvVehicle_XAU16_18__A xatMaxGradvVehicle_XAU16_19__A xatMaxGradvVehicle_XAU16_20__A xatMaxGradvVehicle_XAU16_21__A xatMaxGradvVehicle_XAU16_22__A xatMaxGradvVehicle_XAU16_23__A xatMaxGradvVehicle_XAU16_24__A xatMaxGradvVehicle_XAU16_25__A xatMaxGradvVehicle_XAU16_26__A xatMaxGradvVehicle_XAU16_27__A xatMaxGradvVehicle_XAU16_28__A xatMaxGradvVehicle_XAU16_29__A xatMaxGradvVehicle_XAU16_30__A xatMaxGradvVehicle_XAU16_31__A xatMaxGradvVehicle_XAU16_32__A xatMaxGradvVehicle_XAU16_33__A xatMaxGradvVehicle_XAU16_34__A xatMaxGradvVehicle_XAU16_35__A /end DEF_CHARACTERISTIC
 /begin IN_MEASUREMENT vApplI_AbsSafeNssVehicleSpeed_xdu16 /end IN_MEASUREMENT
 /begin OUT_MEASUREMENT matAbsTorsionBarTorque_xdu16 matAssistanceLimitedY_xau16 matAssistanceX_xau16 matAssistanceY_xau16 matFactRedAssistTrq_xds16 matLimitationDiff_xds16 matLimitation_xds16 matMaxXLimitedAssistance_xdu16 matPT1Offset_xds16 matTorsionBarTorque_xds16 matUnlimitedAssistantTorque_xds16 xatActTorGradFact_xdu16 xatAssistanceGradMax_xdu16 xatAssistanceGrad_xau16 xatAssistFilterFrequ_xdu16 xatMaxGrad_xdu16 /end OUT_MEASUREMENT
/end FUNCTION
/begin FUNCTION AutomaticParkingControl "AutomaticParkingControl"
 /begin DEF_CHARACTERISTIC fAutParkCtrl_EnableDesRackPosFilt_XDU8 fAutParkCtrl_EnableFeedForward_XDU8 mAutParkCtrl_DeadBandTBT_XDU16 tAutParkCtrl_CycleTimeController_XDU8 tAutParkCtrl_CycleTimeControlVariable_XDU8 vAutParkCtrl_DeadBandRackSpeed_XDU16 vAutParkCtrl_MaxGradRackSpeed_XDU16 vAutParkCtrl_MaxRackSpeed_XDU16 xAutParkCtrl_FeedForwardFiltFact_XDU16 xAutParkCtrl_PositionDPart_XDF32 xAutParkCtrl_PositionIMax_XDF32 xAutParkCtrl_PositionIPart_XDF32_0___A xAutParkCtrl_PositionIPart_XDF32_1___A xAutParkCtrl_PositionIPart_XDF32_2___A xAutParkCtrl_PositionIPart_XDF32_3___A xAutParkCtrl_PositionIPart_XDF32_4___A xAutParkCtrl_PositionIPart_XDF32_5___A xAutParkCtrl_PositionPPart_XDF32_0___A xAutParkCtrl_PositionPPart_XDF32_1___A xAutParkCtrl_PositionPPart_XDF32_2___A xAutParkCtrl_PositionPPart_XDF32_3___A xAutParkCtrl_PositionPPart_XDF32_4___A xAutParkCtrl_PositionPPart_XDF32_5___A xAutParkCtrl_RackSpeedDPart_XDF32 xAutParkCtrl_RackSpeedIMax_XDF32 xAutParkCtrl_RackSpeedIPart_XDF32_0___A xAutParkCtrl_RackSpeedIPart_XDF32_1___A xAutParkCtrl_RackSpeedIPart_XDF32_2___A xAutParkCtrl_RackSpeedIPart_XDF32_3___A xAutParkCtrl_RackSpeedIPart_XDF32_4___A xAutParkCtrl_RackSpeedIPart_XDF32_5___A xAutParkCtrl_RackSpeedPPart_XDF32_0___A xAutParkCtrl_RackSpeedPPart_XDF32_1___A xAutParkCtrl_RackSpeedPPart_XDF32_2___A xAutParkCtrl_RackSpeedPPart_XDF32_3___A xAutParkCtrl_RackSpeedPPart_XDF32_4___A xAutParkCtrl_RackSpeedPPart_XDF32_5___A /end DEF_CHARACTERISTIC
 /begin OUT_MEASUREMENT lAutParkCtrl_DesiredRackPosFilt_xds16 vAutParkCtrl_DesiredRackSpeed_xds16 vAutParkCtrl_LimitedDesiredRackSpeed_xds16 /end OUT_MEASUREMENT
/end FUNCTION
/begin FUNCTION AutomaticParkingControlCheck "AutomaticParkingControlCheck"
 /begin DEF_CHARACTERISTIC mAutParkCtrl_CheckHandsOnTorqLim_XDU16 tAutParkCtrl_CheckHandsOnSwOffTime_XDU16 vAutParkCtrl_SafetyLimitMaxVehicleSpeed_XDU16 /end DEF_CHARACTERISTIC
 /begin OUT_MEASUREMENT fAutParkCtrl_MonSafeOk_xdb mAutParkCtrl_DesMotTrqOffsetChecked_xds16 mAutParkCtrl_DesSteerTrqOffsetChecked_xds16 sAutParkCtrl_MakeSafeState_xdu8 xAutParkCtrl_DesActRetFuncFactChecked_xdu16 zAutParkCtrl_HandsOnCounter_xdu16 /end OUT_MEASUREMENT
/end FUNCTION
/begin FUNCTION AutomaticParkingControlCheckI "AutomaticParkingControlCheckI - interface"
 /begin OUT_MEASUREMENT mAutParkCtrlI_DesMotTrqOffset_xds16 mAutParkCtrlI_DesSteerTrqOffset_xds16 sAutParkCtrlI_MakeSafeAndMonState_xdu8 xAutParkCtrlI_DesActRetFuncFact_xdu16 /end OUT_MEASUREMENT
/end FUNCTION
/begin FUNCTION AutomaticParkingControlI "AutomaticParkingControlI - interface"
 /begin OUT_MEASUREMENT mAutParkCtrlI_DesMotTrqOffset4Check_xds16 mAutParkCtrlI_DesSteerTrqOffset4Check_xds16 xAutParkCtrlI_DesActRetFuncFact4Check_xdu16 /end OUT_MEASUREMENT
/end FUNCTION
/begin FUNCTION AutomaticParkingControlSupp "AutomaticParkingControlSupp"
 /begin DEF_CHARACTERISTIC fAutParkCtrl_LtStCorrActive_XDB lAutParkCtrl_MaxRackPosDiff_XDU16 lAutParkCtrl_MaxRackPosGrad_XDU16 mAutParkCtrl_ColumnTorqueLim_XDU16 mAutParkCtrl_HandsOffTorqLim_XDU16 mAutParkCtrl_HandsOnTorqLim_XDU16 tAutParkCtrl_Angle_Diff_APC_XDU16 tAutParkCtrl_ApaReqTime_XDU16 tAutParkCtrl_CycleTime_XDU8 tAutParkCtrl_HandsOffSwOffTime_XDU16 tAutParkCtrl_HandsOnSwOffTime_XDU16 tAutParkCtrl_MAXsteeringAngleSpeedInActive_XDU16 tAutParkCtrl_OverAgGridCheckTime_XDU16 vAutParkCtrl_MaxAPAVehicleSpeed_XDU16 vAutParkCtrl_MaxRequestAngleGradient_XDU16 vAutParkCtrl_MaxSteeringAngleSpeedInActive_XDU16 vAutParkCtrl_MaxVehicleSpeed_XDU16 vAutParkCtrl_StandStillVehicleSpeed_XDU16 wAutParkCtrl_MaxAngleDiff_XDU16 wAutParkCtrl_MaxRequestAngle_XDU16 xAutParkCtrl_InterruptTorqueFactor_XDU16 xAutParkCtrl_RecoverTorqueFactor_XDU16 xAutParkCtrl_RefuseTorqueFactor_XDU16 /end DEF_CHARACTERISTIC
 /begin OUT_MEASUREMENT sAutParkCtrl_CancelState_xdu16 sAutParkCtrl_FctCoCtrlState_xdu8 sAutParkCtrl_FeatureState_xdu8 /end OUT_MEASUREMENT
/end FUNCTION
/begin FUNCTION AutomaticParkingControlSuppI "AutomaticParkingControlSuppI - interface"
 /begin OUT_MEASUREMENT lAutParkCtrlI_DesiredRackPosition_xds16 sAutParkCtrlI_Activate_xdu8 /end OUT_MEASUREMENT
/end FUNCTION
/begin FUNCTION AutosarAbstractionInterface ""
 /begin OUT_MEASUREMENT fBswI_IsInitialized_gdb sHLIpcI_RemoteBoschASDiagnostics_xdu8 /end OUT_MEASUREMENT
/end FUNCTION
/begin FUNCTION AZG "AZG" /begin OUT_MEASUREMENT vazReqVehSpeed_xdu8 /end OUT_MEASUREMENT /end FUNCTION
/begin FUNCTION AZGSecurityAccess "AZGSecurityAccess"
 /begin DEF_CHARACTERISTIC AZG_SecurityAccessDeliveredPublicKey AZG_SecurityAccessDevelopmentPublicKey AZG_SecurityAccessProductionPublicKey /end DEF_CHARACTERISTIC
/end FUNCTION
/begin FUNCTION BasicSteerTorque "Basic Steering Torque" /begin DEF_CHARACTERISTIC xBST_PT1FilterFactor_XDU16 xBST_RackForceScaleFact_XDU16 /end DEF_CHARACTERISTIC /end FUNCTION
/begin FUNCTION BasicSteerTorqueI "Basislenkmoment" /begin OUT_MEASUREMENT mBSTI_NominalSteerTorque_xds16 /end OUT_MEASUREMENT /end FUNCTION
/begin FUNCTION BatteryVoltageMonitor_OemWarning "Warnung aufgrund nicht kritischer Batteriespannung"
 /begin DEF_CHARACTERISTIC tBatVoltMon_HighVoltageValueLeft_XDU16 tBatVoltMon_HighVoltageValueReached_XDU16 tBatVoltMon_LowVoltageValueLeft_XDU16 tBatVoltMon_LowVoltageValueReached_XDU16 tBatVoltMon_NormalVoltageThreshold_XDU16 uBatVoltMon_HighVoltageValueLeft_XDU16 uBatVoltMon_HighVoltageValueReached_XDU16 uBatVoltMon_LowVoltageValueLeft_XDU16 uBatVoltMon_LowVoltageValueReached_XDU16 /end DEF_CHARACTERISTIC
 /begin OUT_MEASUREMENT fBatVolt_StartTimer_gdb tBatVolt_StartTimeStamp_xdu16 tBatVolt_TimeElapsed_xdu32 /end OUT_MEASUREMENT
/end FUNCTION
/begin FUNCTION BlockedSteeringDetection "Mess- und Applikationsgrößen BlockedSteeringDetection"
 /begin DEF_CHARACTERISTIC cBsd_TempratureLimit_XDU8 mBsd_TBTDeadband_XDU16 mBsd_VibrationTorque_XDU16 tBsd_MaxTimeTorqueActive_XDU16 tBsd_StateCycletimer_XDU8 vBsd_LowVehSpeed_XDU16 vBsd_VehicleSpeedForBSDActivation_XDU16 wBsd_MinRotPosChange_XDU16 wBsd_SteeringAngleLimit_XDU16 zBsd_MaxRampUpCycles_XDU8 /end DEF_CHARACTERISTIC
 /begin OUT_MEASUREMENT fBsd_ActivateTorqueGen_xdb fBsd_EnableMonitoring_xdb fBsd_JobResultOK_xdb sBsd_CtrlState_xdu8 sBsd_CurrentInternalState_xdu8 sBsd_FeatureState_xdu8 wBsd_DeltaRotPos_xds32 wBsd_RotPosMax_xds32 wBsd_RotPosMin_xds32 zBsd_BlockDetectedCnt_xdu16 zBsd_BlockSuspicionCnt_xdu16 zBsd_CycleCount_xdu8 /end OUT_MEASUREMENT
/end FUNCTION
/begin FUNCTION BlockedSteeringDetectionCheck "Mess- und Applikationsgrößen BlockedSteeringDetectionCheck"
 /begin DEF_CHARACTERISTIC mBsd_MaxSafetyMotorTorq_XDU16 wBsd_MinSafetyRotPosChange_XDU16 /end DEF_CHARACTERISTIC
 /begin OUT_MEASUREMENT fBsd_FirstRunMonitorSafe_xdb mBsd_MotorTorqueSaturated_xds16 sBsd_FailureCause_xdu8 wBsd_DeltaRotPosMakeSafe_xds32 wBsd_DeltaRotPosMonitor_xds32 wBsd_MaxRotPosMakeSafe_xds32 wBsd_MaxRotPosMonitor_xds32 wBsd_MinRotPosMakeSafe_xds32 wBsd_MinRotPosMonitor_xds32 /end OUT_MEASUREMENT
/end FUNCTION
/begin FUNCTION BlockedSteeringDetectionCheckI "Interfacegrößen BlockedSteeringDetectionCheck" /begin OUT_MEASUREMENT fBsdI_MonSafeOk_xdb mBsdI_MotorTorqueOffset_xds16 /end OUT_MEASUREMENT /end FUNCTION
/begin FUNCTION BlockedSteeringDetectionI "Interfacegrößen BlockedSteeringDetection"
 /begin OUT_MEASUREMENT mBsdI_MotorTorque4Check_xds16 sBsdI_BlockedSteeringDetection_xdu8 /end OUT_MEASUREMENT
/end FUNCTION
/begin FUNCTION BoostCurveInterpolationI "Unterstuetzungskennlinien"
 /begin OUT_MEASUREMENT kBciI_BSTCurveRackForceXAxis_xau16 mBciI_AssistCurveMMotYAxis_xau16 mBciI_AssistCurveTBTXAxis_xau16 mBciI_BSTCurveSteerTorqueYAxis_xau16 /end OUT_MEASUREMENT
/end FUNCTION
/begin FUNCTION BoostCurveInterpolationInterpol "Unterstuetzungskennlinien (interpolate vehicle speed depended characteristic curves)"
 /begin DEF_CHARACTERISTIC mBci_V0BaseTorque_XAS16_00___A mBci_V0BaseTorque_XAS16_01___A mBci_V0BaseTorque_XAS16_02___A mBci_V0BaseTorque_XAS16_03___A mBci_V0BaseTorque_XAS16_04___A mBci_V0BaseTorque_XAS16_05___A mBci_V0BaseTorque_XAS16_06___A mBci_V0BaseTorque_XAS16_07___A mBci_V0BaseTorque_XAS16_08___A mBci_V0BaseTorque_XAS16_09___A mBci_V0BaseTorque_XAS16_10___A mBci_V0BaseTorque_XAS16_11___A mBci_V0BaseTorque_XAS16_12___A mBci_V0BaseTorque_XAS16_13___A mBci_V0BaseTorque_XAS16_14___A mBci_V0BaseTorque_XAS16_15___A mBci_V0BaseTorque_XAS16_16___A mBci_V0BaseTorque_XAS16_17___A mBci_V0BaseTorque_XAS16_18___A mBci_V0BaseTorque_XAS16_19___A mBci_V0BaseTorque_XAS16_20___A mBci_V0BaseTorque_XAS16_21___A mBci_V0BaseTorque_XAS16_22___A mBci_V0BaseTorque_XAS16_23___A mBci_V0BaseTorque_XAS16_24___A mBci_V0BaseTorque_XAS16_25___A mBci_V0BaseTorque_XAS16_26___A mBci_V0BaseTorque_XAS16_27___A mBci_V0BaseTorque_XAS16_28___A mBci_V0BaseTorque_XAS16_29___A mBci_V0BaseTorque_XAS16_30___A mBci_V0BaseTorque_XAS16_31___A mBci_V0BaseTorque_XAS16_32___A mBci_V0BaseTorque_XAS16_33___A mBci_V0BaseTorque_XAS16_34___A mBci_V0BaseTorque_XAS16_35___A mBci_V1BaseTorque_XAS16_00___A mBci_V1BaseTorque_XAS16_01___A mBci_V1BaseTorque_XAS16_02___A mBci_V1BaseTorque_XAS16_03___A mBci_V1BaseTorque_XAS16_04___A mBci_V1BaseTorque_XAS16_05___A mBci_V1BaseTorque_XAS16_06___A mBci_V1BaseTorque_XAS16_07___A mBci_V1BaseTorque_XAS16_08___A mBci_V1BaseTorque_XAS16_09___A mBci_V1BaseTorque_XAS16_10___A mBci_V1BaseTorque_XAS16_11___A mBci_V1BaseTorque_XAS16_12___A mBci_V1BaseTorque_XAS16_13___A mBci_V1BaseTorque_XAS16_14___A mBci_V1BaseTorque_XAS16_15___A mBci_V1BaseTorque_XAS16_16___A mBci_V1BaseTorque_XAS16_17___A mBci_V1BaseTorque_XAS16_18___A mBci_V1BaseTorque_XAS16_19___A mBci_V1BaseTorque_XAS16_20___A mBci_V1BaseTorque_XAS16_21___A mBci_V1BaseTorque_XAS16_22___A mBci_V1BaseTorque_XAS16_23___A mBci_V1BaseTorque_XAS16_24___A mBci_V1BaseTorque_XAS16_25___A mBci_V1BaseTorque_XAS16_26___A mBci_V1BaseTorque_XAS16_27___A mBci_V1BaseTorque_XAS16_28___A mBci_V1BaseTorque_XAS16_29___A mBci_V1BaseTorque_XAS16_30___A mBci_V1BaseTorque_XAS16_31___A mBci_V1BaseTorque_XAS16_32___A mBci_V1BaseTorque_XAS16_33___A mBci_V1BaseTorque_XAS16_34___A mBci_V1BaseTorque_XAS16_35___A mBci_V2BaseTorque_XAS16_00___A mBci_V2BaseTorque_XAS16_01___A mBci_V2BaseTorque_XAS16_02___A mBci_V2BaseTorque_XAS16_03___A mBci_V2BaseTorque_XAS16_04___A mBci_V2BaseTorque_XAS16_05___A mBci_V2BaseTorque_XAS16_06___A mBci_V2BaseTorque_XAS16_07___A mBci_V2BaseTorque_XAS16_08___A mBci_V2BaseTorque_XAS16_09___A mBci_V2BaseTorque_XAS16_10___A mBci_V2BaseTorque_XAS16_11___A mBci_V2BaseTorque_XAS16_12___A mBci_V2BaseTorque_XAS16_13___A mBci_V2BaseTorque_XAS16_14___A mBci_V2BaseTorque_XAS16_15___A mBci_V2BaseTorque_XAS16_16___A mBci_V2BaseTorque_XAS16_17___A mBci_V2BaseTorque_XAS16_18___A mBci_V2BaseTorque_XAS16_19___A mBci_V2BaseTorque_XAS16_20___A mBci_V2BaseTorque_XAS16_21___A mBci_V2BaseTorque_XAS16_22___A mBci_V2BaseTorque_XAS16_23___A mBci_V2BaseTorque_XAS16_24___A mBci_V2BaseTorque_XAS16_25___A mBci_V2BaseTorque_XAS16_26___A mBci_V2BaseTorque_XAS16_27___A mBci_V2BaseTorque_XAS16_28___A mBci_V2BaseTorque_XAS16_29___A mBci_V2BaseTorque_XAS16_30___A mBci_V2BaseTorque_XAS16_31___A mBci_V2BaseTorque_XAS16_32___A mBci_V2BaseTorque_XAS16_33___A mBci_V2BaseTorque_XAS16_34___A mBci_V2BaseTorque_XAS16_35___A mBci_V3BaseTorque_XAS16_00___A mBci_V3BaseTorque_XAS16_01___A mBci_V3BaseTorque_XAS16_02___A mBci_V3BaseTorque_XAS16_03___A mBci_V3BaseTorque_XAS16_04___A mBci_V3BaseTorque_XAS16_05___A mBci_V3BaseTorque_XAS16_06___A mBci_V3BaseTorque_XAS16_07___A mBci_V3BaseTorque_XAS16_08___A mBci_V3BaseTorque_XAS16_09___A mBci_V3BaseTorque_XAS16_10___A mBci_V3BaseTorque_XAS16_11___A mBci_V3BaseTorque_XAS16_12___A mBci_V3BaseTorque_XAS16_13___A mBci_V3BaseTorque_XAS16_14___A mBci_V3BaseTorque_XAS16_15___A mBci_V3BaseTorque_XAS16_16___A mBci_V3BaseTorque_XAS16_17___A mBci_V3BaseTorque_XAS16_18___A mBci_V3BaseTorque_XAS16_19___A mBci_V3BaseTorque_XAS16_20___A mBci_V3BaseTorque_XAS16_21___A mBci_V3BaseTorque_XAS16_22___A mBci_V3BaseTorque_XAS16_23___A mBci_V3BaseTorque_XAS16_24___A mBci_V3BaseTorque_XAS16_25___A mBci_V3BaseTorque_XAS16_26___A mBci_V3BaseTorque_XAS16_27___A mBci_V3BaseTorque_XAS16_28___A mBci_V3BaseTorque_XAS16_29___A mBci_V3BaseTorque_XAS16_30___A mBci_V3BaseTorque_XAS16_31___A mBci_V3BaseTorque_XAS16_32___A mBci_V3BaseTorque_XAS16_33___A mBci_V3BaseTorque_XAS16_34___A mBci_V3BaseTorque_XAS16_35___A mBci_V4BaseTorque_XAS16_00___A mBci_V4BaseTorque_XAS16_01___A mBci_V4BaseTorque_XAS16_02___A mBci_V4BaseTorque_XAS16_03___A mBci_V4BaseTorque_XAS16_04___A mBci_V4BaseTorque_XAS16_05___A mBci_V4BaseTorque_XAS16_06___A mBci_V4BaseTorque_XAS16_07___A mBci_V4BaseTorque_XAS16_08___A mBci_V4BaseTorque_XAS16_09___A mBci_V4BaseTorque_XAS16_10___A mBci_V4BaseTorque_XAS16_11___A mBci_V4BaseTorque_XAS16_12___A mBci_V4BaseTorque_XAS16_13___A mBci_V4BaseTorque_XAS16_14___A mBci_V4BaseTorque_XAS16_15___A mBci_V4BaseTorque_XAS16_16___A mBci_V4BaseTorque_XAS16_17___A mBci_V4BaseTorque_XAS16_18___A mBci_V4BaseTorque_XAS16_19___A mBci_V4BaseTorque_XAS16_20___A mBci_V4BaseTorque_XAS16_21___A mBci_V4BaseTorque_XAS16_22___A mBci_V4BaseTorque_XAS16_23___A mBci_V4BaseTorque_XAS16_24___A mBci_V4BaseTorque_XAS16_25___A mBci_V4BaseTorque_XAS16_26___A mBci_V4BaseTorque_XAS16_27___A mBci_V4BaseTorque_XAS16_28___A mBci_V4BaseTorque_XAS16_29___A mBci_V4BaseTorque_XAS16_30___A mBci_V4BaseTorque_XAS16_31___A mBci_V4BaseTorque_XAS16_32___A mBci_V4BaseTorque_XAS16_33___A mBci_V4BaseTorque_XAS16_34___A mBci_V4BaseTorque_XAS16_35___A mBci_V5BaseTorque_XAS16_00___A mBci_V5BaseTorque_XAS16_01___A mBci_V5BaseTorque_XAS16_02___A mBci_V5BaseTorque_XAS16_03___A mBci_V5BaseTorque_XAS16_04___A mBci_V5BaseTorque_XAS16_05___A mBci_V5BaseTorque_XAS16_06___A mBci_V5BaseTorque_XAS16_07___A mBci_V5BaseTorque_XAS16_08___A mBci_V5BaseTorque_XAS16_09___A mBci_V5BaseTorque_XAS16_10___A mBci_V5BaseTorque_XAS16_11___A mBci_V5BaseTorque_XAS16_12___A mBci_V5BaseTorque_XAS16_13___A mBci_V5BaseTorque_XAS16_14___A mBci_V5BaseTorque_XAS16_15___A mBci_V5BaseTorque_XAS16_16___A mBci_V5BaseTorque_XAS16_17___A mBci_V5BaseTorque_XAS16_18___A mBci_V5BaseTorque_XAS16_19___A mBci_V5BaseTorque_XAS16_20___A mBci_V5BaseTorque_XAS16_21___A mBci_V5BaseTorque_XAS16_22___A mBci_V5BaseTorque_XAS16_23___A mBci_V5BaseTorque_XAS16_24___A mBci_V5BaseTorque_XAS16_25___A mBci_V5BaseTorque_XAS16_26___A mBci_V5BaseTorque_XAS16_27___A mBci_V5BaseTorque_XAS16_28___A mBci_V5BaseTorque_XAS16_29___A mBci_V5BaseTorque_XAS16_30___A mBci_V5BaseTorque_XAS16_31___A mBci_V5BaseTorque_XAS16_32___A mBci_V5BaseTorque_XAS16_33___A mBci_V5BaseTorque_XAS16_34___A mBci_V5BaseTorque_XAS16_35___A mBci_V6BaseTorque_XAS16_00___A mBci_V6BaseTorque_XAS16_01___A mBci_V6BaseTorque_XAS16_02___A mBci_V6BaseTorque_XAS16_03___A mBci_V6BaseTorque_XAS16_04___A mBci_V6BaseTorque_XAS16_05___A mBci_V6BaseTorque_XAS16_06___A mBci_V6BaseTorque_XAS16_07___A mBci_V6BaseTorque_XAS16_08___A mBci_V6BaseTorque_XAS16_09___A mBci_V6BaseTorque_XAS16_10___A mBci_V6BaseTorque_XAS16_11___A mBci_V6BaseTorque_XAS16_12___A mBci_V6BaseTorque_XAS16_13___A mBci_V6BaseTorque_XAS16_14___A mBci_V6BaseTorque_XAS16_15___A mBci_V6BaseTorque_XAS16_16___A mBci_V6BaseTorque_XAS16_17___A mBci_V6BaseTorque_XAS16_18___A mBci_V6BaseTorque_XAS16_19___A mBci_V6BaseTorque_XAS16_20___A mBci_V6BaseTorque_XAS16_21___A mBci_V6BaseTorque_XAS16_22___A mBci_V6BaseTorque_XAS16_23___A mBci_V6BaseTorque_XAS16_24___A mBci_V6BaseTorque_XAS16_25___A mBci_V6BaseTorque_XAS16_26___A mBci_V6BaseTorque_XAS16_27___A mBci_V6BaseTorque_XAS16_28___A mBci_V6BaseTorque_XAS16_29___A mBci_V6BaseTorque_XAS16_30___A mBci_V6BaseTorque_XAS16_31___A mBci_V6BaseTorque_XAS16_32___A mBci_V6BaseTorque_XAS16_33___A mBci_V6BaseTorque_XAS16_34___A mBci_V6BaseTorque_XAS16_35___A zBci_BaseTorqueCharSelect_XAS16_00___A zBci_BaseTorqueCharSelect_XAS16_01___A zBci_BaseTorqueCharSelect_XAS16_02___A zBci_BaseTorqueCharSelect_XAS16_03___A zBci_BaseTorqueCharSelect_XAS16_04___A zBci_BaseTorqueCharSelect_XAS16_05___A zBci_BaseTorqueCharSelect_XAS16_06___A zBci_BaseTorqueCharSelect_XAS16_07___A zBci_BaseTorqueCharSelect_XAS16_08___A zBci_BaseTorqueCharSelect_XAS16_09___A zBci_BaseTorqueCharSelect_XAS16_10___A zBci_BaseTorqueCharSelect_XAS16_11___A zBci_BaseTorqueCharSelect_XAS16_12___A zBci_BaseTorqueCharSelect_XAS16_13___A zBci_BaseTorqueCharSelect_XAS16_14___A zBci_BaseTorqueCharSelect_XAS16_15___A zBci_BaseTorqueCharSelect_XAS16_16___A zBci_BaseTorqueCharSelect_XAS16_17___A zBci_BaseTorqueCharSelect_XAS16_18___A zBci_BaseTorqueCharSelect_XAS16_19___A zBci_BaseTorqueCharSelect_XAS16_20___A zBci_BaseTorqueCharSelect_XAS16_21___A zBci_BaseTorqueCharSelect_XAS16_22___A zBci_BaseTorqueCharSelect_XAS16_23___A zBci_BaseTorqueCharSelect_XAS16_24___A zBci_BaseTorqueCharSelect_XAS16_25___A zBci_BaseTorqueCharSelect_XAS16_26___A zBci_BaseTorqueCharSelect_XAS16_27___A zBci_BaseTorqueCharSelect_XAS16_28___A zBci_BaseTorqueCharSelect_XAS16_29___A zBci_BaseTorqueCharSelect_XAS16_30___A zBci_BaseTorqueCharSelect_XAS16_31___A zBci_BaseTorqueCharSelect_XAS16_32___A zBci_BaseTorqueCharSelect_XAS16_33___A zBci_BaseTorqueCharSelect_XAS16_34___A zBci_BaseTorqueCharSelect_XAS16_35___A /end DEF_CHARACTERISTIC
 /begin IN_MEASUREMENT kApplI_AbsRackForce_xdu16 /end IN_MEASUREMENT
 /begin OUT_MEASUREMENT kBci_BSTCurveRackForceXAxisRawL2_xaf32 kBci_BSTCurveRackForceXAxisRaw_xas16 mBci_BSTCurveSteerTorqueYAxisRawL2_xaf32 mBci_BSTCurveSteerTorqueYAxisRaw_xas16 /end OUT_MEASUREMENT
/end FUNCTION
/begin RECORD_LAYOUT AblGLKLsw FNC_VALUES 3 SWORD COLUMN_DIR DIRECT AXIS_PTS_X 2 SWORD INDEX_INCR DIRECT NO_AXIS_PTS_X 1 UWORD /end RECORD_LAYOUT
/begin RECORD_LAYOUT AblGLKLuw FNC_VALUES 3 UWORD COLUMN_DIR DIRECT AXIS_PTS_X 2 UWORD INDEX_INCR DIRECT NO_AXIS_PTS_X 1 UWORD /end RECORD_LAYOUT
/begin RECORD_LAYOUT AblGLKWBsw FNC_VALUES 1 SWORD COLUMN_DIR DIRECT /end RECORD_LAYOUT
/begin RECORD_LAYOUT AblGLKWBub FNC_VALUES 1 UBYTE COLUMN_DIR DIRECT /end RECORD_LAYOUT
/begin RECORD_LAYOUT AblGLKWfl4 FNC_VALUES 1 FLOAT32_IEEE COLUMN_DIR DIRECT /end RECORD_LAYOUT
/begin RECORD_LAYOUT AblGLKWub FNC_VALUES 1 UBYTE COLUMN_DIR DIRECT /end RECORD_LAYOUT
/begin RECORD_LAYOUT AblGLKWuw FNC_VALUES 1 UWORD COLUMN_DIR DIRECT /end RECORD_LAYOUT
/end MODULE
/end PROJECT
