ASAP2_VERSION 1 70
/begin PROJECT _DF0_D01 "SCU3_B3_VAR_01"
/begin HEADER "" VERSION "DF0_D01_D_01_00" PROJECT_NO _DF0_D01 /end HEADER
/begin MODULE XCP_EPS_ECU "CMP"
/begin MOD_COMMON "" BYTE_ORDER MSB_LAST ALIGNMENT_BYTE 1 ALIGNMENT_WORD 2 ALIGNMENT_LONG 4 ALIGNMENT_FLOAT32_IEEE 4 ALIGNMENT_FLOAT64_IEEE 8 /end MOD_COMMON
/begin CHARACTERISTIC aVehSp_MaxNegGradientVAvg_XAU16 "Max negative gradient of the vehicle speed v_Avg [km/h/10ms]" CURVE 0x150EC8 AblGLKLuw 3.98438 VFZHIGH 0 3.984375 FORMAT "%8.6"
 /begin AXIS_DESCR STD_AXIS vVehSpI_AbsAvgVehSpd_xdu16 VFZHIGH 5 0 500 FORMAT "%8.4" DEPOSIT ABSOLUTE /end AXIS_DESCR
/end CHARACTERISTIC
/begin CHARACTERISTIC aVehSp_MaxNegGradientVMax_XAU8 "Max negative gradient of the vehicle speed v_Max [km/h/10ms]" VALUE 0x150A92 AblGLKWub 3.984 VFZHIGH 0 3.984 FORMAT "%5.3" /end CHARACTERISTIC
/begin CHARACTERISTIC aVehSp_MaxPosGradientVAvg_XAU16 "Max positive gradient of the vehicle speed v_Avg [km/h/10ms]" CURVE 0x150EE0 AblGLKLuw 3.98438 VFZHIGH 0 3.984375 FORMAT "%8.6"
 /begin AXIS_DESCR STD_AXIS vVehSpI_AbsAvgVehSpd_xdu16 VFZHIGH 5 0 500 FORMAT "%8.4" DEPOSIT ABSOLUTE /end AXIS_DESCR
/end CHARACTERISTIC
/begin CHARACTERISTIC aVehSp_MaxPosGradientVMin_XAU8 "Max positive gradient of the vehicle speed v_Min [km/h/10ms]" VALUE 0x150A93 AblGLKWub 3.984 VFZHIGH 0 3.984 FORMAT "%5.3" /end CHARACTERISTIC
/begin CHARACTERISTIC fDSR_EMA_Enable_XDU8 "Aktivierungsschalter fuer EMA, Ein = 1" VALUE 0x150A9E AblGLKWub 1 ZU0 0 1 FORMAT "%5.3" /end CHARACTERISTIC
/begin CHARACTERISTIC fSteerCtrl_DeactivateDPartAtEndstopChatter_XDU16 "deactivate D-part (due to assistance torque) at EndStop in case of CHATTERING" VALUE 0x15053C AblGLKWuw 1 ZU0 0 1 FORMAT "%8.6" /end CHARACTERISTIC
/begin CHARACTERISTIC fSteerCtrl_DeactivateDPartAtEndstop_XDU16 "deactivate D-part (due to assistance torque) at EndStop in case of NO chattering" VALUE 0x15053E AblGLKWuw 1 ZU0 0 1 FORMAT "%8.6" /end CHARACTERISTIC
/begin CHARACTERISTIC fSteerCtrl_NoRotSpDoffLockstop_XDU8 "RotorSpeed Independent Doffset enable at endstop" VALUE 0x150ACF AblGLKWub 1 ZU0 0 1 FORMAT "%5.3" /end CHARACTERISTIC
/begin CHARACTERISTIC fSteerCtrl_UseSteerCtrlTBTGrad_XDB "SteerCtrl interne TBT Gradientenberechnung verwenden" VALUE 0x150AD0 AblGLKWub 1 ZU0 0 1 FORMAT "%5.3" /end CHARACTERISTIC
/begin CHARACTERISTIC fStFC_UseActiveInertia_XDU8_00___A "Schalter für Aktive Trägheit" VALUE 0x1584F0 AblGLKWub 1 BIT 0 1 FORMAT "%5.3" /end CHARACTERISTIC
/begin CHARACTERISTIC fStFC_UseActiveInertia_XDU8_01___A "Schalter für Aktive Trägheit" VALUE 0x1584F1 AblGLKWub 1 BIT 0 1 FORMAT "%5.3" /end CHARACTERISTIC
/begin CHARACTERISTIC fStFC_UseActiveInertia_XDU8_02___A "Schalter für Aktive Trägheit" VALUE 0x1584F2 AblGLKWub 1 BIT 0 1 FORMAT "%5.3" /end CHARACTERISTIC
/begin CHARACTERISTIC fStFC_UseActiveInertia_XDU8_03___A "Schalter für Aktive Trägheit" VALUE 0x1584F3 AblGLKWub 1 BIT 0 1 FORMAT "%5.3" /end CHARACTERISTIC
/begin CHARACTERISTIC fStFC_UseActiveInertia_XDU8_04___A "Schalter für Aktive Trägheit" VALUE 0x1584F4 AblGLKWub 1 BIT 0 1 FORMAT "%5.3" /end CHARACTERISTIC
/begin CHARACTERISTIC fStFC_UseActiveInertia_XDU8_05___A "Schalter für Aktive Trägheit" VALUE 0x1584F5 AblGLKWub 1 BIT 0 1 FORMAT "%5.3" /end CHARACTERISTIC
/begin CHARACTERISTIC fStFC_UseActiveInertia_XDU8_06___A "Schalter für Aktive Trägheit" VALUE 0x1584F6 AblGLKWub 1 BIT 0 1 FORMAT "%5.3" /end CHARACTERISTIC
/begin CHARACTERISTIC fStFC_UseActiveInertia_XDU8_07___A "Schalter für Aktive Trägheit" VALUE 0x1584F7 AblGLKWub 1 BIT 0 1 FORMAT "%5.3" /end CHARACTERISTIC
/begin CHARACTERISTIC fStFC_UseActiveInertia_XDU8_08___A "Schalter für Aktive Trägheit" VALUE 0x1584F8 AblGLKWub 1 BIT 0 1 FORMAT "%5.3" /end CHARACTERISTIC
/begin CHARACTERISTIC fStFC_UseActiveInertia_XDU8_09___A "Schalter für Aktive Trägheit" VALUE 0x1584F9 AblGLKWub 1 BIT 0 1 FORMAT "%5.3" /end CHARACTERISTIC
/begin CHARACTERISTIC fStFC_UseActiveInertia_XDU8_10___A "Schalter für Aktive Trägheit" VALUE 0x1584FA AblGLKWub 1 BIT 0 1 FORMAT "%5.3" /end CHARACTERISTIC
/begin CHARACTERISTIC fStFC_UseActiveInertia_XDU8_11___A "Schalter für Aktive Trägheit" VALUE 0x1584FB AblGLKWub 1 BIT 0 1 FORMAT "%5.3" /end CHARACTERISTIC
/begin CHARACTERISTIC fStFC_UseActiveInertia_XDU8_12___A "Schalter für Aktive Trägheit" VALUE 0x1584FC AblGLKWub 1 BIT 0 1 FORMAT "%5.3" /end CHARACTERISTIC
/begin CHARACTERISTIC fStFC_UseActiveInertia_XDU8_13___A "Schalter für Aktive Trägheit" VALUE 0x1584FD AblGLKWub 1 BIT 0 1 FORMAT "%5.3" /end CHARACTERISTIC
/begin CHARACTERISTIC fStFC_UseActiveInertia_XDU8_14___A "Schalter für Aktive Trägheit" VALUE 0x1584FE AblGLKWub 1 BIT 0 1 FORMAT "%5.3" /end CHARACTERISTIC
/begin CHARACTERISTIC fStFC_UseActiveInertia_XDU8_15___A "Schalter für Aktive Trägheit" VALUE 0x1584FF AblGLKWub 1 BIT 0 1 FORMAT "%5.3" /end CHARACTERISTIC
/begin CHARACTERISTIC fStFC_UseActiveInertia_XDU8_16___A "Schalter für Aktive Trägheit" VALUE 0x158500 AblGLKWub 1 BIT 0 1 FORMAT "%5.3" /end CHARACTERISTIC
/begin CHARACTERISTIC fStFC_UseActiveInertia_XDU8_17___A "Schalter für Aktive Trägheit" VALUE 0x158501 AblGLKWub 1 BIT 0 1 FORMAT "%5.3" /end CHARACTERISTIC
/begin CHARACTERISTIC fStFC_UseActiveInertia_XDU8_18___A "Schalter für Aktive Trägheit" VALUE 0x158502 AblGLKWub 1 BIT 0 1 FORMAT "%5.3" /end CHARACTERISTIC
/begin CHARACTERISTIC fStFC_UseActiveInertia_XDU8_19___A "Schalter für Aktive Trägheit" VALUE 0x158503 AblGLKWub 1 BIT 0 1 FORMAT "%5.3" /end CHARACTERISTIC
/begin CHARACTERISTIC fStFC_UseActiveInertia_XDU8_20___A "Schalter für Aktive Trägheit" VALUE 0x158504 AblGLKWub 1 BIT 0 1 FORMAT "%5.3" /end CHARACTERISTIC
/begin CHARACTERISTIC fStFC_UseActiveInertia_XDU8_21___A "Schalter für Aktive Trägheit" VALUE 0x158505 AblGLKWub 1 BIT 0 1 FORMAT "%5.3" /end CHARACTERISTIC
/begin CHARACTERISTIC fStFC_UseActiveInertia_XDU8_22___A "Schalter für Aktive Trägheit" VALUE 0x158506 AblGLKWub 1 BIT 0 1 FORMAT "%5.3" /end CHARACTERISTIC
/begin CHARACTERISTIC fStFC_UseActiveInertia_XDU8_23___A "Schalter für Aktive Trägheit" VALUE 0x158507 AblGLKWub 1 BIT 0 1 FORMAT "%5.3" /end CHARACTERISTIC
/begin CHARACTERISTIC fStFC_UseActiveInertia_XDU8_24___A "Schalter für Aktive Trägheit" VALUE 0x158508 AblGLKWub 1 BIT 0 1 FORMAT "%5.3" /end CHARACTERISTIC
/begin CHARACTERISTIC fStFC_UseActiveInertia_XDU8_25___A "Schalter für Aktive Trägheit" VALUE 0x158509 AblGLKWub 1 BIT 0 1 FORMAT "%5.3" /end CHARACTERISTIC
/begin CHARACTERISTIC fStFC_UseActiveInertia_XDU8_26___A "Schalter für Aktive Trägheit" VALUE 0x15850A AblGLKWub 1 BIT 0 1 FORMAT "%5.3" /end CHARACTERISTIC
/begin CHARACTERISTIC fStFC_UseActiveInertia_XDU8_27___A "Schalter für Aktive Trägheit" VALUE 0x15850B AblGLKWub 1 BIT 0 1 FORMAT "%5.3" /end CHARACTERISTIC
/begin CHARACTERISTIC fStFC_UseActiveInertia_XDU8_28___A "Schalter für Aktive Trägheit" VALUE 0x15850C AblGLKWub 1 BIT 0 1 FORMAT "%5.3" /end CHARACTERISTIC
/begin CHARACTERISTIC fStFC_UseActiveInertia_XDU8_29___A "Schalter für Aktive Trägheit" VALUE 0x15850D AblGLKWub 1 BIT 0 1 FORMAT "%5.3" /end CHARACTERISTIC
/begin CHARACTERISTIC fStFC_UseActiveInertia_XDU8_30___A "Schalter für Aktive Trägheit" VALUE 0x15850E AblGLKWub 1 BIT 0 1 FORMAT "%5.3" /end CHARACTERISTIC
/begin CHARACTERISTIC fStFC_UseActiveInertia_XDU8_31___A "Schalter für Aktive Trägheit" VALUE 0x15850F AblGLKWub 1 BIT 0 1 FORMAT "%5.3" /end CHARACTERISTIC
/begin CHARACTERISTIC fStFC_UseActiveInertia_XDU8_32___A "Schalter für Aktive Trägheit" VALUE 0x158510 AblGLKWub 1 BIT 0 1 FORMAT "%5.3" /end CHARACTERISTIC
/begin CHARACTERISTIC fStFC_UseActiveInertia_XDU8_33___A "Schalter für Aktive Trägheit" VALUE 0x158511 AblGLKWub 1 BIT 0 1 FORMAT "%5.3" /end CHARACTERISTIC
/begin CHARACTERISTIC fStFC_UseActiveInertia_XDU8_34___A "Schalter für Aktive Trägheit" VALUE 0x158512 AblGLKWub 1 BIT 0 1 FORMAT "%5.3" /end CHARACTERISTIC
/begin CHARACTERISTIC fStFC_UseActiveInertia_XDU8_35___A "Schalter für Aktive Trägheit" VALUE 0x158513 AblGLKWub 1 BIT 0 1 FORMAT "%5.3" /end CHARACTERISTIC
/begin CHARACTERISTIC fStFC_UseBasicSteerTor_XDU8 "Schalter für Basislenkmoment" VALUE 0x14A0DC AblGLKWub 1 BIT 0 1 FORMAT "%5.3" /end CHARACTERISTIC
/begin CHARACTERISTIC fStFC_UseCenterPointFeel_XDU8_00___A "Schalter für Mittengefühl" VALUE 0x158514 AblGLKWub 1 BIT 0 1 FORMAT "%5.3" /end CHARACTERISTIC
/begin CHARACTERISTIC fStFC_UseCenterPointFeel_XDU8_01___A "Schalter für Mittengefühl" VALUE 0x158515 AblGLKWub 1 BIT 0 1 FORMAT "%5.3" /end CHARACTERISTIC
/begin CHARACTERISTIC fStFC_UseCenterPointFeel_XDU8_02___A "Schalter für Mittengefühl" VALUE 0x158516 AblGLKWub 1 BIT 0 1 FORMAT "%5.3" /end CHARACTERISTIC
/begin CHARACTERISTIC fStFC_UseCenterPointFeel_XDU8_03___A "Schalter für Mittengefühl" VALUE 0x158517 AblGLKWub 1 BIT 0 1 FORMAT "%5.3" /end CHARACTERISTIC
/begin CHARACTERISTIC fStFC_UseCenterPointFeel_XDU8_04___A "Schalter für Mittengefühl" VALUE 0x158518 AblGLKWub 1 BIT 0 1 FORMAT "%5.3" /end CHARACTERISTIC
/begin CHARACTERISTIC fStFC_UseCenterPointFeel_XDU8_05___A "Schalter für Mittengefühl" VALUE 0x158519 AblGLKWub 1 BIT 0 1 FORMAT "%5.3" /end CHARACTERISTIC
/begin CHARACTERISTIC fStFC_UseCenterPointFeel_XDU8_06___A "Schalter für Mittengefühl" VALUE 0x15851A AblGLKWub 1 BIT 0 1 FORMAT "%5.3" /end CHARACTERISTIC
/begin CHARACTERISTIC fStFC_UseCenterPointFeel_XDU8_07___A "Schalter für Mittengefühl" VALUE 0x15851B AblGLKWub 1 BIT 0 1 FORMAT "%5.3" /end CHARACTERISTIC
/begin CHARACTERISTIC fStFC_UseCenterPointFeel_XDU8_08___A "Schalter für Mittengefühl" VALUE 0x15851C AblGLKWub 1 BIT 0 1 FORMAT "%5.3" /end CHARACTERISTIC
/begin CHARACTERISTIC fStFC_UseCenterPointFeel_XDU8_09___A "Schalter für Mittengefühl" VALUE 0x15851D AblGLKWub 1 BIT 0 1 FORMAT "%5.3" /end CHARACTERISTIC
/begin CHARACTERISTIC fStFC_UseCenterPointFeel_XDU8_10___A "Schalter für Mittengefühl" VALUE 0x15851E AblGLKWub 1 BIT 0 1 FORMAT "%5.3" /end CHARACTERISTIC
/begin CHARACTERISTIC fStFC_UseCenterPointFeel_XDU8_11___A "Schalter für Mittengefühl" VALUE 0x15851F AblGLKWub 1 BIT 0 1 FORMAT "%5.3" /end CHARACTERISTIC
/begin CHARACTERISTIC fStFC_UseCenterPointFeel_XDU8_12___A "Schalter für Mittengefühl" VALUE 0x158520 AblGLKWub 1 BIT 0 1 FORMAT "%5.3" /end CHARACTERISTIC
/begin CHARACTERISTIC fStFC_UseCenterPointFeel_XDU8_13___A "Schalter für Mittengefühl" VALUE 0x158521 AblGLKWub 1 BIT 0 1 FORMAT "%5.3" /end CHARACTERISTIC
/begin CHARACTERISTIC fStFC_UseCenterPointFeel_XDU8_14___A "Schalter für Mittengefühl" VALUE 0x158522 AblGLKWub 1 BIT 0 1 FORMAT "%5.3" /end CHARACTERISTIC
/begin CHARACTERISTIC fStFC_UseCenterPointFeel_XDU8_15___A "Schalter für Mittengefühl" VALUE 0x158523 AblGLKWub 1 BIT 0 1 FORMAT "%5.3" /end CHARACTERISTIC
/begin CHARACTERISTIC fStFC_UseCenterPointFeel_XDU8_16___A "Schalter für Mittengefühl" VALUE 0x158524 AblGLKWub 1 BIT 0 1 FORMAT "%5.3" /end CHARACTERISTIC
/begin CHARACTERISTIC fStFC_UseCenterPointFeel_XDU8_17___A "Schalter für Mittengefühl" VALUE 0x158525 AblGLKWub 1 BIT 0 1 FORMAT "%5.3" /end CHARACTERISTIC
/begin CHARACTERISTIC fStFC_UseCenterPointFeel_XDU8_18___A "Schalter für Mittengefühl" VALUE 0x158526 AblGLKWub 1 BIT 0 1 FORMAT "%5.3" /end CHARACTERISTIC
/begin CHARACTERISTIC fStFC_UseCenterPointFeel_XDU8_19___A "Schalter für Mittengefühl" VALUE 0x158527 AblGLKWub 1 BIT 0 1 FORMAT "%5.3" /end CHARACTERISTIC
/begin CHARACTERISTIC fStFC_UseCenterPointFeel_XDU8_20___A "Schalter für Mittengefühl" VALUE 0x158528 AblGLKWub 1 BIT 0 1 FORMAT "%5.3" /end CHARACTERISTIC
/begin CHARACTERISTIC fStFC_UseCenterPointFeel_XDU8_21___A "Schalter für Mittengefühl" VALUE 0x158529 AblGLKWub 1 BIT 0 1 FORMAT "%5.3" /end CHARACTERISTIC
/begin CHARACTERISTIC fStFC_UseCenterPointFeel_XDU8_22___A "Schalter für Mittengefühl" VALUE 0x15852A AblGLKWub 1 BIT 0 1 FORMAT "%5.3" /end CHARACTERISTIC
/begin CHARACTERISTIC fStFC_UseCenterPointFeel_XDU8_23___A "Schalter für Mittengefühl" VALUE 0x15852B AblGLKWub 1 BIT 0 1 FORMAT "%5.3" /end CHARACTERISTIC
/begin CHARACTERISTIC fStFC_UseCenterPointFeel_XDU8_24___A "Schalter für Mittengefühl" VALUE 0x15852C AblGLKWub 1 BIT 0 1 FORMAT "%5.3" /end CHARACTERISTIC
/begin CHARACTERISTIC fStFC_UseCenterPointFeel_XDU8_25___A "Schalter für Mittengefühl" VALUE 0x15852D AblGLKWub 1 BIT 0 1 FORMAT "%5.3" /end CHARACTERISTIC
/begin CHARACTERISTIC fStFC_UseCenterPointFeel_XDU8_26___A "Schalter für Mittengefühl" VALUE 0x15852E AblGLKWub 1 BIT 0 1 FORMAT "%5.3" /end CHARACTERISTIC
/begin CHARACTERISTIC fStFC_UseCenterPointFeel_XDU8_27___A "Schalter für Mittengefühl" VALUE 0x15852F AblGLKWub 1 BIT 0 1 FORMAT "%5.3" /end CHARACTERISTIC
/begin CHARACTERISTIC fStFC_UseCenterPointFeel_XDU8_28___A "Schalter für Mittengefühl" VALUE 0x158530 AblGLKWub 1 BIT 0 1 FORMAT "%5.3" /end CHARACTERISTIC
/begin CHARACTERISTIC fStFC_UseCenterPointFeel_XDU8_29___A "Schalter für Mittengefühl" VALUE 0x158531 AblGLKWub 1 BIT 0 1 FORMAT "%5.3" /end CHARACTERISTIC
/begin CHARACTERISTIC fStFC_UseCenterPointFeel_XDU8_30___A "Schalter für Mittengefühl" VALUE 0x158532 AblGLKWub 1 BIT 0 1 FORMAT "%5.3" /end CHARACTERISTIC
/begin CHARACTERISTIC fStFC_UseCenterPointFeel_XDU8_31___A "Schalter für Mittengefühl" VALUE 0x158533 AblGLKWub 1 BIT 0 1 FORMAT "%5.3" /end CHARACTERISTIC
/begin CHARACTERISTIC fStFC_UseCenterPointFeel_XDU8_32___A "Schalter für Mittengefühl" VALUE 0x158534 AblGLKWub 1 BIT 0 1 FORMAT "%5.3" /end CHARACTERISTIC
/begin CHARACTERISTIC fStFC_UseCenterPointFeel_XDU8_33___A "Schalter für Mittengefühl" VALUE 0x158535 AblGLKWub 1 BIT 0 1 FORMAT "%5.3" /end CHARACTERISTIC
/begin CHARACTERISTIC fStFC_UseCenterPointFeel_XDU8_34___A "Schalter für Mittengefühl" VALUE 0x158536 AblGLKWub 1 BIT 0 1 FORMAT "%5.3" /end CHARACTERISTIC
/begin CHARACTERISTIC fStFC_UseCenterPointFeel_XDU8_35___A "Schalter für Mittengefühl" VALUE 0x158537 AblGLKWub 1 BIT 0 1 FORMAT "%5.3" /end CHARACTERISTIC
/begin CHARACTERISTIC fStFC_UseHysteresis_XDU8_00___A "Schalter für Reibung" VALUE 0x158538 AblGLKWub 1 BIT 0 1 FORMAT "%5.3" /end CHARACTERISTIC
/begin CHARACTERISTIC fStFC_UseHysteresis_XDU8_01___A "Schalter für Reibung" VALUE 0x158539 AblGLKWub 1 BIT 0 1 FORMAT "%5.3" /end CHARACTERISTIC
/begin CHARACTERISTIC fStFC_UseHysteresis_XDU8_02___A "Schalter für Reibung" VALUE 0x15853A AblGLKWub 1 BIT 0 1 FORMAT "%5.3" /end CHARACTERISTIC
/begin CHARACTERISTIC fStFC_UseHysteresis_XDU8_03___A "Schalter für Reibung" VALUE 0x15853B AblGLKWub 1 BIT 0 1 FORMAT "%5.3" /end CHARACTERISTIC
/begin CHARACTERISTIC fStFC_UseHysteresis_XDU8_04___A "Schalter für Reibung" VALUE 0x15853C AblGLKWub 1 BIT 0 1 FORMAT "%5.3" /end CHARACTERISTIC
/begin CHARACTERISTIC fStFC_UseHysteresis_XDU8_05___A "Schalter für Reibung" VALUE 0x15853D AblGLKWub 1 BIT 0 1 FORMAT "%5.3" /end CHARACTERISTIC
/begin CHARACTERISTIC fStFC_UseHysteresis_XDU8_06___A "Schalter für Reibung" VALUE 0x15853E AblGLKWub 1 BIT 0 1 FORMAT "%5.3" /end CHARACTERISTIC
/begin CHARACTERISTIC fStFC_UseHysteresis_XDU8_07___A "Schalter für Reibung" VALUE 0x15853F AblGLKWub 1 BIT 0 1 FORMAT "%5.3" /end CHARACTERISTIC
/begin CHARACTERISTIC fStFC_UseHysteresis_XDU8_08___A "Schalter für Reibung" VALUE 0x158540 AblGLKWub 1 BIT 0 1 FORMAT "%5.3" /end CHARACTERISTIC
/begin CHARACTERISTIC fStFC_UseHysteresis_XDU8_09___A "Schalter für Reibung" VALUE 0x158541 AblGLKWub 1 BIT 0 1 FORMAT "%5.3" /end CHARACTERISTIC
/begin CHARACTERISTIC fStFC_UseHysteresis_XDU8_10___A "Schalter für Reibung" VALUE 0x158542 AblGLKWub 1 BIT 0 1 FORMAT "%5.3" /end CHARACTERISTIC
/begin CHARACTERISTIC fStFC_UseHysteresis_XDU8_11___A "Schalter für Reibung" VALUE 0x158543 AblGLKWub 1 BIT 0 1 FORMAT "%5.3" /end CHARACTERISTIC
/begin CHARACTERISTIC fStFC_UseHysteresis_XDU8_12___A "Schalter für Reibung" VALUE 0x158544 AblGLKWub 1 BIT 0 1 FORMAT "%5.3" /end CHARACTERISTIC
/begin CHARACTERISTIC fStFC_UseHysteresis_XDU8_13___A "Schalter für Reibung" VALUE 0x158545 AblGLKWub 1 BIT 0 1 FORMAT "%5.3" /end CHARACTERISTIC
/begin CHARACTERISTIC fStFC_UseHysteresis_XDU8_14___A "Schalter für Reibung" VALUE 0x158546 AblGLKWub 1 BIT 0 1 FORMAT "%5.3" /end CHARACTERISTIC
/begin CHARACTERISTIC fStFC_UseHysteresis_XDU8_15___A "Schalter für Reibung" VALUE 0x158547 AblGLKWub 1 BIT 0 1 FORMAT "%5.3" /end CHARACTERISTIC
/begin CHARACTERISTIC fStFC_UseHysteresis_XDU8_16___A "Schalter für Reibung" VALUE 0x158548 AblGLKWub 1 BIT 0 1 FORMAT "%5.3" /end CHARACTERISTIC
/begin CHARACTERISTIC fStFC_UseHysteresis_XDU8_17___A "Schalter für Reibung" VALUE 0x158549 AblGLKWub 1 BIT 0 1 FORMAT "%5.3" /end CHARACTERISTIC
/begin CHARACTERISTIC fStFC_UseHysteresis_XDU8_18___A "Schalter für Reibung" VALUE 0x15854A AblGLKWub 1 BIT 0 1 FORMAT "%5.3" /end CHARACTERISTIC
/begin CHARACTERISTIC fStFC_UseHysteresis_XDU8_19___A "Schalter für Reibung" VALUE 0x15854B AblGLKWub 1 BIT 0 1 FORMAT "%5.3" /end CHARACTERISTIC
/begin CHARACTERISTIC fStFC_UseHysteresis_XDU8_20___A "Schalter für Reibung" VALUE 0x15854C AblGLKWub 1 BIT 0 1 FORMAT "%5.3" /end CHARACTERISTIC
/begin CHARACTERISTIC fStFC_UseHysteresis_XDU8_21___A "Schalter für Reibung" VALUE 0x15854D AblGLKWub 1 BIT 0 1 FORMAT "%5.3" /end CHARACTERISTIC
/begin CHARACTERISTIC fStFC_UseHysteresis_XDU8_22___A "Schalter für Reibung" VALUE 0x15854E AblGLKWub 1 BIT 0 1 FORMAT "%5.3" /end CHARACTERISTIC
/begin CHARACTERISTIC fStFC_UseHysteresis_XDU8_23___A "Schalter für Reibung" VALUE 0x15854F AblGLKWub 1 BIT 0 1 FORMAT "%5.3" /end CHARACTERISTIC
/begin CHARACTERISTIC fStFC_UseHysteresis_XDU8_24___A "Schalter für Reibung" VALUE 0x158550 AblGLKWub 1 BIT 0 1 FORMAT "%5.3" /end CHARACTERISTIC
/begin CHARACTERISTIC fStFC_UseHysteresis_XDU8_25___A "Schalter für Reibung" VALUE 0x158551 AblGLKWub 1 BIT 0 1 FORMAT "%5.3" /end CHARACTERISTIC
/begin CHARACTERISTIC fStFC_UseHysteresis_XDU8_26___A "Schalter für Reibung" VALUE 0x158552 AblGLKWub 1 BIT 0 1 FORMAT "%5.3" /end CHARACTERISTIC
/begin CHARACTERISTIC fStFC_UseHysteresis_XDU8_27___A "Schalter für Reibung" VALUE 0x158553 AblGLKWub 1 BIT 0 1 FORMAT "%5.3" /end CHARACTERISTIC
/begin CHARACTERISTIC fStFC_UseHysteresis_XDU8_28___A "Schalter für Reibung" VALUE 0x158554 AblGLKWub 1 BIT 0 1 FORMAT "%5.3" /end CHARACTERISTIC
/begin CHARACTERISTIC fStFC_UseHysteresis_XDU8_29___A "Schalter für Reibung" VALUE 0x158555 AblGLKWub 1 BIT 0 1 FORMAT "%5.3" /end CHARACTERISTIC
/begin CHARACTERISTIC fStFC_UseHysteresis_XDU8_30___A "Schalter für Reibung" VALUE 0x158556 AblGLKWub 1 BIT 0 1 FORMAT "%5.3" /end CHARACTERISTIC
/begin CHARACTERISTIC fStFC_UseHysteresis_XDU8_31___A "Schalter für Reibung" VALUE 0x158557 AblGLKWub 1 BIT 0 1 FORMAT "%5.3" /end CHARACTERISTIC
/begin CHARACTERISTIC fStFC_UseHysteresis_XDU8_32___A "Schalter für Reibung" VALUE 0x158558 AblGLKWub 1 BIT 0 1 FORMAT "%5.3" /end CHARACTERISTIC
/begin CHARACTERISTIC fStFC_UseHysteresis_XDU8_33___A "Schalter für Reibung" VALUE 0x158559 AblGLKWub 1 BIT 0 1 FORMAT "%5.3" /end CHARACTERISTIC
/begin CHARACTERISTIC fStFC_UseHysteresis_XDU8_34___A "Schalter für Reibung" VALUE 0x15855A AblGLKWub 1 BIT 0 1 FORMAT "%5.3" /end CHARACTERISTIC
/begin CHARACTERISTIC fStFC_UseHysteresis_XDU8_35___A "Schalter für Reibung" VALUE 0x15855B AblGLKWub 1 BIT 0 1 FORMAT "%5.3" /end CHARACTERISTIC
/begin CHARACTERISTIC fStTorCtrlP_EnableIfEndstopIsInvalid_XDB "Enable controller in case of DistanceToEndstop is not available" VALUE 0x150AD3 AblGLKWub 1 BIT 0 1 FORMAT "%5.3" /end CHARACTERISTIC
/begin CHARACTERISTIC fTsc_CustomerTypeA_provides_TBTred_XDU8 "2ter CustomerTypeA TBT Kanal vorhanden" VALUE 0x150AD4 AblGLKWub 1 ZU0 0 1 FORMAT "%5.3" /end CHARACTERISTIC
/begin CHARACTERISTIC fTsc_DisableTscLimitation_XDU8 "" VALUE 0x150AD5 AblGLKWub 1 ZU0 0 1 FORMAT "%5.3" /end CHARACTERISTIC
/begin CHARACTERISTIC fTsc_DualDMS_provides_TBTred_XDU8 "2ter DualDMS TBT Kanal vorhanden" VALUE 0x150AD6 AblGLKWub 1 ZU0 0 1 FORMAT "%5.3" /end CHARACTERISTIC
/begin CHARACTERISTIC fTsc_DualMMT_provides_TBTred_XDU8 "2ter DualMMT TBT Kanal vorhanden" VALUE 0x150AD7 AblGLKWub 1 ZU0 0 1 FORMAT "%5.3" /end CHARACTERISTIC
/begin CHARACTERISTIC fTsc_EnableAtlowDyn_XDU8 "Enable Extrapol to future only at low dyn" VALUE 0x150AD8 AblGLKWub 1 ZU0 0 1 FORMAT "%5.3" /end CHARACTERISTIC
/begin CHARACTERISTIC fTsc_OtherSensor_provides_TBTred_XDU8 "2ter TBT Kanal vorhanden" VALUE 0x150AD9 AblGLKWub 1 ZU0 0 1 FORMAT "%5.3" /end CHARACTERISTIC
/begin CHARACTERISTIC fTsc_SingleDMS_provides_TBTred_XDU8 "2ter SingleDMS TBT Kanal vorhanden" VALUE 0x150ADA AblGLKWub 1 ZU0 0 1 FORMAT "%5.3" /end CHARACTERISTIC
/begin CHARACTERISTIC fTsc_SingleMMT_provides_TBTred_XDU8 "2ter SingleMMTTBT Kanal vorhanden" VALUE 0x150ADB AblGLKWub 1 ZU0 0 1 FORMAT "%5.3" /end CHARACTERISTIC
/begin CHARACTERISTIC fTsc_Use_GradXtplTBT_XDU8 "mApplI_GradTorsionBarTorque_xds16 = (0:mTsc_FiltGradTBT_xds16, 1:mTsc_FiltGradXtplTBT_xds16)" VALUE 0x150ADC AblGLKWub 1 ZU0 0 1 FORMAT "%5.3" /end CHARACTERISTIC
/begin CHARACTERISTIC fWlc_DevSWWarningsActive_XDU8 "Anschalten von Warnlampe bei verfuegbarem VX1000 oder FIT SW" VALUE 0x150ADD AblGLKWub 1 ZU0 0 1 FORMAT "%5.3" /end CHARACTERISTIC
/begin CHARACTERISTIC jsyInvSteeringRatio_XDU16_0__A "1/Lenkübersetzung * 2^15" VALUE 0x158060 AblGLKWuw 2100 ZU0 900 3000 FORMAT "%8.3" /end CHARACTERISTIC
/begin CHARACTERISTIC jsyInvSteeringRatio_XDU16_1__A "1/Lenkübersetzung * 2^15" VALUE 0x158062 AblGLKWuw 2100 ZU0 900 3000 FORMAT "%8.3" /end CHARACTERISTIC
/begin CHARACTERISTIC mLa_MotorTorqueDepOnTBTV0_XAU16 "torque factor of lane assist depending on driver torque at V0" CURVE 0x1512AC AblGLKLuw 6 RIGHTSH10NP 0 6 FORMAT "%8.6"
 /begin AXIS_DESCR STD_AXIS mApplI_AbsDriverTorque_xdu16 TBTHIGH 6 0 8 FORMAT "%8.6" DEPOSIT ABSOLUTE /end AXIS_DESCR
/end CHARACTERISTIC
/begin CHARACTERISTIC mLa_MotorTorqueDepOnTBTV1_XAU16 "torque factor of lane assist depending on driver torque at V1" CURVE 0x1512C8 AblGLKLuw 5 RIGHTSH10NP 0 5 FORMAT "%8.6"
 /begin AXIS_DESCR STD_AXIS mApplI_AbsDriverTorque_xdu16 TBTHIGH 6 0 8 FORMAT "%8.6" DEPOSIT ABSOLUTE /end AXIS_DESCR
/end CHARACTERISTIC
/begin CHARACTERISTIC mLa_MotorTorqueDepOnTBTV2_XAU16 "torque factor of lane assist depending on driver torque at V2" CURVE 0x1512E4 AblGLKLuw 5 RIGHTSH10NP 0 5 FORMAT "%8.6"
 /begin AXIS_DESCR STD_AXIS mApplI_AbsDriverTorque_xdu16 TBTHIGH 6 0 8 FORMAT "%8.6" DEPOSIT ABSOLUTE /end AXIS_DESCR
/end CHARACTERISTIC
/begin CHARACTERISTIC mLa_MotorTorqueDepOnTBTV3_XAU16 "torque factor of lane assist depending on driver torque at V3" CURVE 0x151300 AblGLKLuw 5 RIGHTSH10NP 0 5 FORMAT "%8.6"
 /begin AXIS_DESCR STD_AXIS mApplI_AbsDriverTorque_xdu16 TBTHIGH 6 0 8 FORMAT "%8.6" DEPOSIT ABSOLUTE /end AXIS_DESCR
/end CHARACTERISTIC
/begin CHARACTERISTIC mLa_MotorTorqueDepOnTBTV4_XAU16 "factor of lane keep assist torque depending on driver torque at V4" CURVE 0x15131C AblGLKLuw 5 RIGHTSH10NP 0 5 FORMAT "%8.6"
 /begin AXIS_DESCR STD_AXIS mApplI_AbsDriverTorque_xdu16 TBTHIGH 6 0 8 FORMAT "%8.6" DEPOSIT ABSOLUTE /end AXIS_DESCR
/end CHARACTERISTIC
/begin CHARACTERISTIC mLa_MotorTorqueDepOnTBTV5_XAU16 "factor of lane keep assist torque depending on driver torque at V5" CURVE 0x151338 AblGLKLuw 5 RIGHTSH10NP 0 5 FORMAT "%8.6"
 /begin AXIS_DESCR STD_AXIS mApplI_AbsDriverTorque_xdu16 TBTHIGH 6 0 8 FORMAT "%8.6" DEPOSIT ABSOLUTE /end AXIS_DESCR
/end CHARACTERISTIC
/begin CHARACTERISTIC MosfetTemp_Reduction_Threshold_XDU16 "MosfetTemp Reduction Thresold" VALUE 0x15065E AblGLKWuw 1 RIGHTSH15NP 0 1 FORMAT "%8.6" /end CHARACTERISTIC
/begin CHARACTERISTIC MotorTemp_Reduction_Threshold_XDU16 "MotorTemp Reduction Thresold" VALUE 0x150660 AblGLKWuw 1 RIGHTSH15NP 0 1 FORMAT "%8.6" /end CHARACTERISTIC
/begin CHARACTERISTIC mSteerCtrl_DOffsetDeadband_XDU16 "dead band D-part offset (due to TorsionBarTorqueGradient)" VALUE 0x150696 AblGLKWuw 2 MMOT 0 2 FORMAT "%8.6" /end CHARACTERISTIC
/begin CHARACTERISTIC mStTorCtrlP_AlternativeMMotMaxDepOnVFZ_XDU16 "substitute value of mStTorCtrlP_MMotMax_XAU16 in case of invalid vehicle speed" VALUE 0x15069A AblGLKWuw 10 MMOT 0 10 FORMAT "%8.5" /end CHARACTERISTIC
/begin CHARACTERISTIC mStTorCtrlP_ChatterMMotMax_XAU16 "maximum motor torque dependent on chatter period counts" CURVE 0x1513CC AblGLKLuw 10 MMOT 0 10 FORMAT "%8.5"
 /begin AXIS_DESCR STD_AXIS zcrChatterPeriodsCount_xdu8 ZU0 3 0 20 FORMAT "%5.2" DEPOSIT ABSOLUTE /end AXIS_DESCR
/end CHARACTERISTIC
/begin CHARACTERISTIC mStTorCtrlP_DistanceToEndstopMMotMax_XAS16 "maximum motor torque dependent on distance to EndStop" CURVE 0x1513DC AblGLKLsw 10 MMOT 0 10 FORMAT "%8.5"
 /begin AXIS_DESCR STD_AXIS lEndStopI_DistanceToEndstop_xds16 RACKPOS128 3 0 100 FORMAT "%8.4" DEPOSIT ABSOLUTE /end AXIS_DESCR
/end CHARACTERISTIC
/begin CHARACTERISTIC mStTorCtrlP_MMotMax_XAU16_0___A "maximum motor torque dependent on vehicle speed" CURVE 0x15B904 AblGLKLuw 10 MMOT 0 10 FORMAT "%8.5"
 /begin AXIS_DESCR STD_AXIS vVehSpI_AbsAvgVehSpd_xdu16 VFZHIGH 3 0 400 FORMAT "%8.4" DEPOSIT ABSOLUTE /end AXIS_DESCR
/end CHARACTERISTIC
/begin CHARACTERISTIC mStTorCtrlP_MMotMax_XAU16_1___A "maximum motor torque dependent on vehicle speed" CURVE 0x15B914 AblGLKLuw 10 MMOT 0 10 FORMAT "%8.5"
 /begin AXIS_DESCR STD_AXIS vVehSpI_AbsAvgVehSpd_xdu16 VFZHIGH 3 0 400 FORMAT "%8.4" DEPOSIT ABSOLUTE /end AXIS_DESCR
/end CHARACTERISTIC
/begin CHARACTERISTIC mStTorCtrlP_MMotMax_XAU16_2___A "maximum motor torque dependent on vehicle speed" CURVE 0x15B924 AblGLKLuw 10 MMOT 0 10 FORMAT "%8.5"
 /begin AXIS_DESCR STD_AXIS vVehSpI_AbsAvgVehSpd_xdu16 VFZHIGH 3 0 400 FORMAT "%8.4" DEPOSIT ABSOLUTE /end AXIS_DESCR
/end CHARACTERISTIC
/begin CHARACTERISTIC mStTorCtrlP_MMotMax_XAU16_3___A "maximum motor torque dependent on vehicle speed" CURVE 0x15B934 AblGLKLuw 10 MMOT 0 10 FORMAT "%8.5"
 /begin AXIS_DESCR STD_AXIS vVehSpI_AbsAvgVehSpd_xdu16 VFZHIGH 3 0 400 FORMAT "%8.4" DEPOSIT ABSOLUTE /end AXIS_DESCR
/end CHARACTERISTIC
/begin CHARACTERISTIC mStTorCtrlP_MMotMax_XAU16_4___A "maximum motor torque dependent on vehicle speed" CURVE 0x15B944 AblGLKLuw 10 MMOT 0 10 FORMAT "%8.5"
 /begin AXIS_DESCR STD_AXIS vVehSpI_AbsAvgVehSpd_xdu16 VFZHIGH 3 0 400 FORMAT "%8.4" DEPOSIT ABSOLUTE /end AXIS_DESCR
/end CHARACTERISTIC
/begin CHARACTERISTIC mStTorCtrlP_MMotMax_XAU16_5___A "maximum motor torque dependent on vehicle speed" CURVE 0x15B954 AblGLKLuw 10 MMOT 0 10 FORMAT "%8.5"
 /begin AXIS_DESCR STD_AXIS vVehSpI_AbsAvgVehSpd_xdu16 VFZHIGH 3 0 400 FORMAT "%8.4" DEPOSIT ABSOLUTE /end AXIS_DESCR
/end CHARACTERISTIC
/begin CHARACTERISTIC msyAbsTorsionBarTorque_XDU16 "Absolutes Drehmomentlimit" VALUE 0x15069C AblGLKWuw 7 TBTHIGH 3 10 FORMAT "%8.5" /end CHARACTERISTIC
/begin CHARACTERISTIC mtrcMaxTorGradVehicleMoving_XDU16 "max. Momentengradient wenn Fahrzeug fährt oder bei Fehler Fahrzeuggeschwindigkeit" VALUE 0x15069E AblGLKWuw 2.49902 TORGRAD 0.0009765625 2.5 FORMAT "%8.6" /end CHARACTERISTIC
/begin CHARACTERISTIC mtrcMaxTorGradVehicleStanding_XDU16 "max. Momentengradient wenn Fahrzeug steht" VALUE 0x1506A0 AblGLKWuw 2.49902 TORGRAD 0.0009765625 2.5 FORMAT "%8.6" /end CHARACTERISTIC
/begin CHARACTERISTIC mTsc_DeadZoneExtrapolGrad_XAU16 "fahrzeuggeschwindigkeitsanh?ngige Extrapolations-TBTdiff-Deadzone" CURVE 0x1513EC AblGLKLuw 0.0996094 TORGRAD 0 0.09960938 FORMAT "%9.7"
 /begin AXIS_DESCR STD_AXIS vTsc_AbsVehicleSpeedFilt4Interpol_xdu16 VFZHIGH 4 0 255 FORMAT "%8.4" DEPOSIT ABSOLUTE /end AXIS_DESCR
/end CHARACTERISTIC
/begin CHARACTERISTIC mTsc_HysteresisTBT_XAU16 "DeadZone TBT Grad: characteristic field dependent on VehicleSpeed and RotorSpeed" MAP 0x151400 AblGLKFuw 0.0996094 TBTHIGH 0 0.09960938 FORMAT "%9.7"
 /begin AXIS_DESCR STD_AXIS vTsc_AbsVehicleSpeedFilt4Interpol_xdu16 VFZHIGH 3 0 500 FORMAT "%8.4" DEPOSIT ABSOLUTE /end AXIS_DESCR
 /begin AXIS_DESCR STD_AXIS nApplI_AbsRotorSpeedFilt_xdu16 VROT 4 0 13000 FORMAT "%3.0" DEPOSIT ABSOLUTE /end AXIS_DESCR
/end CHARACTERISTIC
/begin CHARACTERISTIC mTsc_IntegralDeviationThreshold_XDU16 " " VALUE 0x1506A2 AblGLKWuw 59 TBTHIGH 1 60 FORMAT "%8.5" /end CHARACTERISTIC
/begin CHARACTERISTIC mTsc_LimitationThreshold_XAU16 "fahrzeuggeschwindigkeitsanh?ngiger Extrapolations-Faktor" CURVE 0x151428 AblGLKLuw 1 TBTHIGH 0 1 FORMAT "%8.6"
 /begin AXIS_DESCR STD_AXIS vTsc_AbsVehicleSpeedFilt4Interpol_xdu16 VFZHIGH 5 0 255 FORMAT "%8.4" DEPOSIT ABSOLUTE /end AXIS_DESCR
/end CHARACTERISTIC
/begin CHARACTERISTIC mTsc_MaxAllowedTBTDiff_XDU16 "Maximal erlaubte Abweiung zwischen den beiden Momentensensorsignalen" VALUE 0x1506A4 AblGLKWuw 50 TBTHIGH 0 50 FORMAT "%8.5" /end CHARACTERISTIC
/begin CHARACTERISTIC mTsc_MaxMMotLowDyn_XDU16 "Maximales Motormoment bis zu dem von niedriger Lenkdynamik ausgegangen wird." VALUE 0x1506A6 AblGLKWuw 20 MMOT 0 20 FORMAT "%8.5" /end CHARACTERISTIC
/begin CHARACTERISTIC mTsc_MaxTBTLowDyn_XDU16 "Maximales Drehstabmoment bis zu dem von niedriger Lenkdynamik ausgegangen wird." VALUE 0x1506A8 AblGLKWuw 20 MMOT 0 20 FORMAT "%8.5" /end CHARACTERISTIC
/begin CHARACTERISTIC mTsf_MaxTorqValueCheck_XDU16 "max erlaubtes Fehlermoment" VALUE 0x1506AA AblGLKWuw 1.20019 MMOT 0 1.200195 FORMAT "%8.6" /end CHARACTERISTIC
/begin CHARACTERISTIC mTsf_MaxTorqValue_XDU16 "max allowed error motor torq from HWL" VALUE 0x1506AC AblGLKWuw 1.20019 MMOT 0 1.200195 FORMAT "%8.6" /end CHARACTERISTIC
/begin CHARACTERISTIC mUnSt_LimitMMotOffset_XDU16 "limit of UnSt steering torque offset" VALUE 0x1506AE AblGLKWuw 1 MMOT 0 1 FORMAT "%8.6" /end CHARACTERISTIC
/begin CHARACTERISTIC mUnSt_LimitTBTOffset_XDU16 "limit of UnSt steering torque offset" VALUE 0x1506B0 AblGLKWuw 3 TBTHIGH 0 3 FORMAT "%8.6" /end CHARACTERISTIC
/begin CHARACTERISTIC mUnSt_SafetyLimitSteeringTorqueOffset_XDU16 "Safety limit Handmomentenoffset" VALUE 0x1506B2 AblGLKWuw 3 TBTHIGH 0 3 FORMAT "%8.6" /end CHARACTERISTIC
/begin CHARACTERISTIC mUnSt_WeightingDriverTorque_XAU16 "Gewichtung Drivertorque" CURVE 0x151440 AblGLKLuw 8 TBTHIGH 0 8 FORMAT "%8.6"
 /begin AXIS_DESCR STD_AXIS mApplI_AbsDriverTorque_xdu16 TBTHIGH 8 0 8 FORMAT "%8.6" DEPOSIT ABSOLUTE /end AXIS_DESCR
/end CHARACTERISTIC
/begin CHARACTERISTIC nTsc_MaxRotSpdLowDyn_XDU16 "Maximale Rotorgeschwindigkeit bis zu der von niedriger Lenkdynamik ausgegangen wird." VALUE 0x1506DE AblGLKWuw 13000 VROT 0 13000 FORMAT "%3.0" /end CHARACTERISTIC
/begin CHARACTERISTIC Red_Level_Threshold_Yellow_Off_XDU16 "Redution level thresold to turn the Yellow light Off" VALUE 0x1506E0 AblGLKWuw 1 RIGHTSH15NP 0 1 FORMAT "%8.6" /end CHARACTERISTIC
/begin CHARACTERISTIC Red_Level_Threshold_Yellow_On_XDU16 "Redution level thresold to turn the Yellow light On" VALUE 0x1506E2 AblGLKWuw 1 RIGHTSH15NP 0 1 FORMAT "%8.6" /end CHARACTERISTIC
/begin CHARACTERISTIC sTest_ChannelNoReq_XDU8 "" VALUE 0x1506F4 AblGLKWuw 10 ZU0 0 10 FORMAT "%8.5" /end CHARACTERISTIC
/begin CHARACTERISTIC sTest_ChannelNoValidityReq_XDU8 "" VALUE 0x1506F6 AblGLKWuw 15 ZU0 0 15 FORMAT "%8.5" /end CHARACTERISTIC
/begin CHARACTERISTIC sTest_FeatureState_XDU8 "" VALUE 0x1506F8 AblGLKWuw 5 ZU0 0 5 FORMAT "%8.6" /end CHARACTERISTIC
/begin CHARACTERISTIC tTscI_NominalTaskTimeDiff_us_XDU16 "nominelle Taskzeit" VALUE 0x1507DE AblGLKWuw 4000 TIMUS 1000 5000 FORMAT "%8.3" /end CHARACTERISTIC
/begin CHARACTERISTIC tTsc_DeadZonThreshold_XDU16 "Dead Zone" VALUE 0x1507E0 AblGLKWuw 30000 TIMUS 0 30000 FORMAT "%8.2" /end CHARACTERISTIC
/begin CHARACTERISTIC tTsc_DebounceTimeLowDyn_XDU8 "debounce time for persistent low dyn" VALUE 0x150B25 AblGLKWub 249 TIMMS 1 250 FORMAT "%5.1" /end CHARACTERISTIC
/begin CHARACTERISTIC tTsc_ErrorFilterTimeout_XDU16 " " VALUE 0x1507E2 AblGLKWuw 2499 TIMMS 1 2500 FORMAT "%8.3" /end CHARACTERISTIC
/begin CHARACTERISTIC tTsc_MaxAllowedTime_XDU16 "Maximal erlaubte Zeit der Grenzwertüberschreitung" VALUE 0x1507E4 AblGLKWuw 60000 TIMMS 0 60000 FORMAT "%8.2" /end CHARACTERISTIC
/begin CHARACTERISTIC tTsc_ResetIntDevTime_XDU16 " " VALUE 0x1507E6 AblGLKWuw 2499 TIMMS 1 2500 FORMAT "%8.3" /end CHARACTERISTIC
/begin CHARACTERISTIC tTsc_SystemDelay_us_XDU16 "System Delay Zeit" VALUE 0x1507E8 AblGLKWuw 10000 TIMUS 0 10000 FORMAT "%8.2" /end CHARACTERISTIC
/begin CHARACTERISTIC tTsc_UVRecoverWaitTimer_XDU8 "Max time To recoverd disable averaging" VALUE 0x150B26 AblGLKWub 199 TIMMS 1 200 FORMAT "%5.1" /end CHARACTERISTIC
/begin CHARACTERISTIC tTsf_ConstTorqueTimeout_XDU8 "Zeitzyklus des Checks für MMot" VALUE 0x150B27 AblGLKWub 0.02 TIMSEC_1000 0 0.02 FORMAT "%7.5" /end CHARACTERISTIC
/begin CHARACTERISTIC Undervolt_Reduction_Threshold_XDU16 "Undervolt Reduction Thresold" VALUE 0x150800 AblGLKWuw 1 RIGHTSH15NP 0 1 FORMAT "%8.6" /end CHARACTERISTIC
/begin CHARACTERISTIC vDthrCtrl_MaxPlaVehSpeed_XDU16 "Maximale PLA Geschwindigkeit" VALUE 0x150842 AblGLKWuw 511 VFZHIGH 0 511 FORMAT "%8.4" /end CHARACTERISTIC
/begin CHARACTERISTIC vSteerCtrl_MaxVehSpeedRedDueChatter_XDU16 "maximum vehicle speed to 'SetTorqueRedLevel' due to chattering" VALUE 0x15089E AblGLKWuw 255 VFZHIGH 0 255 FORMAT "%8.4" /end CHARACTERISTIC
/begin CHARACTERISTIC vSteerCtrl_SubstituteSpeed_XDU16 "substitute value for vehicle speed interpolation" VALUE 0x1508A0 AblGLKWuw 500 VFZHIGH 0 500 FORMAT "%8.4" /end CHARACTERISTIC
/begin CHARACTERISTIC vTsc_SubstituteSpeed_XDU16 "substitute value for vehicle speed interpolation" VALUE 0x1508B0 AblGLKWuw 500 VFZHIGH 0 500 FORMAT "%8.4" /end CHARACTERISTIC
/begin CHARACTERISTIC vVehSp_MaxSpeedDiff4NormalDriving_XDU16 "Maximale Differenz zwischen kleinster und größter Radgeschwindigkeit bei der normale Fahrt erkannt wird und somit die Fahrzeuggeschwindigkeit aus dem Durchschnitt aller Radgeschwindigkeiten gebildet wird" VALUE 0x1508B4 AblGLKWuw 500 VFZHIGH 0 500 FORMAT "%8.4" /end CHARACTERISTIC
/begin CHARACTERISTIC vVehSp_TolMaxSpeedDiff4NormalDriving_XDU8 "Additional tolerance offset on calculated max difference between min/max wheel speeds" VALUE 0x150B33 AblGLKWub 3.984 VFZHIGH 0 3.984 FORMAT "%5.3" /end CHARACTERISTIC
/begin CHARACTERISTIC wTsf_SteeringAngleDeactvnThdCheck_XDU16 "SteeringAngle threshold for deactivation of TorqueSensorFallback (Wert muss = wTsf_SteeringAngleDeactvnThd_XDU16 in TsfMain" VALUE 0x150932 AblGLKWuw 1000 SA_10 0 1000 FORMAT "%8.3" /end CHARACTERISTIC
/begin CHARACTERISTIC wTsf_SteeringAngleDeactvnThd_XDU16 "SteeringAngle threshold for deactivation of TorqueSensorFallback" VALUE 0x150934 AblGLKWuw 1000 SA_10 0 1000 FORMAT "%8.3" /end CHARACTERISTIC
/begin CHARACTERISTIC xSteerCtrl_ChatterReduction_XAU16 "reduction level in dependency of chatter cycles counter" CURVE 0x1519C8 AblGLKLuw 1 RIGHTSH15NP 0 1 FORMAT "%8.6"
 /begin AXIS_DESCR STD_AXIS zcrChatterPeriodsCount_xdu8 ZU0 4 0 255 FORMAT "%5.1" DEPOSIT ABSOLUTE /end AXIS_DESCR
/end CHARACTERISTIC
/begin CHARACTERISTIC xSteerCtrl_DOffsetFactorEndStop_XAU16_00___A "fahrzeuggeschwindigkeitsanhängiger D-Offset-Faktor am Endanschlag (unabhaengig RotorSpeed)" CURVE 0x15F6B4 AblGLKLuw 5 DFACTHIGH 0 5 FORMAT "%8.6"
 /begin AXIS_DESCR STD_AXIS vSteerCtrl_AbsVehicleSpeedFilt4Interpol_xdu16 VFZHIGH 4 0 255 FORMAT "%8.4" DEPOSIT ABSOLUTE /end AXIS_DESCR
/end CHARACTERISTIC
/begin CHARACTERISTIC xSteerCtrl_DOffsetFactorEndStop_XAU16_01___A "fahrzeuggeschwindigkeitsanhängiger D-Offset-Faktor am Endanschlag (unabhaengig RotorSpeed)" CURVE 0x15F6C8 AblGLKLuw 5 DFACTHIGH 0 5 FORMAT "%8.6"
 /begin AXIS_DESCR STD_AXIS vSteerCtrl_AbsVehicleSpeedFilt4Interpol_xdu16 VFZHIGH 4 0 255 FORMAT "%8.4" DEPOSIT ABSOLUTE /end AXIS_DESCR
/end CHARACTERISTIC
/begin CHARACTERISTIC xSteerCtrl_DOffsetFactorEndStop_XAU16_02___A "fahrzeuggeschwindigkeitsanhängiger D-Offset-Faktor am Endanschlag (unabhaengig RotorSpeed)" CURVE 0x15F6DC AblGLKLuw 5 DFACTHIGH 0 5 FORMAT "%8.6"
 /begin AXIS_DESCR STD_AXIS vSteerCtrl_AbsVehicleSpeedFilt4Interpol_xdu16 VFZHIGH 4 0 255 FORMAT "%8.4" DEPOSIT ABSOLUTE /end AXIS_DESCR
/end CHARACTERISTIC
/begin CHARACTERISTIC xSteerCtrl_DOffsetFactorEndStop_XAU16_03___A "fahrzeuggeschwindigkeitsanhängiger D-Offset-Faktor am Endanschlag (unabhaengig RotorSpeed)" CURVE 0x15F6F0 AblGLKLuw 5 DFACTHIGH 0 5 FORMAT "%8.6"
 /begin AXIS_DESCR STD_AXIS vSteerCtrl_AbsVehicleSpeedFilt4Interpol_xdu16 VFZHIGH 4 0 255 FORMAT "%8.4" DEPOSIT ABSOLUTE /end AXIS_DESCR
/end CHARACTERISTIC
/begin CHARACTERISTIC xSteerCtrl_DOffsetFactorEndStop_XAU16_04___A "fahrzeuggeschwindigkeitsanhängiger D-Offset-Faktor am Endanschlag (unabhaengig RotorSpeed)" CURVE 0x15F704 AblGLKLuw 5 DFACTHIGH 0 5 FORMAT "%8.6"
 /begin AXIS_DESCR STD_AXIS vSteerCtrl_AbsVehicleSpeedFilt4Interpol_xdu16 VFZHIGH 4 0 255 FORMAT "%8.4" DEPOSIT ABSOLUTE /end AXIS_DESCR
/end CHARACTERISTIC
/begin CHARACTERISTIC xSteerCtrl_DOffsetFactorEndStop_XAU16_05___A "fahrzeuggeschwindigkeitsanhängiger D-Offset-Faktor am Endanschlag (unabhaengig RotorSpeed)" CURVE 0x15F718 AblGLKLuw 5 DFACTHIGH 0 5 FORMAT "%8.6"
 /begin AXIS_DESCR STD_AXIS vSteerCtrl_AbsVehicleSpeedFilt4Interpol_xdu16 VFZHIGH 4 0 255 FORMAT "%8.4" DEPOSIT ABSOLUTE /end AXIS_DESCR
/end CHARACTERISTIC
/begin CHARACTERISTIC xSteerCtrl_DOffsetFactorEndStop_XAU16_06___A "fahrzeuggeschwindigkeitsanhängiger D-Offset-Faktor am Endanschlag (unabhaengig RotorSpeed)" CURVE 0x15F72C AblGLKLuw 5 DFACTHIGH 0 5 FORMAT "%8.6"
 /begin AXIS_DESCR STD_AXIS vSteerCtrl_AbsVehicleSpeedFilt4Interpol_xdu16 VFZHIGH 4 0 255 FORMAT "%8.4" DEPOSIT ABSOLUTE /end AXIS_DESCR
/end CHARACTERISTIC
/begin CHARACTERISTIC xSteerCtrl_DOffsetFactorEndStop_XAU16_07___A "fahrzeuggeschwindigkeitsanhängiger D-Offset-Faktor am Endanschlag (unabhaengig RotorSpeed)" CURVE 0x15F740 AblGLKLuw 5 DFACTHIGH 0 5 FORMAT "%8.6"
 /begin AXIS_DESCR STD_AXIS vSteerCtrl_AbsVehicleSpeedFilt4Interpol_xdu16 VFZHIGH 4 0 255 FORMAT "%8.4" DEPOSIT ABSOLUTE /end AXIS_DESCR
/end CHARACTERISTIC
/begin CHARACTERISTIC xSteerCtrl_DOffsetFactorEndStop_XAU16_08___A "fahrzeuggeschwindigkeitsanhängiger D-Offset-Faktor am Endanschlag (unabhaengig RotorSpeed)" CURVE 0x15F754 AblGLKLuw 5 DFACTHIGH 0 5 FORMAT "%8.6"
 /begin AXIS_DESCR STD_AXIS vSteerCtrl_AbsVehicleSpeedFilt4Interpol_xdu16 VFZHIGH 4 0 255 FORMAT "%8.4" DEPOSIT ABSOLUTE /end AXIS_DESCR
/end CHARACTERISTIC
/begin CHARACTERISTIC xSteerCtrl_DOffsetFactorEndStop_XAU16_09___A "fahrzeuggeschwindigkeitsanhängiger D-Offset-Faktor am Endanschlag (unabhaengig RotorSpeed)" CURVE 0x15F768 AblGLKLuw 5 DFACTHIGH 0 5 FORMAT "%8.6"
 /begin AXIS_DESCR STD_AXIS vSteerCtrl_AbsVehicleSpeedFilt4Interpol_xdu16 VFZHIGH 4 0 255 FORMAT "%8.4" DEPOSIT ABSOLUTE /end AXIS_DESCR
/end CHARACTERISTIC
/begin CHARACTERISTIC xSteerCtrl_DOffsetFactorEndStop_XAU16_10___A "fahrzeuggeschwindigkeitsanhängiger D-Offset-Faktor am Endanschlag (unabhaengig RotorSpeed)" CURVE 0x15F77C AblGLKLuw 5 DFACTHIGH 0 5 FORMAT "%8.6"
 /begin AXIS_DESCR STD_AXIS vSteerCtrl_AbsVehicleSpeedFilt4Interpol_xdu16 VFZHIGH 4 0 255 FORMAT "%8.4" DEPOSIT ABSOLUTE /end AXIS_DESCR
/end CHARACTERISTIC
/begin CHARACTERISTIC xSteerCtrl_DOffsetFactorEndStop_XAU16_11___A "fahrzeuggeschwindigkeitsanhängiger D-Offset-Faktor am Endanschlag (unabhaengig RotorSpeed)" CURVE 0x15F790 AblGLKLuw 5 DFACTHIGH 0 5 FORMAT "%8.6"
 /begin AXIS_DESCR STD_AXIS vSteerCtrl_AbsVehicleSpeedFilt4Interpol_xdu16 VFZHIGH 4 0 255 FORMAT "%8.4" DEPOSIT ABSOLUTE /end AXIS_DESCR
/end CHARACTERISTIC
/begin CHARACTERISTIC xSteerCtrl_DOffsetFactorEndStop_XAU16_12___A "fahrzeuggeschwindigkeitsanhängiger D-Offset-Faktor am Endanschlag (unabhaengig RotorSpeed)" CURVE 0x15F7A4 AblGLKLuw 5 DFACTHIGH 0 5 FORMAT "%8.6"
 /begin AXIS_DESCR STD_AXIS vSteerCtrl_AbsVehicleSpeedFilt4Interpol_xdu16 VFZHIGH 4 0 255 FORMAT "%8.4" DEPOSIT ABSOLUTE /end AXIS_DESCR
/end CHARACTERISTIC
/begin CHARACTERISTIC xSteerCtrl_DOffsetFactorEndStop_XAU16_13___A "fahrzeuggeschwindigkeitsanhängiger D-Offset-Faktor am Endanschlag (unabhaengig RotorSpeed)" CURVE 0x15F7B8 AblGLKLuw 5 DFACTHIGH 0 5 FORMAT "%8.6"
 /begin AXIS_DESCR STD_AXIS vSteerCtrl_AbsVehicleSpeedFilt4Interpol_xdu16 VFZHIGH 4 0 255 FORMAT "%8.4" DEPOSIT ABSOLUTE /end AXIS_DESCR
/end CHARACTERISTIC
/begin CHARACTERISTIC xSteerCtrl_DOffsetFactorEndStop_XAU16_14___A "fahrzeuggeschwindigkeitsanhängiger D-Offset-Faktor am Endanschlag (unabhaengig RotorSpeed)" CURVE 0x15F7CC AblGLKLuw 5 DFACTHIGH 0 5 FORMAT "%8.6"
 /begin AXIS_DESCR STD_AXIS vSteerCtrl_AbsVehicleSpeedFilt4Interpol_xdu16 VFZHIGH 4 0 255 FORMAT "%8.4" DEPOSIT ABSOLUTE /end AXIS_DESCR
/end CHARACTERISTIC
/begin CHARACTERISTIC xSteerCtrl_DOffsetFactorEndStop_XAU16_15___A "fahrzeuggeschwindigkeitsanhängiger D-Offset-Faktor am Endanschlag (unabhaengig RotorSpeed)" CURVE 0x15F7E0 AblGLKLuw 5 DFACTHIGH 0 5 FORMAT "%8.6"
 /begin AXIS_DESCR STD_AXIS vSteerCtrl_AbsVehicleSpeedFilt4Interpol_xdu16 VFZHIGH 4 0 255 FORMAT "%8.4" DEPOSIT ABSOLUTE /end AXIS_DESCR
/end CHARACTERISTIC
/begin CHARACTERISTIC xSteerCtrl_DOffsetFactorEndStop_XAU16_16___A "fahrzeuggeschwindigkeitsanhängiger D-Offset-Faktor am Endanschlag (unabhaengig RotorSpeed)" CURVE 0x15F7F4 AblGLKLuw 5 DFACTHIGH 0 5 FORMAT "%8.6"
 /begin AXIS_DESCR STD_AXIS vSteerCtrl_AbsVehicleSpeedFilt4Interpol_xdu16 VFZHIGH 4 0 255 FORMAT "%8.4" DEPOSIT ABSOLUTE /end AXIS_DESCR
/end CHARACTERISTIC
/begin CHARACTERISTIC xSteerCtrl_DOffsetFactorEndStop_XAU16_17___A "fahrzeuggeschwindigkeitsanhängiger D-Offset-Faktor am Endanschlag (unabhaengig RotorSpeed)" CURVE 0x15F808 AblGLKLuw 5 DFACTHIGH 0 5 FORMAT "%8.6"
 /begin AXIS_DESCR STD_AXIS vSteerCtrl_AbsVehicleSpeedFilt4Interpol_xdu16 VFZHIGH 4 0 255 FORMAT "%8.4" DEPOSIT ABSOLUTE /end AXIS_DESCR
/end CHARACTERISTIC
/begin CHARACTERISTIC xSteerCtrl_DOffsetFactorEndStop_XAU16_18___A "fahrzeuggeschwindigkeitsanhängiger D-Offset-Faktor am Endanschlag (unabhaengig RotorSpeed)" CURVE 0x15F81C AblGLKLuw 5 DFACTHIGH 0 5 FORMAT "%8.6"
 /begin AXIS_DESCR STD_AXIS vSteerCtrl_AbsVehicleSpeedFilt4Interpol_xdu16 VFZHIGH 4 0 255 FORMAT "%8.4" DEPOSIT ABSOLUTE /end AXIS_DESCR
/end CHARACTERISTIC
/begin CHARACTERISTIC xSteerCtrl_DOffsetFactorEndStop_XAU16_19___A "fahrzeuggeschwindigkeitsanhängiger D-Offset-Faktor am Endanschlag (unabhaengig RotorSpeed)" CURVE 0x15F830 AblGLKLuw 5 DFACTHIGH 0 5 FORMAT "%8.6"
 /begin AXIS_DESCR STD_AXIS vSteerCtrl_AbsVehicleSpeedFilt4Interpol_xdu16 VFZHIGH 4 0 255 FORMAT "%8.4" DEPOSIT ABSOLUTE /end AXIS_DESCR
/end CHARACTERISTIC
/begin CHARACTERISTIC xSteerCtrl_DOffsetFactorEndStop_XAU16_20___A "fahrzeuggeschwindigkeitsanhängiger D-Offset-Faktor am Endanschlag (unabhaengig RotorSpeed)" CURVE 0x15F844 AblGLKLuw 5 DFACTHIGH 0 5 FORMAT "%8.6"
 /begin AXIS_DESCR STD_AXIS vSteerCtrl_AbsVehicleSpeedFilt4Interpol_xdu16 VFZHIGH 4 0 255 FORMAT "%8.4" DEPOSIT ABSOLUTE /end AXIS_DESCR
/end CHARACTERISTIC
/begin CHARACTERISTIC xSteerCtrl_DOffsetFactorEndStop_XAU16_21___A "fahrzeuggeschwindigkeitsanhängiger D-Offset-Faktor am Endanschlag (unabhaengig RotorSpeed)" CURVE 0x15F858 AblGLKLuw 5 DFACTHIGH 0 5 FORMAT "%8.6"
 /begin AXIS_DESCR STD_AXIS vSteerCtrl_AbsVehicleSpeedFilt4Interpol_xdu16 VFZHIGH 4 0 255 FORMAT "%8.4" DEPOSIT ABSOLUTE /end AXIS_DESCR
/end CHARACTERISTIC
/begin CHARACTERISTIC xSteerCtrl_DOffsetFactorEndStop_XAU16_22___A "fahrzeuggeschwindigkeitsanhängiger D-Offset-Faktor am Endanschlag (unabhaengig RotorSpeed)" CURVE 0x15F86C AblGLKLuw 5 DFACTHIGH 0 5 FORMAT "%8.6"
 /begin AXIS_DESCR STD_AXIS vSteerCtrl_AbsVehicleSpeedFilt4Interpol_xdu16 VFZHIGH 4 0 255 FORMAT "%8.4" DEPOSIT ABSOLUTE /end AXIS_DESCR
/end CHARACTERISTIC
/begin CHARACTERISTIC xSteerCtrl_DOffsetFactorEndStop_XAU16_23___A "fahrzeuggeschwindigkeitsanhängiger D-Offset-Faktor am Endanschlag (unabhaengig RotorSpeed)" CURVE 0x15F880 AblGLKLuw 5 DFACTHIGH 0 5 FORMAT "%8.6"
 /begin AXIS_DESCR STD_AXIS vSteerCtrl_AbsVehicleSpeedFilt4Interpol_xdu16 VFZHIGH 4 0 255 FORMAT "%8.4" DEPOSIT ABSOLUTE /end AXIS_DESCR
/end CHARACTERISTIC
/begin CHARACTERISTIC xSteerCtrl_DOffsetFactorEndStop_XAU16_24___A "fahrzeuggeschwindigkeitsanhängiger D-Offset-Faktor am Endanschlag (unabhaengig RotorSpeed)" CURVE 0x15F894 AblGLKLuw 5 DFACTHIGH 0 5 FORMAT "%8.6"
 /begin AXIS_DESCR STD_AXIS vSteerCtrl_AbsVehicleSpeedFilt4Interpol_xdu16 VFZHIGH 4 0 255 FORMAT "%8.4" DEPOSIT ABSOLUTE /end AXIS_DESCR
/end CHARACTERISTIC
/begin CHARACTERISTIC xSteerCtrl_DOffsetFactorEndStop_XAU16_25___A "fahrzeuggeschwindigkeitsanhängiger D-Offset-Faktor am Endanschlag (unabhaengig RotorSpeed)" CURVE 0x15F8A8 AblGLKLuw 5 DFACTHIGH 0 5 FORMAT "%8.6"
 /begin AXIS_DESCR STD_AXIS vSteerCtrl_AbsVehicleSpeedFilt4Interpol_xdu16 VFZHIGH 4 0 255 FORMAT "%8.4" DEPOSIT ABSOLUTE /end AXIS_DESCR
/end CHARACTERISTIC
/begin CHARACTERISTIC xSteerCtrl_DOffsetFactorEndStop_XAU16_26___A "fahrzeuggeschwindigkeitsanhängiger D-Offset-Faktor am Endanschlag (unabhaengig RotorSpeed)" CURVE 0x15F8BC AblGLKLuw 5 DFACTHIGH 0 5 FORMAT "%8.6"
 /begin AXIS_DESCR STD_AXIS vSteerCtrl_AbsVehicleSpeedFilt4Interpol_xdu16 VFZHIGH 4 0 255 FORMAT "%8.4" DEPOSIT ABSOLUTE /end AXIS_DESCR
/end CHARACTERISTIC
/begin CHARACTERISTIC xSteerCtrl_DOffsetFactorEndStop_XAU16_27___A "fahrzeuggeschwindigkeitsanhängiger D-Offset-Faktor am Endanschlag (unabhaengig RotorSpeed)" CURVE 0x15F8D0 AblGLKLuw 5 DFACTHIGH 0 5 FORMAT "%8.6"
 /begin AXIS_DESCR STD_AXIS vSteerCtrl_AbsVehicleSpeedFilt4Interpol_xdu16 VFZHIGH 4 0 255 FORMAT "%8.4" DEPOSIT ABSOLUTE /end AXIS_DESCR
/end CHARACTERISTIC
/begin CHARACTERISTIC xSteerCtrl_DOffsetFactorEndStop_XAU16_28___A "fahrzeuggeschwindigkeitsanhängiger D-Offset-Faktor am Endanschlag (unabhaengig RotorSpeed)" CURVE 0x15F8E4 AblGLKLuw 5 DFACTHIGH 0 5 FORMAT "%8.6"
 /begin AXIS_DESCR STD_AXIS vSteerCtrl_AbsVehicleSpeedFilt4Interpol_xdu16 VFZHIGH 4 0 255 FORMAT "%8.4" DEPOSIT ABSOLUTE /end AXIS_DESCR
/end CHARACTERISTIC
/begin CHARACTERISTIC xSteerCtrl_DOffsetFactorEndStop_XAU16_29___A "fahrzeuggeschwindigkeitsanhängiger D-Offset-Faktor am Endanschlag (unabhaengig RotorSpeed)" CURVE 0x15F8F8 AblGLKLuw 5 DFACTHIGH 0 5 FORMAT "%8.6"
 /begin AXIS_DESCR STD_AXIS vSteerCtrl_AbsVehicleSpeedFilt4Interpol_xdu16 VFZHIGH 4 0 255 FORMAT "%8.4" DEPOSIT ABSOLUTE /end AXIS_DESCR
/end CHARACTERISTIC
/begin CHARACTERISTIC xSteerCtrl_DOffsetFactorEndStop_XAU16_30___A "fahrzeuggeschwindigkeitsanhängiger D-Offset-Faktor am Endanschlag (unabhaengig RotorSpeed)" CURVE 0x15F90C AblGLKLuw 5 DFACTHIGH 0 5 FORMAT "%8.6"
 /begin AXIS_DESCR STD_AXIS vSteerCtrl_AbsVehicleSpeedFilt4Interpol_xdu16 VFZHIGH 4 0 255 FORMAT "%8.4" DEPOSIT ABSOLUTE /end AXIS_DESCR
/end CHARACTERISTIC
/begin CHARACTERISTIC xSteerCtrl_DOffsetFactorEndStop_XAU16_31___A "fahrzeuggeschwindigkeitsanhängiger D-Offset-Faktor am Endanschlag (unabhaengig RotorSpeed)" CURVE 0x15F920 AblGLKLuw 5 DFACTHIGH 0 5 FORMAT "%8.6"
 /begin AXIS_DESCR STD_AXIS vSteerCtrl_AbsVehicleSpeedFilt4Interpol_xdu16 VFZHIGH 4 0 255 FORMAT "%8.4" DEPOSIT ABSOLUTE /end AXIS_DESCR
/end CHARACTERISTIC
/begin CHARACTERISTIC xSteerCtrl_DOffsetFactorEndStop_XAU16_32___A "fahrzeuggeschwindigkeitsanhängiger D-Offset-Faktor am Endanschlag (unabhaengig RotorSpeed)" CURVE 0x15F934 AblGLKLuw 5 DFACTHIGH 0 5 FORMAT "%8.6"
 /begin AXIS_DESCR STD_AXIS vSteerCtrl_AbsVehicleSpeedFilt4Interpol_xdu16 VFZHIGH 4 0 255 FORMAT "%8.4" DEPOSIT ABSOLUTE /end AXIS_DESCR
/end CHARACTERISTIC
/begin CHARACTERISTIC xSteerCtrl_DOffsetFactorEndStop_XAU16_33___A "fahrzeuggeschwindigkeitsanhängiger D-Offset-Faktor am Endanschlag (unabhaengig RotorSpeed)" CURVE 0x15F948 AblGLKLuw 5 DFACTHIGH 0 5 FORMAT "%8.6"
 /begin AXIS_DESCR STD_AXIS vSteerCtrl_AbsVehicleSpeedFilt4Interpol_xdu16 VFZHIGH 4 0 255 FORMAT "%8.4" DEPOSIT ABSOLUTE /end AXIS_DESCR
/end CHARACTERISTIC
/begin CHARACTERISTIC xSteerCtrl_DOffsetFactorEndStop_XAU16_34___A "fahrzeuggeschwindigkeitsanhängiger D-Offset-Faktor am Endanschlag (unabhaengig RotorSpeed)" CURVE 0x15F95C AblGLKLuw 5 DFACTHIGH 0 5 FORMAT "%8.6"
 /begin AXIS_DESCR STD_AXIS vSteerCtrl_AbsVehicleSpeedFilt4Interpol_xdu16 VFZHIGH 4 0 255 FORMAT "%8.4" DEPOSIT ABSOLUTE /end AXIS_DESCR
/end CHARACTERISTIC
/begin CHARACTERISTIC xSteerCtrl_DOffsetFactorEndStop_XAU16_35___A "fahrzeuggeschwindigkeitsanhängiger D-Offset-Faktor am Endanschlag (unabhaengig RotorSpeed)" CURVE 0x15F970 AblGLKLuw 5 DFACTHIGH 0 5 FORMAT "%8.6"
 /begin AXIS_DESCR STD_AXIS vSteerCtrl_AbsVehicleSpeedFilt4Interpol_xdu16 VFZHIGH 4 0 255 FORMAT "%8.4" DEPOSIT ABSOLUTE /end AXIS_DESCR
/end CHARACTERISTIC
/begin CHARACTERISTIC xSteerCtrl_DOffsetFactorFactorMechStuck_XAU16_00___A "Kennlinie für D-Offset-Anteilsmoment über DOffsetFactorMoment wenn Anti Hakel Maßnahme an" CURVE 0x15F984 AblGLKLuw 25 MMOT 0 25 FORMAT "%8.5"
 /begin AXIS_DESCR STD_AXIS mSteerCtrl_AbsDOffset_xdu16 MMOT 5 0 25 FORMAT "%8.5" DEPOSIT ABSOLUTE /end AXIS_DESCR
/end CHARACTERISTIC
/begin CHARACTERISTIC xSteerCtrl_DOffsetFactorFactorMechStuck_XAU16_01___A "Kennlinie für D-Offset-Anteilsmoment über DOffsetFactorMoment wenn Anti Hakel Maßnahme an" CURVE 0x15F99C AblGLKLuw 25 MMOT 0 25 FORMAT "%8.5"
 /begin AXIS_DESCR STD_AXIS mSteerCtrl_AbsDOffset_xdu16 MMOT 5 0 25 FORMAT "%8.5" DEPOSIT ABSOLUTE /end AXIS_DESCR
/end CHARACTERISTIC
/begin CHARACTERISTIC xSteerCtrl_DOffsetFactorFactorMechStuck_XAU16_02___A "Kennlinie für D-Offset-Anteilsmoment über DOffsetFactorMoment wenn Anti Hakel Maßnahme an" CURVE 0x15F9B4 AblGLKLuw 25 MMOT 0 25 FORMAT "%8.5"
 /begin AXIS_DESCR STD_AXIS mSteerCtrl_AbsDOffset_xdu16 MMOT 5 0 25 FORMAT "%8.5" DEPOSIT ABSOLUTE /end AXIS_DESCR
/end CHARACTERISTIC
/begin CHARACTERISTIC xSteerCtrl_DOffsetFactorFactorMechStuck_XAU16_03___A "Kennlinie für D-Offset-Anteilsmoment über DOffsetFactorMoment wenn Anti Hakel Maßnahme an" CURVE 0x15F9CC AblGLKLuw 25 MMOT 0 25 FORMAT "%8.5"
 /begin AXIS_DESCR STD_AXIS mSteerCtrl_AbsDOffset_xdu16 MMOT 5 0 25 FORMAT "%8.5" DEPOSIT ABSOLUTE /end AXIS_DESCR
/end CHARACTERISTIC
/begin CHARACTERISTIC xSteerCtrl_DOffsetFactorFactorMechStuck_XAU16_04___A "Kennlinie für D-Offset-Anteilsmoment über DOffsetFactorMoment wenn Anti Hakel Maßnahme an" CURVE 0x15F9E4 AblGLKLuw 25 MMOT 0 25 FORMAT "%8.5"
 /begin AXIS_DESCR STD_AXIS mSteerCtrl_AbsDOffset_xdu16 MMOT 5 0 25 FORMAT "%8.5" DEPOSIT ABSOLUTE /end AXIS_DESCR
/end CHARACTERISTIC
/begin CHARACTERISTIC xSteerCtrl_DOffsetFactorFactorMechStuck_XAU16_05___A "Kennlinie für D-Offset-Anteilsmoment über DOffsetFactorMoment wenn Anti Hakel Maßnahme an" CURVE 0x15F9FC AblGLKLuw 25 MMOT 0 25 FORMAT "%8.5"
 /begin AXIS_DESCR STD_AXIS mSteerCtrl_AbsDOffset_xdu16 MMOT 5 0 25 FORMAT "%8.5" DEPOSIT ABSOLUTE /end AXIS_DESCR
/end CHARACTERISTIC
/begin CHARACTERISTIC xSteerCtrl_DOffsetFactorFactorMechStuck_XAU16_06___A "Kennlinie für D-Offset-Anteilsmoment über DOffsetFactorMoment wenn Anti Hakel Maßnahme an" CURVE 0x15FA14 AblGLKLuw 25 MMOT 0 25 FORMAT "%8.5"
 /begin AXIS_DESCR STD_AXIS mSteerCtrl_AbsDOffset_xdu16 MMOT 5 0 25 FORMAT "%8.5" DEPOSIT ABSOLUTE /end AXIS_DESCR
/end CHARACTERISTIC
/begin CHARACTERISTIC xSteerCtrl_DOffsetFactorFactorMechStuck_XAU16_07___A "Kennlinie für D-Offset-Anteilsmoment über DOffsetFactorMoment wenn Anti Hakel Maßnahme an" CURVE 0x15FA2C AblGLKLuw 25 MMOT 0 25 FORMAT "%8.5"
 /begin AXIS_DESCR STD_AXIS mSteerCtrl_AbsDOffset_xdu16 MMOT 5 0 25 FORMAT "%8.5" DEPOSIT ABSOLUTE /end AXIS_DESCR
/end CHARACTERISTIC
/begin CHARACTERISTIC xSteerCtrl_DOffsetFactorFactorMechStuck_XAU16_08___A "Kennlinie für D-Offset-Anteilsmoment über DOffsetFactorMoment wenn Anti Hakel Maßnahme an" CURVE 0x15FA44 AblGLKLuw 25 MMOT 0 25 FORMAT "%8.5"
 /begin AXIS_DESCR STD_AXIS mSteerCtrl_AbsDOffset_xdu16 MMOT 5 0 25 FORMAT "%8.5" DEPOSIT ABSOLUTE /end AXIS_DESCR
/end CHARACTERISTIC
/begin CHARACTERISTIC xSteerCtrl_DOffsetFactorFactorMechStuck_XAU16_09___A "Kennlinie für D-Offset-Anteilsmoment über DOffsetFactorMoment wenn Anti Hakel Maßnahme an" CURVE 0x15FA5C AblGLKLuw 25 MMOT 0 25 FORMAT "%8.5"
 /begin AXIS_DESCR STD_AXIS mSteerCtrl_AbsDOffset_xdu16 MMOT 5 0 25 FORMAT "%8.5" DEPOSIT ABSOLUTE /end AXIS_DESCR
/end CHARACTERISTIC
/begin CHARACTERISTIC xSteerCtrl_DOffsetFactorFactorMechStuck_XAU16_10___A "Kennlinie für D-Offset-Anteilsmoment über DOffsetFactorMoment wenn Anti Hakel Maßnahme an" CURVE 0x15FA74 AblGLKLuw 25 MMOT 0 25 FORMAT "%8.5"
 /begin AXIS_DESCR STD_AXIS mSteerCtrl_AbsDOffset_xdu16 MMOT 5 0 25 FORMAT "%8.5" DEPOSIT ABSOLUTE /end AXIS_DESCR
/end CHARACTERISTIC
/begin CHARACTERISTIC xSteerCtrl_DOffsetFactorFactorMechStuck_XAU16_11___A "Kennlinie für D-Offset-Anteilsmoment über DOffsetFactorMoment wenn Anti Hakel Maßnahme an" CURVE 0x15FA8C AblGLKLuw 25 MMOT 0 25 FORMAT "%8.5"
 /begin AXIS_DESCR STD_AXIS mSteerCtrl_AbsDOffset_xdu16 MMOT 5 0 25 FORMAT "%8.5" DEPOSIT ABSOLUTE /end AXIS_DESCR
/end CHARACTERISTIC
/begin CHARACTERISTIC xSteerCtrl_DOffsetFactorFactorMechStuck_XAU16_12___A "Kennlinie für D-Offset-Anteilsmoment über DOffsetFactorMoment wenn Anti Hakel Maßnahme an" CURVE 0x15FAA4 AblGLKLuw 25 MMOT 0 25 FORMAT "%8.5"
 /begin AXIS_DESCR STD_AXIS mSteerCtrl_AbsDOffset_xdu16 MMOT 5 0 25 FORMAT "%8.5" DEPOSIT ABSOLUTE /end AXIS_DESCR
/end CHARACTERISTIC
/begin CHARACTERISTIC xSteerCtrl_DOffsetFactorFactorMechStuck_XAU16_13___A "Kennlinie für D-Offset-Anteilsmoment über DOffsetFactorMoment wenn Anti Hakel Maßnahme an" CURVE 0x15FABC AblGLKLuw 25 MMOT 0 25 FORMAT "%8.5"
 /begin AXIS_DESCR STD_AXIS mSteerCtrl_AbsDOffset_xdu16 MMOT 5 0 25 FORMAT "%8.5" DEPOSIT ABSOLUTE /end AXIS_DESCR
/end CHARACTERISTIC
/begin CHARACTERISTIC xSteerCtrl_DOffsetFactorFactorMechStuck_XAU16_14___A "Kennlinie für D-Offset-Anteilsmoment über DOffsetFactorMoment wenn Anti Hakel Maßnahme an" CURVE 0x15FAD4 AblGLKLuw 25 MMOT 0 25 FORMAT "%8.5"
 /begin AXIS_DESCR STD_AXIS mSteerCtrl_AbsDOffset_xdu16 MMOT 5 0 25 FORMAT "%8.5" DEPOSIT ABSOLUTE /end AXIS_DESCR
/end CHARACTERISTIC
/begin CHARACTERISTIC xSteerCtrl_DOffsetFactorFactorMechStuck_XAU16_15___A "Kennlinie für D-Offset-Anteilsmoment über DOffsetFactorMoment wenn Anti Hakel Maßnahme an" CURVE 0x15FAEC AblGLKLuw 25 MMOT 0 25 FORMAT "%8.5"
 /begin AXIS_DESCR STD_AXIS mSteerCtrl_AbsDOffset_xdu16 MMOT 5 0 25 FORMAT "%8.5" DEPOSIT ABSOLUTE /end AXIS_DESCR
/end CHARACTERISTIC
/begin CHARACTERISTIC xSteerCtrl_DOffsetFactorFactorMechStuck_XAU16_16___A "Kennlinie für D-Offset-Anteilsmoment über DOffsetFactorMoment wenn Anti Hakel Maßnahme an" CURVE 0x15FB04 AblGLKLuw 25 MMOT 0 25 FORMAT "%8.5"
 /begin AXIS_DESCR STD_AXIS mSteerCtrl_AbsDOffset_xdu16 MMOT 5 0 25 FORMAT "%8.5" DEPOSIT ABSOLUTE /end AXIS_DESCR
/end CHARACTERISTIC
/begin CHARACTERISTIC xSteerCtrl_DOffsetFactorFactorMechStuck_XAU16_17___A "Kennlinie für D-Offset-Anteilsmoment über DOffsetFactorMoment wenn Anti Hakel Maßnahme an" CURVE 0x15FB1C AblGLKLuw 25 MMOT 0 25 FORMAT "%8.5"
 /begin AXIS_DESCR STD_AXIS mSteerCtrl_AbsDOffset_xdu16 MMOT 5 0 25 FORMAT "%8.5" DEPOSIT ABSOLUTE /end AXIS_DESCR
/end CHARACTERISTIC
/begin CHARACTERISTIC xSteerCtrl_DOffsetFactorFactorMechStuck_XAU16_18___A "Kennlinie für D-Offset-Anteilsmoment über DOffsetFactorMoment wenn Anti Hakel Maßnahme an" CURVE 0x15FB34 AblGLKLuw 25 MMOT 0 25 FORMAT "%8.5"
 /begin AXIS_DESCR STD_AXIS mSteerCtrl_AbsDOffset_xdu16 MMOT 5 0 25 FORMAT "%8.5" DEPOSIT ABSOLUTE /end AXIS_DESCR
/end CHARACTERISTIC
/begin CHARACTERISTIC xSteerCtrl_DOffsetFactorFactorMechStuck_XAU16_19___A "Kennlinie für D-Offset-Anteilsmoment über DOffsetFactorMoment wenn Anti Hakel Maßnahme an" CURVE 0x15FB4C AblGLKLuw 25 MMOT 0 25 FORMAT "%8.5"
 /begin AXIS_DESCR STD_AXIS mSteerCtrl_AbsDOffset_xdu16 MMOT 5 0 25 FORMAT "%8.5" DEPOSIT ABSOLUTE /end AXIS_DESCR
/end CHARACTERISTIC
/begin CHARACTERISTIC xSteerCtrl_DOffsetFactorFactorMechStuck_XAU16_20___A "Kennlinie für D-Offset-Anteilsmoment über DOffsetFactorMoment wenn Anti Hakel Maßnahme an" CURVE 0x15FB64 AblGLKLuw 25 MMOT 0 25 FORMAT "%8.5"
 /begin AXIS_DESCR STD_AXIS mSteerCtrl_AbsDOffset_xdu16 MMOT 5 0 25 FORMAT "%8.5" DEPOSIT ABSOLUTE /end AXIS_DESCR
/end CHARACTERISTIC
/begin CHARACTERISTIC xSteerCtrl_DOffsetFactorFactorMechStuck_XAU16_21___A "Kennlinie für D-Offset-Anteilsmoment über DOffsetFactorMoment wenn Anti Hakel Maßnahme an" CURVE 0x15FB7C AblGLKLuw 25 MMOT 0 25 FORMAT "%8.5"
 /begin AXIS_DESCR STD_AXIS mSteerCtrl_AbsDOffset_xdu16 MMOT 5 0 25 FORMAT "%8.5" DEPOSIT ABSOLUTE /end AXIS_DESCR
/end CHARACTERISTIC
/begin CHARACTERISTIC xSteerCtrl_DOffsetFactorFactorMechStuck_XAU16_22___A "Kennlinie für D-Offset-Anteilsmoment über DOffsetFactorMoment wenn Anti Hakel Maßnahme an" CURVE 0x15FB94 AblGLKLuw 25 MMOT 0 25 FORMAT "%8.5"
 /begin AXIS_DESCR STD_AXIS mSteerCtrl_AbsDOffset_xdu16 MMOT 5 0 25 FORMAT "%8.5" DEPOSIT ABSOLUTE /end AXIS_DESCR
/end CHARACTERISTIC
/begin CHARACTERISTIC xSteerCtrl_DOffsetFactorFactorMechStuck_XAU16_23___A "Kennlinie für D-Offset-Anteilsmoment über DOffsetFactorMoment wenn Anti Hakel Maßnahme an" CURVE 0x15FBAC AblGLKLuw 25 MMOT 0 25 FORMAT "%8.5"
 /begin AXIS_DESCR STD_AXIS mSteerCtrl_AbsDOffset_xdu16 MMOT 5 0 25 FORMAT "%8.5" DEPOSIT ABSOLUTE /end AXIS_DESCR
/end CHARACTERISTIC
/begin CHARACTERISTIC xSteerCtrl_DOffsetFactorFactorMechStuck_XAU16_24___A "Kennlinie für D-Offset-Anteilsmoment über DOffsetFactorMoment wenn Anti Hakel Maßnahme an" CURVE 0x15FBC4 AblGLKLuw 25 MMOT 0 25 FORMAT "%8.5"
 /begin AXIS_DESCR STD_AXIS mSteerCtrl_AbsDOffset_xdu16 MMOT 5 0 25 FORMAT "%8.5" DEPOSIT ABSOLUTE /end AXIS_DESCR
/end CHARACTERISTIC
/begin CHARACTERISTIC xSteerCtrl_DOffsetFactorFactorMechStuck_XAU16_25___A "Kennlinie für D-Offset-Anteilsmoment über DOffsetFactorMoment wenn Anti Hakel Maßnahme an" CURVE 0x15FBDC AblGLKLuw 25 MMOT 0 25 FORMAT "%8.5"
 /begin AXIS_DESCR STD_AXIS mSteerCtrl_AbsDOffset_xdu16 MMOT 5 0 25 FORMAT "%8.5" DEPOSIT ABSOLUTE /end AXIS_DESCR
/end CHARACTERISTIC
/begin CHARACTERISTIC xSteerCtrl_DOffsetFactorFactorMechStuck_XAU16_26___A "Kennlinie für D-Offset-Anteilsmoment über DOffsetFactorMoment wenn Anti Hakel Maßnahme an" CURVE 0x15FBF4 AblGLKLuw 25 MMOT 0 25 FORMAT "%8.5"
 /begin AXIS_DESCR STD_AXIS mSteerCtrl_AbsDOffset_xdu16 MMOT 5 0 25 FORMAT "%8.5" DEPOSIT ABSOLUTE /end AXIS_DESCR
/end CHARACTERISTIC
/begin CHARACTERISTIC xSteerCtrl_DOffsetFactorFactorMechStuck_XAU16_27___A "Kennlinie für D-Offset-Anteilsmoment über DOffsetFactorMoment wenn Anti Hakel Maßnahme an" CURVE 0x15FC0C AblGLKLuw 25 MMOT 0 25 FORMAT "%8.5"
 /begin AXIS_DESCR STD_AXIS mSteerCtrl_AbsDOffset_xdu16 MMOT 5 0 25 FORMAT "%8.5" DEPOSIT ABSOLUTE /end AXIS_DESCR
/end CHARACTERISTIC
/begin CHARACTERISTIC xSteerCtrl_DOffsetFactorFactorMechStuck_XAU16_28___A "Kennlinie für D-Offset-Anteilsmoment über DOffsetFactorMoment wenn Anti Hakel Maßnahme an" CURVE 0x15FC24 AblGLKLuw 25 MMOT 0 25 FORMAT "%8.5"
 /begin AXIS_DESCR STD_AXIS mSteerCtrl_AbsDOffset_xdu16 MMOT 5 0 25 FORMAT "%8.5" DEPOSIT ABSOLUTE /end AXIS_DESCR
/end CHARACTERISTIC
/begin CHARACTERISTIC xSteerCtrl_DOffsetFactorFactorMechStuck_XAU16_29___A "Kennlinie für D-Offset-Anteilsmoment über DOffsetFactorMoment wenn Anti Hakel Maßnahme an" CURVE 0x15FC3C AblGLKLuw 25 MMOT 0 25 FORMAT "%8.5"
 /begin AXIS_DESCR STD_AXIS mSteerCtrl_AbsDOffset_xdu16 MMOT 5 0 25 FORMAT "%8.5" DEPOSIT ABSOLUTE /end AXIS_DESCR
/end CHARACTERISTIC
/begin CHARACTERISTIC xSteerCtrl_DOffsetFactorFactorMechStuck_XAU16_30___A "Kennlinie für D-Offset-Anteilsmoment über DOffsetFactorMoment wenn Anti Hakel Maßnahme an" CURVE 0x15FC54 AblGLKLuw 25 MMOT 0 25 FORMAT "%8.5"
 /begin AXIS_DESCR STD_AXIS mSteerCtrl_AbsDOffset_xdu16 MMOT 5 0 25 FORMAT "%8.5" DEPOSIT ABSOLUTE /end AXIS_DESCR
/end CHARACTERISTIC
/begin CHARACTERISTIC xSteerCtrl_DOffsetFactorFactorMechStuck_XAU16_31___A "Kennlinie für D-Offset-Anteilsmoment über DOffsetFactorMoment wenn Anti Hakel Maßnahme an" CURVE 0x15FC6C AblGLKLuw 25 MMOT 0 25 FORMAT "%8.5"
 /begin AXIS_DESCR STD_AXIS mSteerCtrl_AbsDOffset_xdu16 MMOT 5 0 25 FORMAT "%8.5" DEPOSIT ABSOLUTE /end AXIS_DESCR
/end CHARACTERISTIC
/begin CHARACTERISTIC xSteerCtrl_DOffsetFactorFactorMechStuck_XAU16_32___A "Kennlinie für D-Offset-Anteilsmoment über DOffsetFactorMoment wenn Anti Hakel Maßnahme an" CURVE 0x15FC84 AblGLKLuw 25 MMOT 0 25 FORMAT "%8.5"
 /begin AXIS_DESCR STD_AXIS mSteerCtrl_AbsDOffset_xdu16 MMOT 5 0 25 FORMAT "%8.5" DEPOSIT ABSOLUTE /end AXIS_DESCR
/end CHARACTERISTIC
/begin CHARACTERISTIC xSteerCtrl_DOffsetFactorFactorMechStuck_XAU16_33___A "Kennlinie für D-Offset-Anteilsmoment über DOffsetFactorMoment wenn Anti Hakel Maßnahme an" CURVE 0x15FC9C AblGLKLuw 25 MMOT 0 25 FORMAT "%8.5"
 /begin AXIS_DESCR STD_AXIS mSteerCtrl_AbsDOffset_xdu16 MMOT 5 0 25 FORMAT "%8.5" DEPOSIT ABSOLUTE /end AXIS_DESCR
/end CHARACTERISTIC
/begin CHARACTERISTIC xSteerCtrl_DOffsetFactorFactorMechStuck_XAU16_34___A "Kennlinie für D-Offset-Anteilsmoment über DOffsetFactorMoment wenn Anti Hakel Maßnahme an" CURVE 0x15FCB4 AblGLKLuw 25 MMOT 0 25 FORMAT "%8.5"
 /begin AXIS_DESCR STD_AXIS mSteerCtrl_AbsDOffset_xdu16 MMOT 5 0 25 FORMAT "%8.5" DEPOSIT ABSOLUTE /end AXIS_DESCR
/end CHARACTERISTIC
/begin CHARACTERISTIC xSteerCtrl_DOffsetFactorFactorMechStuck_XAU16_35___A "Kennlinie für D-Offset-Anteilsmoment über DOffsetFactorMoment wenn Anti Hakel Maßnahme an" CURVE 0x15FCCC AblGLKLuw 25 MMOT 0 25 FORMAT "%8.5"
 /begin AXIS_DESCR STD_AXIS mSteerCtrl_AbsDOffset_xdu16 MMOT 5 0 25 FORMAT "%8.5" DEPOSIT ABSOLUTE /end AXIS_DESCR
/end CHARACTERISTIC
/begin CHARACTERISTIC xSteerCtrl_DOffsetFactor_XAU16_00___A "DOffsetFactor: characteristic field dependent on VehicleSpeed and RotorSpeed, this replaces 3D-interpolation" MAP 0x161C64 AblGLKFuw 24.5 DFACTHIGH 0.5 25 FORMAT "%8.5"
 /begin AXIS_DESCR STD_AXIS vSteerCtrl_AbsVehicleSpeedFilt4Interpol_xdu16 VFZHIGH 4 0 500 FORMAT "%8.4" DEPOSIT ABSOLUTE /end AXIS_DESCR
 /begin AXIS_DESCR STD_AXIS nApplI_AbsRotorSpeedFilt_xdu16 VROT 6 0 13000 FORMAT "%3.0" DEPOSIT ABSOLUTE /end AXIS_DESCR
/end CHARACTERISTIC
/begin CHARACTERISTIC xSteerCtrl_DOffsetFactor_XAU16_01___A "DOffsetFactor: characteristic field dependent on VehicleSpeed and RotorSpeed, this replaces 3D-interpolation" MAP 0x161CA8 AblGLKFuw 24.5 DFACTHIGH 0.5 25 FORMAT "%8.5"
 /begin AXIS_DESCR STD_AXIS vSteerCtrl_AbsVehicleSpeedFilt4Interpol_xdu16 VFZHIGH 4 0 500 FORMAT "%8.4" DEPOSIT ABSOLUTE /end AXIS_DESCR
 /begin AXIS_DESCR STD_AXIS nApplI_AbsRotorSpeedFilt_xdu16 VROT 6 0 13000 FORMAT "%3.0" DEPOSIT ABSOLUTE /end AXIS_DESCR
/end CHARACTERISTIC
/begin CHARACTERISTIC xSteerCtrl_DOffsetFactor_XAU16_02___A "DOffsetFactor: characteristic field dependent on VehicleSpeed and RotorSpeed, this replaces 3D-interpolation" MAP 0x161CEC AblGLKFuw 24.5 DFACTHIGH 0.5 25 FORMAT "%8.5"
 /begin AXIS_DESCR STD_AXIS vSteerCtrl_AbsVehicleSpeedFilt4Interpol_xdu16 VFZHIGH 4 0 500 FORMAT "%8.4" DEPOSIT ABSOLUTE /end AXIS_DESCR
 /begin AXIS_DESCR STD_AXIS nApplI_AbsRotorSpeedFilt_xdu16 VROT 6 0 13000 FORMAT "%3.0" DEPOSIT ABSOLUTE /end AXIS_DESCR
/end CHARACTERISTIC
/begin CHARACTERISTIC xSteerCtrl_DOffsetFactor_XAU16_03___A "DOffsetFactor: characteristic field dependent on VehicleSpeed and RotorSpeed, this replaces 3D-interpolation" MAP 0x161D30 AblGLKFuw 24.5 DFACTHIGH 0.5 25 FORMAT "%8.5"
 /begin AXIS_DESCR STD_AXIS vSteerCtrl_AbsVehicleSpeedFilt4Interpol_xdu16 VFZHIGH 4 0 500 FORMAT "%8.4" DEPOSIT ABSOLUTE /end AXIS_DESCR
 /begin AXIS_DESCR STD_AXIS nApplI_AbsRotorSpeedFilt_xdu16 VROT 6 0 13000 FORMAT "%3.0" DEPOSIT ABSOLUTE /end AXIS_DESCR
/end CHARACTERISTIC
/begin CHARACTERISTIC xSteerCtrl_DOffsetFactor_XAU16_04___A "DOffsetFactor: characteristic field dependent on VehicleSpeed and RotorSpeed, this replaces 3D-interpolation" MAP 0x161D74 AblGLKFuw 24.5 DFACTHIGH 0.5 25 FORMAT "%8.5"
 /begin AXIS_DESCR STD_AXIS vSteerCtrl_AbsVehicleSpeedFilt4Interpol_xdu16 VFZHIGH 4 0 500 FORMAT "%8.4" DEPOSIT ABSOLUTE /end AXIS_DESCR
 /begin AXIS_DESCR STD_AXIS nApplI_AbsRotorSpeedFilt_xdu16 VROT 6 0 13000 FORMAT "%3.0" DEPOSIT ABSOLUTE /end AXIS_DESCR
/end CHARACTERISTIC
/begin CHARACTERISTIC xSteerCtrl_DOffsetFactor_XAU16_05___A "DOffsetFactor: characteristic field dependent on VehicleSpeed and RotorSpeed, this replaces 3D-interpolation" MAP 0x161DB8 AblGLKFuw 24.5 DFACTHIGH 0.5 25 FORMAT "%8.5"
 /begin AXIS_DESCR STD_AXIS vSteerCtrl_AbsVehicleSpeedFilt4Interpol_xdu16 VFZHIGH 4 0 500 FORMAT "%8.4" DEPOSIT ABSOLUTE /end AXIS_DESCR
 /begin AXIS_DESCR STD_AXIS nApplI_AbsRotorSpeedFilt_xdu16 VROT 6 0 13000 FORMAT "%3.0" DEPOSIT ABSOLUTE /end AXIS_DESCR
/end CHARACTERISTIC
/begin CHARACTERISTIC xSteerCtrl_DOffsetFactor_XAU16_06___A "DOffsetFactor: characteristic field dependent on VehicleSpeed and RotorSpeed, this replaces 3D-interpolation" MAP 0x161DFC AblGLKFuw 24.5 DFACTHIGH 0.5 25 FORMAT "%8.5"
 /begin AXIS_DESCR STD_AXIS vSteerCtrl_AbsVehicleSpeedFilt4Interpol_xdu16 VFZHIGH 4 0 500 FORMAT "%8.4" DEPOSIT ABSOLUTE /end AXIS_DESCR
 /begin AXIS_DESCR STD_AXIS nApplI_AbsRotorSpeedFilt_xdu16 VROT 6 0 13000 FORMAT "%3.0" DEPOSIT ABSOLUTE /end AXIS_DESCR
/end CHARACTERISTIC
/begin CHARACTERISTIC xSteerCtrl_DOffsetFactor_XAU16_07___A "DOffsetFactor: characteristic field dependent on VehicleSpeed and RotorSpeed, this replaces 3D-interpolation" MAP 0x161E40 AblGLKFuw 24.5 DFACTHIGH 0.5 25 FORMAT "%8.5"
 /begin AXIS_DESCR STD_AXIS vSteerCtrl_AbsVehicleSpeedFilt4Interpol_xdu16 VFZHIGH 4 0 500 FORMAT "%8.4" DEPOSIT ABSOLUTE /end AXIS_DESCR
 /begin AXIS_DESCR STD_AXIS nApplI_AbsRotorSpeedFilt_xdu16 VROT 6 0 13000 FORMAT "%3.0" DEPOSIT ABSOLUTE /end AXIS_DESCR
/end CHARACTERISTIC
/begin CHARACTERISTIC xSteerCtrl_DOffsetFactor_XAU16_08___A "DOffsetFactor: characteristic field dependent on VehicleSpeed and RotorSpeed, this replaces 3D-interpolation" MAP 0x161E84 AblGLKFuw 24.5 DFACTHIGH 0.5 25 FORMAT "%8.5"
 /begin AXIS_DESCR STD_AXIS vSteerCtrl_AbsVehicleSpeedFilt4Interpol_xdu16 VFZHIGH 4 0 500 FORMAT "%8.4" DEPOSIT ABSOLUTE /end AXIS_DESCR
 /begin AXIS_DESCR STD_AXIS nApplI_AbsRotorSpeedFilt_xdu16 VROT 6 0 13000 FORMAT "%3.0" DEPOSIT ABSOLUTE /end AXIS_DESCR
/end CHARACTERISTIC
/begin CHARACTERISTIC xSteerCtrl_DOffsetFactor_XAU16_09___A "DOffsetFactor: characteristic field dependent on VehicleSpeed and RotorSpeed, this replaces 3D-interpolation" MAP 0x161EC8 AblGLKFuw 24.5 DFACTHIGH 0.5 25 FORMAT "%8.5"
 /begin AXIS_DESCR STD_AXIS vSteerCtrl_AbsVehicleSpeedFilt4Interpol_xdu16 VFZHIGH 4 0 500 FORMAT "%8.4" DEPOSIT ABSOLUTE /end AXIS_DESCR
 /begin AXIS_DESCR STD_AXIS nApplI_AbsRotorSpeedFilt_xdu16 VROT 6 0 13000 FORMAT "%3.0" DEPOSIT ABSOLUTE /end AXIS_DESCR
/end CHARACTERISTIC
/begin CHARACTERISTIC xSteerCtrl_DOffsetFactor_XAU16_10___A "DOffsetFactor: characteristic field dependent on VehicleSpeed and RotorSpeed, this replaces 3D-interpolation" MAP 0x161F0C AblGLKFuw 24.5 DFACTHIGH 0.5 25 FORMAT "%8.5"
 /begin AXIS_DESCR STD_AXIS vSteerCtrl_AbsVehicleSpeedFilt4Interpol_xdu16 VFZHIGH 4 0 500 FORMAT "%8.4" DEPOSIT ABSOLUTE /end AXIS_DESCR
 /begin AXIS_DESCR STD_AXIS nApplI_AbsRotorSpeedFilt_xdu16 VROT 6 0 13000 FORMAT "%3.0" DEPOSIT ABSOLUTE /end AXIS_DESCR
/end CHARACTERISTIC
/begin CHARACTERISTIC xSteerCtrl_DOffsetFactor_XAU16_11___A "DOffsetFactor: characteristic field dependent on VehicleSpeed and RotorSpeed, this replaces 3D-interpolation" MAP 0x161F50 AblGLKFuw 24.5 DFACTHIGH 0.5 25 FORMAT "%8.5"
 /begin AXIS_DESCR STD_AXIS vSteerCtrl_AbsVehicleSpeedFilt4Interpol_xdu16 VFZHIGH 4 0 500 FORMAT "%8.4" DEPOSIT ABSOLUTE /end AXIS_DESCR
 /begin AXIS_DESCR STD_AXIS nApplI_AbsRotorSpeedFilt_xdu16 VROT 6 0 13000 FORMAT "%3.0" DEPOSIT ABSOLUTE /end AXIS_DESCR
/end CHARACTERISTIC
/begin CHARACTERISTIC xSteerCtrl_DOffsetFactor_XAU16_12___A "DOffsetFactor: characteristic field dependent on VehicleSpeed and RotorSpeed, this replaces 3D-interpolation" MAP 0x161F94 AblGLKFuw 24.5 DFACTHIGH 0.5 25 FORMAT "%8.5"
 /begin AXIS_DESCR STD_AXIS vSteerCtrl_AbsVehicleSpeedFilt4Interpol_xdu16 VFZHIGH 4 0 500 FORMAT "%8.4" DEPOSIT ABSOLUTE /end AXIS_DESCR
 /begin AXIS_DESCR STD_AXIS nApplI_AbsRotorSpeedFilt_xdu16 VROT 6 0 13000 FORMAT "%3.0" DEPOSIT ABSOLUTE /end AXIS_DESCR
/end CHARACTERISTIC
/begin CHARACTERISTIC xSteerCtrl_DOffsetFactor_XAU16_13___A "DOffsetFactor: characteristic field dependent on VehicleSpeed and RotorSpeed, this replaces 3D-interpolation" MAP 0x161FD8 AblGLKFuw 24.5 DFACTHIGH 0.5 25 FORMAT "%8.5"
 /begin AXIS_DESCR STD_AXIS vSteerCtrl_AbsVehicleSpeedFilt4Interpol_xdu16 VFZHIGH 4 0 500 FORMAT "%8.4" DEPOSIT ABSOLUTE /end AXIS_DESCR
 /begin AXIS_DESCR STD_AXIS nApplI_AbsRotorSpeedFilt_xdu16 VROT 6 0 13000 FORMAT "%3.0" DEPOSIT ABSOLUTE /end AXIS_DESCR
/end CHARACTERISTIC
/begin CHARACTERISTIC xSteerCtrl_DOffsetFactor_XAU16_14___A "DOffsetFactor: characteristic field dependent on VehicleSpeed and RotorSpeed, this replaces 3D-interpolation" MAP 0x16201C AblGLKFuw 24.5 DFACTHIGH 0.5 25 FORMAT "%8.5"
 /begin AXIS_DESCR STD_AXIS vSteerCtrl_AbsVehicleSpeedFilt4Interpol_xdu16 VFZHIGH 4 0 500 FORMAT "%8.4" DEPOSIT ABSOLUTE /end AXIS_DESCR
 /begin AXIS_DESCR STD_AXIS nApplI_AbsRotorSpeedFilt_xdu16 VROT 6 0 13000 FORMAT "%3.0" DEPOSIT ABSOLUTE /end AXIS_DESCR
/end CHARACTERISTIC
/begin CHARACTERISTIC xSteerCtrl_DOffsetFactor_XAU16_15___A "DOffsetFactor: characteristic field dependent on VehicleSpeed and RotorSpeed, this replaces 3D-interpolation" MAP 0x162060 AblGLKFuw 24.5 DFACTHIGH 0.5 25 FORMAT "%8.5"
 /begin AXIS_DESCR STD_AXIS vSteerCtrl_AbsVehicleSpeedFilt4Interpol_xdu16 VFZHIGH 4 0 500 FORMAT "%8.4" DEPOSIT ABSOLUTE /end AXIS_DESCR
 /begin AXIS_DESCR STD_AXIS nApplI_AbsRotorSpeedFilt_xdu16 VROT 6 0 13000 FORMAT "%3.0" DEPOSIT ABSOLUTE /end AXIS_DESCR
/end CHARACTERISTIC
/begin CHARACTERISTIC xSteerCtrl_DOffsetFactor_XAU16_16___A "DOffsetFactor: characteristic field dependent on VehicleSpeed and RotorSpeed, this replaces 3D-interpolation" MAP 0x1620A4 AblGLKFuw 24.5 DFACTHIGH 0.5 25 FORMAT "%8.5"
 /begin AXIS_DESCR STD_AXIS vSteerCtrl_AbsVehicleSpeedFilt4Interpol_xdu16 VFZHIGH 4 0 500 FORMAT "%8.4" DEPOSIT ABSOLUTE /end AXIS_DESCR
 /begin AXIS_DESCR STD_AXIS nApplI_AbsRotorSpeedFilt_xdu16 VROT 6 0 13000 FORMAT "%3.0" DEPOSIT ABSOLUTE /end AXIS_DESCR
/end CHARACTERISTIC
/begin CHARACTERISTIC xSteerCtrl_DOffsetFactor_XAU16_17___A "DOffsetFactor: characteristic field dependent on VehicleSpeed and RotorSpeed, this replaces 3D-interpolation" MAP 0x1620E8 AblGLKFuw 24.5 DFACTHIGH 0.5 25 FORMAT "%8.5"
 /begin AXIS_DESCR STD_AXIS vSteerCtrl_AbsVehicleSpeedFilt4Interpol_xdu16 VFZHIGH 4 0 500 FORMAT "%8.4" DEPOSIT ABSOLUTE /end AXIS_DESCR
 /begin AXIS_DESCR STD_AXIS nApplI_AbsRotorSpeedFilt_xdu16 VROT 6 0 13000 FORMAT "%3.0" DEPOSIT ABSOLUTE /end AXIS_DESCR
/end CHARACTERISTIC
/begin CHARACTERISTIC xSteerCtrl_DOffsetFactor_XAU16_18___A "DOffsetFactor: characteristic field dependent on VehicleSpeed and RotorSpeed, this replaces 3D-interpolation" MAP 0x16212C AblGLKFuw 24.5 DFACTHIGH 0.5 25 FORMAT "%8.5"
 /begin AXIS_DESCR STD_AXIS vSteerCtrl_AbsVehicleSpeedFilt4Interpol_xdu16 VFZHIGH 4 0 500 FORMAT "%8.4" DEPOSIT ABSOLUTE /end AXIS_DESCR
 /begin AXIS_DESCR STD_AXIS nApplI_AbsRotorSpeedFilt_xdu16 VROT 6 0 13000 FORMAT "%3.0" DEPOSIT ABSOLUTE /end AXIS_DESCR
/end CHARACTERISTIC
/begin CHARACTERISTIC xSteerCtrl_DOffsetFactor_XAU16_19___A "DOffsetFactor: characteristic field dependent on VehicleSpeed and RotorSpeed, this replaces 3D-interpolation" MAP 0x162170 AblGLKFuw 24.5 DFACTHIGH 0.5 25 FORMAT "%8.5"
 /begin AXIS_DESCR STD_AXIS vSteerCtrl_AbsVehicleSpeedFilt4Interpol_xdu16 VFZHIGH 4 0 500 FORMAT "%8.4" DEPOSIT ABSOLUTE /end AXIS_DESCR
 /begin AXIS_DESCR STD_AXIS nApplI_AbsRotorSpeedFilt_xdu16 VROT 6 0 13000 FORMAT "%3.0" DEPOSIT ABSOLUTE /end AXIS_DESCR
/end CHARACTERISTIC
/begin CHARACTERISTIC xSteerCtrl_DOffsetFactor_XAU16_20___A "DOffsetFactor: characteristic field dependent on VehicleSpeed and RotorSpeed, this replaces 3D-interpolation" MAP 0x1621B4 AblGLKFuw 24.5 DFACTHIGH 0.5 25 FORMAT "%8.5"
 /begin AXIS_DESCR STD_AXIS vSteerCtrl_AbsVehicleSpeedFilt4Interpol_xdu16 VFZHIGH 4 0 500 FORMAT "%8.4" DEPOSIT ABSOLUTE /end AXIS_DESCR
 /begin AXIS_DESCR STD_AXIS nApplI_AbsRotorSpeedFilt_xdu16 VROT 6 0 13000 FORMAT "%3.0" DEPOSIT ABSOLUTE /end AXIS_DESCR
/end CHARACTERISTIC
/begin CHARACTERISTIC xSteerCtrl_DOffsetFactor_XAU16_21___A "DOffsetFactor: characteristic field dependent on VehicleSpeed and RotorSpeed, this replaces 3D-interpolation" MAP 0x1621F8 AblGLKFuw 24.5 DFACTHIGH 0.5 25 FORMAT "%8.5"
 /begin AXIS_DESCR STD_AXIS vSteerCtrl_AbsVehicleSpeedFilt4Interpol_xdu16 VFZHIGH 4 0 500 FORMAT "%8.4" DEPOSIT ABSOLUTE /end AXIS_DESCR
 /begin AXIS_DESCR STD_AXIS nApplI_AbsRotorSpeedFilt_xdu16 VROT 6 0 13000 FORMAT "%3.0" DEPOSIT ABSOLUTE /end AXIS_DESCR
/end CHARACTERISTIC
/begin CHARACTERISTIC xSteerCtrl_DOffsetFactor_XAU16_22___A "DOffsetFactor: characteristic field dependent on VehicleSpeed and RotorSpeed, this replaces 3D-interpolation" MAP 0x16223C AblGLKFuw 24.5 DFACTHIGH 0.5 25 FORMAT "%8.5"
 /begin AXIS_DESCR STD_AXIS vSteerCtrl_AbsVehicleSpeedFilt4Interpol_xdu16 VFZHIGH 4 0 500 FORMAT "%8.4" DEPOSIT ABSOLUTE /end AXIS_DESCR
 /begin AXIS_DESCR STD_AXIS nApplI_AbsRotorSpeedFilt_xdu16 VROT 6 0 13000 FORMAT "%3.0" DEPOSIT ABSOLUTE /end AXIS_DESCR
/end CHARACTERISTIC
/begin CHARACTERISTIC xSteerCtrl_DOffsetFactor_XAU16_23___A "DOffsetFactor: characteristic field dependent on VehicleSpeed and RotorSpeed, this replaces 3D-interpolation" MAP 0x162280 AblGLKFuw 24.5 DFACTHIGH 0.5 25 FORMAT "%8.5"
 /begin AXIS_DESCR STD_AXIS vSteerCtrl_AbsVehicleSpeedFilt4Interpol_xdu16 VFZHIGH 4 0 500 FORMAT "%8.4" DEPOSIT ABSOLUTE /end AXIS_DESCR
 /begin AXIS_DESCR STD_AXIS nApplI_AbsRotorSpeedFilt_xdu16 VROT 6 0 13000 FORMAT "%3.0" DEPOSIT ABSOLUTE /end AXIS_DESCR
/end CHARACTERISTIC
/begin CHARACTERISTIC xSteerCtrl_DOffsetFactor_XAU16_24___A "DOffsetFactor: characteristic field dependent on VehicleSpeed and RotorSpeed, this replaces 3D-interpolation" MAP 0x1622C4 AblGLKFuw 24.5 DFACTHIGH 0.5 25 FORMAT "%8.5"
 /begin AXIS_DESCR STD_AXIS vSteerCtrl_AbsVehicleSpeedFilt4Interpol_xdu16 VFZHIGH 4 0 500 FORMAT "%8.4" DEPOSIT ABSOLUTE /end AXIS_DESCR
 /begin AXIS_DESCR STD_AXIS nApplI_AbsRotorSpeedFilt_xdu16 VROT 6 0 13000 FORMAT "%3.0" DEPOSIT ABSOLUTE /end AXIS_DESCR
/end CHARACTERISTIC
/begin CHARACTERISTIC xSteerCtrl_DOffsetFactor_XAU16_25___A "DOffsetFactor: characteristic field dependent on VehicleSpeed and RotorSpeed, this replaces 3D-interpolation" MAP 0x162308 AblGLKFuw 24.5 DFACTHIGH 0.5 25 FORMAT "%8.5"
 /begin AXIS_DESCR STD_AXIS vSteerCtrl_AbsVehicleSpeedFilt4Interpol_xdu16 VFZHIGH 4 0 500 FORMAT "%8.4" DEPOSIT ABSOLUTE /end AXIS_DESCR
 /begin AXIS_DESCR STD_AXIS nApplI_AbsRotorSpeedFilt_xdu16 VROT 6 0 13000 FORMAT "%3.0" DEPOSIT ABSOLUTE /end AXIS_DESCR
/end CHARACTERISTIC
/begin CHARACTERISTIC xSteerCtrl_DOffsetFactor_XAU16_26___A "DOffsetFactor: characteristic field dependent on VehicleSpeed and RotorSpeed, this replaces 3D-interpolation" MAP 0x16234C AblGLKFuw 24.5 DFACTHIGH 0.5 25 FORMAT "%8.5"
 /begin AXIS_DESCR STD_AXIS vSteerCtrl_AbsVehicleSpeedFilt4Interpol_xdu16 VFZHIGH 4 0 500 FORMAT "%8.4" DEPOSIT ABSOLUTE /end AXIS_DESCR
 /begin AXIS_DESCR STD_AXIS nApplI_AbsRotorSpeedFilt_xdu16 VROT 6 0 13000 FORMAT "%3.0" DEPOSIT ABSOLUTE /end AXIS_DESCR
/end CHARACTERISTIC
/begin CHARACTERISTIC xSteerCtrl_DOffsetFactor_XAU16_27___A "DOffsetFactor: characteristic field dependent on VehicleSpeed and RotorSpeed, this replaces 3D-interpolation" MAP 0x162390 AblGLKFuw 24.5 DFACTHIGH 0.5 25 FORMAT "%8.5"
 /begin AXIS_DESCR STD_AXIS vSteerCtrl_AbsVehicleSpeedFilt4Interpol_xdu16 VFZHIGH 4 0 500 FORMAT "%8.4" DEPOSIT ABSOLUTE /end AXIS_DESCR
 /begin AXIS_DESCR STD_AXIS nApplI_AbsRotorSpeedFilt_xdu16 VROT 6 0 13000 FORMAT "%3.0" DEPOSIT ABSOLUTE /end AXIS_DESCR
/end CHARACTERISTIC
/begin CHARACTERISTIC xSteerCtrl_DOffsetFactor_XAU16_28___A "DOffsetFactor: characteristic field dependent on VehicleSpeed and RotorSpeed, this replaces 3D-interpolation" MAP 0x1623D4 AblGLKFuw 24.5 DFACTHIGH 0.5 25 FORMAT "%8.5"
 /begin AXIS_DESCR STD_AXIS vSteerCtrl_AbsVehicleSpeedFilt4Interpol_xdu16 VFZHIGH 4 0 500 FORMAT "%8.4" DEPOSIT ABSOLUTE /end AXIS_DESCR
 /begin AXIS_DESCR STD_AXIS nApplI_AbsRotorSpeedFilt_xdu16 VROT 6 0 13000 FORMAT "%3.0" DEPOSIT ABSOLUTE /end AXIS_DESCR
/end CHARACTERISTIC
/begin CHARACTERISTIC xSteerCtrl_DOffsetFactor_XAU16_29___A "DOffsetFactor: characteristic field dependent on VehicleSpeed and RotorSpeed, this replaces 3D-interpolation" MAP 0x162418 AblGLKFuw 24.5 DFACTHIGH 0.5 25 FORMAT "%8.5"
 /begin AXIS_DESCR STD_AXIS vSteerCtrl_AbsVehicleSpeedFilt4Interpol_xdu16 VFZHIGH 4 0 500 FORMAT "%8.4" DEPOSIT ABSOLUTE /end AXIS_DESCR
 /begin AXIS_DESCR STD_AXIS nApplI_AbsRotorSpeedFilt_xdu16 VROT 6 0 13000 FORMAT "%3.0" DEPOSIT ABSOLUTE /end AXIS_DESCR
/end CHARACTERISTIC
/begin CHARACTERISTIC xSteerCtrl_DOffsetFactor_XAU16_30___A "DOffsetFactor: characteristic field dependent on VehicleSpeed and RotorSpeed, this replaces 3D-interpolation" MAP 0x16245C AblGLKFuw 24.5 DFACTHIGH 0.5 25 FORMAT "%8.5"
 /begin AXIS_DESCR STD_AXIS vSteerCtrl_AbsVehicleSpeedFilt4Interpol_xdu16 VFZHIGH 4 0 500 FORMAT "%8.4" DEPOSIT ABSOLUTE /end AXIS_DESCR
 /begin AXIS_DESCR STD_AXIS nApplI_AbsRotorSpeedFilt_xdu16 VROT 6 0 13000 FORMAT "%3.0" DEPOSIT ABSOLUTE /end AXIS_DESCR
/end CHARACTERISTIC
/begin CHARACTERISTIC xSteerCtrl_DOffsetFactor_XAU16_31___A "DOffsetFactor: characteristic field dependent on VehicleSpeed and RotorSpeed, this replaces 3D-interpolation" MAP 0x1624A0 AblGLKFuw 24.5 DFACTHIGH 0.5 25 FORMAT "%8.5"
 /begin AXIS_DESCR STD_AXIS vSteerCtrl_AbsVehicleSpeedFilt4Interpol_xdu16 VFZHIGH 4 0 500 FORMAT "%8.4" DEPOSIT ABSOLUTE /end AXIS_DESCR
 /begin AXIS_DESCR STD_AXIS nApplI_AbsRotorSpeedFilt_xdu16 VROT 6 0 13000 FORMAT "%3.0" DEPOSIT ABSOLUTE /end AXIS_DESCR
/end CHARACTERISTIC
/begin CHARACTERISTIC xSteerCtrl_DOffsetFactor_XAU16_32___A "DOffsetFactor: characteristic field dependent on VehicleSpeed and RotorSpeed, this replaces 3D-interpolation" MAP 0x1624E4 AblGLKFuw 24.5 DFACTHIGH 0.5 25 FORMAT "%8.5"
 /begin AXIS_DESCR STD_AXIS vSteerCtrl_AbsVehicleSpeedFilt4Interpol_xdu16 VFZHIGH 4 0 500 FORMAT "%8.4" DEPOSIT ABSOLUTE /end AXIS_DESCR
 /begin AXIS_DESCR STD_AXIS nApplI_AbsRotorSpeedFilt_xdu16 VROT 6 0 13000 FORMAT "%3.0" DEPOSIT ABSOLUTE /end AXIS_DESCR
/end CHARACTERISTIC
/begin CHARACTERISTIC xSteerCtrl_DOffsetFactor_XAU16_33___A "DOffsetFactor: characteristic field dependent on VehicleSpeed and RotorSpeed, this replaces 3D-interpolation" MAP 0x162528 AblGLKFuw 24.5 DFACTHIGH 0.5 25 FORMAT "%8.5"
 /begin AXIS_DESCR STD_AXIS vSteerCtrl_AbsVehicleSpeedFilt4Interpol_xdu16 VFZHIGH 4 0 500 FORMAT "%8.4" DEPOSIT ABSOLUTE /end AXIS_DESCR
 /begin AXIS_DESCR STD_AXIS nApplI_AbsRotorSpeedFilt_xdu16 VROT 6 0 13000 FORMAT "%3.0" DEPOSIT ABSOLUTE /end AXIS_DESCR
/end CHARACTERISTIC
/begin CHARACTERISTIC xSteerCtrl_DOffsetFactor_XAU16_34___A "DOffsetFactor: characteristic field dependent on VehicleSpeed and RotorSpeed, this replaces 3D-interpolation" MAP 0x16256C AblGLKFuw 24.5 DFACTHIGH 0.5 25 FORMAT "%8.5"
 /begin AXIS_DESCR STD_AXIS vSteerCtrl_AbsVehicleSpeedFilt4Interpol_xdu16 VFZHIGH 4 0 500 FORMAT "%8.4" DEPOSIT ABSOLUTE /end AXIS_DESCR
 /begin AXIS_DESCR STD_AXIS nApplI_AbsRotorSpeedFilt_xdu16 VROT 6 0 13000 FORMAT "%3.0" DEPOSIT ABSOLUTE /end AXIS_DESCR
/end CHARACTERISTIC
/begin CHARACTERISTIC xSteerCtrl_DOffsetFactor_XAU16_35___A "DOffsetFactor: characteristic field dependent on VehicleSpeed and RotorSpeed, this replaces 3D-interpolation" MAP 0x1625B0 AblGLKFuw 24.5 DFACTHIGH 0.5 25 FORMAT "%8.5"
 /begin AXIS_DESCR STD_AXIS vSteerCtrl_AbsVehicleSpeedFilt4Interpol_xdu16 VFZHIGH 4 0 500 FORMAT "%8.4" DEPOSIT ABSOLUTE /end AXIS_DESCR
 /begin AXIS_DESCR STD_AXIS nApplI_AbsRotorSpeedFilt_xdu16 VROT 6 0 13000 FORMAT "%3.0" DEPOSIT ABSOLUTE /end AXIS_DESCR
/end CHARACTERISTIC
/begin CHARACTERISTIC xSteerCtrl_DPartFactor_XAU16_00___A "DPartFactor: characteristic field dependent on VehicleSpeed and RotorSpeed, this replaces 3D-interpolation" MAP 0x1625F4 AblGLKFuw 24.5 DFACTHIGH 0.5 25 FORMAT "%8.5"
 /begin AXIS_DESCR STD_AXIS vSteerCtrl_AbsVehicleSpeedFilt4Interpol_xdu16 VFZHIGH 4 0 500 FORMAT "%8.4" DEPOSIT ABSOLUTE /end AXIS_DESCR
 /begin AXIS_DESCR STD_AXIS nApplI_AbsRotorSpeedFilt_xdu16 VROT 6 0 13000 FORMAT "%3.0" DEPOSIT ABSOLUTE /end AXIS_DESCR
/end CHARACTERISTIC
/begin CHARACTERISTIC xSteerCtrl_DPartFactor_XAU16_01___A "DPartFactor: characteristic field dependent on VehicleSpeed and RotorSpeed, this replaces 3D-interpolation" MAP 0x162638 AblGLKFuw 24.5 DFACTHIGH 0.5 25 FORMAT "%8.5"
 /begin AXIS_DESCR STD_AXIS vSteerCtrl_AbsVehicleSpeedFilt4Interpol_xdu16 VFZHIGH 4 0 500 FORMAT "%8.4" DEPOSIT ABSOLUTE /end AXIS_DESCR
 /begin AXIS_DESCR STD_AXIS nApplI_AbsRotorSpeedFilt_xdu16 VROT 6 0 13000 FORMAT "%3.0" DEPOSIT ABSOLUTE /end AXIS_DESCR
/end CHARACTERISTIC
/begin CHARACTERISTIC xSteerCtrl_DPartFactor_XAU16_02___A "DPartFactor: characteristic field dependent on VehicleSpeed and RotorSpeed, this replaces 3D-interpolation" MAP 0x16267C AblGLKFuw 24.5 DFACTHIGH 0.5 25 FORMAT "%8.5"
 /begin AXIS_DESCR STD_AXIS vSteerCtrl_AbsVehicleSpeedFilt4Interpol_xdu16 VFZHIGH 4 0 500 FORMAT "%8.4" DEPOSIT ABSOLUTE /end AXIS_DESCR
 /begin AXIS_DESCR STD_AXIS nApplI_AbsRotorSpeedFilt_xdu16 VROT 6 0 13000 FORMAT "%3.0" DEPOSIT ABSOLUTE /end AXIS_DESCR
/end CHARACTERISTIC
/begin CHARACTERISTIC xSteerCtrl_DPartFactor_XAU16_03___A "DPartFactor: characteristic field dependent on VehicleSpeed and RotorSpeed, this replaces 3D-interpolation" MAP 0x1626C0 AblGLKFuw 24.5 DFACTHIGH 0.5 25 FORMAT "%8.5"
 /begin AXIS_DESCR STD_AXIS vSteerCtrl_AbsVehicleSpeedFilt4Interpol_xdu16 VFZHIGH 4 0 500 FORMAT "%8.4" DEPOSIT ABSOLUTE /end AXIS_DESCR
 /begin AXIS_DESCR STD_AXIS nApplI_AbsRotorSpeedFilt_xdu16 VROT 6 0 13000 FORMAT "%3.0" DEPOSIT ABSOLUTE /end AXIS_DESCR
/end CHARACTERISTIC
/begin CHARACTERISTIC xSteerCtrl_DPartFactor_XAU16_04___A "DPartFactor: characteristic field dependent on VehicleSpeed and RotorSpeed, this replaces 3D-interpolation" MAP 0x162704 AblGLKFuw 24.5 DFACTHIGH 0.5 25 FORMAT "%8.5"
 /begin AXIS_DESCR STD_AXIS vSteerCtrl_AbsVehicleSpeedFilt4Interpol_xdu16 VFZHIGH 4 0 500 FORMAT "%8.4" DEPOSIT ABSOLUTE /end AXIS_DESCR
 /begin AXIS_DESCR STD_AXIS nApplI_AbsRotorSpeedFilt_xdu16 VROT 6 0 13000 FORMAT "%3.0" DEPOSIT ABSOLUTE /end AXIS_DESCR
/end CHARACTERISTIC
/begin CHARACTERISTIC xSteerCtrl_DPartFactor_XAU16_05___A "DPartFactor: characteristic field dependent on VehicleSpeed and RotorSpeed, this replaces 3D-interpolation" MAP 0x162748 AblGLKFuw 24.5 DFACTHIGH 0.5 25 FORMAT "%8.5"
 /begin AXIS_DESCR STD_AXIS vSteerCtrl_AbsVehicleSpeedFilt4Interpol_xdu16 VFZHIGH 4 0 500 FORMAT "%8.4" DEPOSIT ABSOLUTE /end AXIS_DESCR
 /begin AXIS_DESCR STD_AXIS nApplI_AbsRotorSpeedFilt_xdu16 VROT 6 0 13000 FORMAT "%3.0" DEPOSIT ABSOLUTE /end AXIS_DESCR
/end CHARACTERISTIC
/begin CHARACTERISTIC xSteerCtrl_DPartFactor_XAU16_06___A "DPartFactor: characteristic field dependent on VehicleSpeed and RotorSpeed, this replaces 3D-interpolation" MAP 0x16278C AblGLKFuw 24.5 DFACTHIGH 0.5 25 FORMAT "%8.5"
 /begin AXIS_DESCR STD_AXIS vSteerCtrl_AbsVehicleSpeedFilt4Interpol_xdu16 VFZHIGH 4 0 500 FORMAT "%8.4" DEPOSIT ABSOLUTE /end AXIS_DESCR
 /begin AXIS_DESCR STD_AXIS nApplI_AbsRotorSpeedFilt_xdu16 VROT 6 0 13000 FORMAT "%3.0" DEPOSIT ABSOLUTE /end AXIS_DESCR
/end CHARACTERISTIC
/begin CHARACTERISTIC xSteerCtrl_DPartFactor_XAU16_07___A "DPartFactor: characteristic field dependent on VehicleSpeed and RotorSpeed, this replaces 3D-interpolation" MAP 0x1627D0 AblGLKFuw 24.5 DFACTHIGH 0.5 25 FORMAT "%8.5"
 /begin AXIS_DESCR STD_AXIS vSteerCtrl_AbsVehicleSpeedFilt4Interpol_xdu16 VFZHIGH 4 0 500 FORMAT "%8.4" DEPOSIT ABSOLUTE /end AXIS_DESCR
 /begin AXIS_DESCR STD_AXIS nApplI_AbsRotorSpeedFilt_xdu16 VROT 6 0 13000 FORMAT "%3.0" DEPOSIT ABSOLUTE /end AXIS_DESCR
/end CHARACTERISTIC
/begin CHARACTERISTIC xSteerCtrl_DPartFactor_XAU16_08___A "DPartFactor: characteristic field dependent on VehicleSpeed and RotorSpeed, this replaces 3D-interpolation" MAP 0x162814 AblGLKFuw 24.5 DFACTHIGH 0.5 25 FORMAT "%8.5"
 /begin AXIS_DESCR STD_AXIS vSteerCtrl_AbsVehicleSpeedFilt4Interpol_xdu16 VFZHIGH 4 0 500 FORMAT "%8.4" DEPOSIT ABSOLUTE /end AXIS_DESCR
 /begin AXIS_DESCR STD_AXIS nApplI_AbsRotorSpeedFilt_xdu16 VROT 6 0 13000 FORMAT "%3.0" DEPOSIT ABSOLUTE /end AXIS_DESCR
/end CHARACTERISTIC
/begin CHARACTERISTIC xSteerCtrl_DPartFactor_XAU16_09___A "DPartFactor: characteristic field dependent on VehicleSpeed and RotorSpeed, this replaces 3D-interpolation" MAP 0x162858 AblGLKFuw 24.5 DFACTHIGH 0.5 25 FORMAT "%8.5"
 /begin AXIS_DESCR STD_AXIS vSteerCtrl_AbsVehicleSpeedFilt4Interpol_xdu16 VFZHIGH 4 0 500 FORMAT "%8.4" DEPOSIT ABSOLUTE /end AXIS_DESCR
 /begin AXIS_DESCR STD_AXIS nApplI_AbsRotorSpeedFilt_xdu16 VROT 6 0 13000 FORMAT "%3.0" DEPOSIT ABSOLUTE /end AXIS_DESCR
/end CHARACTERISTIC
/begin CHARACTERISTIC xSteerCtrl_DPartFactor_XAU16_10___A "DPartFactor: characteristic field dependent on VehicleSpeed and RotorSpeed, this replaces 3D-interpolation" MAP 0x16289C AblGLKFuw 24.5 DFACTHIGH 0.5 25 FORMAT "%8.5"
 /begin AXIS_DESCR STD_AXIS vSteerCtrl_AbsVehicleSpeedFilt4Interpol_xdu16 VFZHIGH 4 0 500 FORMAT "%8.4" DEPOSIT ABSOLUTE /end AXIS_DESCR
 /begin AXIS_DESCR STD_AXIS nApplI_AbsRotorSpeedFilt_xdu16 VROT 6 0 13000 FORMAT "%3.0" DEPOSIT ABSOLUTE /end AXIS_DESCR
/end CHARACTERISTIC
/begin CHARACTERISTIC xSteerCtrl_DPartFactor_XAU16_11___A "DPartFactor: characteristic field dependent on VehicleSpeed and RotorSpeed, this replaces 3D-interpolation" MAP 0x1628E0 AblGLKFuw 24.5 DFACTHIGH 0.5 25 FORMAT "%8.5"
 /begin AXIS_DESCR STD_AXIS vSteerCtrl_AbsVehicleSpeedFilt4Interpol_xdu16 VFZHIGH 4 0 500 FORMAT "%8.4" DEPOSIT ABSOLUTE /end AXIS_DESCR
 /begin AXIS_DESCR STD_AXIS nApplI_AbsRotorSpeedFilt_xdu16 VROT 6 0 13000 FORMAT "%3.0" DEPOSIT ABSOLUTE /end AXIS_DESCR
/end CHARACTERISTIC
/begin CHARACTERISTIC xSteerCtrl_DPartFactor_XAU16_12___A "DPartFactor: characteristic field dependent on VehicleSpeed and RotorSpeed, this replaces 3D-interpolation" MAP 0x162924 AblGLKFuw 24.5 DFACTHIGH 0.5 25 FORMAT "%8.5"
 /begin AXIS_DESCR STD_AXIS vSteerCtrl_AbsVehicleSpeedFilt4Interpol_xdu16 VFZHIGH 4 0 500 FORMAT "%8.4" DEPOSIT ABSOLUTE /end AXIS_DESCR
 /begin AXIS_DESCR STD_AXIS nApplI_AbsRotorSpeedFilt_xdu16 VROT 6 0 13000 FORMAT "%3.0" DEPOSIT ABSOLUTE /end AXIS_DESCR
/end CHARACTERISTIC
/begin CHARACTERISTIC xSteerCtrl_DPartFactor_XAU16_13___A "DPartFactor: characteristic field dependent on VehicleSpeed and RotorSpeed, this replaces 3D-interpolation" MAP 0x162968 AblGLKFuw 24.5 DFACTHIGH 0.5 25 FORMAT "%8.5"
 /begin AXIS_DESCR STD_AXIS vSteerCtrl_AbsVehicleSpeedFilt4Interpol_xdu16 VFZHIGH 4 0 500 FORMAT "%8.4" DEPOSIT ABSOLUTE /end AXIS_DESCR
 /begin AXIS_DESCR STD_AXIS nApplI_AbsRotorSpeedFilt_xdu16 VROT 6 0 13000 FORMAT "%3.0" DEPOSIT ABSOLUTE /end AXIS_DESCR
/end CHARACTERISTIC
/begin CHARACTERISTIC xSteerCtrl_DPartFactor_XAU16_14___A "DPartFactor: characteristic field dependent on VehicleSpeed and RotorSpeed, this replaces 3D-interpolation" MAP 0x1629AC AblGLKFuw 24.5 DFACTHIGH 0.5 25 FORMAT "%8.5"
 /begin AXIS_DESCR STD_AXIS vSteerCtrl_AbsVehicleSpeedFilt4Interpol_xdu16 VFZHIGH 4 0 500 FORMAT "%8.4" DEPOSIT ABSOLUTE /end AXIS_DESCR
 /begin AXIS_DESCR STD_AXIS nApplI_AbsRotorSpeedFilt_xdu16 VROT 6 0 13000 FORMAT "%3.0" DEPOSIT ABSOLUTE /end AXIS_DESCR
/end CHARACTERISTIC
/begin CHARACTERISTIC xSteerCtrl_DPartFactor_XAU16_15___A "DPartFactor: characteristic field dependent on VehicleSpeed and RotorSpeed, this replaces 3D-interpolation" MAP 0x1629F0 AblGLKFuw 24.5 DFACTHIGH 0.5 25 FORMAT "%8.5"
 /begin AXIS_DESCR STD_AXIS vSteerCtrl_AbsVehicleSpeedFilt4Interpol_xdu16 VFZHIGH 4 0 500 FORMAT "%8.4" DEPOSIT ABSOLUTE /end AXIS_DESCR
 /begin AXIS_DESCR STD_AXIS nApplI_AbsRotorSpeedFilt_xdu16 VROT 6 0 13000 FORMAT "%3.0" DEPOSIT ABSOLUTE /end AXIS_DESCR
/end CHARACTERISTIC
/begin CHARACTERISTIC xSteerCtrl_DPartFactor_XAU16_16___A "DPartFactor: characteristic field dependent on VehicleSpeed and RotorSpeed, this replaces 3D-interpolation" MAP 0x162A34 AblGLKFuw 24.5 DFACTHIGH 0.5 25 FORMAT "%8.5"
 /begin AXIS_DESCR STD_AXIS vSteerCtrl_AbsVehicleSpeedFilt4Interpol_xdu16 VFZHIGH 4 0 500 FORMAT "%8.4" DEPOSIT ABSOLUTE /end AXIS_DESCR
 /begin AXIS_DESCR STD_AXIS nApplI_AbsRotorSpeedFilt_xdu16 VROT 6 0 13000 FORMAT "%3.0" DEPOSIT ABSOLUTE /end AXIS_DESCR
/end CHARACTERISTIC
/begin CHARACTERISTIC xSteerCtrl_DPartFactor_XAU16_17___A "DPartFactor: characteristic field dependent on VehicleSpeed and RotorSpeed, this replaces 3D-interpolation" MAP 0x162A78 AblGLKFuw 24.5 DFACTHIGH 0.5 25 FORMAT "%8.5"
 /begin AXIS_DESCR STD_AXIS vSteerCtrl_AbsVehicleSpeedFilt4Interpol_xdu16 VFZHIGH 4 0 500 FORMAT "%8.4" DEPOSIT ABSOLUTE /end AXIS_DESCR
 /begin AXIS_DESCR STD_AXIS nApplI_AbsRotorSpeedFilt_xdu16 VROT 6 0 13000 FORMAT "%3.0" DEPOSIT ABSOLUTE /end AXIS_DESCR
/end CHARACTERISTIC
/begin CHARACTERISTIC xSteerCtrl_DPartFactor_XAU16_18___A "DPartFactor: characteristic field dependent on VehicleSpeed and RotorSpeed, this replaces 3D-interpolation" MAP 0x162ABC AblGLKFuw 24.5 DFACTHIGH 0.5 25 FORMAT "%8.5"
 /begin AXIS_DESCR STD_AXIS vSteerCtrl_AbsVehicleSpeedFilt4Interpol_xdu16 VFZHIGH 4 0 500 FORMAT "%8.4" DEPOSIT ABSOLUTE /end AXIS_DESCR
 /begin AXIS_DESCR STD_AXIS nApplI_AbsRotorSpeedFilt_xdu16 VROT 6 0 13000 FORMAT "%3.0" DEPOSIT ABSOLUTE /end AXIS_DESCR
/end CHARACTERISTIC
/begin CHARACTERISTIC xSteerCtrl_DPartFactor_XAU16_19___A "DPartFactor: characteristic field dependent on VehicleSpeed and RotorSpeed, this replaces 3D-interpolation" MAP 0x162B00 AblGLKFuw 24.5 DFACTHIGH 0.5 25 FORMAT "%8.5"
 /begin AXIS_DESCR STD_AXIS vSteerCtrl_AbsVehicleSpeedFilt4Interpol_xdu16 VFZHIGH 4 0 500 FORMAT "%8.4" DEPOSIT ABSOLUTE /end AXIS_DESCR
 /begin AXIS_DESCR STD_AXIS nApplI_AbsRotorSpeedFilt_xdu16 VROT 6 0 13000 FORMAT "%3.0" DEPOSIT ABSOLUTE /end AXIS_DESCR
/end CHARACTERISTIC
/begin CHARACTERISTIC xSteerCtrl_DPartFactor_XAU16_20___A "DPartFactor: characteristic field dependent on VehicleSpeed and RotorSpeed, this replaces 3D-interpolation" MAP 0x162B44 AblGLKFuw 24.5 DFACTHIGH 0.5 25 FORMAT "%8.5"
 /begin AXIS_DESCR STD_AXIS vSteerCtrl_AbsVehicleSpeedFilt4Interpol_xdu16 VFZHIGH 4 0 500 FORMAT "%8.4" DEPOSIT ABSOLUTE /end AXIS_DESCR
 /begin AXIS_DESCR STD_AXIS nApplI_AbsRotorSpeedFilt_xdu16 VROT 6 0 13000 FORMAT "%3.0" DEPOSIT ABSOLUTE /end AXIS_DESCR
/end CHARACTERISTIC
/begin CHARACTERISTIC xSteerCtrl_DPartFactor_XAU16_21___A "DPartFactor: characteristic field dependent on VehicleSpeed and RotorSpeed, this replaces 3D-interpolation" MAP 0x162B88 AblGLKFuw 24.5 DFACTHIGH 0.5 25 FORMAT "%8.5"
 /begin AXIS_DESCR STD_AXIS vSteerCtrl_AbsVehicleSpeedFilt4Interpol_xdu16 VFZHIGH 4 0 500 FORMAT "%8.4" DEPOSIT ABSOLUTE /end AXIS_DESCR
 /begin AXIS_DESCR STD_AXIS nApplI_AbsRotorSpeedFilt_xdu16 VROT 6 0 13000 FORMAT "%3.0" DEPOSIT ABSOLUTE /end AXIS_DESCR
/end CHARACTERISTIC
/begin CHARACTERISTIC xSteerCtrl_DPartFactor_XAU16_22___A "DPartFactor: characteristic field dependent on VehicleSpeed and RotorSpeed, this replaces 3D-interpolation" MAP 0x162BCC AblGLKFuw 24.5 DFACTHIGH 0.5 25 FORMAT "%8.5"
 /begin AXIS_DESCR STD_AXIS vSteerCtrl_AbsVehicleSpeedFilt4Interpol_xdu16 VFZHIGH 4 0 500 FORMAT "%8.4" DEPOSIT ABSOLUTE /end AXIS_DESCR
 /begin AXIS_DESCR STD_AXIS nApplI_AbsRotorSpeedFilt_xdu16 VROT 6 0 13000 FORMAT "%3.0" DEPOSIT ABSOLUTE /end AXIS_DESCR
/end CHARACTERISTIC
/begin CHARACTERISTIC xSteerCtrl_DPartFactor_XAU16_23___A "DPartFactor: characteristic field dependent on VehicleSpeed and RotorSpeed, this replaces 3D-interpolation" MAP 0x162C10 AblGLKFuw 24.5 DFACTHIGH 0.5 25 FORMAT "%8.5"
 /begin AXIS_DESCR STD_AXIS vSteerCtrl_AbsVehicleSpeedFilt4Interpol_xdu16 VFZHIGH 4 0 500 FORMAT "%8.4" DEPOSIT ABSOLUTE /end AXIS_DESCR
 /begin AXIS_DESCR STD_AXIS nApplI_AbsRotorSpeedFilt_xdu16 VROT 6 0 13000 FORMAT "%3.0" DEPOSIT ABSOLUTE /end AXIS_DESCR
/end CHARACTERISTIC
/begin CHARACTERISTIC xSteerCtrl_DPartFactor_XAU16_24___A "DPartFactor: characteristic field dependent on VehicleSpeed and RotorSpeed, this replaces 3D-interpolation" MAP 0x162C54 AblGLKFuw 24.5 DFACTHIGH 0.5 25 FORMAT "%8.5"
 /begin AXIS_DESCR STD_AXIS vSteerCtrl_AbsVehicleSpeedFilt4Interpol_xdu16 VFZHIGH 4 0 500 FORMAT "%8.4" DEPOSIT ABSOLUTE /end AXIS_DESCR
 /begin AXIS_DESCR STD_AXIS nApplI_AbsRotorSpeedFilt_xdu16 VROT 6 0 13000 FORMAT "%3.0" DEPOSIT ABSOLUTE /end AXIS_DESCR
/end CHARACTERISTIC
/begin CHARACTERISTIC xSteerCtrl_DPartFactor_XAU16_25___A "DPartFactor: characteristic field dependent on VehicleSpeed and RotorSpeed, this replaces 3D-interpolation" MAP 0x162C98 AblGLKFuw 24.5 DFACTHIGH 0.5 25 FORMAT "%8.5"
 /begin AXIS_DESCR STD_AXIS vSteerCtrl_AbsVehicleSpeedFilt4Interpol_xdu16 VFZHIGH 4 0 500 FORMAT "%8.4" DEPOSIT ABSOLUTE /end AXIS_DESCR
 /begin AXIS_DESCR STD_AXIS nApplI_AbsRotorSpeedFilt_xdu16 VROT 6 0 13000 FORMAT "%3.0" DEPOSIT ABSOLUTE /end AXIS_DESCR
/end CHARACTERISTIC
/begin CHARACTERISTIC xSteerCtrl_DPartFactor_XAU16_26___A "DPartFactor: characteristic field dependent on VehicleSpeed and RotorSpeed, this replaces 3D-interpolation" MAP 0x162CDC AblGLKFuw 24.5 DFACTHIGH 0.5 25 FORMAT "%8.5"
 /begin AXIS_DESCR STD_AXIS vSteerCtrl_AbsVehicleSpeedFilt4Interpol_xdu16 VFZHIGH 4 0 500 FORMAT "%8.4" DEPOSIT ABSOLUTE /end AXIS_DESCR
 /begin AXIS_DESCR STD_AXIS nApplI_AbsRotorSpeedFilt_xdu16 VROT 6 0 13000 FORMAT "%3.0" DEPOSIT ABSOLUTE /end AXIS_DESCR
/end CHARACTERISTIC
/begin CHARACTERISTIC xSteerCtrl_DPartFactor_XAU16_27___A "DPartFactor: characteristic field dependent on VehicleSpeed and RotorSpeed, this replaces 3D-interpolation" MAP 0x162D20 AblGLKFuw 24.5 DFACTHIGH 0.5 25 FORMAT "%8.5"
 /begin AXIS_DESCR STD_AXIS vSteerCtrl_AbsVehicleSpeedFilt4Interpol_xdu16 VFZHIGH 4 0 500 FORMAT "%8.4" DEPOSIT ABSOLUTE /end AXIS_DESCR
 /begin AXIS_DESCR STD_AXIS nApplI_AbsRotorSpeedFilt_xdu16 VROT 6 0 13000 FORMAT "%3.0" DEPOSIT ABSOLUTE /end AXIS_DESCR
/end CHARACTERISTIC
/begin CHARACTERISTIC xSteerCtrl_DPartFactor_XAU16_28___A "DPartFactor: characteristic field dependent on VehicleSpeed and RotorSpeed, this replaces 3D-interpolation" MAP 0x162D64 AblGLKFuw 24.5 DFACTHIGH 0.5 25 FORMAT "%8.5"
 /begin AXIS_DESCR STD_AXIS vSteerCtrl_AbsVehicleSpeedFilt4Interpol_xdu16 VFZHIGH 4 0 500 FORMAT "%8.4" DEPOSIT ABSOLUTE /end AXIS_DESCR
 /begin AXIS_DESCR STD_AXIS nApplI_AbsRotorSpeedFilt_xdu16 VROT 6 0 13000 FORMAT "%3.0" DEPOSIT ABSOLUTE /end AXIS_DESCR
/end CHARACTERISTIC
/begin CHARACTERISTIC xSteerCtrl_DPartFactor_XAU16_29___A "DPartFactor: characteristic field dependent on VehicleSpeed and RotorSpeed, this replaces 3D-interpolation" MAP 0x162DA8 AblGLKFuw 24.5 DFACTHIGH 0.5 25 FORMAT "%8.5"
 /begin AXIS_DESCR STD_AXIS vSteerCtrl_AbsVehicleSpeedFilt4Interpol_xdu16 VFZHIGH 4 0 500 FORMAT "%8.4" DEPOSIT ABSOLUTE /end AXIS_DESCR
 /begin AXIS_DESCR STD_AXIS nApplI_AbsRotorSpeedFilt_xdu16 VROT 6 0 13000 FORMAT "%3.0" DEPOSIT ABSOLUTE /end AXIS_DESCR
/end CHARACTERISTIC
/begin CHARACTERISTIC xSteerCtrl_DPartFactor_XAU16_30___A "DPartFactor: characteristic field dependent on VehicleSpeed and RotorSpeed, this replaces 3D-interpolation" MAP 0x162DEC AblGLKFuw 24.5 DFACTHIGH 0.5 25 FORMAT "%8.5"
 /begin AXIS_DESCR STD_AXIS vSteerCtrl_AbsVehicleSpeedFilt4Interpol_xdu16 VFZHIGH 4 0 500 FORMAT "%8.4" DEPOSIT ABSOLUTE /end AXIS_DESCR
 /begin AXIS_DESCR STD_AXIS nApplI_AbsRotorSpeedFilt_xdu16 VROT 6 0 13000 FORMAT "%3.0" DEPOSIT ABSOLUTE /end AXIS_DESCR
/end CHARACTERISTIC
/begin CHARACTERISTIC xSteerCtrl_DPartFactor_XAU16_31___A "DPartFactor: characteristic field dependent on VehicleSpeed and RotorSpeed, this replaces 3D-interpolation" MAP 0x162E30 AblGLKFuw 24.5 DFACTHIGH 0.5 25 FORMAT "%8.5"
 /begin AXIS_DESCR STD_AXIS vSteerCtrl_AbsVehicleSpeedFilt4Interpol_xdu16 VFZHIGH 4 0 500 FORMAT "%8.4" DEPOSIT ABSOLUTE /end AXIS_DESCR
 /begin AXIS_DESCR STD_AXIS nApplI_AbsRotorSpeedFilt_xdu16 VROT 6 0 13000 FORMAT "%3.0" DEPOSIT ABSOLUTE /end AXIS_DESCR
/end CHARACTERISTIC
/begin CHARACTERISTIC xSteerCtrl_DPartFactor_XAU16_32___A "DPartFactor: characteristic field dependent on VehicleSpeed and RotorSpeed, this replaces 3D-interpolation" MAP 0x162E74 AblGLKFuw 24.5 DFACTHIGH 0.5 25 FORMAT "%8.5"
 /begin AXIS_DESCR STD_AXIS vSteerCtrl_AbsVehicleSpeedFilt4Interpol_xdu16 VFZHIGH 4 0 500 FORMAT "%8.4" DEPOSIT ABSOLUTE /end AXIS_DESCR
 /begin AXIS_DESCR STD_AXIS nApplI_AbsRotorSpeedFilt_xdu16 VROT 6 0 13000 FORMAT "%3.0" DEPOSIT ABSOLUTE /end AXIS_DESCR
/end CHARACTERISTIC
/begin CHARACTERISTIC xSteerCtrl_DPartFactor_XAU16_33___A "DPartFactor: characteristic field dependent on VehicleSpeed and RotorSpeed, this replaces 3D-interpolation" MAP 0x162EB8 AblGLKFuw 24.5 DFACTHIGH 0.5 25 FORMAT "%8.5"
 /begin AXIS_DESCR STD_AXIS vSteerCtrl_AbsVehicleSpeedFilt4Interpol_xdu16 VFZHIGH 4 0 500 FORMAT "%8.4" DEPOSIT ABSOLUTE /end AXIS_DESCR
 /begin AXIS_DESCR STD_AXIS nApplI_AbsRotorSpeedFilt_xdu16 VROT 6 0 13000 FORMAT "%3.0" DEPOSIT ABSOLUTE /end AXIS_DESCR
/end CHARACTERISTIC
/begin CHARACTERISTIC xSteerCtrl_DPartFactor_XAU16_34___A "DPartFactor: characteristic field dependent on VehicleSpeed and RotorSpeed, this replaces 3D-interpolation" MAP 0x162EFC AblGLKFuw 24.5 DFACTHIGH 0.5 25 FORMAT "%8.5"
 /begin AXIS_DESCR STD_AXIS vSteerCtrl_AbsVehicleSpeedFilt4Interpol_xdu16 VFZHIGH 4 0 500 FORMAT "%8.4" DEPOSIT ABSOLUTE /end AXIS_DESCR
 /begin AXIS_DESCR STD_AXIS nApplI_AbsRotorSpeedFilt_xdu16 VROT 6 0 13000 FORMAT "%3.0" DEPOSIT ABSOLUTE /end AXIS_DESCR
/end CHARACTERISTIC
/begin CHARACTERISTIC xSteerCtrl_DPartFactor_XAU16_35___A "DPartFactor: characteristic field dependent on VehicleSpeed and RotorSpeed, this replaces 3D-interpolation" MAP 0x162F40 AblGLKFuw 24.5 DFACTHIGH 0.5 25 FORMAT "%8.5"
 /begin AXIS_DESCR STD_AXIS vSteerCtrl_AbsVehicleSpeedFilt4Interpol_xdu16 VFZHIGH 4 0 500 FORMAT "%8.4" DEPOSIT ABSOLUTE /end AXIS_DESCR
 /begin AXIS_DESCR STD_AXIS nApplI_AbsRotorSpeedFilt_xdu16 VROT 6 0 13000 FORMAT "%3.0" DEPOSIT ABSOLUTE /end AXIS_DESCR
/end CHARACTERISTIC
/begin CHARACTERISTIC xSteerCtrl_FilterGradTBT_XAU16 "Filter GradTBT: characteristic field dependent on VehicleSpeed and RotorSpeed" MAP 0x1519DC AblGLKFuw 0.999023 RIGHTSH10NP 0.0009765625 1 FORMAT "%8.6"
 /begin AXIS_DESCR STD_AXIS vSteerCtrl_AbsVehicleSpeedFilt4Interpol_xdu16 VFZHIGH 3 0 500 FORMAT "%8.4" DEPOSIT ABSOLUTE /end AXIS_DESCR
 /begin AXIS_DESCR STD_AXIS nApplI_AbsRotorSpeedFilt_xdu16 VROT 4 0 13000 FORMAT "%3.0" DEPOSIT ABSOLUTE /end AXIS_DESCR
/end CHARACTERISTIC
/begin CHARACTERISTIC xSteerCtrl_HysteresisTBT_XAU16 "DeadZone TBT: characteristic field dependent on VehicleSpeed and RotorSpeed" MAP 0x151A04 AblGLKFuw 1 TBTHIGH 0 1 FORMAT "%8.6"
 /begin AXIS_DESCR STD_AXIS vSteerCtrl_AbsVehicleSpeedFilt4Interpol_xdu16 VFZHIGH 3 0 500 FORMAT "%8.4" DEPOSIT ABSOLUTE /end AXIS_DESCR
 /begin AXIS_DESCR STD_AXIS nApplI_AbsRotorSpeedFilt_xdu16 VROT 4 0 13000 FORMAT "%3.0" DEPOSIT ABSOLUTE /end AXIS_DESCR
/end CHARACTERISTIC
/begin CHARACTERISTIC xSteerCtrl_SubstDOffsetFactChatter_XDU16_0___A "substitute value of D-part offset factor (due to TorsionBarTorqueGradient) if chattering is detected" VALUE 0x1584A4 AblGLKWuw 25 DFACTHIGH 0 25 FORMAT "%8.5" /end CHARACTERISTIC
/begin CHARACTERISTIC xSteerCtrl_SubstDOffsetFactChatter_XDU16_1___A "substitute value of D-part offset factor (due to TorsionBarTorqueGradient) if chattering is detected" VALUE 0x1584A6 AblGLKWuw 25 DFACTHIGH 0 25 FORMAT "%8.5" /end CHARACTERISTIC
/begin CHARACTERISTIC xSteerCtrl_SubstDOffsetFactChatter_XDU16_2___A "substitute value of D-part offset factor (due to TorsionBarTorqueGradient) if chattering is detected" VALUE 0x1584A8 AblGLKWuw 25 DFACTHIGH 0 25 FORMAT "%8.5" /end CHARACTERISTIC
/begin CHARACTERISTIC xSteerCtrl_SubstDOffsetFactChatter_XDU16_3___A "substitute value of D-part offset factor (due to TorsionBarTorqueGradient) if chattering is detected" VALUE 0x1584AA AblGLKWuw 25 DFACTHIGH 0 25 FORMAT "%8.5" /end CHARACTERISTIC
/begin CHARACTERISTIC xSteerCtrl_SubstDPartFactChatter_XDU16_0___A "substitute value of D-part factor (due to assistance torque) if chattering is detected" VALUE 0x1584AC AblGLKWuw 25 DFACTHIGH 0 25 FORMAT "%8.5" /end CHARACTERISTIC
/begin CHARACTERISTIC xSteerCtrl_SubstDPartFactChatter_XDU16_1___A "substitute value of D-part factor (due to assistance torque) if chattering is detected" VALUE 0x1584AE AblGLKWuw 25 DFACTHIGH 0 25 FORMAT "%8.5" /end CHARACTERISTIC
/begin CHARACTERISTIC xSteerCtrl_SubstDPartFactChatter_XDU16_2___A "substitute value of D-part factor (due to assistance torque) if chattering is detected" VALUE 0x1584B0 AblGLKWuw 25 DFACTHIGH 0 25 FORMAT "%8.5" /end CHARACTERISTIC
/begin CHARACTERISTIC xSteerCtrl_SubstDPartFactChatter_XDU16_3___A "substitute value of D-part factor (due to assistance torque) if chattering is detected" VALUE 0x1584B2 AblGLKWuw 25 DFACTHIGH 0 25 FORMAT "%8.5" /end CHARACTERISTIC
/begin CHARACTERISTIC xStTorCtrlP_DFactorTBTControl_XAU16_0___A "D-part factor depending on absolute filtered rotor speed" CURVE 0x15FCE4 AblGLKLuw 10 RIGHTSH10NP 0 10 FORMAT "%8.5"
 /begin AXIS_DESCR STD_AXIS nApplI_AbsRotorSpeedFilt_xdu16 VROT 4 0 4002 FORMAT "%3.0" DEPOSIT ABSOLUTE /end AXIS_DESCR
/end CHARACTERISTIC
/begin CHARACTERISTIC xStTorCtrlP_DFactorTBTControl_XAU16_1___A "D-part factor depending on absolute filtered rotor speed" CURVE 0x15FCF8 AblGLKLuw 10 RIGHTSH10NP 0 10 FORMAT "%8.5"
 /begin AXIS_DESCR STD_AXIS nApplI_AbsRotorSpeedFilt_xdu16 VROT 4 0 4002 FORMAT "%3.0" DEPOSIT ABSOLUTE /end AXIS_DESCR
/end CHARACTERISTIC
/begin CHARACTERISTIC xStTorCtrlP_DFactorTBTControl_XAU16_2___A "D-part factor depending on absolute filtered rotor speed" CURVE 0x15FD0C AblGLKLuw 10 RIGHTSH10NP 0 10 FORMAT "%8.5"
 /begin AXIS_DESCR STD_AXIS nApplI_AbsRotorSpeedFilt_xdu16 VROT 4 0 4002 FORMAT "%3.0" DEPOSIT ABSOLUTE /end AXIS_DESCR
/end CHARACTERISTIC
/begin CHARACTERISTIC xStTorCtrlP_DFactorTBTControl_XAU16_3___A "D-part factor depending on absolute filtered rotor speed" CURVE 0x15FD20 AblGLKLuw 10 RIGHTSH10NP 0 10 FORMAT "%8.5"
 /begin AXIS_DESCR STD_AXIS nApplI_AbsRotorSpeedFilt_xdu16 VROT 4 0 4002 FORMAT "%3.0" DEPOSIT ABSOLUTE /end AXIS_DESCR
/end CHARACTERISTIC
/begin CHARACTERISTIC xStTorCtrlP_DFactorTBTControl_XAU16_4___A "D-part factor depending on absolute filtered rotor speed" CURVE 0x15FD34 AblGLKLuw 10 RIGHTSH10NP 0 10 FORMAT "%8.5"
 /begin AXIS_DESCR STD_AXIS nApplI_AbsRotorSpeedFilt_xdu16 VROT 4 0 4002 FORMAT "%3.0" DEPOSIT ABSOLUTE /end AXIS_DESCR
/end CHARACTERISTIC
/begin CHARACTERISTIC xStTorCtrlP_DFactorTBTControl_XAU16_5___A "D-part factor depending on absolute filtered rotor speed" CURVE 0x15FD48 AblGLKLuw 10 RIGHTSH10NP 0 10 FORMAT "%8.5"
 /begin AXIS_DESCR STD_AXIS nApplI_AbsRotorSpeedFilt_xdu16 VROT 4 0 4002 FORMAT "%3.0" DEPOSIT ABSOLUTE /end AXIS_DESCR
/end CHARACTERISTIC
/begin CHARACTERISTIC xStTorCtrlP_DPt1FactorTBTControl_XDU16_0___A "D-part PT1 filter factor" VALUE 0x1584B4 AblGLKWuw 1 RIGHTSH10NP 0 1 FORMAT "%8.6" /end CHARACTERISTIC
/begin CHARACTERISTIC xStTorCtrlP_DPt1FactorTBTControl_XDU16_1___A "D-part PT1 filter factor" VALUE 0x1584B6 AblGLKWuw 1 RIGHTSH10NP 0 1 FORMAT "%8.6" /end CHARACTERISTIC
/begin CHARACTERISTIC xStTorCtrlP_DPt1FactorTBTControl_XDU16_2___A "D-part PT1 filter factor" VALUE 0x1584B8 AblGLKWuw 1 RIGHTSH10NP 0 1 FORMAT "%8.6" /end CHARACTERISTIC
/begin CHARACTERISTIC xStTorCtrlP_DPt1FactorTBTControl_XDU16_3___A "D-part PT1 filter factor" VALUE 0x1584BA AblGLKWuw 1 RIGHTSH10NP 0 1 FORMAT "%8.6" /end CHARACTERISTIC
/begin CHARACTERISTIC xStTorCtrlP_DPt1FactorTBTControl_XDU16_4___A "D-part PT1 filter factor" VALUE 0x1584BC AblGLKWuw 1 RIGHTSH10NP 0 1 FORMAT "%8.6" /end CHARACTERISTIC
/begin CHARACTERISTIC xStTorCtrlP_DPt1FactorTBTControl_XDU16_5___A "D-part PT1 filter factor" VALUE 0x1584BE AblGLKWuw 1 RIGHTSH10NP 0 1 FORMAT "%8.6" /end CHARACTERISTIC
/begin CHARACTERISTIC xStTorCtrlP_FactChatterMMotMax_XAU16 "factor maximum motor torque dependent on chatter period counts" CURVE 0x151A2C AblGLKLuw 1 RIGHTSH10NP 0 1 FORMAT "%8.6"
 /begin AXIS_DESCR STD_AXIS zcrChatterPeriodsCount_xdu8 ZU0 3 0 100 FORMAT "%5.1" DEPOSIT ABSOLUTE /end AXIS_DESCR
/end CHARACTERISTIC
/begin CHARACTERISTIC xStTorCtrlP_FactorDepOnWeightedInt_XAU16_0___A "maximum allowed motor torque factor depending on WeightedIntegratedDeviation (MTL)" CURVE 0x15FD5C AblGLKLuw 1 RIGHTSH15NP 0 1 FORMAT "%8.6"
 /begin AXIS_DESCR STD_AXIS xMotTorLimI_WeightedIntegratedDeviation_xdu16 RIGHTSH15NP 2 0 1 FORMAT "%8.6" DEPOSIT ABSOLUTE /end AXIS_DESCR
/end CHARACTERISTIC
/begin CHARACTERISTIC xStTorCtrlP_FactorDepOnWeightedInt_XAU16_1___A "maximum allowed motor torque factor depending on WeightedIntegratedDeviation (MTL)" CURVE 0x15FD68 AblGLKLuw 1 RIGHTSH15NP 0 1 FORMAT "%8.6"
 /begin AXIS_DESCR STD_AXIS xMotTorLimI_WeightedIntegratedDeviation_xdu16 RIGHTSH15NP 2 0 1 FORMAT "%8.6" DEPOSIT ABSOLUTE /end AXIS_DESCR
/end CHARACTERISTIC
/begin CHARACTERISTIC xStTorCtrlP_FactorDepOnWeightedInt_XAU16_2___A "maximum allowed motor torque factor depending on WeightedIntegratedDeviation (MTL)" CURVE 0x15FD74 AblGLKLuw 1 RIGHTSH15NP 0 1 FORMAT "%8.6"
 /begin AXIS_DESCR STD_AXIS xMotTorLimI_WeightedIntegratedDeviation_xdu16 RIGHTSH15NP 2 0 1 FORMAT "%8.6" DEPOSIT ABSOLUTE /end AXIS_DESCR
/end CHARACTERISTIC
/begin CHARACTERISTIC xStTorCtrlP_FactorDepOnWeightedInt_XAU16_3___A "maximum allowed motor torque factor depending on WeightedIntegratedDeviation (MTL)" CURVE 0x15FD80 AblGLKLuw 1 RIGHTSH15NP 0 1 FORMAT "%8.6"
 /begin AXIS_DESCR STD_AXIS xMotTorLimI_WeightedIntegratedDeviation_xdu16 RIGHTSH15NP 2 0 1 FORMAT "%8.6" DEPOSIT ABSOLUTE /end AXIS_DESCR
/end CHARACTERISTIC
/begin CHARACTERISTIC xStTorCtrlP_FactorDepOnWeightedInt_XAU16_4___A "maximum allowed motor torque factor depending on WeightedIntegratedDeviation (MTL)" CURVE 0x15FD8C AblGLKLuw 1 RIGHTSH15NP 0 1 FORMAT "%8.6"
 /begin AXIS_DESCR STD_AXIS xMotTorLimI_WeightedIntegratedDeviation_xdu16 RIGHTSH15NP 2 0 1 FORMAT "%8.6" DEPOSIT ABSOLUTE /end AXIS_DESCR
/end CHARACTERISTIC
/begin CHARACTERISTIC xStTorCtrlP_FactorDepOnWeightedInt_XAU16_5___A "maximum allowed motor torque factor depending on WeightedIntegratedDeviation (MTL)" CURVE 0x15FD98 AblGLKLuw 1 RIGHTSH15NP 0 1 FORMAT "%8.6"
 /begin AXIS_DESCR STD_AXIS xMotTorLimI_WeightedIntegratedDeviation_xdu16 RIGHTSH15NP 2 0 1 FORMAT "%8.6" DEPOSIT ABSOLUTE /end AXIS_DESCR
/end CHARACTERISTIC
/begin CHARACTERISTIC xStTorCtrlP_IFactorTBTControl_XAU16_0___A "I-part factor depending on absolute filtered rotor speed" CURVE 0x15FDA4 AblGLKLuw 1 RIGHTSH15NP 0 1 FORMAT "%8.6"
 /begin AXIS_DESCR STD_AXIS nApplI_AbsRotorSpeedFilt_xdu16 VROT 4 0 4002 FORMAT "%3.0" DEPOSIT ABSOLUTE /end AXIS_DESCR
/end CHARACTERISTIC
/begin CHARACTERISTIC xStTorCtrlP_IFactorTBTControl_XAU16_1___A "I-part factor depending on absolute filtered rotor speed" CURVE 0x15FDB8 AblGLKLuw 1 RIGHTSH15NP 0 1 FORMAT "%8.6"
 /begin AXIS_DESCR STD_AXIS nApplI_AbsRotorSpeedFilt_xdu16 VROT 4 0 4002 FORMAT "%3.0" DEPOSIT ABSOLUTE /end AXIS_DESCR
/end CHARACTERISTIC
/begin CHARACTERISTIC xStTorCtrlP_IFactorTBTControl_XAU16_2___A "I-part factor depending on absolute filtered rotor speed" CURVE 0x15FDCC AblGLKLuw 1 RIGHTSH15NP 0 1 FORMAT "%8.6"
 /begin AXIS_DESCR STD_AXIS nApplI_AbsRotorSpeedFilt_xdu16 VROT 4 0 4002 FORMAT "%3.0" DEPOSIT ABSOLUTE /end AXIS_DESCR
/end CHARACTERISTIC
/begin CHARACTERISTIC xStTorCtrlP_IFactorTBTControl_XAU16_3___A "I-part factor depending on absolute filtered rotor speed" CURVE 0x15FDE0 AblGLKLuw 1 RIGHTSH15NP 0 1 FORMAT "%8.6"
 /begin AXIS_DESCR STD_AXIS nApplI_AbsRotorSpeedFilt_xdu16 VROT 4 0 4002 FORMAT "%3.0" DEPOSIT ABSOLUTE /end AXIS_DESCR
/end CHARACTERISTIC
/begin CHARACTERISTIC xStTorCtrlP_IFactorTBTControl_XAU16_4___A "I-part factor depending on absolute filtered rotor speed" CURVE 0x15FDF4 AblGLKLuw 1 RIGHTSH15NP 0 1 FORMAT "%8.6"
 /begin AXIS_DESCR STD_AXIS nApplI_AbsRotorSpeedFilt_xdu16 VROT 4 0 4002 FORMAT "%3.0" DEPOSIT ABSOLUTE /end AXIS_DESCR
/end CHARACTERISTIC
/begin CHARACTERISTIC xStTorCtrlP_IFactorTBTControl_XAU16_5___A "I-part factor depending on absolute filtered rotor speed" CURVE 0x15FE08 AblGLKLuw 1 RIGHTSH15NP 0 1 FORMAT "%8.6"
 /begin AXIS_DESCR STD_AXIS nApplI_AbsRotorSpeedFilt_xdu16 VROT 4 0 4002 FORMAT "%3.0" DEPOSIT ABSOLUTE /end AXIS_DESCR
/end CHARACTERISTIC
/begin CHARACTERISTIC xStTorCtrlP_PFactorTBTControl_XAU16_0___A "P-part factor depending on absolute filtered rotor speed" CURVE 0x15FE1C AblGLKLuw 1 RIGHTSH10NP 0 1 FORMAT "%8.6"
 /begin AXIS_DESCR STD_AXIS nApplI_AbsRotorSpeedFilt_xdu16 VROT 4 0 4002 FORMAT "%3.0" DEPOSIT ABSOLUTE /end AXIS_DESCR
/end CHARACTERISTIC
/begin CHARACTERISTIC xStTorCtrlP_PFactorTBTControl_XAU16_1___A "P-part factor depending on absolute filtered rotor speed" CURVE 0x15FE30 AblGLKLuw 1 RIGHTSH10NP 0 1 FORMAT "%8.6"
 /begin AXIS_DESCR STD_AXIS nApplI_AbsRotorSpeedFilt_xdu16 VROT 4 0 4002 FORMAT "%3.0" DEPOSIT ABSOLUTE /end AXIS_DESCR
/end CHARACTERISTIC
/begin CHARACTERISTIC xStTorCtrlP_PFactorTBTControl_XAU16_2___A "P-part factor depending on absolute filtered rotor speed" CURVE 0x15FE44 AblGLKLuw 1 RIGHTSH10NP 0 1 FORMAT "%8.6"
 /begin AXIS_DESCR STD_AXIS nApplI_AbsRotorSpeedFilt_xdu16 VROT 4 0 4002 FORMAT "%3.0" DEPOSIT ABSOLUTE /end AXIS_DESCR
/end CHARACTERISTIC
/begin CHARACTERISTIC xStTorCtrlP_PFactorTBTControl_XAU16_3___A "P-part factor depending on absolute filtered rotor speed" CURVE 0x15FE58 AblGLKLuw 1 RIGHTSH10NP 0 1 FORMAT "%8.6"
 /begin AXIS_DESCR STD_AXIS nApplI_AbsRotorSpeedFilt_xdu16 VROT 4 0 4002 FORMAT "%3.0" DEPOSIT ABSOLUTE /end AXIS_DESCR
/end CHARACTERISTIC
/begin CHARACTERISTIC xStTorCtrlP_PFactorTBTControl_XAU16_4___A "P-part factor depending on absolute filtered rotor speed" CURVE 0x15FE6C AblGLKLuw 1 RIGHTSH10NP 0 1 FORMAT "%8.6"
 /begin AXIS_DESCR STD_AXIS nApplI_AbsRotorSpeedFilt_xdu16 VROT 4 0 4002 FORMAT "%3.0" DEPOSIT ABSOLUTE /end AXIS_DESCR
/end CHARACTERISTIC
/begin CHARACTERISTIC xStTorCtrlP_PFactorTBTControl_XAU16_5___A "P-part factor depending on absolute filtered rotor speed" CURVE 0x15FE80 AblGLKLuw 1 RIGHTSH10NP 0 1 FORMAT "%8.6"
 /begin AXIS_DESCR STD_AXIS nApplI_AbsRotorSpeedFilt_xdu16 VROT 4 0 4002 FORMAT "%3.0" DEPOSIT ABSOLUTE /end AXIS_DESCR
/end CHARACTERISTIC
/begin CHARACTERISTIC xStTorCtrlP_PPt1FactorTBTControl_XDU16_0___A "P-part PT1 filter factor" VALUE 0x1584C0 AblGLKWuw 1 RIGHTSH10NP 0 1 FORMAT "%8.6" /end CHARACTERISTIC
/begin CHARACTERISTIC xStTorCtrlP_PPt1FactorTBTControl_XDU16_1___A "P-part PT1 filter factor" VALUE 0x1584C2 AblGLKWuw 1 RIGHTSH10NP 0 1 FORMAT "%8.6" /end CHARACTERISTIC
/begin CHARACTERISTIC xStTorCtrlP_PPt1FactorTBTControl_XDU16_2___A "P-part PT1 filter factor" VALUE 0x1584C4 AblGLKWuw 1 RIGHTSH10NP 0 1 FORMAT "%8.6" /end CHARACTERISTIC
/begin CHARACTERISTIC xStTorCtrlP_PPt1FactorTBTControl_XDU16_3___A "P-part PT1 filter factor" VALUE 0x1584C6 AblGLKWuw 1 RIGHTSH10NP 0 1 FORMAT "%8.6" /end CHARACTERISTIC
/begin CHARACTERISTIC xStTorCtrlP_PPt1FactorTBTControl_XDU16_4___A "P-part PT1 filter factor" VALUE 0x1584C8 AblGLKWuw 1 RIGHTSH10NP 0 1 FORMAT "%8.6" /end CHARACTERISTIC
/begin CHARACTERISTIC xStTorCtrlP_PPt1FactorTBTControl_XDU16_5___A "P-part PT1 filter factor" VALUE 0x1584CA AblGLKWuw 1 RIGHTSH10NP 0 1 FORMAT "%8.6" /end CHARACTERISTIC
/begin CHARACTERISTIC xStTorCtrlP_RampInGrad_XDU16 "gradient to ramp in the motor torque [factor / 10 ms]" VALUE 0x150A4E AblGLKWuw 0.999023 RIGHTSH10NP_10MS 0.0009765625 1 FORMAT "%8.6" /end CHARACTERISTIC
/begin CHARACTERISTIC xStTorCtrlP_RampOutGrad_XDU16 "gradient to ramp out the motor torque [factor / 10 ms]" VALUE 0x150A50 AblGLKWuw 0.999023 RIGHTSH10NP_10MS 0.0009765625 1 FORMAT "%8.6" /end CHARACTERISTIC
/begin CHARACTERISTIC xsyEngTorqueToRackForce_XDU16 "Faktor von Motormoment auf Zahnstangenkraft" VALUE 0x150A52 AblGLKWuw 4999 TORQUE2FORCE 1 5000 FORMAT "%8.3" /end CHARACTERISTIC
/begin CHARACTERISTIC xsyExpandedRotorInertia_XDU16 "Zusammengefasste Massenträgheit [kgm^2] von Rotor, Schnecke, Lager, ... " VALUE 0x150A54 AblGLKWuw 0.000999987 RIGHTSH24NP 0 0.0009999871 FORMAT "%11.9" /end CHARACTERISTIC
/begin CHARACTERISTIC xsyGearRatioMot2Rack_XDU16 "Faktor für Umrechnung Motorumdrehung [360°] auf Zahnstangenweg [mm]" VALUE 0x150A56 AblGLKWuw 3 RACKPOS128 2 5 FORMAT "%8.6" /end CHARACTERISTIC
/begin CHARACTERISTIC xsyInvSteeringRatioVarFact_XAU16 "Anpassfaktor Übersetzung für i variabel" CURVE 0x151A3C AblGLKLuw 1.99902 RIGHTSH10NP 0.0009765625 2 FORMAT "%8.6"
 /begin AXIS_DESCR STD_AXIS wApplI_AbsSteeringAngle_xdu16 SA_10 13 0 700 FORMAT "%8.4" DEPOSIT ABSOLUTE /end AXIS_DESCR
/end CHARACTERISTIC
/begin CHARACTERISTIC xsyInvSystemStiff_XDU16 "inverse Systemsteifigkeit = 1/1.5 * 2^16 * SA10/TBTHIGH (Drehstabsteifigkeit+Lenksaeule)^-1, bei Änderung muss Systemsteifigkeit nachgezogen werden " VALUE 0x150A58 AblGLKWuw 900 ZU0 100 1000 FORMAT "%8.3" /end CHARACTERISTIC
/begin CHARACTERISTIC xsyNoEffDepEngTorqueToRackForce_XDU16 "Faktor von Motormoment auf Zahnstangenkraft ohne Wirkungsgrad" VALUE 0x150A5A AblGLKWuw 4999 TORQUE2FORCE 1 5000 FORMAT "%8.3" /end CHARACTERISTIC
/begin CHARACTERISTIC xsyRackForceToEngTorque_XDU16 "Faktor von Zahnstangenkraft auf Motormoment" VALUE 0x150A5C AblGLKWuw 0.00300002 FORCE2TORQUE 0 0.003000021 FORMAT "%11.9" /end CHARACTERISTIC
/begin CHARACTERISTIC xsyRatioEfficiency_XDU16 "Faktor für Umrechnung Handmoment auf Motormoment" VALUE 0x150A5E AblGLKWuw 0.200012 RIGHTSH15NP 0 0.2000122 FORMAT "%9.7" /end CHARACTERISTIC
/begin CHARACTERISTIC xsyRotorInertia_XDU16 "Relevante Massenträgheit des Rotors [kgm^2]" VALUE 0x150A60 AblGLKWuw 0.000999987 RIGHTSH24NP 0 0.0009999871 FORMAT "%11.9" /end CHARACTERISTIC
/begin CHARACTERISTIC xTsc_ExtrapolFactor_XAU16 "fahrzeuggeschwindigkeitsanh?ngiger Extrapolations-Faktor" CURVE 0x151A74 AblGLKLuw 1 DFACTHIGH 0 1 FORMAT "%8.6"
 /begin AXIS_DESCR STD_AXIS vTsc_AbsVehicleSpeedFilt4Interpol_xdu16 VFZHIGH 4 0 255 FORMAT "%8.4" DEPOSIT ABSOLUTE /end AXIS_DESCR
/end CHARACTERISTIC
/begin CHARACTERISTIC xTsc_PT1tauGradTBT_XAU16 "fahrzeuggeschwindigkeitsanh?ngige PT1 Filterkonstante GradTBT" CURVE 0x151A88 AblGLKLuw 1 RIGHTSH10NP 0 1 FORMAT "%8.6"
 /begin AXIS_DESCR STD_AXIS vTsc_AbsVehicleSpeedFilt4Interpol_xdu16 VFZHIGH 4 0 255 FORMAT "%8.4" DEPOSIT ABSOLUTE /end AXIS_DESCR
/end CHARACTERISTIC
/begin CHARACTERISTIC xTsc_SubstExtrapolFactChatter_XDU16 "substitute value of Extrapol factor if chattering is detected" VALUE 0x150A62 AblGLKWuw 1 DFACTHIGH 0 1 FORMAT "%8.6" /end CHARACTERISTIC
/begin CHARACTERISTIC xTsc_TorqueGradLowDyn_XDU16 "Allowed Torque gradient change per ms " VALUE 0x150A64 AblGLKWuw 0.0996094 MMOT 0 0.09960938 FORMAT "%9.7" /end CHARACTERISTIC
/begin CHARACTERISTIC xTsf_RampGradient_XDU16 "ramp gradient in Nm/ms" VALUE 0x150A66 AblGLKWuw 0.999969 RIGHTSH15NP 3.051758E-05 1 FORMAT "%8.6" /end CHARACTERISTIC
/begin CHARACTERISTIC xTsf_RotSpeedCurveFact_XAU16 "Rotor Speed Kennlinien factor zwischen 1...0" CURVE 0x151A9C AblGLKLuw 1 RIGHTSH15NP 0 1 FORMAT "%8.6"
 /begin AXIS_DESCR STD_AXIS nTsf_AbsRotorSpeed_xdu16 VROT 3 0 13000 FORMAT "%3.0" DEPOSIT ABSOLUTE /end AXIS_DESCR
/end CHARACTERISTIC
/begin CHARACTERISTIC xUnSt_ActivateUndersteerFeedback_XDB "Aktivierung Fahrzustandsrückmeldung Untersteuern" VALUE 0x150B3E AblGLKWub 1 ZU0 0 1 FORMAT "%5.3" /end CHARACTERISTIC
/begin CHARACTERISTIC xUnSt_BypassFactMmot_XDU16 "Factor für das Understeer Bypass Motor Moment" VALUE 0x150A68 AblGLKWuw 0.0898438 RIGHTSH10NP 0 0.08984375 FORMAT "%10.8" /end CHARACTERISTIC
/begin CHARACTERISTIC xUnSt_DegUnStFiltFact_XAU16 "Faktor in Abhaengigkeit des Untersteuergrades" CURVE 0x151AAC AblGLKLuw 1 RIGHTSH10NP 0 1 FORMAT "%8.6"
 /begin AXIS_DESCR STD_AXIS xUnSt_DegUnStFilt_xdu16 RIGHTSH10NP 6 0 1 FORMAT "%8.6" DEPOSIT ABSOLUTE /end AXIS_DESCR
/end CHARACTERISTIC
/begin CHARACTERISTIC xUnSt_FilterFactOfUndersteer_XDU16 "Filterfaktor für Untersteuergrad" VALUE 0x150A6A AblGLKWuw 1 RIGHTSH10NP 0 1 FORMAT "%8.6" /end CHARACTERISTIC
/begin CHARACTERISTIC xUnSt_MaxFactorOnTBTUndersteer_XDU16 "Begrenzung des Faktors" VALUE 0x150A6C AblGLKWuw 1 RIGHTSH10NP 0 1 FORMAT "%8.6" /end CHARACTERISTIC
/begin CHARACTERISTIC xUnSt_RampUpDownGradUndersteer_XDS16 "maximaler Gradient für den Untersteuergrad" VALUE 0x150A6E AblGLKWsw 10 RIGHTSH10NP 0 10 FORMAT "%8.5" /end CHARACTERISTIC
/begin CHARACTERISTIC xUnSt_VehSpeedFact_XAU16 "Faktor auf Untersteuergrad in Abhaengigkeit der Fahrzeuggeschwindigkeit" CURVE 0x151AC8 AblGLKLuw 1 RIGHTSH10NP 0 1 FORMAT "%8.6"
 /begin AXIS_DESCR STD_AXIS vApplI_AbsVehicleSpeedFilt_xdu16 VFZHIGH 6 0 250 FORMAT "%8.4" DEPOSIT ABSOLUTE /end AXIS_DESCR
/end CHARACTERISTIC
/begin CHARACTERISTIC xVehSp_Factor4MaxSpeedDiff4NormalDriving_XDU8 "Faktor zur Berechnung der maximalen Differenz zwischen kleinster und größter Radgeschwindigkeit bei der normale Fahrt erkannt wird (MaxDiff = Factor * VehSp * SteerAngle) Faktor=MaxRadlenkwinkel[°] / MaxLenkwinkel[°] * pi / 180 / Radstand [m] * Spurbreite" VALUE 0x150B3F AblGLKWub 0.00769 RIGHTSH15NP 0 0.00769 FORMAT "%8.6" /end CHARACTERISTIC
/begin CHARACTERISTIC ySteerCtrl_RampDownRedLevDueChatter_XDU16 "negative gradient of reduction due to chattering" VALUE 0x150A86 AblGLKWuw 1 RIGHTSH15NP_1MS 0 1 FORMAT "%8.6" /end CHARACTERISTIC
/begin CHARACTERISTIC ySteerCtrl_RampUpRedLevDueChatter_XDU16 "positive gradient of reduction due to chattering" VALUE 0x150A88 AblGLKWuw 1 RIGHTSH15NP_1MS 0 1 FORMAT "%8.6" /end CHARACTERISTIC
/begin CHARACTERISTIC yTsc_Disable_Extrapol_TBT_XDU8 "disable extrapolation" VALUE 0x150B43 AblGLKWub 1 ZU0 0 1 FORMAT "%5.3" /end CHARACTERISTIC
/begin CHARACTERISTIC yTsc_Disable_HwlI_TBT_Grad_Avg_XDU8 "Mittelung verhindern vom Gradient HwlI_TBTs" VALUE 0x150B44 AblGLKWub 1 ZU0 0 1 FORMAT "%5.3" /end CHARACTERISTIC
/begin CHARACTERISTIC yTsc_Disable_TscI_TBT_Avg_XDU8 "Mittelung verhindern von TscI_TBT" VALUE 0x150B45 AblGLKWub 1 ZU0 0 1 FORMAT "%5.3" /end CHARACTERISTIC
/begin CHARACTERISTIC zSteerCtrl_ChatteringDetected_XDU8_0___A "chatter periods counter threshold to detect chattering (shall be identically to zcrMinChatterPeriodsCountDelayed_XDU8)" VALUE 0x15858C AblGLKWub 30 ZU0 0 30 FORMAT "%5.2" /end CHARACTERISTIC
/begin CHARACTERISTIC zSteerCtrl_ChatteringDetected_XDU8_1___A "chatter periods counter threshold to detect chattering (shall be identically to zcrMinChatterPeriodsCountDelayed_XDU8)" VALUE 0x15858D AblGLKWub 30 ZU0 0 30 FORMAT "%5.2" /end CHARACTERISTIC
/begin CHARACTERISTIC zSteerCtrl_ChatteringDetected_XDU8_2___A "chatter periods counter threshold to detect chattering (shall be identically to zcrMinChatterPeriodsCountDelayed_XDU8)" VALUE 0x15858E AblGLKWub 30 ZU0 0 30 FORMAT "%5.2" /end CHARACTERISTIC
/begin CHARACTERISTIC zSteerCtrl_ChatteringDetected_XDU8_3___A "chatter periods counter threshold to detect chattering (shall be identically to zcrMinChatterPeriodsCountDelayed_XDU8)" VALUE 0x15858F AblGLKWub 30 ZU0 0 30 FORMAT "%5.2" /end CHARACTERISTIC
/begin CHARACTERISTIC zstTBTDiffDelaySelect_XDU16 "D Filterung Zeitdifferenz" VALUE 0x150A90 AblGLKWuw 7 TIMMS 1 8 FORMAT "%8.6" /end CHARACTERISTIC
/begin CHARACTERISTIC zTsc_ChatteringDetected_XDU8 "chatter periods counter threshold to detect chattering (like zSteerCtrl_ChatteringDetected_XDU8 and zcrMinChatterPeriodsCountDelayed_XDU8)" VALUE 0x150B61 AblGLKWub 30 ZU0 0 30 FORMAT "%5.2" /end CHARACTERISTIC
/begin CHARACTERISTIC zVehSp_MinValidWheelSpeeds4Avg_XDU8 "Minimum number of valid wheel speed signals required to provide the average output speed (v_Avg)" VALUE 0x150B62 AblGLKWub 3 ZU0 1 4 FORMAT "%5.3" /end CHARACTERISTIC
/begin CHARACTERISTIC zVehSp_MinValidWheelSpeeds4Safe_XDU8 "Minimum number of valid wheel speed signals required to provide the safe output speeds (v_Min, v_Max)" VALUE 0x150B63 AblGLKWub 3 ZU0 1 4 FORMAT "%5.3" /end CHARACTERISTIC
/begin CHARACTERISTIC zVTorqueConvCharSelect_XAU8 "Speed dependent selection of Driver Factor characteristics" VAL_BLK 0x150EBC AblGLKWBuw 150 ZU0 0 150 NUMBER 6 FORMAT "%8.4" /end CHARACTERISTIC
/begin MEASUREMENT fApplI_DsrErrorMode_xdb "Flag ob diverse CAN Eingangsignale gueltig sind" UWORD ZU0 1 100 0 1 BIT_MASK 0x1 FORMAT "%5.3" ECU_ADDRESS 0xFEBE941F /end MEASUREMENT
/begin MEASUREMENT fBswI_BusOffState_xdu8 "The Current Bus Off state" UBYTE ZU0 1 100 0 10 FORMAT "%5.2" ECU_ADDRESS 0xFEBE942D /end MEASUREMENT
/begin MEASUREMENT fccStoppStartOperation_xdb "StoppStart Betrieb (Stromaufnahme verringern)" UBYTE STATUS 1 100 0 1 BIT_MASK 0x1 FORMAT "%5.3" ECU_ADDRESS 0xFEBE942F /end MEASUREMENT
/begin MEASUREMENT fccSwitch2DriveUp_xdb "Schalte in Drive Up" UBYTE STATUS 1 100 0 1 BIT_MASK 0x1 FORMAT "%5.3" ECU_ADDRESS 0xFEBE9430 /end MEASUREMENT
/begin MEASUREMENT fDsr_DrvStrActivated_xdb "Flag ob diverse CAN Eingangsignale gueltig sind" UWORD ZU0 1 100 0 1 BIT_MASK 0x1 FORMAT "%5.3" ECU_ADDRESS 0xFEBE9444 /end MEASUREMENT
/begin MEASUREMENT fDsr_EmaActivated_xdb "Flag ob diverse CAN Eingangsignale gueltig sind" UWORD ZU0 1 100 0 1 BIT_MASK 0x1 FORMAT "%5.3" ECU_ADDRESS 0xFEBE9446 /end MEASUREMENT
/begin MEASUREMENT fDsr_InputValid_xdb "Flag ob diverse CAN Eingangsignale gueltig sind" UWORD ZU0 1 100 0 1 BIT_MASK 0x1 FORMAT "%5.3" ECU_ADDRESS 0xFEBE9447 /end MEASUREMENT
/begin MEASUREMENT fErrHdlI_MonShutDown_xdb "Error flag ?berwachung Errorhandler" UBYTE STATUS 1 100 0 1 BIT_MASK 0x1 FORMAT "%5.3" ECU_ADDRESS 0xFEBE9462 /end MEASUREMENT
/begin MEASUREMENT fNvMCI_ReadAllFinished_xdb "" UWORD ZU0 1 100 0 1 FORMAT "%8.6" ECU_ADDRESS 0xFEBE9493 /end MEASUREMENT
/begin MEASUREMENT fSccI_DemClearRequired_xdb "Set if the Variant ID, Sample ID and Major Release ID mismatches" UBYTE BIT 1 100 0 1 BIT_MASK 0x1 FORMAT "%5.3" ECU_ADDRESS 0xFEBE94BB /end MEASUREMENT
/begin MEASUREMENT fTscI_DisableAveraging_xdb "Flag, um zu wissen, dass Lesen oder Schreiben aufgerufen wird " UWORD ZU0 1 100 0 1 BIT_MASK 0x1 FORMAT "%5.3" ECU_ADDRESS 0xFEBE94C7 /end MEASUREMENT
/begin MEASUREMENT fTscI_TbtSensor_provides_TBTred_xdu8 "2ter TBT Kanal vorhanden" UBYTE ZU0 1 100 0 1 FORMAT "%5.3" ECU_ADDRESS 0xFEBE94C9 /end MEASUREMENT
/begin MEASUREMENT fTscI_Use_GradXtplTBT_xdb "mApplI_GradTorsionBarTorque_xds16 = (0:mTsc_FiltGradTBT_xds16, 1:mTsc_FiltGradXtplTBT_xds16)" UBYTE STATUS 1 100 0 1 BIT_MASK 0x1 FORMAT "%5.3" ECU_ADDRESS 0xFEBE94CA /end MEASUREMENT
/begin MEASUREMENT fTsf_ErrorflagSign_xdu8 "Errorflag - MMot Vorzeichenfehler" UBYTE ZU0 1 100 0 1 FORMAT "%5.3" ECU_ADDRESS 0xFEBE94CB /end MEASUREMENT
/begin MEASUREMENT fTsf_ErrorflagSteeringAngleRange_xdu8 "Errorflag - SteeringAngleRange Fehler" UBYTE ZU0 1 100 0 1 FORMAT "%5.3" ECU_ADDRESS 0xFEBE94CC /end MEASUREMENT
/begin MEASUREMENT fTsf_Errorflag_MaxValue_xdu8 "Errorflag - MMot Zeitfehler (< maxMMotValue)" UBYTE ZU0 1 100 0 1 FORMAT "%5.3" ECU_ADDRESS 0xFEBE94CD /end MEASUREMENT
/begin MEASUREMENT fTsf_MMotCheckErrorbit_xdu8 "Errorflag - MMot Fehler durch Rampe" UBYTE ZU0 1 100 0 1 FORMAT "%5.3" ECU_ADDRESS 0xFEBE94CE /end MEASUREMENT
/begin MEASUREMENT fTsf_SteeringTorqueSignCheck_xdu8 "Errorflag - SteeringTorque Vorzeichenfehler" UBYTE ZU0 1 100 0 1 FORMAT "%5.3" ECU_ADDRESS 0xFEBE94CF /end MEASUREMENT
/begin MEASUREMENT fUnStI_MonSafeOk_xdb "Indicates whether the MonitorSafe checks report OK (true) or if they have detected a problem (false)" UWORD ZU0 1 100 0 1 BIT_MASK 0x1 FORMAT "%5.3" ECU_ADDRESS 0xFEBE94D0 /end MEASUREMENT
/begin MEASUREMENT fUnSt_Activate_xdb "Indicates whether UnSt shall actively calculate and request a torque." UWORD ZU0 1 100 0 1 BIT_MASK 0x1 FORMAT "%5.3" ECU_ADDRESS 0xFEBE94D1 /end MEASUREMENT
/begin MEASUREMENT fVehSp_MonOk_xdb "Min/Max speeds have passed the plausibility check" UWORD ZU0 1 100 0 1 BIT_MASK 0x1 FORMAT "%5.3" ECU_ADDRESS 0xFEBE94D2 /end MEASUREMENT
/begin MEASUREMENT jWlc_WarningLightStateRed_gau8 "Ecu Warning Light Status" UBYTE ZU0 1 100 0 5 FORMAT "%5.3" ECU_ADDRESS 0xFEBE9B84 MATRIX_DIM 21 1 1 /end MEASUREMENT
/begin MEASUREMENT jWlc_WarningLightState_gau8 "Ecu Warning Light Status" UBYTE ZU0 1 100 0 5 FORMAT "%5.3" ECU_ADDRESS 0xFEBE9B9C MATRIX_DIM 21 1 1 /end MEASUREMENT
/begin MEASUREMENT mApplI_AbsTorsionBarTorque_xdu16 "HW LIB: absolutes Drehstabmoment" UWORD TBTHIGH 1 100 0 25 FORMAT "%8.5" ECU_ADDRESS 0xFEBE9002 /end MEASUREMENT
/begin MEASUREMENT mApplI_GradTorsionBarTorque_xds16 "HW LIB: Drehmomentgradient" SWORD TORGRAD 1 100 -25 25 FORMAT "%8.5" ECU_ADDRESS 0xFEBE9008 /end MEASUREMENT
/begin MEASUREMENT mApplI_MaxAllowedTorque_xdu16 "Motormoment Maximalwert Vorgabe von HighLevel an HWLib" UWORD MMOT 1 100 1 20 FORMAT "%8.5" ECU_ADDRESS 0xFEBE900C /end MEASUREMENT
/begin MEASUREMENT mApplI_SteerTqReq_xds16 "Anforderung des Lenkmoments vom CAN" SWORD MMOT 1 100 -30 30 FORMAT "%8.5" ECU_ADDRESS 0xFEBE9012 /end MEASUREMENT
/begin MEASUREMENT mApplI_TorsionBarTorqueMin_xds16 "Minimales Drehstabmoment beider Kanäle, wenn die Signale voneinander unterschiedlich sind" SWORD TBTHIGH 1 100 -25 25 FORMAT "%8.5" ECU_ADDRESS 0xFEBE9014 /end MEASUREMENT
/begin MEASUREMENT mApplI_TorsionBarTorque_xds16 "HW LIB: Drehstabmoment" SWORD TBTHIGH 1 100 -25 25 FORMAT "%8.5" ECU_ADDRESS 0xFEBE4AC4 /end MEASUREMENT
/begin MEASUREMENT mLa_TorqueConvMMotYAxis_xau16 "y-Achsenwerte der berechneten Unterstützungs-Kennlinie (nominelles Unterstützungsmoment)" UWORD MMOT 1 100 0 12 FORMAT "%8.5" ECU_ADDRESS 0xFEBE9970 MATRIX_DIM 6 1 1 /end MEASUREMENT
/begin MEASUREMENT mLa_TorqueConvTBTXAxis_xau16 "x-Achsenwerte der berechneten Unterstützungs-Kennlinie (Handmoment)" UWORD TBTHIGH 1 100 0 15 FORMAT "%8.5" ECU_ADDRESS 0xFEBE997C MATRIX_DIM 6 1 1 /end MEASUREMENT
/begin MEASUREMENT mSteerCtrlI_MotorTorque_xds16 "totalized motor torque (D-part and D-offset)" SWORD MMOT 1 100 -8 8 FORMAT "%8.6" ECU_ADDRESS 0xFEBE8F62 /end MEASUREMENT
/begin MEASUREMENT mSteerCtrl_AbsDOffset_xdu16 "Absolute D-offset-part steering torque for interpolation" UWORD MMOT 1 100 0 25 FORMAT "%8.5" ECU_ADDRESS 0xFEBE9164 /end MEASUREMENT
/begin MEASUREMENT mSteerCtrl_DOffset_xds16 "D-part offset calculated out of GradTorsionBarTorque" SWORD MMOT 1 100 -8 8 FORMAT "%8.6" ECU_ADDRESS 0xFEBE8F64 /end MEASUREMENT
/begin MEASUREMENT mSteerCtrl_DPart_xds16 "D-part calculated out of the assistance torque" SWORD MMOT 1 100 -8 8 FORMAT "%8.6" ECU_ADDRESS 0xFEBE8F66 /end MEASUREMENT
/begin MEASUREMENT mSteerCtrl_FiltSCGradTBT_xds16 "gradient TBT calculated in SteerCtrl" SWORD TORGRAD 1 100 -5 5 FORMAT "%8.6" ECU_ADDRESS 0xFEBE8F68 /end MEASUREMENT
/begin MEASUREMENT mSteerCtrl_HystTorsionBarTorque_xds16 "hysteresis torsion bar torque" SWORD TBTHIGH 1 100 -25 25 FORMAT "%8.5" ECU_ADDRESS 0xFEBE8F6A /end MEASUREMENT
/begin MEASUREMENT mStFCI_NominalSteerTorque_xds16 "Soll-Handmoment in Lenkungsregler" SWORD TBTHIGH 1 100 -25 25 FORMAT "%8.5" ECU_ADDRESS 0xFEBE9166 /end MEASUREMENT
/begin MEASUREMENT mStTorCtrlPI_MotorTorque_xds16 "Desired motor torque offset of Steer Torque Controller Plus (RG3)" SWORD MMOT 1 100 -10 10 FORMAT "%8.5" ECU_ADDRESS 0xFEBE8F6C /end MEASUREMENT
/begin MEASUREMENT mTrqSumI_SteerTrqSum_xds16 "summation of all input steering torques of additional function" SWORD TBTHIGH 1 100 -25 25 FORMAT "%8.5" ECU_ADDRESS 0xFEBE916A /end MEASUREMENT
/begin MEASUREMENT mTrqSumI_TrqSumAfterMTL_xds16 "summation of all input motor torques of sub connector after MotorTorqueLimiter" SWORD MMOT 1 100 -12 12 FORMAT "%8.5" ECU_ADDRESS 0xFEBE916C /end MEASUREMENT
/begin MEASUREMENT mTrqSumI_TrqSumBeforeMTL_xds16 "summation of all input motor torques of sub connector before MotorTorqueLimiter" SWORD MMOT 1 100 -12 12 FORMAT "%8.5" ECU_ADDRESS 0xFEBE916E /end MEASUREMENT
/begin MEASUREMENT mTscI_ExtrapolTBT_xds16 "Extrapoliertes Drehstabmoment" SWORD TBTHIGH 1 100 -25 25 FORMAT "%8.5" ECU_ADDRESS 0xFEBE9170 /end MEASUREMENT
/begin MEASUREMENT mTscI_HysteresisTBT_xdu16 "HysteresisTBT: DeadZone TBT Grad" UWORD TBTHIGH 1 100 0 0.09960938 FORMAT "%9.7" ECU_ADDRESS 0xFEBE9172 /end MEASUREMENT
/begin MEASUREMENT mTscI_TorsionBarTorque_xds16 "Drehstabmoment" SWORD TBTHIGH 1 100 -25 25 FORMAT "%8.5" ECU_ADDRESS 0xFEBE9174 /end MEASUREMENT
/begin MEASUREMENT mTsc_AvgFiltGradTBT_xds16 "Gradient HwlTBT Avg" SWORD TORGRAD 1 100 -25 25 FORMAT "%8.5" ECU_ADDRESS 0xFEBE9176 /end MEASUREMENT
/begin MEASUREMENT mTsc_DeadZoneExtrapolGrad_xdu16 "fahrzeuggeschwindigkeitsanh?ngige Extrapolations-TBTdiff-Deadzone" UWORD TORGRAD 1 100 0 5 FORMAT "%8.6" ECU_ADDRESS 0xFEBE9178 /end MEASUREMENT
/begin MEASUREMENT mTsc_ExtrapolTBTmain_xds16 "Extrapoliertes Drehstabmoment Main" SWORD TBTHIGH 1 100 -25 25 FORMAT "%8.5" ECU_ADDRESS 0xFEBE917A /end MEASUREMENT
/begin MEASUREMENT mTsc_ExtrapolTBTred_xds16 "Extrapoliertes Drehstabmoment Red" SWORD TBTHIGH 1 100 -25 25 FORMAT "%8.5" ECU_ADDRESS 0xFEBE917C /end MEASUREMENT
/begin MEASUREMENT mTsc_FiltGradTBTmain_xds16 "Gradient HwlTBT (main)" SWORD TORGRAD 1 100 -25 25 FORMAT "%8.5" ECU_ADDRESS 0xFEBE917E /end MEASUREMENT
/begin MEASUREMENT mTsc_FiltGradTBTred_xds16 "Gradient TBT Red" SWORD TORGRAD 1 100 -25 25 FORMAT "%8.5" ECU_ADDRESS 0xFEBE9180 /end MEASUREMENT
/begin MEASUREMENT mTsc_FiltGradTBT_xds16 "Gradient HwlTBT" SWORD TORGRAD 1 100 -25 25 FORMAT "%8.5" ECU_ADDRESS 0xFEBE9182 /end MEASUREMENT
/begin MEASUREMENT mTsc_FiltGradXtplTBT_xds16 "Gradient Extrapolierte TBT" SWORD TORGRAD 1 100 -25 25 FORMAT "%8.5" ECU_ADDRESS 0xFEBE9184 /end MEASUREMENT
/begin MEASUREMENT mTsc_HystTorsionBarTorqueRed_xds16 "TBT Red nach Hysteresefilter" SWORD TBTHIGH 1 100 -25 25 FORMAT "%8.5" ECU_ADDRESS 0xFEBE8F70 /end MEASUREMENT
/begin MEASUREMENT mTsc_HystTorsionBarTorque_xds16 "TBT nach Hysteresefilter" SWORD TBTHIGH 1 100 -25 25 FORMAT "%8.5" ECU_ADDRESS 0xFEBE8F72 /end MEASUREMENT
/begin MEASUREMENT mTsc_HystXtplTorsionBarTorque_xds16 "Extrapolierte TBT nach Hysteresefilter" SWORD TBTHIGH 1 100 -25 25 FORMAT "%8.5" ECU_ADDRESS 0xFEBE8F74 /end MEASUREMENT
/begin MEASUREMENT mTsc_mIntegratDevTorque_xdu16 "" UWORD TBTHIGH 1 100 0 60 FORMAT "%8.5" ECU_ADDRESS 0xFEBE9186 /end MEASUREMENT
/begin MEASUREMENT mTsc_TbtTorqueCondLimLower_xds16 " " SWORD TBTHIGH 1 100 -25 25 FORMAT "%8.5" ECU_ADDRESS 0xFEBE9188 /end MEASUREMENT
/begin MEASUREMENT mTsc_TbtTorqueCondLimUpper_xds16 "" SWORD TBTHIGH 1 100 -25 25 FORMAT "%8.5" ECU_ADDRESS 0xFEBE918A /end MEASUREMENT
/begin MEASUREMENT mTsc_TbtTorqueCondLim_xds16 " " SWORD TBTHIGH 1 100 -25 25 FORMAT "%8.5" ECU_ADDRESS 0xFEBE918C /end MEASUREMENT
/begin MEASUREMENT mTsfI_MotorTorque4Check_xds16 "Motormoment nach der Funktion (mit Checkkomponente)" SWORD MMOT 1 100 -12 12 FORMAT "%8.5" ECU_ADDRESS 0xFEBE918E /end MEASUREMENT
/begin MEASUREMENT mTsfI_MotorTorque_xds16 "Motormoment nach der Funktion (mit Checkkomponente)" SWORD MMOT 1 100 -12 12 FORMAT "%8.5" ECU_ADDRESS 0xFEBE9190 /end MEASUREMENT
/begin MEASUREMENT mUnStI_MotorTorqueOffset4Check_xds16 "Motormomentoffset Untersteuern (Input-Check)" SWORD MMOT 1 100 -0.5 0.5 FORMAT "%9.7" ECU_ADDRESS 0xFEBE9192 /end MEASUREMENT
/begin MEASUREMENT mUnStI_MotorTorqueOffset_xds16 "Motormomentoffset Untersteuern" SWORD MMOT 1 100 -0.5 0.5 FORMAT "%9.7" ECU_ADDRESS 0xFEBE9194 /end MEASUREMENT
/begin MEASUREMENT mUnStI_SteeringTorqueOffset4Check_xds16 "Handmomentoffset Untersteuern (Input-Check)" SWORD TBTHIGH 1 100 -3 3 FORMAT "%8.6" ECU_ADDRESS 0xFEBE9196 /end MEASUREMENT
/begin MEASUREMENT mUnStI_SteeringTorqueOffset_xds16 "Handmomentoffset Untersteuern" SWORD TBTHIGH 1 100 -3 3 FORMAT "%8.6" ECU_ADDRESS 0xFEBE9198 /end MEASUREMENT
/begin MEASUREMENT mUnSt_SteeringTorqueOffsetMakeSafe_xds16 "Handmomentoffset Untersteuern aus MakeSafe Funktion" SWORD TBTHIGH 1 100 -3 3 FORMAT "%8.6" ECU_ADDRESS 0xFEBE919A /end MEASUREMENT
/begin MEASUREMENT nTsf_AbsRotorSpeed_xdu16 "Absolutwert von Rotorspeed" UWORD VROT 1 100 0 13000 FORMAT "%3.0" ECU_ADDRESS 0xFEBE91BE /end MEASUREMENT
/begin MEASUREMENT sApplI_DsrSta_D_Req_xdu8 "DSR intervention request from  Controller" UBYTE ZU0 1 100 0 15 FORMAT "%5.2" ECU_ADDRESS 0xFEBE94EB /end MEASUREMENT
/begin MEASUREMENT sApplI_EmaEnabled_xdu8 "EMA DSR Enable" UBYTE ZU0 1 100 0 255 FORMAT "%5.1" ECU_ADDRESS 0xFEBE94ED /end MEASUREMENT
/begin MEASUREMENT sApplI_TorsionBarTorqueMinState_xdu16 "Status Drehstabmoment von beiden Kanälen" UWORD ZU0 1 100 0 32781 FORMAT "%8.2" ECU_ADDRESS 0xFEBE91CE /end MEASUREMENT
/begin MEASUREMENT sccEventMemory_xdu32 "EventMemory" ULONG ZU0 1 100 0 4294967295 FORMAT "%13.2" ECU_ADDRESS 0xFEBE8CF8 /end MEASUREMENT
/begin MEASUREMENT seeProductionMode_xdu16 "ZFLS-Endmontagelinienprüfung" UWORD ZU0 1 100 0 65535 FORMAT "%8.2" ECU_ADDRESS 0xFEBE91D4 /end MEASUREMENT
/begin MEASUREMENT sHwlI_AbsRotbasedAngleDetails_xdu32 ".." ULONG ZU0 1 100 0 4294967295 FORMAT "%13.2" ECU_ADDRESS 0xFEBE8CFC /end MEASUREMENT
/begin MEASUREMENT sNvMCI_ErrLvl_Red_xdu8 "" UBYTE ZU0 1 100 0 2 FORMAT "%5.3" ECU_ADDRESS 0xFEBE4299 /end MEASUREMENT
/begin MEASUREMENT sNvMCI_ErrLvl_xdu8 "" UBYTE ZU0 1 100 0 2 FORMAT "%5.3" ECU_ADDRESS 0xFEBE95A6 /end MEASUREMENT
/begin MEASUREMENT sStTorCtrlP_FctCoCtrlState_xdu8 "Return value of the FunctionCoordinator." UBYTE ZU0 1 100 0 99 FORMAT "%5.2" ECU_ADDRESS 0xFEBE95FC /end MEASUREMENT
/begin MEASUREMENT sStTorCtrlP_FeatureState_xdu8 "Internal feature state for FunctionCoordinator." UBYTE ZU0 1 100 0 5 FORMAT "%5.3" ECU_ADDRESS 0xFEBE95FD /end MEASUREMENT
/begin MEASUREMENT sSwInCompI_ErrLvl_Red_xdu8 "" UBYTE ZU0 1 100 0 2 FORMAT "%5.3" ECU_ADDRESS 0xFEBE42BA /end MEASUREMENT
/begin MEASUREMENT sSwInCompI_ErrLvl_xdu8 "" UBYTE ZU0 1 100 0 2 FORMAT "%5.3" ECU_ADDRESS 0xFEBE95FE /end MEASUREMENT
/begin MEASUREMENT sTaskControlI_SingleControllerReset_xdu8 "Flag, das im DriveExitHandler zu einem Reset des betroffenen Controllers führt." UBYTE ZU0 1 100 0 255 FORMAT "%5.1" ECU_ADDRESS 0xFEBE4B23 /end MEASUREMENT
/begin MEASUREMENT sTest_ChannelArbitration_xdu8 "" UBYTE ZU0 1 100 0 1 FORMAT "%5.3" ECU_ADDRESS 0xFEBE95FF /end MEASUREMENT
/begin MEASUREMENT sTest_ChannelNo_xdu8 "" UBYTE ZU0 1 100 0 10 FORMAT "%5.2" ECU_ADDRESS 0xFEBE9600 /end MEASUREMENT
/begin MEASUREMENT sTest_CtrlState_xdu8 "RÃ¼ckgabewert des Function Coordinators" UBYTE ZU0 1 100 0 99 FORMAT "%5.2" ECU_ADDRESS 0xFEBE9601 /end MEASUREMENT
/begin MEASUREMENT sTsfI_ErrLvl_Red_xdu8 "Error level redundant [0=NoError], [1=SWError], [2=HWError]" UBYTE ZU0 1 100 0 2 FORMAT "%5.3" ECU_ADDRESS 0xFEBE42BB /end MEASUREMENT
/begin MEASUREMENT sTsfI_ErrLvl_xdu8 "Error level [0=NoError], [1=SWError], [2=HWError]" UBYTE ZU0 1 100 0 2 FORMAT "%5.3" ECU_ADDRESS 0xFEBE9602 /end MEASUREMENT
/begin MEASUREMENT sUnSt_FeatureState_xdu8 "Internal feature state for FunctionCoordinator." UBYTE ZU0 1 100 0 3 FORMAT "%5.3" ECU_ADDRESS 0xFEBE9603 /end MEASUREMENT
/begin MEASUREMENT sWlcI_EcuWarningLights_xdu8 "Ecu Warning Light Status" UBYTE ZU0 1 100 0 4 FORMAT "%5.3" ECU_ADDRESS 0xFEBE9604 /end MEASUREMENT
/begin MEASUREMENT tLdTrkI_TimeTempZone01_xdu32 "Minuten in Zone 1" ULONG ZU0 1 100 0 4294967295 FORMAT "%13.2" ECU_ADDRESS 0xFEBE8D0C /end MEASUREMENT
/begin MEASUREMENT tLdTrkI_TimeTempZone02_xdu32 "Minuten in Zone 2" ULONG ZU0 1 100 0 4294967295 FORMAT "%13.2" ECU_ADDRESS 0xFEBE8D10 /end MEASUREMENT
/begin MEASUREMENT tLdTrkI_TimeTempZone03_xdu32 "Minuten in Zone 3" ULONG ZU0 1 100 0 4294967295 FORMAT "%13.2" ECU_ADDRESS 0xFEBE8D14 /end MEASUREMENT
/begin MEASUREMENT tLdTrkI_TimeTempZone04_xdu32 "Minuten in Zone 4" ULONG ZU0 1 100 0 4294967295 FORMAT "%13.2" ECU_ADDRESS 0xFEBE8D18 /end MEASUREMENT
/begin MEASUREMENT tLdTrkI_TimeTempZone05_xdu32 "Minuten in Zone 5" ULONG ZU0 1 100 0 4294967295 FORMAT "%13.2" ECU_ADDRESS 0xFEBE8D1C /end MEASUREMENT
/begin MEASUREMENT tLdTrkI_TimeTempZone06_xdu32 "Minuten in Zone 6" ULONG ZU0 1 100 0 4294967295 FORMAT "%13.2" ECU_ADDRESS 0xFEBE8D20 /end MEASUREMENT
/begin MEASUREMENT tLdTrkI_TimeTempZone07_xdu32 "Minuten in Zone 7" ULONG ZU0 1 100 0 4294967295 FORMAT "%13.2" ECU_ADDRESS 0xFEBE8D24 /end MEASUREMENT
/begin MEASUREMENT tLdTrkI_TimeTempZone08_xdu32 "Minuten in Zone 8" ULONG ZU0 1 100 0 4294967295 FORMAT "%13.2" ECU_ADDRESS 0xFEBE8D28 /end MEASUREMENT
/begin MEASUREMENT tLdTrkI_TimeTempZone09_xdu32 "Minuten in Zone 9" ULONG ZU0 1 100 0 4294967295 FORMAT "%13.2" ECU_ADDRESS 0xFEBE8D2C /end MEASUREMENT
/begin MEASUREMENT tLdTrkI_TimeTempZone10_xdu32 "Minuten in Zone 10" ULONG ZU0 1 100 0 4294967295 FORMAT "%13.2" ECU_ADDRESS 0xFEBE8D30 /end MEASUREMENT
/begin MEASUREMENT tLdTrkI_TimeTempZone11_xdu32 "Minuten in Zone 11" ULONG ZU0 1 100 0 4294967295 FORMAT "%13.2" ECU_ADDRESS 0xFEBE8D34 /end MEASUREMENT
/begin MEASUREMENT tLdTrkI_TimeTempZone12_xdu32 "Minuten in Zone 12" ULONG ZU0 1 100 0 4294967295 FORMAT "%13.2" ECU_ADDRESS 0xFEBE8D38 /end MEASUREMENT
/begin MEASUREMENT tLdTrkI_TimeTempZone13_xdu32 "Minuten in Zone 13" ULONG ZU0 1 100 0 4294967295 FORMAT "%13.2" ECU_ADDRESS 0xFEBE8D3C /end MEASUREMENT
/begin MEASUREMENT tLdTrkI_TimeTempZone14_xdu32 "Minuten in Zone 14" ULONG ZU0 1 100 0 4294967295 FORMAT "%13.2" ECU_ADDRESS 0xFEBE8D40 /end MEASUREMENT
/begin MEASUREMENT tLdTrkI_TimeTempZone15_xdu32 "Minuten in Zone 15" ULONG ZU0 1 100 0 4294967295 FORMAT "%13.2" ECU_ADDRESS 0xFEBE8D44 /end MEASUREMENT
/begin MEASUREMENT tLdTrkI_TimeTempZone16_xdu32 "Minuten in Zone 16" ULONG ZU0 1 100 0 4294967295 FORMAT "%13.2" ECU_ADDRESS 0xFEBE8D48 /end MEASUREMENT
/begin MEASUREMENT tLdTrkI_TimeTempZone17_xdu32 "Minuten in Zone 17" ULONG ZU0 1 100 0 4294967295 FORMAT "%13.2" ECU_ADDRESS 0xFEBE8D4C /end MEASUREMENT
/begin MEASUREMENT tLdTrkI_TimeTempZone18_xdu32 "Minuten in Zone 18" ULONG ZU0 1 100 0 4294967295 FORMAT "%13.2" ECU_ADDRESS 0xFEBE8D50 /end MEASUREMENT
/begin MEASUREMENT tLdTrkI_TimeTempZone19_xdu32 "Minuten in Zone 19" ULONG ZU0 1 100 0 4294967295 FORMAT "%13.2" ECU_ADDRESS 0xFEBE8D54 /end MEASUREMENT
/begin MEASUREMENT tLdTrkI_TimeTempZone20_xdu32 "Minuten in Zone 20" ULONG ZU0 1 100 0 4294967295 FORMAT "%13.2" ECU_ADDRESS 0xFEBE8D58 /end MEASUREMENT
/begin MEASUREMENT tSysTimer_SystemTimeSeconds_xdu16 "Systemzeit in Sekunden" UWORD TIMS 1 100 0 65535 FORMAT "%6.0" ECU_ADDRESS 0xFEBE9216 /end MEASUREMENT
/begin MEASUREMENT tTscI_GradTBTSTred_xdu16 "Delta T der TBTred SampleTime" UWORD TIMUS 1 100 0 65535 FORMAT "%8.2" ECU_ADDRESS 0xFEBE9218 /end MEASUREMENT
/begin MEASUREMENT tTscI_GradTBTST_xdu16 "Delta T der TBT SampleTime" UWORD TIMUS 1 100 0 65535 FORMAT "%8.2" ECU_ADDRESS 0xFEBE921A /end MEASUREMENT
/begin MEASUREMENT tTsc_ErrorFilterTimer_xdu16 " " UWORD TIMMS 1 100 0 65535 FORMAT "%8.2" ECU_ADDRESS 0xFEBE921C /end MEASUREMENT
/begin MEASUREMENT tTsc_GradSysT_TBTSTred_us_xdu16 "Alter des HandmomentenRedsignals" UWORD TIMUS 1 100 0 65535 FORMAT "%8.2" ECU_ADDRESS 0xFEBE921E /end MEASUREMENT
/begin MEASUREMENT tTsc_GradSysT_TBTST_us_xdu16 "Alter des Handmomentensignals" UWORD TIMUS 1 100 0 65535 FORMAT "%8.2" ECU_ADDRESS 0xFEBE9220 /end MEASUREMENT
/begin MEASUREMENT tTsc_SystemTime_xdu16 "Systemzeit als Referenz" UWORD TIMUS 1 100 0 65535 FORMAT "%8.2" ECU_ADDRESS 0xFEBE9222 /end MEASUREMENT
/begin MEASUREMENT tTsc_TBTViolationTime_xdu16 "Zeit der Grenzwertüberschreitung der erlaubten Drehstabsmomentenabweichung" UWORD TIMMS 1 100 0 60000 FORMAT "%8.2" ECU_ADDRESS 0xFEBE8F7A /end MEASUREMENT
/begin MEASUREMENT tTsc_TorqueMainSatSigAge_xdu16 "Alter des Handmomentensignals" UWORD TIMUS 1 100 0 65535 FORMAT "%8.2" ECU_ADDRESS 0xFEBE9224 /end MEASUREMENT
/begin MEASUREMENT tTsc_TorqueRedSatSigAge_xdu16 "Alter des HandmomentenRedsignals" UWORD TIMUS 1 100 0 65535 FORMAT "%8.2" ECU_ADDRESS 0xFEBE9226 /end MEASUREMENT
/begin MEASUREMENT vSteerCtrl_AbsVehicleSpeedFilt4Interpol_xdu16 "SteerCtrl: abs. vehicle speed: processed for interpolation" UWORD VFZHIGH 1 100 0 500 FORMAT "%8.4" ECU_ADDRESS 0xFEBE9274 /end MEASUREMENT
/begin MEASUREMENT vTsc_AbsVehicleSpeedFilt4Interpol_xdu16 "SteerCtrl: abs. vehicle speed: processed for interpolation" UWORD VFZHIGH 1 100 0 500 FORMAT "%8.4" ECU_ADDRESS 0xFEBE9276 /end MEASUREMENT
/begin MEASUREMENT vVehSpI_AbsAvgVehSpd4Check_xdu16 "Average vehicle speed to be read by check component. Note: this is just a simple average used for plausibilization." UWORD VFZHIGH 1 100 0 500 FORMAT "%8.4" ECU_ADDRESS 0xFEBE9278 /end MEASUREMENT
/begin MEASUREMENT vVehSpI_AbsAvgVehSpd_xdu16 "Average vehicle speed. Goal: be as close to the actual speed over ground as possible." UWORD VFZHIGH 1 100 0 500 FORMAT "%8.4" ECU_ADDRESS 0xFEBE927A /end MEASUREMENT
/begin MEASUREMENT vVehSpI_AbsMaxSafeVehSpd_xdu16 "Maximum vehicle speed. Goal: actual speed over ground <= AbsMaxSafeVehSpd." UWORD VFZHIGH 1 100 0 500 FORMAT "%8.4" ECU_ADDRESS 0xFEBE927C /end MEASUREMENT
/begin MEASUREMENT vVehSpI_AbsMaxVehSpd4Check_xdu16 "Maximum vehicle speed to be read by check component." UWORD VFZHIGH 1 100 0 500 FORMAT "%8.4" ECU_ADDRESS 0xFEBE927E /end MEASUREMENT
/begin MEASUREMENT vVehSpI_AbsMinSafeVehSpd_xdu16 "Minimum vehicle speed. Goal: actual speed over ground >= AbsMinSafeVehSpd." UWORD VFZHIGH 1 100 0 500 FORMAT "%8.4" ECU_ADDRESS 0xFEBE9280 /end MEASUREMENT
/begin MEASUREMENT vVehSpI_AbsMinVehSpd4Check_xdu16 "Minimum vehicle speed to be read by check component." UWORD VFZHIGH 1 100 0 500 FORMAT "%8.4" ECU_ADDRESS 0xFEBE9282 /end MEASUREMENT
/begin MEASUREMENT xApplI_TorsionBarStiffness_xdu16 "HW LIB: Drehstabsteifigkeit" UWORD TBTSTIFFHIGH 1 100 0.09960938 4 FORMAT "%8.6" ECU_ADDRESS 0xFEBE930A /end MEASUREMENT
/begin MEASUREMENT xDrvStrRec_RampIn_xdu16 "RampIn Gradient für DSR" UWORD TORGRAD_10MS 1 100 0 4 FORMAT "%8.6" ECU_ADDRESS 0xFEBE9324 /end MEASUREMENT
/begin MEASUREMENT xDrvStrRec_RampOut_xdu16 "RampOut Gradient für DSR" UWORD TORGRAD_10MS 1 100 0 4 FORMAT "%8.6" ECU_ADDRESS 0xFEBE9328 /end MEASUREMENT
/begin MEASUREMENT xSteerCtrl_DOffsetFactorAxis1Fraction_xdu16 "DOffset: fraction (f) prelookup Axis 1 (AbsVehicleSpeedFilt)" UWORD RIGHTSH16NP 1 100 0 1 FORMAT "%8.6" ECU_ADDRESS 0xFEBE938C /end MEASUREMENT
/begin MEASUREMENT xSteerCtrl_DOffsetFactorAxis1Index_xdu8 "DOffset: index (k) prelookup Axis 1 (AbsVehicleSpeedFilt)" UBYTE ZU0 1 100 0 255 FORMAT "%5.1" ECU_ADDRESS 0xFEBE9614 /end MEASUREMENT
/begin MEASUREMENT xSteerCtrl_DPartFactorAxis1Fraction_xdu16 "DPartFactor: fraction (f) prelookup Axis 1 (AbsVehicleSpeedFilt)" UWORD RIGHTSH16NP 1 100 0 1 FORMAT "%8.6" ECU_ADDRESS 0xFEBE938E /end MEASUREMENT
/begin MEASUREMENT xSteerCtrl_DPartFactorAxis1Index_xdu8 "DPartFactor: index (k) prelookup Axis 1 (AbsVehicleSpeedFilt)" UBYTE ZU0 1 100 0 255 FORMAT "%5.1" ECU_ADDRESS 0xFEBE9615 /end MEASUREMENT
/begin MEASUREMENT xSteerCtrl_FilterGradTBTAxis1Fraction_xdu16 "FilterGradTBT: fraction (f) prelookup Axis 1 (AbsVehicleSpeedFilt)" UWORD RIGHTSH16NP 1 100 0 1 FORMAT "%8.6" ECU_ADDRESS 0xFEBE9390 /end MEASUREMENT
/begin MEASUREMENT xSteerCtrl_FilterGradTBTAxis1Index_xdu8 "FilterGradTBT: index (k) prelookup Axis 1 (AbsVehicleSpeedFilt)" UBYTE ZU0 1 100 0 255 FORMAT "%5.1" ECU_ADDRESS 0xFEBE9616 /end MEASUREMENT
/begin MEASUREMENT xSteerCtrl_HysteresisTBTAxis1Fraction_xdu16 "HysteresisTBT: fraction (f) prelookup Axis 1 (AbsVehicleSpeedFilt)" UWORD RIGHTSH16NP 1 100 0 1 FORMAT "%8.6" ECU_ADDRESS 0xFEBE9392 /end MEASUREMENT
/begin MEASUREMENT xSteerCtrl_HysteresisTBTAxis1Index_xdu8 "HysteresisTBT: index (k) prelookup Axis 1 (AbsVehicleSpeedFilt)" UBYTE ZU0 1 100 0 255 FORMAT "%5.1" ECU_ADDRESS 0xFEBE9617 /end MEASUREMENT
/begin MEASUREMENT xStTorCtrlP_RampInOut_xdu16 "factor to ramp in and ramp out the motor torque" UWORD RIGHTSH10NP 1 100 0 1 FORMAT "%8.6" ECU_ADDRESS 0xFEBE9394 /end MEASUREMENT
/begin MEASUREMENT xtcActualGradientRedLevel_xau16 "aktuelle Reduktion der Gradientenbegrenzung kanalweise" UWORD RIGHTSH15NP 1 100 0 1 FORMAT "%8.6" ECU_ADDRESS 0xFEBE8E6C MATRIX_DIM 2 1 1 /end MEASUREMENT
/begin MEASUREMENT xtcActualMotCharTorqLevel_xau16 "aktuelle Stauchung Motorkennlinie kanalweise" UWORD RIGHTSH15NP 1 100 0 1 FORMAT "%8.6" ECU_ADDRESS 0xFEBE9398 MATRIX_DIM 3 1 1 /end MEASUREMENT
/begin MEASUREMENT xtcActualTorqueRedLevel_xau16 "aktuelle Reduktion kanalweise" UWORD RIGHTSH15NP 1 100 0 1 FORMAT "%8.6" ECU_ADDRESS 0xFEBE9844 MATRIX_DIM 8 1 1 /end MEASUREMENT
/begin MEASUREMENT xtcTargetGradientRedLevel_xau16 "angeforderte Reduktion der Gradientenbegrenzung kanalweise" UWORD RIGHTSH15NP 1 100 0 1 FORMAT "%8.6" ECU_ADDRESS 0xFEBE8E70 MATRIX_DIM 2 1 1 /end MEASUREMENT
/begin MEASUREMENT xtcTargetMotCharTorqLevel_xau16 "angeforderte Stauchung Motorkennlinie kanalweise" UWORD RIGHTSH15NP 1 100 0 1 FORMAT "%8.6" ECU_ADDRESS 0xFEBE93A0 MATRIX_DIM 3 1 1 /end MEASUREMENT
/begin MEASUREMENT xtcTargetTorqueRedLevel_xau16 "angeforderte Reduktion kanalweise" UWORD RIGHTSH15NP 1 100 0 1 FORMAT "%8.6" ECU_ADDRESS 0xFEBE9854 MATRIX_DIM 8 1 1 /end MEASUREMENT
/begin MEASUREMENT xTscI_PT1tauGradTBT_xdu16 "fahrzeuggeschwindigkeitsanhängige PT1 Filterkonstante GradTBT" UWORD RIGHTSH10NP 1 100 0 1 FORMAT "%8.6" ECU_ADDRESS 0xFEBE93A8 /end MEASUREMENT
/begin MEASUREMENT xTsc_ExtrapolFactor_xdu16 "fahrzeuggeschwindigkeitsanh?ngiger Extrapolations-Faktor" UWORD DFACTHIGH 1 100 0 1 FORMAT "%8.6" ECU_ADDRESS 0xFEBE93AA /end MEASUREMENT
/begin MEASUREMENT xTsc_HysteresisTBTAxis1Fraction_xdu16 "HysteresisTBT: fraction (f) prelookup Axis 1 (AbsVehicleSpeedFilt)" UWORD RIGHTSH16NP 1 100 0 1 FORMAT "%8.6" ECU_ADDRESS 0xFEBE93AC /end MEASUREMENT
/begin MEASUREMENT xUnSt_DegUnStFilt_xdu16 "Untersteuergrad gefiltert" UWORD RIGHTSH10NP 1 100 0 5 FORMAT "%8.6" ECU_ADDRESS 0xFEBE93AE /end MEASUREMENT
/begin MEASUREMENT yApplI_MaxBatteryCurrentGradient_xdu16 "Maximal erlaubter Battriestromgradient (A/ms)" UWORD SM_I_MS 1 100 0 120 FORMAT "%8.4" ECU_ADDRESS 0xFEBE93B0 /end MEASUREMENT
/begin MEASUREMENT yeeDisErrEntryProd_xdu32 "Fehlereingabe in der Produktion ein / aus" ULONG ZU0 1 100 0 4294967295 FORMAT "%13.2" ECU_ADDRESS 0xFEBE8E78 /end MEASUREMENT
/begin MEASUREMENT yeeDisFctDeliv_xdu32 "Funktionalität im Feld ein / aus" ULONG ZU0 1 100 0 4294967295 FORMAT "%13.2" ECU_ADDRESS 0xFEBE8E80 /end MEASUREMENT
/begin MEASUREMENT yeeDisFctProd_xdu32 "Funktionalität in der Produktion ein / aus" ULONG ZU0 1 100 0 4294967295 FORMAT "%13.2" ECU_ADDRESS 0xFEBE8E88 /end MEASUREMENT
/begin MEASUREMENT yEerSyncI_RoutedSubstFunct_xdu32 "Beeinhaltet den Zustand aller zu routenden substitution functions als bit" ULONG ZU0 1 100 0 4294967295 FORMAT "%13.2" ECU_ADDRESS 0xFEBE8E94 /end MEASUREMENT
/begin MEASUREMENT ySwID_SlaveSWLabel_xau8 "SW Label vom slave µC" UBYTE ZU0 1 100 0 255 FORMAT "%5.1" ECU_ADDRESS 0xFEBE9AB0 MATRIX_DIM 20 1 1 /end MEASUREMENT
/begin MEASUREMENT ysyVehCharacteristic_xdu8 "Bitcodierte Schalter zur Umschaltung von Anpssungskennlinen" UBYTE ZU0 1 100 0 255 FORMAT "%5.1" ECU_ADDRESS 0xFEBE9638 /end MEASUREMENT
/begin MEASUREMENT ysyVehVar_xdu32 "Bitcodierte Schalter zur Fahrzeugvarianten-Anpassung" ULONG ZU0 1 100 0 4294967295 FORMAT "%13.2" ECU_ADDRESS 0xFEBE8EE0 /end MEASUREMENT
/begin MEASUREMENT ytcGradientRedGradNeg_xau16 "negativer Gradient der Gradientenbegrenzung kanalweise" UWORD RIGHTSH15NP_1MS 1 100 0 1 FORMAT "%8.6" ECU_ADDRESS 0xFEBE8EE4 MATRIX_DIM 2 1 1 /end MEASUREMENT
/begin MEASUREMENT ytcGradientRedGradPos_xau16 "" UWORD RIGHTSH15NP_1MS 1 100 0 1 FORMAT "%8.6" ECU_ADDRESS 0xFEBE8EE8 MATRIX_DIM 2 1 1 /end MEASUREMENT
/begin MEASUREMENT ytcMotCharTorqRedGradNeg_xau16 "negativer Gradient der Motorkennlinienstauchung" UWORD RIGHTSH15NP_1MS 1 100 0 1 FORMAT "%8.6" ECU_ADDRESS 0xFEBE93CC MATRIX_DIM 3 1 1 /end MEASUREMENT
/begin MEASUREMENT ytcMotCharTorqRedGradPos_xau16 "positiver Gradient der Motorkennlinienstauchung kanalweise" UWORD RIGHTSH15NP_1MS 1 100 0 1 FORMAT "%8.6" ECU_ADDRESS 0xFEBE93D4 MATRIX_DIM 3 1 1 /end MEASUREMENT
/begin MEASUREMENT ytcTorqueRedGradNeg_xau16 "negativer Gradient der Reduktion kanalweise" UWORD RIGHTSH15NP_1MS 1 100 0 1 FORMAT "%8.6" ECU_ADDRESS 0xFEBE9864 MATRIX_DIM 8 1 1 /end MEASUREMENT
/begin MEASUREMENT ytcTorqueRedGradPos_xau16 "positiver Gradient der Reduktion kanalweise" UWORD RIGHTSH15NP_1MS 1 100 0 1 FORMAT "%8.6" ECU_ADDRESS 0xFEBE9874 MATRIX_DIM 8 1 1 /end MEASUREMENT
/begin MEASUREMENT yTsc_HysteresisTBTAxis1Index_xdu8 "HysteresisTBT: index (k) prelookup Axis 1 (AbsVehicleSpeedFilt)" UBYTE ZU0 1 100 0 255 FORMAT "%5.1" ECU_ADDRESS 0xFEBE9639 /end MEASUREMENT
/begin MEASUREMENT zLdTrkI_SteerRangeCounter01_xdu32 "Lenkwinkelbereichzaehler links" ULONG ZU0 1 100 0 4294967295 FORMAT "%13.2" ECU_ADDRESS 0xFEBE8EF4 /end MEASUREMENT
/begin MEASUREMENT zLdTrkI_SteerRangeCounter02_xdu32 "Lenkwinkelbereichzaehler links" ULONG ZU0 1 100 0 4294967295 FORMAT "%13.2" ECU_ADDRESS 0xFEBE8EF8 /end MEASUREMENT
/begin MEASUREMENT zLdTrkI_SteerRangeCounter03_xdu32 "Lenkwinkelbereichzaehler links" ULONG ZU0 1 100 0 4294967295 FORMAT "%13.2" ECU_ADDRESS 0xFEBE8EFC /end MEASUREMENT
/begin MEASUREMENT zLdTrkI_SteerRangeCounter04_xdu32 "Lenkwinkelbereichzaehler links" ULONG ZU0 1 100 0 4294967295 FORMAT "%13.2" ECU_ADDRESS 0xFEBE8F00 /end MEASUREMENT
/begin MEASUREMENT zLdTrkI_SteerRangeCounter05_xdu32 "Lenkwinkelbereichzaehler links" ULONG ZU0 1 100 0 4294967295 FORMAT "%13.2" ECU_ADDRESS 0xFEBE8F04 /end MEASUREMENT
/begin MEASUREMENT zLdTrkI_SteerRangeCounter06_xdu32 "Lenkwinkelbereichzaehler links" ULONG ZU0 1 100 0 4294967295 FORMAT "%13.2" ECU_ADDRESS 0xFEBE8F08 /end MEASUREMENT
/begin MEASUREMENT zLdTrkI_SteerRangeCounter07_xdu32 "Lenkwinkelbereichzaehler links" ULONG ZU0 1 100 0 4294967295 FORMAT "%13.2" ECU_ADDRESS 0xFEBE8F0C /end MEASUREMENT
/begin MEASUREMENT zLdTrkI_SteerRangeCounter08_xdu32 "Lenkwinkelbereichzaehler links" ULONG ZU0 1 100 0 4294967295 FORMAT "%13.2" ECU_ADDRESS 0xFEBE8F10 /end MEASUREMENT
/begin MEASUREMENT zLdTrkI_SteerRangeCounter09_xdu32 "Lenkwinkelbereichzaehler links" ULONG ZU0 1 100 0 4294967295 FORMAT "%13.2" ECU_ADDRESS 0xFEBE8F14 /end MEASUREMENT
/begin MEASUREMENT zLdTrkI_SteerRangeCounter10_xdu32 "Lenkwinkelbereichzaehler links" ULONG ZU0 1 100 0 4294967295 FORMAT "%13.2" ECU_ADDRESS 0xFEBE8F18 /end MEASUREMENT
/begin MEASUREMENT zLdTrkI_SteerRangeCounter11_xdu32 "Lenkwinkelbereichzaehler links" ULONG ZU0 1 100 0 4294967295 FORMAT "%13.2" ECU_ADDRESS 0xFEBE8F1C /end MEASUREMENT
/begin MEASUREMENT zLdTrkI_SteerRangeCounter12_xdu32 "Lenkwinkelbereichzaehler rechts" ULONG ZU0 1 100 0 4294967295 FORMAT "%13.2" ECU_ADDRESS 0xFEBE8F20 /end MEASUREMENT
/begin MEASUREMENT zLdTrkI_SteerRangeCounter13_xdu32 "Lenkwinkelbereichzaehler rechts" ULONG ZU0 1 100 0 4294967295 FORMAT "%13.2" ECU_ADDRESS 0xFEBE8F24 /end MEASUREMENT
/begin MEASUREMENT zLdTrkI_SteerRangeCounter14_xdu32 "Lenkwinkelbereichzaehler rechts" ULONG ZU0 1 100 0 4294967295 FORMAT "%13.2" ECU_ADDRESS 0xFEBE8F28 /end MEASUREMENT
/begin MEASUREMENT zLdTrkI_SteerRangeCounter15_xdu32 "Lenkwinkelbereichzaehler rechts" ULONG ZU0 1 100 0 4294967295 FORMAT "%13.2" ECU_ADDRESS 0xFEBE8F2C /end MEASUREMENT
/begin MEASUREMENT zLdTrkI_SteerRangeCounter16_xdu32 "Lenkwinkelbereichzaehler rechts" ULONG ZU0 1 100 0 4294967295 FORMAT "%13.2" ECU_ADDRESS 0xFEBE8F30 /end MEASUREMENT
/begin MEASUREMENT zLdTrkI_SteerRangeCounter17_xdu32 "Lenkwinkelbereichzaehler rechts" ULONG ZU0 1 100 0 4294967295 FORMAT "%13.2" ECU_ADDRESS 0xFEBE8F34 /end MEASUREMENT
/begin MEASUREMENT zLdTrkI_SteerRangeCounter18_xdu32 "Lenkwinkelbereichzaehler rechts" ULONG ZU0 1 100 0 4294967295 FORMAT "%13.2" ECU_ADDRESS 0xFEBE8F38 /end MEASUREMENT
/begin MEASUREMENT zLdTrkI_SteerRangeCounter19_xdu32 "Lenkwinkelbereichzaehler rechts" ULONG ZU0 1 100 0 4294967295 FORMAT "%13.2" ECU_ADDRESS 0xFEBE8F3C /end MEASUREMENT
/begin MEASUREMENT zLdTrkI_SteerRangeCounter20_xdu32 "Lenkwinkelbereichzaehler rechts" ULONG ZU0 1 100 0 4294967295 FORMAT "%13.2" ECU_ADDRESS 0xFEBE8F40 /end MEASUREMENT
/begin MEASUREMENT zLdTrkI_SteerRangeCounter21_xdu32 "Lenkwinkelbereichzaehler rechts" ULONG ZU0 1 100 0 4294967295 FORMAT "%13.2" ECU_ADDRESS 0xFEBE8F44 /end MEASUREMENT
/begin MEASUREMENT zLdTrkI_SteerRangeCounter22_xdu32 "Lenkwinkelbereichzaehler rechts" ULONG ZU0 1 100 0 4294967295 FORMAT "%13.2" ECU_ADDRESS 0xFEBE8F48 /end MEASUREMENT
/begin COMPU_METHOD BIT "" RAT_FUNC "%6.2" "Bitanzeige" COEFFS 0 1 0 0 0 1 /end COMPU_METHOD
/begin COMPU_METHOD DFACTHIGH "" RAT_FUNC "%6.5" "ms" COEFFS 0 1024 0 0 0 1 /end COMPU_METHOD
/begin COMPU_METHOD FORCE2TORQUE "" RAT_FUNC "%10.9" "Nm/N" COEFFS 0 16777216 0 0 0 1 /end COMPU_METHOD
/begin COMPU_METHOD MMOT "" RAT_FUNC "%6.5" "Nm" COEFFS 0 1024 0 0 0 1 /end COMPU_METHOD
/begin COMPU_METHOD RACKPOS128 "" RAT_FUNC "%6.4" "mm" COEFFS 0 128 0 0 0 1 /end COMPU_METHOD
/begin COMPU_METHOD RIGHTSH10NP "" RAT_FUNC "%6.5" "" COEFFS 0 1024 0 0 0 1 /end COMPU_METHOD
/begin COMPU_METHOD RIGHTSH10NP_10MS "" RAT_FUNC "%6.5" "1/10ms" COEFFS 0 1024 0 0 0 1 /end COMPU_METHOD
/begin COMPU_METHOD RIGHTSH15NP "" RAT_FUNC "%7.6" "" COEFFS 0 32768 0 0 0 1 /end COMPU_METHOD
/begin COMPU_METHOD RIGHTSH15NP_1MS "" RAT_FUNC "%7.6" "1/1ms" COEFFS 0 32768 0 0 0 1 /end COMPU_METHOD
/begin COMPU_METHOD RIGHTSH16NP "" RAT_FUNC "%7.6" "" COEFFS 0 65536 0 0 0 1 /end COMPU_METHOD
/begin COMPU_METHOD RIGHTSH24NP "" RAT_FUNC "%10.9" "" COEFFS 0 16777216 0 0 0 1 /end COMPU_METHOD
/begin COMPU_METHOD SA_10 "" RAT_FUNC "%6.3" "Â°" COEFFS 0 10 0 0 0 1 /end COMPU_METHOD
/begin COMPU_METHOD SM_I_MS "" RAT_FUNC "%6.4" "A/ms" COEFFS 0 16 0 0 0 1 /end COMPU_METHOD
/begin COMPU_METHOD STATUS "" RAT_FUNC "%6.2" "Status" COEFFS 0 1 0 0 0 1 /end COMPU_METHOD
/begin COMPU_METHOD TBTHIGH "" RAT_FUNC "%6.5" "Nm" COEFFS 0 1024 0 0 0 1 /end COMPU_METHOD
/begin COMPU_METHOD TBTSTIFFHIGH "" RAT_FUNC "%6.5" "NM / Â°" COEFFS 0 1024 0 0 0 1 /end COMPU_METHOD
/begin COMPU_METHOD TIMMS "" RAT_FUNC "%6.2" "ms" COEFFS 0 1 0 0 0 1 /end COMPU_METHOD
/begin COMPU_METHOD TIMS "" RAT_FUNC "%6.2" "s" COEFFS 0 1 0 0 0 1 /end COMPU_METHOD
/begin COMPU_METHOD TIMSEC_1000 "" RAT_FUNC "%6.5" "s" COEFFS 0 1000 0 0 0 1 /end COMPU_METHOD
/begin COMPU_METHOD TIMUS "" RAT_FUNC "%6.2" "us" COEFFS 0 1 0 0 0 1 /end COMPU_METHOD
/begin COMPU_METHOD TORGRAD "" RAT_FUNC "%6.5" "Nm/ms" COEFFS 0 1024 0 0 0 1 /end COMPU_METHOD
/begin COMPU_METHOD TORGRAD_10MS "" RAT_FUNC "%6.5" "Nm/10ms" COEFFS 0 1024 0 0 0 1 /end COMPU_METHOD
/begin COMPU_METHOD TORQUE2FORCE "" RAT_FUNC "%6.2" "N/Nm" COEFFS 0 1 0 0 0 1 /end COMPU_METHOD
/begin COMPU_METHOD VFZHIGH "" RAT_FUNC "%6.4" "km/h" COEFFS 0 64 0 0 0 1 /end COMPU_METHOD
/begin COMPU_METHOD VROT "" RAT_FUNC "%3.1" "1/min" COEFFS 0 1 0 0 0 1 /end COMPU_METHOD
/begin COMPU_METHOD ZU0 "" RAT_FUNC "%6.2" "" COEFFS 0 1 0 0 0 1 /end COMPU_METHOD
/begin FUNCTION SteeringControlInterpol "Steering Control (interpolate vehicle speed depended characteristic curves)"
 /begin DEF_CHARACTERISTIC fSteerCtrl_UseSteerCtrlTBTGrad_XDB vSteerCtrl_SubstituteSpeed_XDU16 xSteerCtrl_DOffsetFactor_XAU16_00___A xSteerCtrl_DOffsetFactor_XAU16_01___A xSteerCtrl_DOffsetFactor_XAU16_02___A xSteerCtrl_DOffsetFactor_XAU16_03___A xSteerCtrl_DOffsetFactor_XAU16_04___A xSteerCtrl_DOffsetFactor_XAU16_05___A xSteerCtrl_DOffsetFactor_XAU16_06___A xSteerCtrl_DOffsetFactor_XAU16_07___A xSteerCtrl_DOffsetFactor_XAU16_08___A xSteerCtrl_DOffsetFactor_XAU16_09___A xSteerCtrl_DOffsetFactor_XAU16_10___A xSteerCtrl_DOffsetFactor_XAU16_11___A xSteerCtrl_DOffsetFactor_XAU16_12___A xSteerCtrl_DOffsetFactor_XAU16_13___A xSteerCtrl_DOffsetFactor_XAU16_14___A xSteerCtrl_DOffsetFactor_XAU16_15___A xSteerCtrl_DOffsetFactor_XAU16_16___A xSteerCtrl_DOffsetFactor_XAU16_17___A xSteerCtrl_DOffsetFactor_XAU16_18___A xSteerCtrl_DOffsetFactor_XAU16_19___A xSteerCtrl_DOffsetFactor_XAU16_20___A xSteerCtrl_DOffsetFactor_XAU16_21___A xSteerCtrl_DOffsetFactor_XAU16_22___A xSteerCtrl_DOffsetFactor_XAU16_23___A xSteerCtrl_DOffsetFactor_XAU16_24___A xSteerCtrl_DOffsetFactor_XAU16_25___A xSteerCtrl_DOffsetFactor_XAU16_26___A xSteerCtrl_DOffsetFactor_XAU16_27___A xSteerCtrl_DOffsetFactor_XAU16_28___A xSteerCtrl_DOffsetFactor_XAU16_29___A xSteerCtrl_DOffsetFactor_XAU16_30___A xSteerCtrl_DOffsetFactor_XAU16_31___A xSteerCtrl_DOffsetFactor_XAU16_32___A xSteerCtrl_DOffsetFactor_XAU16_33___A xSteerCtrl_DOffsetFactor_XAU16_34___A xSteerCtrl_DOffsetFactor_XAU16_35___A xSteerCtrl_DPartFactor_XAU16_00___A xSteerCtrl_DPartFactor_XAU16_01___A xSteerCtrl_DPartFactor_XAU16_02___A xSteerCtrl_DPartFactor_XAU16_03___A xSteerCtrl_DPartFactor_XAU16_04___A xSteerCtrl_DPartFactor_XAU16_05___A xSteerCtrl_DPartFactor_XAU16_06___A xSteerCtrl_DPartFactor_XAU16_07___A xSteerCtrl_DPartFactor_XAU16_08___A xSteerCtrl_DPartFactor_XAU16_09___A xSteerCtrl_DPartFactor_XAU16_10___A xSteerCtrl_DPartFactor_XAU16_11___A xSteerCtrl_DPartFactor_XAU16_12___A xSteerCtrl_DPartFactor_XAU16_13___A xSteerCtrl_DPartFactor_XAU16_14___A xSteerCtrl_DPartFactor_XAU16_15___A xSteerCtrl_DPartFactor_XAU16_16___A xSteerCtrl_DPartFactor_XAU16_17___A xSteerCtrl_DPartFactor_XAU16_18___A xSteerCtrl_DPartFactor_XAU16_19___A xSteerCtrl_DPartFactor_XAU16_20___A xSteerCtrl_DPartFactor_XAU16_21___A xSteerCtrl_DPartFactor_XAU16_22___A xSteerCtrl_DPartFactor_XAU16_23___A xSteerCtrl_DPartFactor_XAU16_24___A xSteerCtrl_DPartFactor_XAU16_25___A xSteerCtrl_DPartFactor_XAU16_26___A xSteerCtrl_DPartFactor_XAU16_27___A xSteerCtrl_DPartFactor_XAU16_28___A xSteerCtrl_DPartFactor_XAU16_29___A xSteerCtrl_DPartFactor_XAU16_30___A xSteerCtrl_DPartFactor_XAU16_31___A xSteerCtrl_DPartFactor_XAU16_32___A xSteerCtrl_DPartFactor_XAU16_33___A xSteerCtrl_DPartFactor_XAU16_34___A xSteerCtrl_DPartFactor_XAU16_35___A xSteerCtrl_FilterGradTBT_XAU16 xSteerCtrl_HysteresisTBT_XAU16 /end DEF_CHARACTERISTIC
 /begin IN_MEASUREMENT nApplI_AbsRotorSpeedFilt_xdu16 /end IN_MEASUREMENT
 /begin OUT_MEASUREMENT mSteerCtrl_FiltSCGradTBT_xds16 mSteerCtrl_HystTorsionBarTorque_xds16 vSteerCtrl_AbsVehicleSpeedFilt4Interpol_xdu16 xSteerCtrl_DOffsetFactorAxis1Fraction_xdu16 xSteerCtrl_DOffsetFactorAxis1Index_xdu8 xSteerCtrl_DPartFactorAxis1Fraction_xdu16 xSteerCtrl_DPartFactorAxis1Index_xdu8 xSteerCtrl_FilterGradTBTAxis1Fraction_xdu16 xSteerCtrl_FilterGradTBTAxis1Index_xdu8 xSteerCtrl_HysteresisTBTAxis1Fraction_xdu16 xSteerCtrl_HysteresisTBTAxis1Index_xdu8 /end OUT_MEASUREMENT
/end FUNCTION
/begin FUNCTION SteeringControlV2 "SteeringControlV2"
 /begin DEF_CHARACTERISTIC fSteerCtrl_DeactivateDPartAtEndstopChatter_XDU16 fSteerCtrl_DeactivateDPartAtEndstop_XDU16 fSteerCtrl_NoRotSpDoffLockstop_XDU8 mSteerCtrl_DOffsetDeadband_XDU16 vSteerCtrl_MaxVehSpeedRedDueChatter_XDU16 xSteerCtrl_ChatterReduction_XAU16 xSteerCtrl_DOffsetFactorEndStop_XAU16_00___A xSteerCtrl_DOffsetFactorEndStop_XAU16_01___A xSteerCtrl_DOffsetFactorEndStop_XAU16_02___A xSteerCtrl_DOffsetFactorEndStop_XAU16_03___A xSteerCtrl_DOffsetFactorEndStop_XAU16_04___A xSteerCtrl_DOffsetFactorEndStop_XAU16_05___A xSteerCtrl_DOffsetFactorEndStop_XAU16_06___A xSteerCtrl_DOffsetFactorEndStop_XAU16_07___A xSteerCtrl_DOffsetFactorEndStop_XAU16_08___A xSteerCtrl_DOffsetFactorEndStop_XAU16_09___A xSteerCtrl_DOffsetFactorEndStop_XAU16_10___A xSteerCtrl_DOffsetFactorEndStop_XAU16_11___A xSteerCtrl_DOffsetFactorEndStop_XAU16_12___A xSteerCtrl_DOffsetFactorEndStop_XAU16_13___A xSteerCtrl_DOffsetFactorEndStop_XAU16_14___A xSteerCtrl_DOffsetFactorEndStop_XAU16_15___A xSteerCtrl_DOffsetFactorEndStop_XAU16_16___A xSteerCtrl_DOffsetFactorEndStop_XAU16_17___A xSteerCtrl_DOffsetFactorEndStop_XAU16_18___A xSteerCtrl_DOffsetFactorEndStop_XAU16_19___A xSteerCtrl_DOffsetFactorEndStop_XAU16_20___A xSteerCtrl_DOffsetFactorEndStop_XAU16_21___A xSteerCtrl_DOffsetFactorEndStop_XAU16_22___A xSteerCtrl_DOffsetFactorEndStop_XAU16_23___A xSteerCtrl_DOffsetFactorEndStop_XAU16_24___A xSteerCtrl_DOffsetFactorEndStop_XAU16_25___A xSteerCtrl_DOffsetFactorEndStop_XAU16_26___A xSteerCtrl_DOffsetFactorEndStop_XAU16_27___A xSteerCtrl_DOffsetFactorEndStop_XAU16_28___A xSteerCtrl_DOffsetFactorEndStop_XAU16_29___A xSteerCtrl_DOffsetFactorEndStop_XAU16_30___A xSteerCtrl_DOffsetFactorEndStop_XAU16_31___A xSteerCtrl_DOffsetFactorEndStop_XAU16_32___A xSteerCtrl_DOffsetFactorEndStop_XAU16_33___A xSteerCtrl_DOffsetFactorEndStop_XAU16_34___A xSteerCtrl_DOffsetFactorEndStop_XAU16_35___A xSteerCtrl_DOffsetFactorFactorMechStuck_XAU16_00___A xSteerCtrl_DOffsetFactorFactorMechStuck_XAU16_01___A xSteerCtrl_DOffsetFactorFactorMechStuck_XAU16_02___A xSteerCtrl_DOffsetFactorFactorMechStuck_XAU16_03___A xSteerCtrl_DOffsetFactorFactorMechStuck_XAU16_04___A xSteerCtrl_DOffsetFactorFactorMechStuck_XAU16_05___A xSteerCtrl_DOffsetFactorFactorMechStuck_XAU16_06___A xSteerCtrl_DOffsetFactorFactorMechStuck_XAU16_07___A xSteerCtrl_DOffsetFactorFactorMechStuck_XAU16_08___A xSteerCtrl_DOffsetFactorFactorMechStuck_XAU16_09___A xSteerCtrl_DOffsetFactorFactorMechStuck_XAU16_10___A xSteerCtrl_DOffsetFactorFactorMechStuck_XAU16_11___A xSteerCtrl_DOffsetFactorFactorMechStuck_XAU16_12___A xSteerCtrl_DOffsetFactorFactorMechStuck_XAU16_13___A xSteerCtrl_DOffsetFactorFactorMechStuck_XAU16_14___A xSteerCtrl_DOffsetFactorFactorMechStuck_XAU16_15___A xSteerCtrl_DOffsetFactorFactorMechStuck_XAU16_16___A xSteerCtrl_DOffsetFactorFactorMechStuck_XAU16_17___A xSteerCtrl_DOffsetFactorFactorMechStuck_XAU16_18___A xSteerCtrl_DOffsetFactorFactorMechStuck_XAU16_19___A xSteerCtrl_DOffsetFactorFactorMechStuck_XAU16_20___A xSteerCtrl_DOffsetFactorFactorMechStuck_XAU16_21___A xSteerCtrl_DOffsetFactorFactorMechStuck_XAU16_22___A xSteerCtrl_DOffsetFactorFactorMechStuck_XAU16_23___A xSteerCtrl_DOffsetFactorFactorMechStuck_XAU16_24___A xSteerCtrl_DOffsetFactorFactorMechStuck_XAU16_25___A xSteerCtrl_DOffsetFactorFactorMechStuck_XAU16_26___A xSteerCtrl_DOffsetFactorFactorMechStuck_XAU16_27___A xSteerCtrl_DOffsetFactorFactorMechStuck_XAU16_28___A xSteerCtrl_DOffsetFactorFactorMechStuck_XAU16_29___A xSteerCtrl_DOffsetFactorFactorMechStuck_XAU16_30___A xSteerCtrl_DOffsetFactorFactorMechStuck_XAU16_31___A xSteerCtrl_DOffsetFactorFactorMechStuck_XAU16_32___A xSteerCtrl_DOffsetFactorFactorMechStuck_XAU16_33___A xSteerCtrl_DOffsetFactorFactorMechStuck_XAU16_34___A xSteerCtrl_DOffsetFactorFactorMechStuck_XAU16_35___A xSteerCtrl_SubstDOffsetFactChatter_XDU16_0___A xSteerCtrl_SubstDOffsetFactChatter_XDU16_1___A xSteerCtrl_SubstDOffsetFactChatter_XDU16_2___A xSteerCtrl_SubstDOffsetFactChatter_XDU16_3___A xSteerCtrl_SubstDPartFactChatter_XDU16_0___A xSteerCtrl_SubstDPartFactChatter_XDU16_1___A xSteerCtrl_SubstDPartFactChatter_XDU16_2___A xSteerCtrl_SubstDPartFactChatter_XDU16_3___A ySteerCtrl_RampDownRedLevDueChatter_XDU16 ySteerCtrl_RampUpRedLevDueChatter_XDU16 zSteerCtrl_ChatteringDetected_XDU8_0___A zSteerCtrl_ChatteringDetected_XDU8_1___A zSteerCtrl_ChatteringDetected_XDU8_2___A zSteerCtrl_ChatteringDetected_XDU8_3___A /end DEF_CHARACTERISTIC
 /begin IN_MEASUREMENT vSteerCtrl_AbsVehicleSpeedFilt4Interpol_xdu16 zcrChatterPeriodsCount_xdu8 /end IN_MEASUREMENT
 /begin OUT_MEASUREMENT mSteerCtrl_AbsDOffset_xdu16 mSteerCtrl_DOffset_xds16 mSteerCtrl_DPart_xds16 /end OUT_MEASUREMENT
/end FUNCTION
/begin FUNCTION SteeringControlV2I "SteeringControlV2 - interface" /begin OUT_MEASUREMENT mSteerCtrlI_MotorTorque_xds16 /end OUT_MEASUREMENT /end FUNCTION
/begin FUNCTION SteeringFeelCoordinator "SteeringFeelCoordinator"
 /begin DEF_CHARACTERISTIC fStFC_UseActiveInertia_XDU8_00___A fStFC_UseActiveInertia_XDU8_01___A fStFC_UseActiveInertia_XDU8_02___A fStFC_UseActiveInertia_XDU8_03___A fStFC_UseActiveInertia_XDU8_04___A fStFC_UseActiveInertia_XDU8_05___A fStFC_UseActiveInertia_XDU8_06___A fStFC_UseActiveInertia_XDU8_07___A fStFC_UseActiveInertia_XDU8_08___A fStFC_UseActiveInertia_XDU8_09___A fStFC_UseActiveInertia_XDU8_10___A fStFC_UseActiveInertia_XDU8_11___A fStFC_UseActiveInertia_XDU8_12___A fStFC_UseActiveInertia_XDU8_13___A fStFC_UseActiveInertia_XDU8_14___A fStFC_UseActiveInertia_XDU8_15___A fStFC_UseActiveInertia_XDU8_16___A fStFC_UseActiveInertia_XDU8_17___A fStFC_UseActiveInertia_XDU8_18___A fStFC_UseActiveInertia_XDU8_19___A fStFC_UseActiveInertia_XDU8_20___A fStFC_UseActiveInertia_XDU8_21___A fStFC_UseActiveInertia_XDU8_22___A fStFC_UseActiveInertia_XDU8_23___A fStFC_UseActiveInertia_XDU8_24___A fStFC_UseActiveInertia_XDU8_25___A fStFC_UseActiveInertia_XDU8_26___A fStFC_UseActiveInertia_XDU8_27___A fStFC_UseActiveInertia_XDU8_28___A fStFC_UseActiveInertia_XDU8_29___A fStFC_UseActiveInertia_XDU8_30___A fStFC_UseActiveInertia_XDU8_31___A fStFC_UseActiveInertia_XDU8_32___A fStFC_UseActiveInertia_XDU8_33___A fStFC_UseActiveInertia_XDU8_34___A fStFC_UseActiveInertia_XDU8_35___A fStFC_UseBasicSteerTor_XDU8 fStFC_UseCenterPointFeel_XDU8_00___A fStFC_UseCenterPointFeel_XDU8_01___A fStFC_UseCenterPointFeel_XDU8_02___A fStFC_UseCenterPointFeel_XDU8_03___A fStFC_UseCenterPointFeel_XDU8_04___A fStFC_UseCenterPointFeel_XDU8_05___A fStFC_UseCenterPointFeel_XDU8_06___A fStFC_UseCenterPointFeel_XDU8_07___A fStFC_UseCenterPointFeel_XDU8_08___A fStFC_UseCenterPointFeel_XDU8_09___A fStFC_UseCenterPointFeel_XDU8_10___A fStFC_UseCenterPointFeel_XDU8_11___A fStFC_UseCenterPointFeel_XDU8_12___A fStFC_UseCenterPointFeel_XDU8_13___A fStFC_UseCenterPointFeel_XDU8_14___A fStFC_UseCenterPointFeel_XDU8_15___A fStFC_UseCenterPointFeel_XDU8_16___A fStFC_UseCenterPointFeel_XDU8_17___A fStFC_UseCenterPointFeel_XDU8_18___A fStFC_UseCenterPointFeel_XDU8_19___A fStFC_UseCenterPointFeel_XDU8_20___A fStFC_UseCenterPointFeel_XDU8_21___A fStFC_UseCenterPointFeel_XDU8_22___A fStFC_UseCenterPointFeel_XDU8_23___A fStFC_UseCenterPointFeel_XDU8_24___A fStFC_UseCenterPointFeel_XDU8_25___A fStFC_UseCenterPointFeel_XDU8_26___A fStFC_UseCenterPointFeel_XDU8_27___A fStFC_UseCenterPointFeel_XDU8_28___A fStFC_UseCenterPointFeel_XDU8_29___A fStFC_UseCenterPointFeel_XDU8_30___A fStFC_UseCenterPointFeel_XDU8_31___A fStFC_UseCenterPointFeel_XDU8_32___A fStFC_UseCenterPointFeel_XDU8_33___A fStFC_UseCenterPointFeel_XDU8_34___A fStFC_UseCenterPointFeel_XDU8_35___A fStFC_UseHysteresis_XDU8_00___A fStFC_UseHysteresis_XDU8_01___A fStFC_UseHysteresis_XDU8_02___A fStFC_UseHysteresis_XDU8_03___A fStFC_UseHysteresis_XDU8_04___A fStFC_UseHysteresis_XDU8_05___A fStFC_UseHysteresis_XDU8_06___A fStFC_UseHysteresis_XDU8_07___A fStFC_UseHysteresis_XDU8_08___A fStFC_UseHysteresis_XDU8_09___A fStFC_UseHysteresis_XDU8_10___A fStFC_UseHysteresis_XDU8_11___A fStFC_UseHysteresis_XDU8_12___A fStFC_UseHysteresis_XDU8_13___A fStFC_UseHysteresis_XDU8_14___A fStFC_UseHysteresis_XDU8_15___A fStFC_UseHysteresis_XDU8_16___A fStFC_UseHysteresis_XDU8_17___A fStFC_UseHysteresis_XDU8_18___A fStFC_UseHysteresis_XDU8_19___A fStFC_UseHysteresis_XDU8_20___A fStFC_UseHysteresis_XDU8_21___A fStFC_UseHysteresis_XDU8_22___A fStFC_UseHysteresis_XDU8_23___A fStFC_UseHysteresis_XDU8_24___A fStFC_UseHysteresis_XDU8_25___A fStFC_UseHysteresis_XDU8_26___A fStFC_UseHysteresis_XDU8_27___A fStFC_UseHysteresis_XDU8_28___A fStFC_UseHysteresis_XDU8_29___A fStFC_UseHysteresis_XDU8_30___A fStFC_UseHysteresis_XDU8_31___A fStFC_UseHysteresis_XDU8_32___A fStFC_UseHysteresis_XDU8_33___A fStFC_UseHysteresis_XDU8_34___A fStFC_UseHysteresis_XDU8_35___A /end DEF_CHARACTERISTIC
/end FUNCTION
/begin FUNCTION SteeringFeelCoordinatorI "SteeringFeelCoordinator - interfaces" /begin OUT_MEASUREMENT mStFCI_NominalSteerTorque_xds16 /end OUT_MEASUREMENT /end FUNCTION
/begin FUNCTION SteeringRangeTrackerI "SteeringRangeTracker - interface"
 /begin OUT_MEASUREMENT zLdTrkI_SteerRangeCounter01_xdu32 zLdTrkI_SteerRangeCounter02_xdu32 zLdTrkI_SteerRangeCounter03_xdu32 zLdTrkI_SteerRangeCounter04_xdu32 zLdTrkI_SteerRangeCounter05_xdu32 zLdTrkI_SteerRangeCounter06_xdu32 zLdTrkI_SteerRangeCounter07_xdu32 zLdTrkI_SteerRangeCounter08_xdu32 zLdTrkI_SteerRangeCounter09_xdu32 zLdTrkI_SteerRangeCounter10_xdu32 zLdTrkI_SteerRangeCounter11_xdu32 zLdTrkI_SteerRangeCounter12_xdu32 zLdTrkI_SteerRangeCounter13_xdu32 zLdTrkI_SteerRangeCounter14_xdu32 zLdTrkI_SteerRangeCounter15_xdu32 zLdTrkI_SteerRangeCounter16_xdu32 zLdTrkI_SteerRangeCounter17_xdu32 zLdTrkI_SteerRangeCounter18_xdu32 zLdTrkI_SteerRangeCounter19_xdu32 zLdTrkI_SteerRangeCounter20_xdu32 zLdTrkI_SteerRangeCounter21_xdu32 zLdTrkI_SteerRangeCounter22_xdu32 /end OUT_MEASUREMENT
/end FUNCTION
/begin FUNCTION SteerTorqueControllerPlus "SteerTorqueControllerPlus"
 /begin DEF_CHARACTERISTIC fStTorCtrlP_EnableIfEndstopIsInvalid_XDB mStTorCtrlP_AlternativeMMotMaxDepOnVFZ_XDU16 mStTorCtrlP_ChatterMMotMax_XAU16 mStTorCtrlP_DistanceToEndstopMMotMax_XAS16 mStTorCtrlP_MMotMax_XAU16_0___A mStTorCtrlP_MMotMax_XAU16_1___A mStTorCtrlP_MMotMax_XAU16_2___A mStTorCtrlP_MMotMax_XAU16_3___A mStTorCtrlP_MMotMax_XAU16_4___A mStTorCtrlP_MMotMax_XAU16_5___A xStTorCtrlP_DFactorTBTControl_XAU16_0___A xStTorCtrlP_DFactorTBTControl_XAU16_1___A xStTorCtrlP_DFactorTBTControl_XAU16_2___A xStTorCtrlP_DFactorTBTControl_XAU16_3___A xStTorCtrlP_DFactorTBTControl_XAU16_4___A xStTorCtrlP_DFactorTBTControl_XAU16_5___A xStTorCtrlP_DPt1FactorTBTControl_XDU16_0___A xStTorCtrlP_DPt1FactorTBTControl_XDU16_1___A xStTorCtrlP_DPt1FactorTBTControl_XDU16_2___A xStTorCtrlP_DPt1FactorTBTControl_XDU16_3___A xStTorCtrlP_DPt1FactorTBTControl_XDU16_4___A xStTorCtrlP_DPt1FactorTBTControl_XDU16_5___A xStTorCtrlP_FactChatterMMotMax_XAU16 xStTorCtrlP_FactorDepOnWeightedInt_XAU16_0___A xStTorCtrlP_FactorDepOnWeightedInt_XAU16_1___A xStTorCtrlP_FactorDepOnWeightedInt_XAU16_2___A xStTorCtrlP_FactorDepOnWeightedInt_XAU16_3___A xStTorCtrlP_FactorDepOnWeightedInt_XAU16_4___A xStTorCtrlP_FactorDepOnWeightedInt_XAU16_5___A xStTorCtrlP_IFactorTBTControl_XAU16_0___A xStTorCtrlP_IFactorTBTControl_XAU16_1___A xStTorCtrlP_IFactorTBTControl_XAU16_2___A xStTorCtrlP_IFactorTBTControl_XAU16_3___A xStTorCtrlP_IFactorTBTControl_XAU16_4___A xStTorCtrlP_IFactorTBTControl_XAU16_5___A xStTorCtrlP_PFactorTBTControl_XAU16_0___A xStTorCtrlP_PFactorTBTControl_XAU16_1___A xStTorCtrlP_PFactorTBTControl_XAU16_2___A xStTorCtrlP_PFactorTBTControl_XAU16_3___A xStTorCtrlP_PFactorTBTControl_XAU16_4___A xStTorCtrlP_PFactorTBTControl_XAU16_5___A xStTorCtrlP_PPt1FactorTBTControl_XDU16_0___A xStTorCtrlP_PPt1FactorTBTControl_XDU16_1___A xStTorCtrlP_PPt1FactorTBTControl_XDU16_2___A xStTorCtrlP_PPt1FactorTBTControl_XDU16_3___A xStTorCtrlP_PPt1FactorTBTControl_XDU16_4___A xStTorCtrlP_PPt1FactorTBTControl_XDU16_5___A xStTorCtrlP_RampInGrad_XDU16 xStTorCtrlP_RampOutGrad_XDU16 /end DEF_CHARACTERISTIC
 /begin IN_MEASUREMENT lEndStopI_DistanceToEndstop_xds16 nApplI_AbsRotorSpeedFilt_xdu16 vVehSpI_AbsAvgVehSpd_xdu16 xMotTorLimI_WeightedIntegratedDeviation_xdu16 zcrChatterPeriodsCount_xdu8 /end IN_MEASUREMENT
 /begin OUT_MEASUREMENT sStTorCtrlP_FctCoCtrlState_xdu8 sStTorCtrlP_FeatureState_xdu8 xStTorCtrlP_RampInOut_xdu16 /end OUT_MEASUREMENT
/end FUNCTION
/begin FUNCTION SteerTorqueControllerPlusI "SteerTorqueControllerPlus (RG3) - Interface" /begin OUT_MEASUREMENT mStTorCtrlPI_MotorTorque_xds16 /end OUT_MEASUREMENT /end FUNCTION
/begin FUNCTION Stubs "Stubs" /begin DEF_CHARACTERISTIC zstTBTDiffDelaySelect_XDU16 /end DEF_CHARACTERISTIC
 /begin OUT_MEASUREMENT fBswI_BusOffState_xdu8 fccStoppStartOperation_xdb fccSwitch2DriveUp_xdb fErrHdlI_MonShutDown_xdb fNvMCI_ReadAllFinished_xdb mApplI_MaxAllowedTorque_xdu16 sccEventMemory_xdu32 sHwlI_AbsRotbasedAngleDetails_xdu32 sNvMCI_ErrLvl_Red_xdu8 sNvMCI_ErrLvl_xdu8 yApplI_MaxBatteryCurrentGradient_xdu16 yEerSyncI_RoutedSubstFunct_xdu32 /end OUT_MEASUREMENT
/end FUNCTION
/begin FUNCTION SubConnMotTrqSumAfterMtlI "SubConnMotTrqSumAfterMtl - interface" /begin DEF_CHARACTERISTIC vDthrCtrl_MaxPlaVehSpeed_XDU16 /end DEF_CHARACTERISTIC /begin OUT_MEASUREMENT mTrqSumI_TrqSumAfterMTL_xds16 /end OUT_MEASUREMENT /end FUNCTION
/begin FUNCTION SubConnMotTrqSumBeforeMtlI "SubConnMotTrqSumBeforeMtl - interface" /begin OUT_MEASUREMENT mTrqSumI_TrqSumBeforeMTL_xds16 /end OUT_MEASUREMENT /end FUNCTION
/begin FUNCTION SubConnSteerTrqSumI "SubConnSteerTrqSum - interface" /begin OUT_MEASUREMENT mTrqSumI_SteerTrqSum_xds16 /end OUT_MEASUREMENT /end FUNCTION
/begin FUNCTION SW_ID "SW_ID"
 /begin OUT_MEASUREMENT fSccI_DemClearRequired_xdb sSwInCompI_ErrLvl_Red_xdu8 sSwInCompI_ErrLvl_xdu8 ySwID_SlaveSWLabel_xau8 /end OUT_MEASUREMENT
/end FUNCTION
/begin FUNCTION SystemData "Systemdaten"
 /begin DEF_CHARACTERISTIC jsyInvSteeringRatio_XDU16_0__A jsyInvSteeringRatio_XDU16_1__A msyAbsTorsionBarTorque_XDU16 xsyEngTorqueToRackForce_XDU16 xsyExpandedRotorInertia_XDU16 xsyGearRatioMot2Rack_XDU16 xsyInvSteeringRatioVarFact_XAU16 xsyInvSystemStiff_XDU16 xsyNoEffDepEngTorqueToRackForce_XDU16 xsyRackForceToEngTorque_XDU16 xsyRatioEfficiency_XDU16 xsyRotorInertia_XDU16 /end DEF_CHARACTERISTIC
 /begin IN_MEASUREMENT wApplI_AbsSteeringAngle_xdu16 /end IN_MEASUREMENT
 /begin OUT_MEASUREMENT seeProductionMode_xdu16 yeeDisErrEntryProd_xdu32 yeeDisFctDeliv_xdu32 yeeDisFctProd_xdu32 ysyVehCharacteristic_xdu8 ysyVehVar_xdu32 /end OUT_MEASUREMENT
/end FUNCTION
/begin FUNCTION SystemTimer "Stellt die Systemzeit zur Verfï¿½gung" /begin OUT_MEASUREMENT tSysTimer_SystemTimeSeconds_xdu16 /end OUT_MEASUREMENT /end FUNCTION
/begin FUNCTION TaskControlInterface "Interfaces der TaskControl" /begin OUT_MEASUREMENT sTaskControlI_SingleControllerReset_xdu8 /end OUT_MEASUREMENT /end FUNCTION
/begin FUNCTION TemperatureTracker_Interface "TemperatureTracker Interfacee"
 /begin OUT_MEASUREMENT tLdTrkI_TimeTempZone01_xdu32 tLdTrkI_TimeTempZone02_xdu32 tLdTrkI_TimeTempZone03_xdu32 tLdTrkI_TimeTempZone04_xdu32 tLdTrkI_TimeTempZone05_xdu32 tLdTrkI_TimeTempZone06_xdu32 tLdTrkI_TimeTempZone07_xdu32 tLdTrkI_TimeTempZone08_xdu32 tLdTrkI_TimeTempZone09_xdu32 tLdTrkI_TimeTempZone10_xdu32 tLdTrkI_TimeTempZone11_xdu32 tLdTrkI_TimeTempZone12_xdu32 tLdTrkI_TimeTempZone13_xdu32 tLdTrkI_TimeTempZone14_xdu32 tLdTrkI_TimeTempZone15_xdu32 tLdTrkI_TimeTempZone16_xdu32 tLdTrkI_TimeTempZone17_xdu32 tLdTrkI_TimeTempZone18_xdu32 tLdTrkI_TimeTempZone19_xdu32 tLdTrkI_TimeTempZone20_xdu32 /end OUT_MEASUREMENT
/end FUNCTION
/begin FUNCTION TemplateI "template - interface" /begin DEF_CHARACTERISTIC fDSR_EMA_Enable_XDU8 /end DEF_CHARACTERISTIC
 /begin OUT_MEASUREMENT fApplI_DsrErrorMode_xdb fDsr_DrvStrActivated_xdb fDsr_EmaActivated_xdb fDsr_InputValid_xdb mApplI_SteerTqReq_xds16 sApplI_DsrSta_D_Req_xdu8 sApplI_EmaEnabled_xdu8 xDrvStrRec_RampIn_xdu16 xDrvStrRec_RampOut_xdu16 /end OUT_MEASUREMENT
/end FUNCTION
/begin FUNCTION TestFunction "TestFunction"
 /begin DEF_CHARACTERISTIC sTest_ChannelNoReq_XDU8 sTest_ChannelNoValidityReq_XDU8 sTest_FeatureState_XDU8 /end DEF_CHARACTERISTIC
 /begin OUT_MEASUREMENT sTest_ChannelArbitration_xdu8 sTest_ChannelNo_xdu8 sTest_CtrlState_xdu8 /end OUT_MEASUREMENT
/end FUNCTION
/begin FUNCTION TorqueConvert ""
 /begin DEF_CHARACTERISTIC mLa_MotorTorqueDepOnTBTV0_XAU16 mLa_MotorTorqueDepOnTBTV1_XAU16 mLa_MotorTorqueDepOnTBTV2_XAU16 mLa_MotorTorqueDepOnTBTV3_XAU16 mLa_MotorTorqueDepOnTBTV4_XAU16 mLa_MotorTorqueDepOnTBTV5_XAU16 zVTorqueConvCharSelect_XAU8 /end DEF_CHARACTERISTIC
 /begin IN_MEASUREMENT mApplI_AbsDriverTorque_xdu16 /end IN_MEASUREMENT
 /begin OUT_MEASUREMENT mLa_TorqueConvMMotYAxis_xau16 mLa_TorqueConvTBTXAxis_xau16 /end OUT_MEASUREMENT
/end FUNCTION
/begin FUNCTION TorqueReductionCoordinator "Begrenzung des Maximalmoments"
 /begin DEF_CHARACTERISTIC mtrcMaxTorGradVehicleMoving_XDU16 mtrcMaxTorGradVehicleStanding_XDU16 /end DEF_CHARACTERISTIC
/end FUNCTION
/begin FUNCTION TorqueReductionCoordinatorConf "Konfiguration der TRC Kanï¿½le"
 /begin OUT_MEASUREMENT xtcActualGradientRedLevel_xau16 xtcActualMotCharTorqLevel_xau16 xtcActualTorqueRedLevel_xau16 xtcTargetGradientRedLevel_xau16 xtcTargetMotCharTorqLevel_xau16 xtcTargetTorqueRedLevel_xau16 ytcGradientRedGradNeg_xau16 ytcGradientRedGradPos_xau16 ytcMotCharTorqRedGradNeg_xau16 ytcMotCharTorqRedGradPos_xau16 ytcTorqueRedGradNeg_xau16 ytcTorqueRedGradPos_xau16 /end OUT_MEASUREMENT
/end FUNCTION
/begin FUNCTION TorqueSensorFallback "TorqueSensorFallback - Main"
 /begin DEF_CHARACTERISTIC mTsf_MaxTorqValue_XDU16 wTsf_SteeringAngleDeactvnThd_XDU16 xTsf_RampGradient_XDU16 xTsf_RotSpeedCurveFact_XAU16 /end DEF_CHARACTERISTIC
 /begin OUT_MEASUREMENT nTsf_AbsRotorSpeed_xdu16 /end OUT_MEASUREMENT
/end FUNCTION
/begin FUNCTION TorqueSensorFallbackCheck "TorqueSensorFallback - Check"
 /begin DEF_CHARACTERISTIC mTsf_MaxTorqValueCheck_XDU16 tTsf_ConstTorqueTimeout_XDU8 wTsf_SteeringAngleDeactvnThdCheck_XDU16 /end DEF_CHARACTERISTIC
 /begin OUT_MEASUREMENT fTsf_ErrorflagSign_xdu8 fTsf_ErrorflagSteeringAngleRange_xdu8 fTsf_Errorflag_MaxValue_xdu8 fTsf_MMotCheckErrorbit_xdu8 fTsf_SteeringTorqueSignCheck_xdu8 /end OUT_MEASUREMENT
/end FUNCTION
/begin FUNCTION TorqueSensorFallbackCheckI "ITorqueSensorFallback - Check"
 /begin OUT_MEASUREMENT mTsfI_MotorTorque_xds16 sTsfI_ErrLvl_Red_xdu8 sTsfI_ErrLvl_xdu8 /end OUT_MEASUREMENT
/end FUNCTION
/begin FUNCTION TorqueSensorFallbackI "ITorqueSensorFallback - Main" /begin OUT_MEASUREMENT mTsfI_MotorTorque4Check_xds16 /end OUT_MEASUREMENT /end FUNCTION
/begin FUNCTION TorqueSignalConditioning "Messgroessen und Parameter der TorqueSignalConditioning SDK"
 /begin DEF_CHARACTERISTIC fTsc_CustomerTypeA_provides_TBTred_XDU8 fTsc_DualDMS_provides_TBTred_XDU8 fTsc_DualMMT_provides_TBTred_XDU8 fTsc_EnableAtlowDyn_XDU8 fTsc_OtherSensor_provides_TBTred_XDU8 fTsc_SingleDMS_provides_TBTred_XDU8 fTsc_SingleMMT_provides_TBTred_XDU8 mTsc_DeadZoneExtrapolGrad_XAU16 mTsc_HysteresisTBT_XAU16 mTsc_MaxMMotLowDyn_XDU16 mTsc_MaxTBTLowDyn_XDU16 nTsc_MaxRotSpdLowDyn_XDU16 tTsc_DeadZonThreshold_XDU16 tTsc_DebounceTimeLowDyn_XDU8 tTsc_SystemDelay_us_XDU16 vTsc_SubstituteSpeed_XDU16 xTsc_ExtrapolFactor_XAU16 xTsc_PT1tauGradTBT_XAU16 xTsc_SubstExtrapolFactChatter_XDU16 xTsc_TorqueGradLowDyn_XDU16 yTsc_Disable_Extrapol_TBT_XDU8 yTsc_Disable_TscI_TBT_Avg_XDU8 zTsc_ChatteringDetected_XDU8 /end DEF_CHARACTERISTIC
 /begin IN_MEASUREMENT nApplI_AbsRotorSpeedFilt_xdu16 /end IN_MEASUREMENT
 /begin OUT_MEASUREMENT mTsc_DeadZoneExtrapolGrad_xdu16 mTsc_ExtrapolTBTmain_xds16 mTsc_ExtrapolTBTred_xds16 tTsc_GradSysT_TBTSTred_us_xdu16 tTsc_GradSysT_TBTST_us_xdu16 tTsc_SystemTime_xdu16 tTsc_TorqueMainSatSigAge_xdu16 tTsc_TorqueRedSatSigAge_xdu16 vTsc_AbsVehicleSpeedFilt4Interpol_xdu16 xTsc_ExtrapolFactor_xdu16 xTsc_HysteresisTBTAxis1Fraction_xdu16 yTsc_HysteresisTBTAxis1Index_xdu8 /end OUT_MEASUREMENT
/end FUNCTION
/begin FUNCTION TorqueSignalConditioningcheck "Messgroessen und Parameter der TorqueSignalConditioning SDK"
 /begin DEF_CHARACTERISTIC fTsc_DisableTscLimitation_XDU8 mTsc_IntegralDeviationThreshold_XDU16 mTsc_LimitationThreshold_XAU16 tTsc_ErrorFilterTimeout_XDU16 tTsc_ResetIntDevTime_XDU16 /end DEF_CHARACTERISTIC
 /begin IN_MEASUREMENT vTsc_AbsVehicleSpeedFilt4Interpol_xdu16 /end IN_MEASUREMENT
 /begin OUT_MEASUREMENT mTsc_mIntegratDevTorque_xdu16 mTsc_TbtTorqueCondLimLower_xds16 mTsc_TbtTorqueCondLimUpper_xds16 mTsc_TbtTorqueCondLim_xds16 tTsc_ErrorFilterTimer_xdu16 /end OUT_MEASUREMENT
/end FUNCTION
/begin FUNCTION TorqueSignalConditioningcheckI "Interfaces der TorqueSignalConditioning SDK"
 /begin OUT_MEASUREMENT fTscI_DisableAveraging_xdb mApplI_AbsTorsionBarTorque_xdu16 mApplI_TorsionBarTorque_xds16 xApplI_TorsionBarStiffness_xdu16 /end OUT_MEASUREMENT
/end FUNCTION
/begin FUNCTION TorqueSignalConditioningI "Interfaces der TorqueSignalConditioning SDK" /begin DEF_CHARACTERISTIC tTscI_NominalTaskTimeDiff_us_XDU16 /end DEF_CHARACTERISTIC
 /begin OUT_MEASUREMENT fTscI_TbtSensor_provides_TBTred_xdu8 mTscI_ExtrapolTBT_xds16 mTscI_HysteresisTBT_xdu16 tTscI_GradTBTSTred_xdu16 tTscI_GradTBTST_xdu16 xTscI_PT1tauGradTBT_xdu16 /end OUT_MEASUREMENT
/end FUNCTION
/begin FUNCTION TorqueSignalConditioningplausi "Interfaces der TorqueSignalConditioningPlausi SDK" /begin DEF_CHARACTERISTIC tTsc_UVRecoverWaitTimer_XDU8 /end DEF_CHARACTERISTIC /end FUNCTION
/begin FUNCTION TscGrad "Messgroessen und Parameter der TscGrad SDK" /begin DEF_CHARACTERISTIC yTsc_Disable_HwlI_TBT_Grad_Avg_XDU8 /end DEF_CHARACTERISTIC
 /begin OUT_MEASUREMENT mTsc_AvgFiltGradTBT_xds16 mTsc_FiltGradTBTmain_xds16 mTsc_FiltGradTBTred_xds16 mTsc_FiltGradTBT_xds16 mTsc_FiltGradXtplTBT_xds16 mTsc_HystTorsionBarTorqueRed_xds16 mTsc_HystTorsionBarTorque_xds16 mTsc_HystXtplTorsionBarTorque_xds16 /end OUT_MEASUREMENT
/end FUNCTION
/begin FUNCTION TscGradI "Interfaces der TscGrad SDK" /begin OUT_MEASUREMENT mApplI_GradTorsionBarTorque_xds16 /end OUT_MEASUREMENT /end FUNCTION
/begin FUNCTION TscMin "Messgroessen und Parameter der TscMin" /begin DEF_CHARACTERISTIC mTsc_MaxAllowedTBTDiff_XDU16 tTsc_MaxAllowedTime_XDU16 /end DEF_CHARACTERISTIC /begin OUT_MEASUREMENT tTsc_TBTViolationTime_xdu16 /end OUT_MEASUREMENT /end FUNCTION
/begin FUNCTION TscMinI "TscMin - interface"
 /begin OUT_MEASUREMENT mApplI_TorsionBarTorqueMin_xds16 sApplI_TorsionBarTorqueMinState_xdu16 /end OUT_MEASUREMENT
/end FUNCTION
/begin FUNCTION TscSupp "TscSupp" /begin DEF_CHARACTERISTIC fTsc_Use_GradXtplTBT_XDU8 /end DEF_CHARACTERISTIC /end FUNCTION
/begin FUNCTION TscSuppI "TscSupp - interface" /begin OUT_MEASUREMENT fTscI_Use_GradXtplTBT_xdb mTscI_TorsionBarTorque_xds16 /end OUT_MEASUREMENT /end FUNCTION
/begin FUNCTION Understeer "Mess- und Applikationsgrößen Understeer"
 /begin DEF_CHARACTERISTIC mUnSt_LimitMMotOffset_XDU16 mUnSt_LimitTBTOffset_XDU16 mUnSt_WeightingDriverTorque_XAU16 xUnSt_ActivateUndersteerFeedback_XDB xUnSt_BypassFactMmot_XDU16 xUnSt_DegUnStFiltFact_XAU16 xUnSt_FilterFactOfUndersteer_XDU16 xUnSt_MaxFactorOnTBTUndersteer_XDU16 xUnSt_RampUpDownGradUndersteer_XDS16 xUnSt_VehSpeedFact_XAU16 /end DEF_CHARACTERISTIC
 /begin IN_MEASUREMENT mApplI_AbsDriverTorque_xdu16 vApplI_AbsVehicleSpeedFilt_xdu16 /end IN_MEASUREMENT
 /begin OUT_MEASUREMENT fUnSt_Activate_xdb sUnSt_FeatureState_xdu8 xUnSt_DegUnStFilt_xdu16 /end OUT_MEASUREMENT
/end FUNCTION
/begin FUNCTION UndersteerCheck "Mess- und Applikationsgrößen UndersteerCheck Komponente" /begin DEF_CHARACTERISTIC mUnSt_SafetyLimitSteeringTorqueOffset_XDU16 /end DEF_CHARACTERISTIC /begin OUT_MEASUREMENT mUnSt_SteeringTorqueOffsetMakeSafe_xds16 /end OUT_MEASUREMENT /end FUNCTION
/begin FUNCTION UndersteerCheckI "Interface Mess- und Applikationsgrößen UndersteerCheck Komponente"
 /begin OUT_MEASUREMENT fUnStI_MonSafeOk_xdb mUnStI_MotorTorqueOffset_xds16 mUnStI_SteeringTorqueOffset_xds16 /end OUT_MEASUREMENT
/end FUNCTION
/begin FUNCTION UndersteerI "Interface Mess- und Applikationsgrößen Understeer"
 /begin OUT_MEASUREMENT mUnStI_MotorTorqueOffset4Check_xds16 mUnStI_SteeringTorqueOffset4Check_xds16 /end OUT_MEASUREMENT
/end FUNCTION
/begin FUNCTION VehSp_Avg "Calculation of the average vehicle speed"
 /begin DEF_CHARACTERISTIC aVehSp_MaxNegGradientVAvg_XAU16 aVehSp_MaxPosGradientVAvg_XAU16 vVehSp_MaxSpeedDiff4NormalDriving_XDU16 vVehSp_TolMaxSpeedDiff4NormalDriving_XDU8 xVehSp_Factor4MaxSpeedDiff4NormalDriving_XDU8 zVehSp_MinValidWheelSpeeds4Avg_XDU8 /end DEF_CHARACTERISTIC
 /begin IN_MEASUREMENT vVehSpI_AbsAvgVehSpd_xdu16 /end IN_MEASUREMENT
/end FUNCTION
/begin FUNCTION VehSp_AvgI "Calculation of the average vehicle speed - interface" /begin OUT_MEASUREMENT vVehSpI_AbsAvgVehSpd_xdu16 /end OUT_MEASUREMENT /end FUNCTION
/begin FUNCTION VehSp_Check "Check the vehicle speeds" /begin OUT_MEASUREMENT fVehSp_MonOk_xdb /end OUT_MEASUREMENT /end FUNCTION
/begin FUNCTION VehSp_CheckI "Check the vehicle speeds - interface"
 /begin OUT_MEASUREMENT vVehSpI_AbsMaxSafeVehSpd_xdu16 vVehSpI_AbsMinSafeVehSpd_xdu16 /end OUT_MEASUREMENT
/end FUNCTION
/begin FUNCTION VehSp_Safe "Calculation of safe vehicle speeds"
 /begin DEF_CHARACTERISTIC aVehSp_MaxNegGradientVMax_XAU8 aVehSp_MaxPosGradientVMin_XAU8 zVehSp_MinValidWheelSpeeds4Safe_XDU8 /end DEF_CHARACTERISTIC
/end FUNCTION
/begin FUNCTION VehSp_SafeI "Calculation of safe vehicle speeds - interface"
 /begin OUT_MEASUREMENT vVehSpI_AbsAvgVehSpd4Check_xdu16 vVehSpI_AbsMaxVehSpd4Check_xdu16 vVehSpI_AbsMinVehSpd4Check_xdu16 /end OUT_MEASUREMENT
/end FUNCTION
/begin FUNCTION WarningLightCalculation_main ""
 /begin OUT_MEASUREMENT jWlc_WarningLightStateRed_gau8 jWlc_WarningLightState_gau8 sWlcI_EcuWarningLights_xdu8 /end OUT_MEASUREMENT
/end FUNCTION
/begin FUNCTION WarningLightCalculation_wrapper ""
 /begin DEF_CHARACTERISTIC fWlc_DevSWWarningsActive_XDU8 MosfetTemp_Reduction_Threshold_XDU16 MotorTemp_Reduction_Threshold_XDU16 Red_Level_Threshold_Yellow_Off_XDU16 Red_Level_Threshold_Yellow_On_XDU16 Undervolt_Reduction_Threshold_XDU16 /end DEF_CHARACTERISTIC
/end FUNCTION
/begin RECORD_LAYOUT AblGLKFuw FNC_VALUES 3 UWORD COLUMN_DIR DIRECT AXIS_PTS_X 1 UWORD INDEX_INCR DIRECT AXIS_PTS_Y 2 UWORD INDEX_INCR DIRECT /end RECORD_LAYOUT
/begin RECORD_LAYOUT AblGLKLsw FNC_VALUES 3 SWORD COLUMN_DIR DIRECT AXIS_PTS_X 2 SWORD INDEX_INCR DIRECT NO_AXIS_PTS_X 1 UWORD /end RECORD_LAYOUT
/begin RECORD_LAYOUT AblGLKLuw FNC_VALUES 3 UWORD COLUMN_DIR DIRECT AXIS_PTS_X 2 UWORD INDEX_INCR DIRECT NO_AXIS_PTS_X 1 UWORD /end RECORD_LAYOUT
/begin RECORD_LAYOUT AblGLKWBuw FNC_VALUES 1 UWORD COLUMN_DIR DIRECT /end RECORD_LAYOUT
/begin RECORD_LAYOUT AblGLKWsw FNC_VALUES 1 SWORD COLUMN_DIR DIRECT /end RECORD_LAYOUT
/begin RECORD_LAYOUT AblGLKWub FNC_VALUES 1 UBYTE COLUMN_DIR DIRECT /end RECORD_LAYOUT
/begin RECORD_LAYOUT AblGLKWuw FNC_VALUES 1 UWORD COLUMN_DIR DIRECT /end RECORD_LAYOUT
/end MODULE
/end PROJECT
