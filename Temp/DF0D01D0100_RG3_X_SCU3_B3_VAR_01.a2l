/*
© by ASAM e.V., 2017
AML for the protocol layer specific parameters
Any use is limited to the scope described in the ASAM license terms.
This file is distributable in accordance with the ASAM license terms.
See www.asam.net/license.html for further details.
*/
ASAP2_VERSION 1 70
/begin PROJECT _DF0_D01 "SCU3_B3_VAR_01"
/begin HEADER "" VERSION "DF0_D01_D_01_00" PROJECT_NO _DF0_D01 /end HEADER
/begin MODULE XCP_EPS_ECU "CMP"
/begin MOD_COMMON "" BYTE_ORDER MSB_LAST ALIGNMENT_BYTE 1 ALIGNMENT_WORD 2 ALIGNMENT_LONG 4 ALIGNMENT_FLOAT32_IEEE 4 ALIGNMENT_FLOAT64_IEEE 8 /end MOD_COMMON
/* Definitions for XCP */
/begin IF_DATA XCPplus 0x0102
 /begin PAG 0x06 FREEZE_SUPPORTED /end PAG
 /begin PGM PGM_MODE_ABSOLUTE 0x00 0x00 /end PGM
 /begin XCP_ON_CAN /************************ start of CAN *********************/ 0x0104 /* XCP on CAN version */ CAN_ID_MASTER 0x5BE /* CMD/STIM CAN-ID */ /* master -> slave */ CAN_ID_SLAVE 0x5BF /* RES/ERR/EV/SERV/DAQ CAN-ID */ /* slave -> master */ /* Bit31= 1: extended identifier */ BAUDRATE 500000 /* BAUDRATE [Hz] */ SAMPLE_POINT 80 /* sample point */ /* [% complete bit time] */ BTL_CYCLES 20 /* BTL_CYCLES */ /* [slots per bit time] */ SJW 2 /* length synchr. segment */ /* [BTL_CYCLES] */ MAX_BUS_LOAD 100 /* maximum available bus */ MEASUREMENT_SPLIT_ALLOWED /* Supports splitting of measurements to increase payload */ /************************* end of CAN **********************/ /*************** start of PROTOCOL_LAYER *******************/
  /begin PROTOCOL_LAYER /* At MODULE */ 0x0104 /* XCP protocol layer version */ 250 /* T1 [ms] */ 250 /* T2 [ms] */ 0 /* T3 [ms] */ 0 /* T4 [ms] */ 0 /* T5 [ms] */ 0 /* T6 [ms] */ 0 /* T7 [ms] */ 8 /* MAX_CTO */ 8 /* MAX_DTO default for DAQ and STIM */ BYTE_ORDER_MSB_LAST /* BYTE_ORDER: INTEL */ ADDRESS_GRANULARITY_BYTE /* ADDRESS_GRANULARITY */ OPTIONAL_CMD GET_COMM_MODE_INFO OPTIONAL_CMD GET_ID OPTIONAL_CMD SET_MTA OPTIONAL_CMD UPLOAD OPTIONAL_CMD SHORT_UPLOAD OPTIONAL_CMD BUILD_CHECKSUM OPTIONAL_CMD USER_CMD OPTIONAL_CMD DOWNLOAD OPTIONAL_CMD DOWNLOAD_NEXT OPTIONAL_CMD DOWNLOAD_MAX OPTIONAL_CMD MODIFY_BITS OPTIONAL_CMD SET_CAL_PAGE OPTIONAL_CMD GET_CAL_PAGE OPTIONAL_CMD GET_PAG_PROCESSOR_INFO OPTIONAL_CMD GET_SEGMENT_INFO OPTIONAL_CMD GET_PAGE_INFO OPTIONAL_CMD COPY_CAL_PAGE OPTIONAL_CMD CLEAR_DAQ_LIST OPTIONAL_CMD SET_DAQ_PTR OPTIONAL_CMD WRITE_DAQ OPTIONAL_CMD SET_DAQ_LIST_MODE OPTIONAL_CMD GET_DAQ_LIST_MODE OPTIONAL_CMD START_STOP_DAQ_LIST OPTIONAL_CMD START_STOP_SYNCH OPTIONAL_CMD GET_DAQ_CLOCK OPTIONAL_CMD READ_DAQ OPTIONAL_CMD GET_DAQ_PROCESSOR_INFO OPTIONAL_CMD GET_DAQ_RESOLUTION_INFO OPTIONAL_CMD GET_DAQ_EVENT_INFO OPTIONAL_CMD FREE_DAQ OPTIONAL_CMD ALLOC_DAQ OPTIONAL_CMD ALLOC_ODT OPTIONAL_CMD ALLOC_ODT_ENTRY OPTIONAL_LEVEL1_CMD GET_VERSION COMMUNICATION_MODE_SUPPORTED /* optional modes supported */ BLOCK SLAVE /* Slave Block Mode supported */ MASTER /* Master Block Mode supported */ 255 /* MAX_BS */ 0 /* MIN_ST */ /end PROTOCOL_LAYER
  /***************** end of PROTOCOL_LAYER *******************/ /********************* start of DAQ ************************/
  /begin DAQ /* DAQ supported, at MODULE*/ DYNAMIC /* DAQ_CONFIG_TYPE */ 65535 /* MAX_DAQ */ 4 /* MAX_EVENT_CHANNEL */ 0 /* MIN_DAQ */ OPTIMISATION_TYPE_DEFAULT /* OPTIMISATION_TYPE */ ADDRESS_EXTENSION_FREE /* ADDRESS_EXTENSION */ IDENTIFICATION_FIELD_TYPE_ABSOLUTE /* IDENTIFICATION_FIELD */ GRANULARITY_ODT_ENTRY_SIZE_DAQ_BYTE /* GRANULARITY_ODT_ENTRY_SIZE_DAQ */ 255 /* MAX_ODT_ENTRY_SIZE_DAQ */ OVERLOAD_INDICATION_EVENT /* OVERLOAD_INDICATION */ PRESCALER_SUPPORTED
   /begin TIMESTAMP_SUPPORTED 1 /* TIMESTAMP_TICKS */ SIZE_DWORD /* TIMESTAMP_SIZE */ UNIT_1MS /* RESOLUTION OF TIMESTAMP */ /end TIMESTAMP_SUPPORTED
   /begin DAQ_MEMORY_CONSUMPTION 1495 /* DAQ_MEMORY_LIMIT: in Elements[AG] */ 46 /* DAQ_SIZE: number of elements[AG] per DAQ list */ 6 /* ODT_SIZE: number of elements[AG] per ODT */ 5 /* ODT_ENTRY_SIZE: number of elements[AG] per ODT_entry */ 2 /* ODT_DAQ_BUFFER_ELEMENT_SIZE: number of */ /* payload elements[AG]*factor = sizeof(send buffer)[AG] */ 0 /* ODT_STIM_BUFFER_ELEMENT_SIZE: number of */ /* payload elements[AG]*factor = sizeof(receive buffer)[AG] */
    /begin BUFFER_RESERVE /* default for all EVENTs */ 0 /* ODT_DAQ_BUFFER_ELEMENT_RESERVE in % of */ /* ODT_DAQ_BUFFER_ELEMENT_SIZE */ 0 /* ODT_STIM_BUFFER_ELEMENT_RESERVE in % of */ /* ODT_STIM_BUFFER_ELEMENT_SIZE */ /end BUFFER_RESERVE
   /end DAQ_MEMORY_CONSUMPTION
   /******************* start of EVENT ************************/
   /begin EVENT "2ms time synchronous" "2_ms" 0 DAQ 1 2 6 7 /begin MIN_CYCLE_TIME /* Configuration with 0-0 not allowed */ 5 6 /end MIN_CYCLE_TIME /end EVENT
   /begin EVENT "10ms time synchronous" "10_ms" 2 DAQ 1 10 6 6 /end EVENT
   /begin EVENT "100ms time synchronous" "100_ms" 3 DAQ 1 100 6 5 /end EVENT
   /********************* end of EVENT ************************/ /end DAQ
  /********************* end of DAQ **************************/ TRANSPORT_LAYER_INSTANCE "CAN_0_PL0" /end XCP_ON_CAN
/end IF_DATA
/begin MOD_PAR "SBK" VERSION "DF0_D01_D_01_00" CUSTOMER_NO "__" USER "GDUMMY" PHONE_NO "GDUMMY" ECU "ZFLS IBK" CPU_TYPE "NEC PhoenixFS" /* DRIVE calibration block */
 /begin MEMORY_SEGMENT DRIVE_ROM "Drive calibration ROM block for initialization" DATA FLASH INTERN 0x0014A000 0x1FF0 -1 -1 -1 -1 -1
  /begin IF_DATA XCPplus 0x0102
   /begin SEGMENT 0x00 0x02 0x00 0x00 0x00
    /begin PAGE 0x0 ECU_ACCESS_DONT_CARE XCP_READ_ACCESS_DONT_CARE XCP_WRITE_ACCESS_NOT_ALLOWED /end PAGE
    /begin PAGE 0x1 ECU_ACCESS_DONT_CARE XCP_READ_ACCESS_DONT_CARE XCP_WRITE_ACCESS_DONT_CARE /end PAGE
    /begin ADDRESS_MAPPING 0x0014A000 0xFEEDC000 0x1FF0 /end ADDRESS_MAPPING
   /end SEGMENT
  /end IF_DATA
 /end MEMORY_SEGMENT
 /* SYSTEM calibration block */
 /begin MEMORY_SEGMENT SYSTEM_ROM "System calibration ROM block for initialization" DATA FLASH INTERN 0x00150400 0x1FF0 -1 -1 -1 -1 -1
  /begin IF_DATA XCPplus 0x0102
   /begin SEGMENT 0x01 0x02 0x00 0x00 0x00
    /begin PAGE 0x0 ECU_ACCESS_DONT_CARE XCP_READ_ACCESS_DONT_CARE XCP_WRITE_ACCESS_NOT_ALLOWED /end PAGE
    /begin PAGE 0x1 ECU_ACCESS_DONT_CARE XCP_READ_ACCESS_DONT_CARE XCP_WRITE_ACCESS_DONT_CARE /end PAGE
    /begin ADDRESS_MAPPING 0x00150400 0xFEEDE000 0x1FF0 /end ADDRESS_MAPPING
   /end SEGMENT
  /end IF_DATA
 /end MEMORY_SEGMENT
 /* TUNING calibration block */
 /begin MEMORY_SEGMENT TUNING_ROM "Tuning calibration ROM block for initialization" DATA FLASH INTERN 0x00158000 0xFFF0 -1 -1 -1 -1 -1
  /begin IF_DATA XCPplus 0x0102
   /begin SEGMENT 0x02 0x02 0x00 0x00 0x00
    /begin PAGE 0x0 ECU_ACCESS_DONT_CARE XCP_READ_ACCESS_DONT_CARE XCP_WRITE_ACCESS_NOT_ALLOWED /end PAGE
    /begin PAGE 0x1 ECU_ACCESS_DONT_CARE XCP_READ_ACCESS_DONT_CARE XCP_WRITE_ACCESS_DONT_CARE /end PAGE
    /begin ADDRESS_MAPPING 0x00158000 0xFEEE0000 0xFFF0 /end ADDRESS_MAPPING
   /end SEGMENT
  /end IF_DATA
 /end MEMORY_SEGMENT
 /* FOC calibration block */
 /begin MEMORY_SEGMENT FOC_ROM "FOC calibration ROM block for initialization" DATA FLASH INTERN 0x00140000 0x1FF0 -1 -1 -1 -1 -1
  /begin IF_DATA XCPplus 0x0102
   /begin SEGMENT 0x03 0x02 0x00 0x00 0x00
    /begin PAGE 0x0 ECU_ACCESS_DONT_CARE XCP_READ_ACCESS_DONT_CARE XCP_WRITE_ACCESS_NOT_ALLOWED /end PAGE
    /begin PAGE 0x1 ECU_ACCESS_DONT_CARE XCP_READ_ACCESS_DONT_CARE XCP_WRITE_ACCESS_DONT_CARE /end PAGE
    /begin ADDRESS_MAPPING 0x00140000 0xFEEDA000 0x1FF0 /end ADDRESS_MAPPING
   /end SEGMENT
  /end IF_DATA
 /end MEMORY_SEGMENT
 /* HWL calibration block */
 /begin MEMORY_SEGMENT HWL "HWL calibration block" DATA FLASH INTERN 0x00120000 13312 -1 -1 -1 -1 -1
  /begin IF_DATA XCPplus 0x0102
   /begin SEGMENT 0x04 0x02 0x00 0x00 0x00
    /begin PAGE 0x0 ECU_ACCESS_WITH_XCP_ONLY XCP_READ_ACCESS_WITH_ECU_ONLY XCP_WRITE_ACCESS_NOT_ALLOWED /end PAGE
    /begin PAGE 0x1 ECU_ACCESS_WITH_XCP_ONLY XCP_READ_ACCESS_WITH_ECU_ONLY XCP_WRITE_ACCESS_WITH_ECU_ONLY /end PAGE
    /begin ADDRESS_MAPPING 0x00120000 0xFEEF0000 13312 /end ADDRESS_MAPPING
   /end SEGMENT
  /end IF_DATA
 /end MEMORY_SEGMENT
 /* Definitions for MEMORY_SEGMENT Measurement data */ /* Values are defined in damos_variables.mak */
 /begin MEMORY_SEGMENT Meas "Measurement data" VARIABLES RAM INTERN 0xFEBE0000 0x20000 -1 -1 -1 -1 -1
  /begin IF_DATA XCPplus 0x0102
   /begin SEGMENT 0x05 0x01 0x00 0x00 0x00
    /begin PAGE 0x0 ECU_ACCESS_WITH_XCP_ONLY XCP_READ_ACCESS_WITH_ECU_ONLY XCP_WRITE_ACCESS_NOT_ALLOWED /end PAGE
   /end SEGMENT
  /end IF_DATA
 /end MEMORY_SEGMENT
 /* Definitions for MEMORY_SEGMENT Code */ /* Values are defined in damos_variables.mak */
 /begin MEMORY_SEGMENT Code "" CODE FLASH INTERN 0x00000000 0x10FFFF -1 -1 -1 -1 -1 /end MEMORY_SEGMENT
 /begin MEMORY_SEGMENT Code "NoCalib section for Drive" CODE FLASH INTERN 0x00148000 0x400 -1 -1 -1 -1 -1 /end MEMORY_SEGMENT
 /begin MEMORY_SEGMENT Code "NoCalib section for System" CODE FLASH INTERN 0x00150000 0x400 -1 -1 -1 -1 -1 /end MEMORY_SEGMENT
/end MOD_PAR
/begin CHARACTERISTIC aAhaDet_AccLimit_XDU16 "Grenzwert für max. Beschl. pro Schrittweite" VALUE 0x150524 AblGLKWuw 20 VFZHIGH 0 20 FORMAT "%8.5" /end CHARACTERISTIC
/begin CHARACTERISTIC aAhaDet_MaxAbsLateralAccel_XDU16 "Schwelle der Querbeschleunigung für Geradeauserkennung" VALUE 0x150526 AblGLKWuw 1 AFZ 0 1 FORMAT "%8.6" /end CHARACTERISTIC
/begin CHARACTERISTIC mActDamp_MaxMotorTorqueDepOnRotorSpeed_XAU16 "limitation of active return torque depending on rotor speed" CURVE 0x15100C AblGLKLuw 1 MMOT 0 1 FORMAT "%8.6"
 /begin AXIS_DESCR STD_AXIS nActDamp_AbsRotorSpeedFilt_xdu16 VROT 2 0 13000 FORMAT "%3.0" DEPOSIT ABSOLUTE /end AXIS_DESCR
/end CHARACTERISTIC
/begin CHARACTERISTIC mActIn_InertiaMax_XAU16 "Maximalwert für Trägheit bei Handmomentenregelung" CURVE 0x151018 AblGLKLuw 10 TBTHIGH 0 10 FORMAT "%8.5"
 /begin AXIS_DESCR STD_AXIS vApplI_AbsVehicleSpeedFilt_xdu16 VFZHIGH 4 0 400 FORMAT "%8.4" DEPOSIT ABSOLUTE /end AXIS_DESCR
/end CHARACTERISTIC
/begin CHARACTERISTIC mActRet_MaxMotorTorqueDepOnSteeringAngle_XAU16 "limitation of active return torque depending on steering angle" CURVE 0x15102C AblGLKLuw 3 MMOT 0 3 FORMAT "%8.6"
 /begin AXIS_DESCR STD_AXIS wApplI_AbsSteeringAngle_xdu16 SA_10 5 0 1000 FORMAT "%8.3" DEPOSIT ABSOLUTE /end AXIS_DESCR
/end CHARACTERISTIC
/begin CHARACTERISTIC mActRet_MaxMotorTorqueDepOnVehSpeed_XAU16 "limitation of active return torque depending on vehicle speed" CURVE 0x151044 AblGLKLuw 3 MMOT 0 3 FORMAT "%8.6"
 /begin AXIS_DESCR STD_AXIS vVehSpI_AbsMaxSafeVehSpd_xdu16 VFZHIGH 5 0 500 FORMAT "%8.4" DEPOSIT ABSOLUTE /end AXIS_DESCR
/end CHARACTERISTIC
/begin CHARACTERISTIC mActRet_MaxMotorTorque_XDU8 "limitation of active return torque" VALUE 0x150ADF AblGLKWub 3 MMOT_RSH6 0 3 FORMAT "%5.3" /end CHARACTERISTIC
/begin CHARACTERISTIC mActRet_MaxTBT4ShutDown_XDU8 "maximum torsion bar torque to allow active return torque" VALUE 0x150AE0 AblGLKWub 15 TBT_RSH4 0 15 FORMAT "%5.2" /end CHARACTERISTIC
/begin CHARACTERISTIC mAhaDet_TorqueLimit_XDU16 "Grenzwert des Lenkradmoments für Geradeausfahrt" VALUE 0x15058A AblGLKWuw 10 TBTHIGH 0 10 FORMAT "%8.5" /end CHARACTERISTIC
/begin CHARACTERISTIC tAhaDet_AheadDetectionTimer_XDU8 "Ahead detection Erkennungszeit" VALUE 0x150B07 AblGLKWub 2.5 TIMSEC 0 2.5 FORMAT "%5.3" /end CHARACTERISTIC
/begin CHARACTERISTIC vActRet_NominalSteeringSpeed_XAU16_00___A "nominal steering angle return speed depending on vehicle speed and steering angle" MAP 0x1600D4 AblGLKFuw 1500 SAS_8 0 1500 FORMAT "%8.3"
 /begin AXIS_DESCR STD_AXIS vVehSpI_AbsAvgVehSpd_xdu16 VFZHIGH 6 0 500 FORMAT "%8.4" DEPOSIT ABSOLUTE /end AXIS_DESCR
 /begin AXIS_DESCR STD_AXIS wApplI_AbsSteeringAngle_xdu16 SA_10 13 0 1000 FORMAT "%8.3" DEPOSIT ABSOLUTE /end AXIS_DESCR
/end CHARACTERISTIC
/begin CHARACTERISTIC vActRet_NominalSteeringSpeed_XAU16_01___A "nominal steering angle return speed depending on vehicle speed and steering angle" MAP 0x160198 AblGLKFuw 1500 SAS_8 0 1500 FORMAT "%8.3"
 /begin AXIS_DESCR STD_AXIS vVehSpI_AbsAvgVehSpd_xdu16 VFZHIGH 6 0 500 FORMAT "%8.4" DEPOSIT ABSOLUTE /end AXIS_DESCR
 /begin AXIS_DESCR STD_AXIS wApplI_AbsSteeringAngle_xdu16 SA_10 13 0 1000 FORMAT "%8.3" DEPOSIT ABSOLUTE /end AXIS_DESCR
/end CHARACTERISTIC
/begin CHARACTERISTIC vActRet_NominalSteeringSpeed_XAU16_02___A "nominal steering angle return speed depending on vehicle speed and steering angle" MAP 0x16025C AblGLKFuw 1500 SAS_8 0 1500 FORMAT "%8.3"
 /begin AXIS_DESCR STD_AXIS vVehSpI_AbsAvgVehSpd_xdu16 VFZHIGH 6 0 500 FORMAT "%8.4" DEPOSIT ABSOLUTE /end AXIS_DESCR
 /begin AXIS_DESCR STD_AXIS wApplI_AbsSteeringAngle_xdu16 SA_10 13 0 1000 FORMAT "%8.3" DEPOSIT ABSOLUTE /end AXIS_DESCR
/end CHARACTERISTIC
/begin CHARACTERISTIC vActRet_NominalSteeringSpeed_XAU16_03___A "nominal steering angle return speed depending on vehicle speed and steering angle" MAP 0x160320 AblGLKFuw 1500 SAS_8 0 1500 FORMAT "%8.3"
 /begin AXIS_DESCR STD_AXIS vVehSpI_AbsAvgVehSpd_xdu16 VFZHIGH 6 0 500 FORMAT "%8.4" DEPOSIT ABSOLUTE /end AXIS_DESCR
 /begin AXIS_DESCR STD_AXIS wApplI_AbsSteeringAngle_xdu16 SA_10 13 0 1000 FORMAT "%8.3" DEPOSIT ABSOLUTE /end AXIS_DESCR
/end CHARACTERISTIC
/begin CHARACTERISTIC vActRet_NominalSteeringSpeed_XAU16_04___A "nominal steering angle return speed depending on vehicle speed and steering angle" MAP 0x1603E4 AblGLKFuw 1500 SAS_8 0 1500 FORMAT "%8.3"
 /begin AXIS_DESCR STD_AXIS vVehSpI_AbsAvgVehSpd_xdu16 VFZHIGH 6 0 500 FORMAT "%8.4" DEPOSIT ABSOLUTE /end AXIS_DESCR
 /begin AXIS_DESCR STD_AXIS wApplI_AbsSteeringAngle_xdu16 SA_10 13 0 1000 FORMAT "%8.3" DEPOSIT ABSOLUTE /end AXIS_DESCR
/end CHARACTERISTIC
/begin CHARACTERISTIC vActRet_NominalSteeringSpeed_XAU16_05___A "nominal steering angle return speed depending on vehicle speed and steering angle" MAP 0x1604A8 AblGLKFuw 1500 SAS_8 0 1500 FORMAT "%8.3"
 /begin AXIS_DESCR STD_AXIS vVehSpI_AbsAvgVehSpd_xdu16 VFZHIGH 6 0 500 FORMAT "%8.4" DEPOSIT ABSOLUTE /end AXIS_DESCR
 /begin AXIS_DESCR STD_AXIS wApplI_AbsSteeringAngle_xdu16 SA_10 13 0 1000 FORMAT "%8.3" DEPOSIT ABSOLUTE /end AXIS_DESCR
/end CHARACTERISTIC
/begin CHARACTERISTIC vActRet_NominalSteeringSpeed_XAU16_06___A "nominal steering angle return speed depending on vehicle speed and steering angle" MAP 0x16056C AblGLKFuw 1500 SAS_8 0 1500 FORMAT "%8.3"
 /begin AXIS_DESCR STD_AXIS vVehSpI_AbsAvgVehSpd_xdu16 VFZHIGH 6 0 500 FORMAT "%8.4" DEPOSIT ABSOLUTE /end AXIS_DESCR
 /begin AXIS_DESCR STD_AXIS wApplI_AbsSteeringAngle_xdu16 SA_10 13 0 1000 FORMAT "%8.3" DEPOSIT ABSOLUTE /end AXIS_DESCR
/end CHARACTERISTIC
/begin CHARACTERISTIC vActRet_NominalSteeringSpeed_XAU16_07___A "nominal steering angle return speed depending on vehicle speed and steering angle" MAP 0x160630 AblGLKFuw 1500 SAS_8 0 1500 FORMAT "%8.3"
 /begin AXIS_DESCR STD_AXIS vVehSpI_AbsAvgVehSpd_xdu16 VFZHIGH 6 0 500 FORMAT "%8.4" DEPOSIT ABSOLUTE /end AXIS_DESCR
 /begin AXIS_DESCR STD_AXIS wApplI_AbsSteeringAngle_xdu16 SA_10 13 0 1000 FORMAT "%8.3" DEPOSIT ABSOLUTE /end AXIS_DESCR
/end CHARACTERISTIC
/begin CHARACTERISTIC vActRet_NominalSteeringSpeed_XAU16_08___A "nominal steering angle return speed depending on vehicle speed and steering angle" MAP 0x1606F4 AblGLKFuw 1500 SAS_8 0 1500 FORMAT "%8.3"
 /begin AXIS_DESCR STD_AXIS vVehSpI_AbsAvgVehSpd_xdu16 VFZHIGH 6 0 500 FORMAT "%8.4" DEPOSIT ABSOLUTE /end AXIS_DESCR
 /begin AXIS_DESCR STD_AXIS wApplI_AbsSteeringAngle_xdu16 SA_10 13 0 1000 FORMAT "%8.3" DEPOSIT ABSOLUTE /end AXIS_DESCR
/end CHARACTERISTIC
/begin CHARACTERISTIC vActRet_NominalSteeringSpeed_XAU16_09___A "nominal steering angle return speed depending on vehicle speed and steering angle" MAP 0x1607B8 AblGLKFuw 1500 SAS_8 0 1500 FORMAT "%8.3"
 /begin AXIS_DESCR STD_AXIS vVehSpI_AbsAvgVehSpd_xdu16 VFZHIGH 6 0 500 FORMAT "%8.4" DEPOSIT ABSOLUTE /end AXIS_DESCR
 /begin AXIS_DESCR STD_AXIS wApplI_AbsSteeringAngle_xdu16 SA_10 13 0 1000 FORMAT "%8.3" DEPOSIT ABSOLUTE /end AXIS_DESCR
/end CHARACTERISTIC
/begin CHARACTERISTIC vActRet_NominalSteeringSpeed_XAU16_10___A "nominal steering angle return speed depending on vehicle speed and steering angle" MAP 0x16087C AblGLKFuw 1500 SAS_8 0 1500 FORMAT "%8.3"
 /begin AXIS_DESCR STD_AXIS vVehSpI_AbsAvgVehSpd_xdu16 VFZHIGH 6 0 500 FORMAT "%8.4" DEPOSIT ABSOLUTE /end AXIS_DESCR
 /begin AXIS_DESCR STD_AXIS wApplI_AbsSteeringAngle_xdu16 SA_10 13 0 1000 FORMAT "%8.3" DEPOSIT ABSOLUTE /end AXIS_DESCR
/end CHARACTERISTIC
/begin CHARACTERISTIC vActRet_NominalSteeringSpeed_XAU16_11___A "nominal steering angle return speed depending on vehicle speed and steering angle" MAP 0x160940 AblGLKFuw 1500 SAS_8 0 1500 FORMAT "%8.3"
 /begin AXIS_DESCR STD_AXIS vVehSpI_AbsAvgVehSpd_xdu16 VFZHIGH 6 0 500 FORMAT "%8.4" DEPOSIT ABSOLUTE /end AXIS_DESCR
 /begin AXIS_DESCR STD_AXIS wApplI_AbsSteeringAngle_xdu16 SA_10 13 0 1000 FORMAT "%8.3" DEPOSIT ABSOLUTE /end AXIS_DESCR
/end CHARACTERISTIC
/begin CHARACTERISTIC vActRet_NominalSteeringSpeed_XAU16_12___A "nominal steering angle return speed depending on vehicle speed and steering angle" MAP 0x160A04 AblGLKFuw 1500 SAS_8 0 1500 FORMAT "%8.3"
 /begin AXIS_DESCR STD_AXIS vVehSpI_AbsAvgVehSpd_xdu16 VFZHIGH 6 0 500 FORMAT "%8.4" DEPOSIT ABSOLUTE /end AXIS_DESCR
 /begin AXIS_DESCR STD_AXIS wApplI_AbsSteeringAngle_xdu16 SA_10 13 0 1000 FORMAT "%8.3" DEPOSIT ABSOLUTE /end AXIS_DESCR
/end CHARACTERISTIC
/begin CHARACTERISTIC vActRet_NominalSteeringSpeed_XAU16_13___A "nominal steering angle return speed depending on vehicle speed and steering angle" MAP 0x160AC8 AblGLKFuw 1500 SAS_8 0 1500 FORMAT "%8.3"
 /begin AXIS_DESCR STD_AXIS vVehSpI_AbsAvgVehSpd_xdu16 VFZHIGH 6 0 500 FORMAT "%8.4" DEPOSIT ABSOLUTE /end AXIS_DESCR
 /begin AXIS_DESCR STD_AXIS wApplI_AbsSteeringAngle_xdu16 SA_10 13 0 1000 FORMAT "%8.3" DEPOSIT ABSOLUTE /end AXIS_DESCR
/end CHARACTERISTIC
/begin CHARACTERISTIC vActRet_NominalSteeringSpeed_XAU16_14___A "nominal steering angle return speed depending on vehicle speed and steering angle" MAP 0x160B8C AblGLKFuw 1500 SAS_8 0 1500 FORMAT "%8.3"
 /begin AXIS_DESCR STD_AXIS vVehSpI_AbsAvgVehSpd_xdu16 VFZHIGH 6 0 500 FORMAT "%8.4" DEPOSIT ABSOLUTE /end AXIS_DESCR
 /begin AXIS_DESCR STD_AXIS wApplI_AbsSteeringAngle_xdu16 SA_10 13 0 1000 FORMAT "%8.3" DEPOSIT ABSOLUTE /end AXIS_DESCR
/end CHARACTERISTIC
/begin CHARACTERISTIC vActRet_NominalSteeringSpeed_XAU16_15___A "nominal steering angle return speed depending on vehicle speed and steering angle" MAP 0x160C50 AblGLKFuw 1500 SAS_8 0 1500 FORMAT "%8.3"
 /begin AXIS_DESCR STD_AXIS vVehSpI_AbsAvgVehSpd_xdu16 VFZHIGH 6 0 500 FORMAT "%8.4" DEPOSIT ABSOLUTE /end AXIS_DESCR
 /begin AXIS_DESCR STD_AXIS wApplI_AbsSteeringAngle_xdu16 SA_10 13 0 1000 FORMAT "%8.3" DEPOSIT ABSOLUTE /end AXIS_DESCR
/end CHARACTERISTIC
/begin CHARACTERISTIC vActRet_NominalSteeringSpeed_XAU16_16___A "nominal steering angle return speed depending on vehicle speed and steering angle" MAP 0x160D14 AblGLKFuw 1500 SAS_8 0 1500 FORMAT "%8.3"
 /begin AXIS_DESCR STD_AXIS vVehSpI_AbsAvgVehSpd_xdu16 VFZHIGH 6 0 500 FORMAT "%8.4" DEPOSIT ABSOLUTE /end AXIS_DESCR
 /begin AXIS_DESCR STD_AXIS wApplI_AbsSteeringAngle_xdu16 SA_10 13 0 1000 FORMAT "%8.3" DEPOSIT ABSOLUTE /end AXIS_DESCR
/end CHARACTERISTIC
/begin CHARACTERISTIC vActRet_NominalSteeringSpeed_XAU16_17___A "nominal steering angle return speed depending on vehicle speed and steering angle" MAP 0x160DD8 AblGLKFuw 1500 SAS_8 0 1500 FORMAT "%8.3"
 /begin AXIS_DESCR STD_AXIS vVehSpI_AbsAvgVehSpd_xdu16 VFZHIGH 6 0 500 FORMAT "%8.4" DEPOSIT ABSOLUTE /end AXIS_DESCR
 /begin AXIS_DESCR STD_AXIS wApplI_AbsSteeringAngle_xdu16 SA_10 13 0 1000 FORMAT "%8.3" DEPOSIT ABSOLUTE /end AXIS_DESCR
/end CHARACTERISTIC
/begin CHARACTERISTIC vActRet_NominalSteeringSpeed_XAU16_18___A "nominal steering angle return speed depending on vehicle speed and steering angle" MAP 0x160E9C AblGLKFuw 1500 SAS_8 0 1500 FORMAT "%8.3"
 /begin AXIS_DESCR STD_AXIS vVehSpI_AbsAvgVehSpd_xdu16 VFZHIGH 6 0 500 FORMAT "%8.4" DEPOSIT ABSOLUTE /end AXIS_DESCR
 /begin AXIS_DESCR STD_AXIS wApplI_AbsSteeringAngle_xdu16 SA_10 13 0 1000 FORMAT "%8.3" DEPOSIT ABSOLUTE /end AXIS_DESCR
/end CHARACTERISTIC
/begin CHARACTERISTIC vActRet_NominalSteeringSpeed_XAU16_19___A "nominal steering angle return speed depending on vehicle speed and steering angle" MAP 0x160F60 AblGLKFuw 1500 SAS_8 0 1500 FORMAT "%8.3"
 /begin AXIS_DESCR STD_AXIS vVehSpI_AbsAvgVehSpd_xdu16 VFZHIGH 6 0 500 FORMAT "%8.4" DEPOSIT ABSOLUTE /end AXIS_DESCR
 /begin AXIS_DESCR STD_AXIS wApplI_AbsSteeringAngle_xdu16 SA_10 13 0 1000 FORMAT "%8.3" DEPOSIT ABSOLUTE /end AXIS_DESCR
/end CHARACTERISTIC
/begin CHARACTERISTIC vActRet_NominalSteeringSpeed_XAU16_20___A "nominal steering angle return speed depending on vehicle speed and steering angle" MAP 0x161024 AblGLKFuw 1500 SAS_8 0 1500 FORMAT "%8.3"
 /begin AXIS_DESCR STD_AXIS vVehSpI_AbsAvgVehSpd_xdu16 VFZHIGH 6 0 500 FORMAT "%8.4" DEPOSIT ABSOLUTE /end AXIS_DESCR
 /begin AXIS_DESCR STD_AXIS wApplI_AbsSteeringAngle_xdu16 SA_10 13 0 1000 FORMAT "%8.3" DEPOSIT ABSOLUTE /end AXIS_DESCR
/end CHARACTERISTIC
/begin CHARACTERISTIC vActRet_NominalSteeringSpeed_XAU16_21___A "nominal steering angle return speed depending on vehicle speed and steering angle" MAP 0x1610E8 AblGLKFuw 1500 SAS_8 0 1500 FORMAT "%8.3"
 /begin AXIS_DESCR STD_AXIS vVehSpI_AbsAvgVehSpd_xdu16 VFZHIGH 6 0 500 FORMAT "%8.4" DEPOSIT ABSOLUTE /end AXIS_DESCR
 /begin AXIS_DESCR STD_AXIS wApplI_AbsSteeringAngle_xdu16 SA_10 13 0 1000 FORMAT "%8.3" DEPOSIT ABSOLUTE /end AXIS_DESCR
/end CHARACTERISTIC
/begin CHARACTERISTIC vActRet_NominalSteeringSpeed_XAU16_22___A "nominal steering angle return speed depending on vehicle speed and steering angle" MAP 0x1611AC AblGLKFuw 1500 SAS_8 0 1500 FORMAT "%8.3"
 /begin AXIS_DESCR STD_AXIS vVehSpI_AbsAvgVehSpd_xdu16 VFZHIGH 6 0 500 FORMAT "%8.4" DEPOSIT ABSOLUTE /end AXIS_DESCR
 /begin AXIS_DESCR STD_AXIS wApplI_AbsSteeringAngle_xdu16 SA_10 13 0 1000 FORMAT "%8.3" DEPOSIT ABSOLUTE /end AXIS_DESCR
/end CHARACTERISTIC
/begin CHARACTERISTIC vActRet_NominalSteeringSpeed_XAU16_23___A "nominal steering angle return speed depending on vehicle speed and steering angle" MAP 0x161270 AblGLKFuw 1500 SAS_8 0 1500 FORMAT "%8.3"
 /begin AXIS_DESCR STD_AXIS vVehSpI_AbsAvgVehSpd_xdu16 VFZHIGH 6 0 500 FORMAT "%8.4" DEPOSIT ABSOLUTE /end AXIS_DESCR
 /begin AXIS_DESCR STD_AXIS wApplI_AbsSteeringAngle_xdu16 SA_10 13 0 1000 FORMAT "%8.3" DEPOSIT ABSOLUTE /end AXIS_DESCR
/end CHARACTERISTIC
/begin CHARACTERISTIC vActRet_NominalSteeringSpeed_XAU16_24___A "nominal steering angle return speed depending on vehicle speed and steering angle" MAP 0x161334 AblGLKFuw 1500 SAS_8 0 1500 FORMAT "%8.3"
 /begin AXIS_DESCR STD_AXIS vVehSpI_AbsAvgVehSpd_xdu16 VFZHIGH 6 0 500 FORMAT "%8.4" DEPOSIT ABSOLUTE /end AXIS_DESCR
 /begin AXIS_DESCR STD_AXIS wApplI_AbsSteeringAngle_xdu16 SA_10 13 0 1000 FORMAT "%8.3" DEPOSIT ABSOLUTE /end AXIS_DESCR
/end CHARACTERISTIC
/begin CHARACTERISTIC vActRet_NominalSteeringSpeed_XAU16_25___A "nominal steering angle return speed depending on vehicle speed and steering angle" MAP 0x1613F8 AblGLKFuw 1500 SAS_8 0 1500 FORMAT "%8.3"
 /begin AXIS_DESCR STD_AXIS vVehSpI_AbsAvgVehSpd_xdu16 VFZHIGH 6 0 500 FORMAT "%8.4" DEPOSIT ABSOLUTE /end AXIS_DESCR
 /begin AXIS_DESCR STD_AXIS wApplI_AbsSteeringAngle_xdu16 SA_10 13 0 1000 FORMAT "%8.3" DEPOSIT ABSOLUTE /end AXIS_DESCR
/end CHARACTERISTIC
/begin CHARACTERISTIC vActRet_NominalSteeringSpeed_XAU16_26___A "nominal steering angle return speed depending on vehicle speed and steering angle" MAP 0x1614BC AblGLKFuw 1500 SAS_8 0 1500 FORMAT "%8.3"
 /begin AXIS_DESCR STD_AXIS vVehSpI_AbsAvgVehSpd_xdu16 VFZHIGH 6 0 500 FORMAT "%8.4" DEPOSIT ABSOLUTE /end AXIS_DESCR
 /begin AXIS_DESCR STD_AXIS wApplI_AbsSteeringAngle_xdu16 SA_10 13 0 1000 FORMAT "%8.3" DEPOSIT ABSOLUTE /end AXIS_DESCR
/end CHARACTERISTIC
/begin CHARACTERISTIC vActRet_NominalSteeringSpeed_XAU16_27___A "nominal steering angle return speed depending on vehicle speed and steering angle" MAP 0x161580 AblGLKFuw 1500 SAS_8 0 1500 FORMAT "%8.3"
 /begin AXIS_DESCR STD_AXIS vVehSpI_AbsAvgVehSpd_xdu16 VFZHIGH 6 0 500 FORMAT "%8.4" DEPOSIT ABSOLUTE /end AXIS_DESCR
 /begin AXIS_DESCR STD_AXIS wApplI_AbsSteeringAngle_xdu16 SA_10 13 0 1000 FORMAT "%8.3" DEPOSIT ABSOLUTE /end AXIS_DESCR
/end CHARACTERISTIC
/begin CHARACTERISTIC vActRet_NominalSteeringSpeed_XAU16_28___A "nominal steering angle return speed depending on vehicle speed and steering angle" MAP 0x161644 AblGLKFuw 1500 SAS_8 0 1500 FORMAT "%8.3"
 /begin AXIS_DESCR STD_AXIS vVehSpI_AbsAvgVehSpd_xdu16 VFZHIGH 6 0 500 FORMAT "%8.4" DEPOSIT ABSOLUTE /end AXIS_DESCR
 /begin AXIS_DESCR STD_AXIS wApplI_AbsSteeringAngle_xdu16 SA_10 13 0 1000 FORMAT "%8.3" DEPOSIT ABSOLUTE /end AXIS_DESCR
/end CHARACTERISTIC
/begin CHARACTERISTIC vActRet_NominalSteeringSpeed_XAU16_29___A "nominal steering angle return speed depending on vehicle speed and steering angle" MAP 0x161708 AblGLKFuw 1500 SAS_8 0 1500 FORMAT "%8.3"
 /begin AXIS_DESCR STD_AXIS vVehSpI_AbsAvgVehSpd_xdu16 VFZHIGH 6 0 500 FORMAT "%8.4" DEPOSIT ABSOLUTE /end AXIS_DESCR
 /begin AXIS_DESCR STD_AXIS wApplI_AbsSteeringAngle_xdu16 SA_10 13 0 1000 FORMAT "%8.3" DEPOSIT ABSOLUTE /end AXIS_DESCR
/end CHARACTERISTIC
/begin CHARACTERISTIC vActRet_NominalSteeringSpeed_XAU16_30___A "nominal steering angle return speed depending on vehicle speed and steering angle" MAP 0x1617CC AblGLKFuw 1500 SAS_8 0 1500 FORMAT "%8.3"
 /begin AXIS_DESCR STD_AXIS vVehSpI_AbsAvgVehSpd_xdu16 VFZHIGH 6 0 500 FORMAT "%8.4" DEPOSIT ABSOLUTE /end AXIS_DESCR
 /begin AXIS_DESCR STD_AXIS wApplI_AbsSteeringAngle_xdu16 SA_10 13 0 1000 FORMAT "%8.3" DEPOSIT ABSOLUTE /end AXIS_DESCR
/end CHARACTERISTIC
/begin CHARACTERISTIC vActRet_NominalSteeringSpeed_XAU16_31___A "nominal steering angle return speed depending on vehicle speed and steering angle" MAP 0x161890 AblGLKFuw 1500 SAS_8 0 1500 FORMAT "%8.3"
 /begin AXIS_DESCR STD_AXIS vVehSpI_AbsAvgVehSpd_xdu16 VFZHIGH 6 0 500 FORMAT "%8.4" DEPOSIT ABSOLUTE /end AXIS_DESCR
 /begin AXIS_DESCR STD_AXIS wApplI_AbsSteeringAngle_xdu16 SA_10 13 0 1000 FORMAT "%8.3" DEPOSIT ABSOLUTE /end AXIS_DESCR
/end CHARACTERISTIC
/begin CHARACTERISTIC vActRet_NominalSteeringSpeed_XAU16_32___A "nominal steering angle return speed depending on vehicle speed and steering angle" MAP 0x161954 AblGLKFuw 1500 SAS_8 0 1500 FORMAT "%8.3"
 /begin AXIS_DESCR STD_AXIS vVehSpI_AbsAvgVehSpd_xdu16 VFZHIGH 6 0 500 FORMAT "%8.4" DEPOSIT ABSOLUTE /end AXIS_DESCR
 /begin AXIS_DESCR STD_AXIS wApplI_AbsSteeringAngle_xdu16 SA_10 13 0 1000 FORMAT "%8.3" DEPOSIT ABSOLUTE /end AXIS_DESCR
/end CHARACTERISTIC
/begin CHARACTERISTIC vActRet_NominalSteeringSpeed_XAU16_33___A "nominal steering angle return speed depending on vehicle speed and steering angle" MAP 0x161A18 AblGLKFuw 1500 SAS_8 0 1500 FORMAT "%8.3"
 /begin AXIS_DESCR STD_AXIS vVehSpI_AbsAvgVehSpd_xdu16 VFZHIGH 6 0 500 FORMAT "%8.4" DEPOSIT ABSOLUTE /end AXIS_DESCR
 /begin AXIS_DESCR STD_AXIS wApplI_AbsSteeringAngle_xdu16 SA_10 13 0 1000 FORMAT "%8.3" DEPOSIT ABSOLUTE /end AXIS_DESCR
/end CHARACTERISTIC
/begin CHARACTERISTIC vActRet_NominalSteeringSpeed_XAU16_34___A "nominal steering angle return speed depending on vehicle speed and steering angle" MAP 0x161ADC AblGLKFuw 1500 SAS_8 0 1500 FORMAT "%8.3"
 /begin AXIS_DESCR STD_AXIS vVehSpI_AbsAvgVehSpd_xdu16 VFZHIGH 6 0 500 FORMAT "%8.4" DEPOSIT ABSOLUTE /end AXIS_DESCR
 /begin AXIS_DESCR STD_AXIS wApplI_AbsSteeringAngle_xdu16 SA_10 13 0 1000 FORMAT "%8.3" DEPOSIT ABSOLUTE /end AXIS_DESCR
/end CHARACTERISTIC
/begin CHARACTERISTIC vActRet_NominalSteeringSpeed_XAU16_35___A "nominal steering angle return speed depending on vehicle speed and steering angle" MAP 0x161BA0 AblGLKFuw 1500 SAS_8 0 1500 FORMAT "%8.3"
 /begin AXIS_DESCR STD_AXIS vVehSpI_AbsAvgVehSpd_xdu16 VFZHIGH 6 0 500 FORMAT "%8.4" DEPOSIT ABSOLUTE /end AXIS_DESCR
 /begin AXIS_DESCR STD_AXIS wApplI_AbsSteeringAngle_xdu16 SA_10 13 0 1000 FORMAT "%8.3" DEPOSIT ABSOLUTE /end AXIS_DESCR
/end CHARACTERISTIC
/begin CHARACTERISTIC vAhaDet_FrontESPvLimit_XDU16 "maximale Differenz zwischen Raddrehzahlen VA und VehicleSpeedFilt-Signal fuer Geradeauserkennung" VALUE 0x150802 AblGLKWuw 20 VFZHIGH 0 20 FORMAT "%8.5" /end CHARACTERISTIC
/begin CHARACTERISTIC vAhaDet_FrontRearRotationLimit_XDU16 "maximale Raddrehzahldifferenz zwischen Vorder- und Hinterachse fuer Geradeauserkennung" VALUE 0x150804 AblGLKWuw 20 VFZHIGH 0 20 FORMAT "%8.5" /end CHARACTERISTIC
/begin CHARACTERISTIC vAhaDet_LeftRightRotationLimit_XDU16 "maximale Raddrehzahldifferenz zwischen linker und rechter Seite, damit wsaAngleWheel_xds16 berechnet wird" VALUE 0x150806 AblGLKWuw 20 VFZHIGH 0 20 FORMAT "%8.5" /end CHARACTERISTIC
/begin CHARACTERISTIC vAhaDet_MaxAbsYawVelocity_XDU16 "Schwelle der Gierrate für Geradeauserkennung" VALUE 0x150808 AblGLKWuw 30 VGIER 0 30 FORMAT "%8.5" /end CHARACTERISTIC
/begin CHARACTERISTIC vAhaDet_MinRotationLimit_XDU16 "alle 4 Raddrehzahl muessen oberhalb dieser Schwelle sein fuer Geradeauserkennung" VALUE 0x15080A AblGLKWuw 19 VFZHIGH 1 20 FORMAT "%8.5" /end CHARACTERISTIC
/begin CHARACTERISTIC vAhaDet_MinVehicleSpeed_XDU16 "Schwelle Fahrzeuggeschwindigkeit für grundlegende Geradeauserkennung" VALUE 0x15080C AblGLKWuw 255 VFZHIGH 0 255 FORMAT "%8.4" /end CHARACTERISTIC
/begin CHARACTERISTIC vAhaDet_StAnSpeedLimit_XDU16 "Maximale Lenkradwinkelgeschwindigkeit" VALUE 0x15080E AblGLKWuw 1200 SAS_8 0 1200 FORMAT "%8.3" /end CHARACTERISTIC
/begin CHARACTERISTIC xActDamp_FactorDepOnDriverTorque_XAU16_00___A "active damping factor depending on driver torque" CURVE 0x15BA54 AblGLKLuw 2 RIGHTSH10NP 0 2 FORMAT "%8.6"
 /begin AXIS_DESCR STD_AXIS mApplI_AbsDriverTorque_xdu16 TBTHIGH 4 0 25 FORMAT "%8.5" DEPOSIT ABSOLUTE /end AXIS_DESCR
/end CHARACTERISTIC
/begin CHARACTERISTIC xActDamp_FactorDepOnDriverTorque_XAU16_01___A "active damping factor depending on driver torque" CURVE 0x15BA68 AblGLKLuw 2 RIGHTSH10NP 0 2 FORMAT "%8.6"
 /begin AXIS_DESCR STD_AXIS mApplI_AbsDriverTorque_xdu16 TBTHIGH 4 0 25 FORMAT "%8.5" DEPOSIT ABSOLUTE /end AXIS_DESCR
/end CHARACTERISTIC
/begin CHARACTERISTIC xActDamp_FactorDepOnDriverTorque_XAU16_02___A "active damping factor depending on driver torque" CURVE 0x15BA7C AblGLKLuw 2 RIGHTSH10NP 0 2 FORMAT "%8.6"
 /begin AXIS_DESCR STD_AXIS mApplI_AbsDriverTorque_xdu16 TBTHIGH 4 0 25 FORMAT "%8.5" DEPOSIT ABSOLUTE /end AXIS_DESCR
/end CHARACTERISTIC
/begin CHARACTERISTIC xActDamp_FactorDepOnDriverTorque_XAU16_03___A "active damping factor depending on driver torque" CURVE 0x15BA90 AblGLKLuw 2 RIGHTSH10NP 0 2 FORMAT "%8.6"
 /begin AXIS_DESCR STD_AXIS mApplI_AbsDriverTorque_xdu16 TBTHIGH 4 0 25 FORMAT "%8.5" DEPOSIT ABSOLUTE /end AXIS_DESCR
/end CHARACTERISTIC
/begin CHARACTERISTIC xActDamp_FactorDepOnDriverTorque_XAU16_04___A "active damping factor depending on driver torque" CURVE 0x15BAA4 AblGLKLuw 2 RIGHTSH10NP 0 2 FORMAT "%8.6"
 /begin AXIS_DESCR STD_AXIS mApplI_AbsDriverTorque_xdu16 TBTHIGH 4 0 25 FORMAT "%8.5" DEPOSIT ABSOLUTE /end AXIS_DESCR
/end CHARACTERISTIC
/begin CHARACTERISTIC xActDamp_FactorDepOnDriverTorque_XAU16_05___A "active damping factor depending on driver torque" CURVE 0x15BAB8 AblGLKLuw 2 RIGHTSH10NP 0 2 FORMAT "%8.6"
 /begin AXIS_DESCR STD_AXIS mApplI_AbsDriverTorque_xdu16 TBTHIGH 4 0 25 FORMAT "%8.5" DEPOSIT ABSOLUTE /end AXIS_DESCR
/end CHARACTERISTIC
/begin CHARACTERISTIC xActDamp_FactorDepOnDriverTorque_XAU16_06___A "active damping factor depending on driver torque" CURVE 0x15BACC AblGLKLuw 2 RIGHTSH10NP 0 2 FORMAT "%8.6"
 /begin AXIS_DESCR STD_AXIS mApplI_AbsDriverTorque_xdu16 TBTHIGH 4 0 25 FORMAT "%8.5" DEPOSIT ABSOLUTE /end AXIS_DESCR
/end CHARACTERISTIC
/begin CHARACTERISTIC xActDamp_FactorDepOnDriverTorque_XAU16_07___A "active damping factor depending on driver torque" CURVE 0x15BAE0 AblGLKLuw 2 RIGHTSH10NP 0 2 FORMAT "%8.6"
 /begin AXIS_DESCR STD_AXIS mApplI_AbsDriverTorque_xdu16 TBTHIGH 4 0 25 FORMAT "%8.5" DEPOSIT ABSOLUTE /end AXIS_DESCR
/end CHARACTERISTIC
/begin CHARACTERISTIC xActDamp_FactorDepOnDriverTorque_XAU16_08___A "active damping factor depending on driver torque" CURVE 0x15BAF4 AblGLKLuw 2 RIGHTSH10NP 0 2 FORMAT "%8.6"
 /begin AXIS_DESCR STD_AXIS mApplI_AbsDriverTorque_xdu16 TBTHIGH 4 0 25 FORMAT "%8.5" DEPOSIT ABSOLUTE /end AXIS_DESCR
/end CHARACTERISTIC
/begin CHARACTERISTIC xActDamp_FactorDepOnDriverTorque_XAU16_09___A "active damping factor depending on driver torque" CURVE 0x15BB08 AblGLKLuw 2 RIGHTSH10NP 0 2 FORMAT "%8.6"
 /begin AXIS_DESCR STD_AXIS mApplI_AbsDriverTorque_xdu16 TBTHIGH 4 0 25 FORMAT "%8.5" DEPOSIT ABSOLUTE /end AXIS_DESCR
/end CHARACTERISTIC
/begin CHARACTERISTIC xActDamp_FactorDepOnDriverTorque_XAU16_10___A "active damping factor depending on driver torque" CURVE 0x15BB1C AblGLKLuw 2 RIGHTSH10NP 0 2 FORMAT "%8.6"
 /begin AXIS_DESCR STD_AXIS mApplI_AbsDriverTorque_xdu16 TBTHIGH 4 0 25 FORMAT "%8.5" DEPOSIT ABSOLUTE /end AXIS_DESCR
/end CHARACTERISTIC
/begin CHARACTERISTIC xActDamp_FactorDepOnDriverTorque_XAU16_11___A "active damping factor depending on driver torque" CURVE 0x15BB30 AblGLKLuw 2 RIGHTSH10NP 0 2 FORMAT "%8.6"
 /begin AXIS_DESCR STD_AXIS mApplI_AbsDriverTorque_xdu16 TBTHIGH 4 0 25 FORMAT "%8.5" DEPOSIT ABSOLUTE /end AXIS_DESCR
/end CHARACTERISTIC
/begin CHARACTERISTIC xActDamp_FactorDepOnDriverTorque_XAU16_12___A "active damping factor depending on driver torque" CURVE 0x15BB44 AblGLKLuw 2 RIGHTSH10NP 0 2 FORMAT "%8.6"
 /begin AXIS_DESCR STD_AXIS mApplI_AbsDriverTorque_xdu16 TBTHIGH 4 0 25 FORMAT "%8.5" DEPOSIT ABSOLUTE /end AXIS_DESCR
/end CHARACTERISTIC
/begin CHARACTERISTIC xActDamp_FactorDepOnDriverTorque_XAU16_13___A "active damping factor depending on driver torque" CURVE 0x15BB58 AblGLKLuw 2 RIGHTSH10NP 0 2 FORMAT "%8.6"
 /begin AXIS_DESCR STD_AXIS mApplI_AbsDriverTorque_xdu16 TBTHIGH 4 0 25 FORMAT "%8.5" DEPOSIT ABSOLUTE /end AXIS_DESCR
/end CHARACTERISTIC
/begin CHARACTERISTIC xActDamp_FactorDepOnDriverTorque_XAU16_14___A "active damping factor depending on driver torque" CURVE 0x15BB6C AblGLKLuw 2 RIGHTSH10NP 0 2 FORMAT "%8.6"
 /begin AXIS_DESCR STD_AXIS mApplI_AbsDriverTorque_xdu16 TBTHIGH 4 0 25 FORMAT "%8.5" DEPOSIT ABSOLUTE /end AXIS_DESCR
/end CHARACTERISTIC
/begin CHARACTERISTIC xActDamp_FactorDepOnDriverTorque_XAU16_15___A "active damping factor depending on driver torque" CURVE 0x15BB80 AblGLKLuw 2 RIGHTSH10NP 0 2 FORMAT "%8.6"
 /begin AXIS_DESCR STD_AXIS mApplI_AbsDriverTorque_xdu16 TBTHIGH 4 0 25 FORMAT "%8.5" DEPOSIT ABSOLUTE /end AXIS_DESCR
/end CHARACTERISTIC
/begin CHARACTERISTIC xActDamp_FactorDepOnDriverTorque_XAU16_16___A "active damping factor depending on driver torque" CURVE 0x15BB94 AblGLKLuw 2 RIGHTSH10NP 0 2 FORMAT "%8.6"
 /begin AXIS_DESCR STD_AXIS mApplI_AbsDriverTorque_xdu16 TBTHIGH 4 0 25 FORMAT "%8.5" DEPOSIT ABSOLUTE /end AXIS_DESCR
/end CHARACTERISTIC
/begin CHARACTERISTIC xActDamp_FactorDepOnDriverTorque_XAU16_17___A "active damping factor depending on driver torque" CURVE 0x15BBA8 AblGLKLuw 2 RIGHTSH10NP 0 2 FORMAT "%8.6"
 /begin AXIS_DESCR STD_AXIS mApplI_AbsDriverTorque_xdu16 TBTHIGH 4 0 25 FORMAT "%8.5" DEPOSIT ABSOLUTE /end AXIS_DESCR
/end CHARACTERISTIC
/begin CHARACTERISTIC xActDamp_FactorDepOnDriverTorque_XAU16_18___A "active damping factor depending on driver torque" CURVE 0x15BBBC AblGLKLuw 2 RIGHTSH10NP 0 2 FORMAT "%8.6"
 /begin AXIS_DESCR STD_AXIS mApplI_AbsDriverTorque_xdu16 TBTHIGH 4 0 25 FORMAT "%8.5" DEPOSIT ABSOLUTE /end AXIS_DESCR
/end CHARACTERISTIC
/begin CHARACTERISTIC xActDamp_FactorDepOnDriverTorque_XAU16_19___A "active damping factor depending on driver torque" CURVE 0x15BBD0 AblGLKLuw 2 RIGHTSH10NP 0 2 FORMAT "%8.6"
 /begin AXIS_DESCR STD_AXIS mApplI_AbsDriverTorque_xdu16 TBTHIGH 4 0 25 FORMAT "%8.5" DEPOSIT ABSOLUTE /end AXIS_DESCR
/end CHARACTERISTIC
/begin CHARACTERISTIC xActDamp_FactorDepOnDriverTorque_XAU16_20___A "active damping factor depending on driver torque" CURVE 0x15BBE4 AblGLKLuw 2 RIGHTSH10NP 0 2 FORMAT "%8.6"
 /begin AXIS_DESCR STD_AXIS mApplI_AbsDriverTorque_xdu16 TBTHIGH 4 0 25 FORMAT "%8.5" DEPOSIT ABSOLUTE /end AXIS_DESCR
/end CHARACTERISTIC
/begin CHARACTERISTIC xActDamp_FactorDepOnDriverTorque_XAU16_21___A "active damping factor depending on driver torque" CURVE 0x15BBF8 AblGLKLuw 2 RIGHTSH10NP 0 2 FORMAT "%8.6"
 /begin AXIS_DESCR STD_AXIS mApplI_AbsDriverTorque_xdu16 TBTHIGH 4 0 25 FORMAT "%8.5" DEPOSIT ABSOLUTE /end AXIS_DESCR
/end CHARACTERISTIC
/begin CHARACTERISTIC xActDamp_FactorDepOnDriverTorque_XAU16_22___A "active damping factor depending on driver torque" CURVE 0x15BC0C AblGLKLuw 2 RIGHTSH10NP 0 2 FORMAT "%8.6"
 /begin AXIS_DESCR STD_AXIS mApplI_AbsDriverTorque_xdu16 TBTHIGH 4 0 25 FORMAT "%8.5" DEPOSIT ABSOLUTE /end AXIS_DESCR
/end CHARACTERISTIC
/begin CHARACTERISTIC xActDamp_FactorDepOnDriverTorque_XAU16_23___A "active damping factor depending on driver torque" CURVE 0x15BC20 AblGLKLuw 2 RIGHTSH10NP 0 2 FORMAT "%8.6"
 /begin AXIS_DESCR STD_AXIS mApplI_AbsDriverTorque_xdu16 TBTHIGH 4 0 25 FORMAT "%8.5" DEPOSIT ABSOLUTE /end AXIS_DESCR
/end CHARACTERISTIC
/begin CHARACTERISTIC xActDamp_FactorDepOnDriverTorque_XAU16_24___A "active damping factor depending on driver torque" CURVE 0x15BC34 AblGLKLuw 2 RIGHTSH10NP 0 2 FORMAT "%8.6"
 /begin AXIS_DESCR STD_AXIS mApplI_AbsDriverTorque_xdu16 TBTHIGH 4 0 25 FORMAT "%8.5" DEPOSIT ABSOLUTE /end AXIS_DESCR
/end CHARACTERISTIC
/begin CHARACTERISTIC xActDamp_FactorDepOnDriverTorque_XAU16_25___A "active damping factor depending on driver torque" CURVE 0x15BC48 AblGLKLuw 2 RIGHTSH10NP 0 2 FORMAT "%8.6"
 /begin AXIS_DESCR STD_AXIS mApplI_AbsDriverTorque_xdu16 TBTHIGH 4 0 25 FORMAT "%8.5" DEPOSIT ABSOLUTE /end AXIS_DESCR
/end CHARACTERISTIC
/begin CHARACTERISTIC xActDamp_FactorDepOnDriverTorque_XAU16_26___A "active damping factor depending on driver torque" CURVE 0x15BC5C AblGLKLuw 2 RIGHTSH10NP 0 2 FORMAT "%8.6"
 /begin AXIS_DESCR STD_AXIS mApplI_AbsDriverTorque_xdu16 TBTHIGH 4 0 25 FORMAT "%8.5" DEPOSIT ABSOLUTE /end AXIS_DESCR
/end CHARACTERISTIC
/begin CHARACTERISTIC xActDamp_FactorDepOnDriverTorque_XAU16_27___A "active damping factor depending on driver torque" CURVE 0x15BC70 AblGLKLuw 2 RIGHTSH10NP 0 2 FORMAT "%8.6"
 /begin AXIS_DESCR STD_AXIS mApplI_AbsDriverTorque_xdu16 TBTHIGH 4 0 25 FORMAT "%8.5" DEPOSIT ABSOLUTE /end AXIS_DESCR
/end CHARACTERISTIC
/begin CHARACTERISTIC xActDamp_FactorDepOnDriverTorque_XAU16_28___A "active damping factor depending on driver torque" CURVE 0x15BC84 AblGLKLuw 2 RIGHTSH10NP 0 2 FORMAT "%8.6"
 /begin AXIS_DESCR STD_AXIS mApplI_AbsDriverTorque_xdu16 TBTHIGH 4 0 25 FORMAT "%8.5" DEPOSIT ABSOLUTE /end AXIS_DESCR
/end CHARACTERISTIC
/begin CHARACTERISTIC xActDamp_FactorDepOnDriverTorque_XAU16_29___A "active damping factor depending on driver torque" CURVE 0x15BC98 AblGLKLuw 2 RIGHTSH10NP 0 2 FORMAT "%8.6"
 /begin AXIS_DESCR STD_AXIS mApplI_AbsDriverTorque_xdu16 TBTHIGH 4 0 25 FORMAT "%8.5" DEPOSIT ABSOLUTE /end AXIS_DESCR
/end CHARACTERISTIC
/begin CHARACTERISTIC xActDamp_FactorDepOnDriverTorque_XAU16_30___A "active damping factor depending on driver torque" CURVE 0x15BCAC AblGLKLuw 2 RIGHTSH10NP 0 2 FORMAT "%8.6"
 /begin AXIS_DESCR STD_AXIS mApplI_AbsDriverTorque_xdu16 TBTHIGH 4 0 25 FORMAT "%8.5" DEPOSIT ABSOLUTE /end AXIS_DESCR
/end CHARACTERISTIC
/begin CHARACTERISTIC xActDamp_FactorDepOnDriverTorque_XAU16_31___A "active damping factor depending on driver torque" CURVE 0x15BCC0 AblGLKLuw 2 RIGHTSH10NP 0 2 FORMAT "%8.6"
 /begin AXIS_DESCR STD_AXIS mApplI_AbsDriverTorque_xdu16 TBTHIGH 4 0 25 FORMAT "%8.5" DEPOSIT ABSOLUTE /end AXIS_DESCR
/end CHARACTERISTIC
/begin CHARACTERISTIC xActDamp_FactorDepOnDriverTorque_XAU16_32___A "active damping factor depending on driver torque" CURVE 0x15BCD4 AblGLKLuw 2 RIGHTSH10NP 0 2 FORMAT "%8.6"
 /begin AXIS_DESCR STD_AXIS mApplI_AbsDriverTorque_xdu16 TBTHIGH 4 0 25 FORMAT "%8.5" DEPOSIT ABSOLUTE /end AXIS_DESCR
/end CHARACTERISTIC
/begin CHARACTERISTIC xActDamp_FactorDepOnDriverTorque_XAU16_33___A "active damping factor depending on driver torque" CURVE 0x15BCE8 AblGLKLuw 2 RIGHTSH10NP 0 2 FORMAT "%8.6"
 /begin AXIS_DESCR STD_AXIS mApplI_AbsDriverTorque_xdu16 TBTHIGH 4 0 25 FORMAT "%8.5" DEPOSIT ABSOLUTE /end AXIS_DESCR
/end CHARACTERISTIC
/begin CHARACTERISTIC xActDamp_FactorDepOnDriverTorque_XAU16_34___A "active damping factor depending on driver torque" CURVE 0x15BCFC AblGLKLuw 2 RIGHTSH10NP 0 2 FORMAT "%8.6"
 /begin AXIS_DESCR STD_AXIS mApplI_AbsDriverTorque_xdu16 TBTHIGH 4 0 25 FORMAT "%8.5" DEPOSIT ABSOLUTE /end AXIS_DESCR
/end CHARACTERISTIC
/begin CHARACTERISTIC xActDamp_FactorDepOnDriverTorque_XAU16_35___A "active damping factor depending on driver torque" CURVE 0x15BD10 AblGLKLuw 2 RIGHTSH10NP 0 2 FORMAT "%8.6"
 /begin AXIS_DESCR STD_AXIS mApplI_AbsDriverTorque_xdu16 TBTHIGH 4 0 25 FORMAT "%8.5" DEPOSIT ABSOLUTE /end AXIS_DESCR
/end CHARACTERISTIC
/begin CHARACTERISTIC xActDamp_FactorDepOnSteerAngle_XAU16_00___A "active damping factor depending on steering angle" CURVE 0x15BD24 AblGLKLuw 1.5 RIGHTSH10NP 0 1.5 FORMAT "%8.6"
 /begin AXIS_DESCR STD_AXIS wApplI_AbsSteeringAngle_xdu16 SA_10 5 0 1000 FORMAT "%8.3" DEPOSIT ABSOLUTE /end AXIS_DESCR
/end CHARACTERISTIC
/begin CHARACTERISTIC xActDamp_FactorDepOnSteerAngle_XAU16_01___A "active damping factor depending on steering angle" CURVE 0x15BD3C AblGLKLuw 1.5 RIGHTSH10NP 0 1.5 FORMAT "%8.6"
 /begin AXIS_DESCR STD_AXIS wApplI_AbsSteeringAngle_xdu16 SA_10 5 0 1000 FORMAT "%8.3" DEPOSIT ABSOLUTE /end AXIS_DESCR
/end CHARACTERISTIC
/begin CHARACTERISTIC xActDamp_FactorDepOnSteerAngle_XAU16_02___A "active damping factor depending on steering angle" CURVE 0x15BD54 AblGLKLuw 1.5 RIGHTSH10NP 0 1.5 FORMAT "%8.6"
 /begin AXIS_DESCR STD_AXIS wApplI_AbsSteeringAngle_xdu16 SA_10 5 0 1000 FORMAT "%8.3" DEPOSIT ABSOLUTE /end AXIS_DESCR
/end CHARACTERISTIC
/begin CHARACTERISTIC xActDamp_FactorDepOnSteerAngle_XAU16_03___A "active damping factor depending on steering angle" CURVE 0x15BD6C AblGLKLuw 1.5 RIGHTSH10NP 0 1.5 FORMAT "%8.6"
 /begin AXIS_DESCR STD_AXIS wApplI_AbsSteeringAngle_xdu16 SA_10 5 0 1000 FORMAT "%8.3" DEPOSIT ABSOLUTE /end AXIS_DESCR
/end CHARACTERISTIC
/begin CHARACTERISTIC xActDamp_FactorDepOnSteerAngle_XAU16_04___A "active damping factor depending on steering angle" CURVE 0x15BD84 AblGLKLuw 1.5 RIGHTSH10NP 0 1.5 FORMAT "%8.6"
 /begin AXIS_DESCR STD_AXIS wApplI_AbsSteeringAngle_xdu16 SA_10 5 0 1000 FORMAT "%8.3" DEPOSIT ABSOLUTE /end AXIS_DESCR
/end CHARACTERISTIC
/begin CHARACTERISTIC xActDamp_FactorDepOnSteerAngle_XAU16_05___A "active damping factor depending on steering angle" CURVE 0x15BD9C AblGLKLuw 1.5 RIGHTSH10NP 0 1.5 FORMAT "%8.6"
 /begin AXIS_DESCR STD_AXIS wApplI_AbsSteeringAngle_xdu16 SA_10 5 0 1000 FORMAT "%8.3" DEPOSIT ABSOLUTE /end AXIS_DESCR
/end CHARACTERISTIC
/begin CHARACTERISTIC xActDamp_FactorDepOnSteerAngle_XAU16_06___A "active damping factor depending on steering angle" CURVE 0x15BDB4 AblGLKLuw 1.5 RIGHTSH10NP 0 1.5 FORMAT "%8.6"
 /begin AXIS_DESCR STD_AXIS wApplI_AbsSteeringAngle_xdu16 SA_10 5 0 1000 FORMAT "%8.3" DEPOSIT ABSOLUTE /end AXIS_DESCR
/end CHARACTERISTIC
/begin CHARACTERISTIC xActDamp_FactorDepOnSteerAngle_XAU16_07___A "active damping factor depending on steering angle" CURVE 0x15BDCC AblGLKLuw 1.5 RIGHTSH10NP 0 1.5 FORMAT "%8.6"
 /begin AXIS_DESCR STD_AXIS wApplI_AbsSteeringAngle_xdu16 SA_10 5 0 1000 FORMAT "%8.3" DEPOSIT ABSOLUTE /end AXIS_DESCR
/end CHARACTERISTIC
/begin CHARACTERISTIC xActDamp_FactorDepOnSteerAngle_XAU16_08___A "active damping factor depending on steering angle" CURVE 0x15BDE4 AblGLKLuw 1.5 RIGHTSH10NP 0 1.5 FORMAT "%8.6"
 /begin AXIS_DESCR STD_AXIS wApplI_AbsSteeringAngle_xdu16 SA_10 5 0 1000 FORMAT "%8.3" DEPOSIT ABSOLUTE /end AXIS_DESCR
/end CHARACTERISTIC
/begin CHARACTERISTIC xActDamp_FactorDepOnSteerAngle_XAU16_09___A "active damping factor depending on steering angle" CURVE 0x15BDFC AblGLKLuw 1.5 RIGHTSH10NP 0 1.5 FORMAT "%8.6"
 /begin AXIS_DESCR STD_AXIS wApplI_AbsSteeringAngle_xdu16 SA_10 5 0 1000 FORMAT "%8.3" DEPOSIT ABSOLUTE /end AXIS_DESCR
/end CHARACTERISTIC
/begin CHARACTERISTIC xActDamp_FactorDepOnSteerAngle_XAU16_10___A "active damping factor depending on steering angle" CURVE 0x15BE14 AblGLKLuw 1.5 RIGHTSH10NP 0 1.5 FORMAT "%8.6"
 /begin AXIS_DESCR STD_AXIS wApplI_AbsSteeringAngle_xdu16 SA_10 5 0 1000 FORMAT "%8.3" DEPOSIT ABSOLUTE /end AXIS_DESCR
/end CHARACTERISTIC
/begin CHARACTERISTIC xActDamp_FactorDepOnSteerAngle_XAU16_11___A "active damping factor depending on steering angle" CURVE 0x15BE2C AblGLKLuw 1.5 RIGHTSH10NP 0 1.5 FORMAT "%8.6"
 /begin AXIS_DESCR STD_AXIS wApplI_AbsSteeringAngle_xdu16 SA_10 5 0 1000 FORMAT "%8.3" DEPOSIT ABSOLUTE /end AXIS_DESCR
/end CHARACTERISTIC
/begin CHARACTERISTIC xActDamp_FactorDepOnSteerAngle_XAU16_12___A "active damping factor depending on steering angle" CURVE 0x15BE44 AblGLKLuw 1.5 RIGHTSH10NP 0 1.5 FORMAT "%8.6"
 /begin AXIS_DESCR STD_AXIS wApplI_AbsSteeringAngle_xdu16 SA_10 5 0 1000 FORMAT "%8.3" DEPOSIT ABSOLUTE /end AXIS_DESCR
/end CHARACTERISTIC
/begin CHARACTERISTIC xActDamp_FactorDepOnSteerAngle_XAU16_13___A "active damping factor depending on steering angle" CURVE 0x15BE5C AblGLKLuw 1.5 RIGHTSH10NP 0 1.5 FORMAT "%8.6"
 /begin AXIS_DESCR STD_AXIS wApplI_AbsSteeringAngle_xdu16 SA_10 5 0 1000 FORMAT "%8.3" DEPOSIT ABSOLUTE /end AXIS_DESCR
/end CHARACTERISTIC
/begin CHARACTERISTIC xActDamp_FactorDepOnSteerAngle_XAU16_14___A "active damping factor depending on steering angle" CURVE 0x15BE74 AblGLKLuw 1.5 RIGHTSH10NP 0 1.5 FORMAT "%8.6"
 /begin AXIS_DESCR STD_AXIS wApplI_AbsSteeringAngle_xdu16 SA_10 5 0 1000 FORMAT "%8.3" DEPOSIT ABSOLUTE /end AXIS_DESCR
/end CHARACTERISTIC
/begin CHARACTERISTIC xActDamp_FactorDepOnSteerAngle_XAU16_15___A "active damping factor depending on steering angle" CURVE 0x15BE8C AblGLKLuw 1.5 RIGHTSH10NP 0 1.5 FORMAT "%8.6"
 /begin AXIS_DESCR STD_AXIS wApplI_AbsSteeringAngle_xdu16 SA_10 5 0 1000 FORMAT "%8.3" DEPOSIT ABSOLUTE /end AXIS_DESCR
/end CHARACTERISTIC
/begin CHARACTERISTIC xActDamp_FactorDepOnSteerAngle_XAU16_16___A "active damping factor depending on steering angle" CURVE 0x15BEA4 AblGLKLuw 1.5 RIGHTSH10NP 0 1.5 FORMAT "%8.6"
 /begin AXIS_DESCR STD_AXIS wApplI_AbsSteeringAngle_xdu16 SA_10 5 0 1000 FORMAT "%8.3" DEPOSIT ABSOLUTE /end AXIS_DESCR
/end CHARACTERISTIC
/begin CHARACTERISTIC xActDamp_FactorDepOnSteerAngle_XAU16_17___A "active damping factor depending on steering angle" CURVE 0x15BEBC AblGLKLuw 1.5 RIGHTSH10NP 0 1.5 FORMAT "%8.6"
 /begin AXIS_DESCR STD_AXIS wApplI_AbsSteeringAngle_xdu16 SA_10 5 0 1000 FORMAT "%8.3" DEPOSIT ABSOLUTE /end AXIS_DESCR
/end CHARACTERISTIC
/begin CHARACTERISTIC xActDamp_FactorDepOnSteerAngle_XAU16_18___A "active damping factor depending on steering angle" CURVE 0x15BED4 AblGLKLuw 1.5 RIGHTSH10NP 0 1.5 FORMAT "%8.6"
 /begin AXIS_DESCR STD_AXIS wApplI_AbsSteeringAngle_xdu16 SA_10 5 0 1000 FORMAT "%8.3" DEPOSIT ABSOLUTE /end AXIS_DESCR
/end CHARACTERISTIC
/begin CHARACTERISTIC xActDamp_FactorDepOnSteerAngle_XAU16_19___A "active damping factor depending on steering angle" CURVE 0x15BEEC AblGLKLuw 1.5 RIGHTSH10NP 0 1.5 FORMAT "%8.6"
 /begin AXIS_DESCR STD_AXIS wApplI_AbsSteeringAngle_xdu16 SA_10 5 0 1000 FORMAT "%8.3" DEPOSIT ABSOLUTE /end AXIS_DESCR
/end CHARACTERISTIC
/begin CHARACTERISTIC xActDamp_FactorDepOnSteerAngle_XAU16_20___A "active damping factor depending on steering angle" CURVE 0x15BF04 AblGLKLuw 1.5 RIGHTSH10NP 0 1.5 FORMAT "%8.6"
 /begin AXIS_DESCR STD_AXIS wApplI_AbsSteeringAngle_xdu16 SA_10 5 0 1000 FORMAT "%8.3" DEPOSIT ABSOLUTE /end AXIS_DESCR
/end CHARACTERISTIC
/begin CHARACTERISTIC xActDamp_FactorDepOnSteerAngle_XAU16_21___A "active damping factor depending on steering angle" CURVE 0x15BF1C AblGLKLuw 1.5 RIGHTSH10NP 0 1.5 FORMAT "%8.6"
 /begin AXIS_DESCR STD_AXIS wApplI_AbsSteeringAngle_xdu16 SA_10 5 0 1000 FORMAT "%8.3" DEPOSIT ABSOLUTE /end AXIS_DESCR
/end CHARACTERISTIC
/begin CHARACTERISTIC xActDamp_FactorDepOnSteerAngle_XAU16_22___A "active damping factor depending on steering angle" CURVE 0x15BF34 AblGLKLuw 1.5 RIGHTSH10NP 0 1.5 FORMAT "%8.6"
 /begin AXIS_DESCR STD_AXIS wApplI_AbsSteeringAngle_xdu16 SA_10 5 0 1000 FORMAT "%8.3" DEPOSIT ABSOLUTE /end AXIS_DESCR
/end CHARACTERISTIC
/begin CHARACTERISTIC xActDamp_FactorDepOnSteerAngle_XAU16_23___A "active damping factor depending on steering angle" CURVE 0x15BF4C AblGLKLuw 1.5 RIGHTSH10NP 0 1.5 FORMAT "%8.6"
 /begin AXIS_DESCR STD_AXIS wApplI_AbsSteeringAngle_xdu16 SA_10 5 0 1000 FORMAT "%8.3" DEPOSIT ABSOLUTE /end AXIS_DESCR
/end CHARACTERISTIC
/begin CHARACTERISTIC xActDamp_FactorDepOnSteerAngle_XAU16_24___A "active damping factor depending on steering angle" CURVE 0x15BF64 AblGLKLuw 1.5 RIGHTSH10NP 0 1.5 FORMAT "%8.6"
 /begin AXIS_DESCR STD_AXIS wApplI_AbsSteeringAngle_xdu16 SA_10 5 0 1000 FORMAT "%8.3" DEPOSIT ABSOLUTE /end AXIS_DESCR
/end CHARACTERISTIC
/begin CHARACTERISTIC xActDamp_FactorDepOnSteerAngle_XAU16_25___A "active damping factor depending on steering angle" CURVE 0x15BF7C AblGLKLuw 1.5 RIGHTSH10NP 0 1.5 FORMAT "%8.6"
 /begin AXIS_DESCR STD_AXIS wApplI_AbsSteeringAngle_xdu16 SA_10 5 0 1000 FORMAT "%8.3" DEPOSIT ABSOLUTE /end AXIS_DESCR
/end CHARACTERISTIC
/begin CHARACTERISTIC xActDamp_FactorDepOnSteerAngle_XAU16_26___A "active damping factor depending on steering angle" CURVE 0x15BF94 AblGLKLuw 1.5 RIGHTSH10NP 0 1.5 FORMAT "%8.6"
 /begin AXIS_DESCR STD_AXIS wApplI_AbsSteeringAngle_xdu16 SA_10 5 0 1000 FORMAT "%8.3" DEPOSIT ABSOLUTE /end AXIS_DESCR
/end CHARACTERISTIC
/begin CHARACTERISTIC xActDamp_FactorDepOnSteerAngle_XAU16_27___A "active damping factor depending on steering angle" CURVE 0x15BFAC AblGLKLuw 1.5 RIGHTSH10NP 0 1.5 FORMAT "%8.6"
 /begin AXIS_DESCR STD_AXIS wApplI_AbsSteeringAngle_xdu16 SA_10 5 0 1000 FORMAT "%8.3" DEPOSIT ABSOLUTE /end AXIS_DESCR
/end CHARACTERISTIC
/begin CHARACTERISTIC xActDamp_FactorDepOnSteerAngle_XAU16_28___A "active damping factor depending on steering angle" CURVE 0x15BFC4 AblGLKLuw 1.5 RIGHTSH10NP 0 1.5 FORMAT "%8.6"
 /begin AXIS_DESCR STD_AXIS wApplI_AbsSteeringAngle_xdu16 SA_10 5 0 1000 FORMAT "%8.3" DEPOSIT ABSOLUTE /end AXIS_DESCR
/end CHARACTERISTIC
/begin CHARACTERISTIC xActDamp_FactorDepOnSteerAngle_XAU16_29___A "active damping factor depending on steering angle" CURVE 0x15BFDC AblGLKLuw 1.5 RIGHTSH10NP 0 1.5 FORMAT "%8.6"
 /begin AXIS_DESCR STD_AXIS wApplI_AbsSteeringAngle_xdu16 SA_10 5 0 1000 FORMAT "%8.3" DEPOSIT ABSOLUTE /end AXIS_DESCR
/end CHARACTERISTIC
/begin CHARACTERISTIC xActDamp_FactorDepOnSteerAngle_XAU16_30___A "active damping factor depending on steering angle" CURVE 0x15BFF4 AblGLKLuw 1.5 RIGHTSH10NP 0 1.5 FORMAT "%8.6"
 /begin AXIS_DESCR STD_AXIS wApplI_AbsSteeringAngle_xdu16 SA_10 5 0 1000 FORMAT "%8.3" DEPOSIT ABSOLUTE /end AXIS_DESCR
/end CHARACTERISTIC
/begin CHARACTERISTIC xActDamp_FactorDepOnSteerAngle_XAU16_31___A "active damping factor depending on steering angle" CURVE 0x15C00C AblGLKLuw 1.5 RIGHTSH10NP 0 1.5 FORMAT "%8.6"
 /begin AXIS_DESCR STD_AXIS wApplI_AbsSteeringAngle_xdu16 SA_10 5 0 1000 FORMAT "%8.3" DEPOSIT ABSOLUTE /end AXIS_DESCR
/end CHARACTERISTIC
/begin CHARACTERISTIC xActDamp_FactorDepOnSteerAngle_XAU16_32___A "active damping factor depending on steering angle" CURVE 0x15C024 AblGLKLuw 1.5 RIGHTSH10NP 0 1.5 FORMAT "%8.6"
 /begin AXIS_DESCR STD_AXIS wApplI_AbsSteeringAngle_xdu16 SA_10 5 0 1000 FORMAT "%8.3" DEPOSIT ABSOLUTE /end AXIS_DESCR
/end CHARACTERISTIC
/begin CHARACTERISTIC xActDamp_FactorDepOnSteerAngle_XAU16_33___A "active damping factor depending on steering angle" CURVE 0x15C03C AblGLKLuw 1.5 RIGHTSH10NP 0 1.5 FORMAT "%8.6"
 /begin AXIS_DESCR STD_AXIS wApplI_AbsSteeringAngle_xdu16 SA_10 5 0 1000 FORMAT "%8.3" DEPOSIT ABSOLUTE /end AXIS_DESCR
/end CHARACTERISTIC
/begin CHARACTERISTIC xActDamp_FactorDepOnSteerAngle_XAU16_34___A "active damping factor depending on steering angle" CURVE 0x15C054 AblGLKLuw 1.5 RIGHTSH10NP 0 1.5 FORMAT "%8.6"
 /begin AXIS_DESCR STD_AXIS wApplI_AbsSteeringAngle_xdu16 SA_10 5 0 1000 FORMAT "%8.3" DEPOSIT ABSOLUTE /end AXIS_DESCR
/end CHARACTERISTIC
/begin CHARACTERISTIC xActDamp_FactorDepOnSteerAngle_XAU16_35___A "active damping factor depending on steering angle" CURVE 0x15C06C AblGLKLuw 1.5 RIGHTSH10NP 0 1.5 FORMAT "%8.6"
 /begin AXIS_DESCR STD_AXIS wApplI_AbsSteeringAngle_xdu16 SA_10 5 0 1000 FORMAT "%8.3" DEPOSIT ABSOLUTE /end AXIS_DESCR
/end CHARACTERISTIC
/begin CHARACTERISTIC xActDamp_FactorDepOnVehSpeed_XAU16_00___A "active damping factor depending on vehicle speed" CURVE 0x15C084 AblGLKLuw 2 RIGHTSH10NP 0 2 FORMAT "%8.6"
 /begin AXIS_DESCR STD_AXIS vVehSpI_AbsAvgVehSpd_xdu16 VFZHIGH 4 0 500 FORMAT "%8.4" DEPOSIT ABSOLUTE /end AXIS_DESCR
/end CHARACTERISTIC
/begin CHARACTERISTIC xActDamp_FactorDepOnVehSpeed_XAU16_01___A "active damping factor depending on vehicle speed" CURVE 0x15C098 AblGLKLuw 2 RIGHTSH10NP 0 2 FORMAT "%8.6"
 /begin AXIS_DESCR STD_AXIS vVehSpI_AbsAvgVehSpd_xdu16 VFZHIGH 4 0 500 FORMAT "%8.4" DEPOSIT ABSOLUTE /end AXIS_DESCR
/end CHARACTERISTIC
/begin CHARACTERISTIC xActDamp_FactorDepOnVehSpeed_XAU16_02___A "active damping factor depending on vehicle speed" CURVE 0x15C0AC AblGLKLuw 2 RIGHTSH10NP 0 2 FORMAT "%8.6"
 /begin AXIS_DESCR STD_AXIS vVehSpI_AbsAvgVehSpd_xdu16 VFZHIGH 4 0 500 FORMAT "%8.4" DEPOSIT ABSOLUTE /end AXIS_DESCR
/end CHARACTERISTIC
/begin CHARACTERISTIC xActDamp_FactorDepOnVehSpeed_XAU16_03___A "active damping factor depending on vehicle speed" CURVE 0x15C0C0 AblGLKLuw 2 RIGHTSH10NP 0 2 FORMAT "%8.6"
 /begin AXIS_DESCR STD_AXIS vVehSpI_AbsAvgVehSpd_xdu16 VFZHIGH 4 0 500 FORMAT "%8.4" DEPOSIT ABSOLUTE /end AXIS_DESCR
/end CHARACTERISTIC
/begin CHARACTERISTIC xActDamp_FactorDepOnVehSpeed_XAU16_04___A "active damping factor depending on vehicle speed" CURVE 0x15C0D4 AblGLKLuw 2 RIGHTSH10NP 0 2 FORMAT "%8.6"
 /begin AXIS_DESCR STD_AXIS vVehSpI_AbsAvgVehSpd_xdu16 VFZHIGH 4 0 500 FORMAT "%8.4" DEPOSIT ABSOLUTE /end AXIS_DESCR
/end CHARACTERISTIC
/begin CHARACTERISTIC xActDamp_FactorDepOnVehSpeed_XAU16_05___A "active damping factor depending on vehicle speed" CURVE 0x15C0E8 AblGLKLuw 2 RIGHTSH10NP 0 2 FORMAT "%8.6"
 /begin AXIS_DESCR STD_AXIS vVehSpI_AbsAvgVehSpd_xdu16 VFZHIGH 4 0 500 FORMAT "%8.4" DEPOSIT ABSOLUTE /end AXIS_DESCR
/end CHARACTERISTIC
/begin CHARACTERISTIC xActDamp_FactorDepOnVehSpeed_XAU16_06___A "active damping factor depending on vehicle speed" CURVE 0x15C0FC AblGLKLuw 2 RIGHTSH10NP 0 2 FORMAT "%8.6"
 /begin AXIS_DESCR STD_AXIS vVehSpI_AbsAvgVehSpd_xdu16 VFZHIGH 4 0 500 FORMAT "%8.4" DEPOSIT ABSOLUTE /end AXIS_DESCR
/end CHARACTERISTIC
/begin CHARACTERISTIC xActDamp_FactorDepOnVehSpeed_XAU16_07___A "active damping factor depending on vehicle speed" CURVE 0x15C110 AblGLKLuw 2 RIGHTSH10NP 0 2 FORMAT "%8.6"
 /begin AXIS_DESCR STD_AXIS vVehSpI_AbsAvgVehSpd_xdu16 VFZHIGH 4 0 500 FORMAT "%8.4" DEPOSIT ABSOLUTE /end AXIS_DESCR
/end CHARACTERISTIC
/begin CHARACTERISTIC xActDamp_FactorDepOnVehSpeed_XAU16_08___A "active damping factor depending on vehicle speed" CURVE 0x15C124 AblGLKLuw 2 RIGHTSH10NP 0 2 FORMAT "%8.6"
 /begin AXIS_DESCR STD_AXIS vVehSpI_AbsAvgVehSpd_xdu16 VFZHIGH 4 0 500 FORMAT "%8.4" DEPOSIT ABSOLUTE /end AXIS_DESCR
/end CHARACTERISTIC
/begin CHARACTERISTIC xActDamp_FactorDepOnVehSpeed_XAU16_09___A "active damping factor depending on vehicle speed" CURVE 0x15C138 AblGLKLuw 2 RIGHTSH10NP 0 2 FORMAT "%8.6"
 /begin AXIS_DESCR STD_AXIS vVehSpI_AbsAvgVehSpd_xdu16 VFZHIGH 4 0 500 FORMAT "%8.4" DEPOSIT ABSOLUTE /end AXIS_DESCR
/end CHARACTERISTIC
/begin CHARACTERISTIC xActDamp_FactorDepOnVehSpeed_XAU16_10___A "active damping factor depending on vehicle speed" CURVE 0x15C14C AblGLKLuw 2 RIGHTSH10NP 0 2 FORMAT "%8.6"
 /begin AXIS_DESCR STD_AXIS vVehSpI_AbsAvgVehSpd_xdu16 VFZHIGH 4 0 500 FORMAT "%8.4" DEPOSIT ABSOLUTE /end AXIS_DESCR
/end CHARACTERISTIC
/begin CHARACTERISTIC xActDamp_FactorDepOnVehSpeed_XAU16_11___A "active damping factor depending on vehicle speed" CURVE 0x15C160 AblGLKLuw 2 RIGHTSH10NP 0 2 FORMAT "%8.6"
 /begin AXIS_DESCR STD_AXIS vVehSpI_AbsAvgVehSpd_xdu16 VFZHIGH 4 0 500 FORMAT "%8.4" DEPOSIT ABSOLUTE /end AXIS_DESCR
/end CHARACTERISTIC
/begin CHARACTERISTIC xActDamp_FactorDepOnVehSpeed_XAU16_12___A "active damping factor depending on vehicle speed" CURVE 0x15C174 AblGLKLuw 2 RIGHTSH10NP 0 2 FORMAT "%8.6"
 /begin AXIS_DESCR STD_AXIS vVehSpI_AbsAvgVehSpd_xdu16 VFZHIGH 4 0 500 FORMAT "%8.4" DEPOSIT ABSOLUTE /end AXIS_DESCR
/end CHARACTERISTIC
/begin CHARACTERISTIC xActDamp_FactorDepOnVehSpeed_XAU16_13___A "active damping factor depending on vehicle speed" CURVE 0x15C188 AblGLKLuw 2 RIGHTSH10NP 0 2 FORMAT "%8.6"
 /begin AXIS_DESCR STD_AXIS vVehSpI_AbsAvgVehSpd_xdu16 VFZHIGH 4 0 500 FORMAT "%8.4" DEPOSIT ABSOLUTE /end AXIS_DESCR
/end CHARACTERISTIC
/begin CHARACTERISTIC xActDamp_FactorDepOnVehSpeed_XAU16_14___A "active damping factor depending on vehicle speed" CURVE 0x15C19C AblGLKLuw 2 RIGHTSH10NP 0 2 FORMAT "%8.6"
 /begin AXIS_DESCR STD_AXIS vVehSpI_AbsAvgVehSpd_xdu16 VFZHIGH 4 0 500 FORMAT "%8.4" DEPOSIT ABSOLUTE /end AXIS_DESCR
/end CHARACTERISTIC
/begin CHARACTERISTIC xActDamp_FactorDepOnVehSpeed_XAU16_15___A "active damping factor depending on vehicle speed" CURVE 0x15C1B0 AblGLKLuw 2 RIGHTSH10NP 0 2 FORMAT "%8.6"
 /begin AXIS_DESCR STD_AXIS vVehSpI_AbsAvgVehSpd_xdu16 VFZHIGH 4 0 500 FORMAT "%8.4" DEPOSIT ABSOLUTE /end AXIS_DESCR
/end CHARACTERISTIC
/begin CHARACTERISTIC xActDamp_FactorDepOnVehSpeed_XAU16_16___A "active damping factor depending on vehicle speed" CURVE 0x15C1C4 AblGLKLuw 2 RIGHTSH10NP 0 2 FORMAT "%8.6"
 /begin AXIS_DESCR STD_AXIS vVehSpI_AbsAvgVehSpd_xdu16 VFZHIGH 4 0 500 FORMAT "%8.4" DEPOSIT ABSOLUTE /end AXIS_DESCR
/end CHARACTERISTIC
/begin CHARACTERISTIC xActDamp_FactorDepOnVehSpeed_XAU16_17___A "active damping factor depending on vehicle speed" CURVE 0x15C1D8 AblGLKLuw 2 RIGHTSH10NP 0 2 FORMAT "%8.6"
 /begin AXIS_DESCR STD_AXIS vVehSpI_AbsAvgVehSpd_xdu16 VFZHIGH 4 0 500 FORMAT "%8.4" DEPOSIT ABSOLUTE /end AXIS_DESCR
/end CHARACTERISTIC
/begin CHARACTERISTIC xActDamp_FactorDepOnVehSpeed_XAU16_18___A "active damping factor depending on vehicle speed" CURVE 0x15C1EC AblGLKLuw 2 RIGHTSH10NP 0 2 FORMAT "%8.6"
 /begin AXIS_DESCR STD_AXIS vVehSpI_AbsAvgVehSpd_xdu16 VFZHIGH 4 0 500 FORMAT "%8.4" DEPOSIT ABSOLUTE /end AXIS_DESCR
/end CHARACTERISTIC
/begin CHARACTERISTIC xActDamp_FactorDepOnVehSpeed_XAU16_19___A "active damping factor depending on vehicle speed" CURVE 0x15C200 AblGLKLuw 2 RIGHTSH10NP 0 2 FORMAT "%8.6"
 /begin AXIS_DESCR STD_AXIS vVehSpI_AbsAvgVehSpd_xdu16 VFZHIGH 4 0 500 FORMAT "%8.4" DEPOSIT ABSOLUTE /end AXIS_DESCR
/end CHARACTERISTIC
/begin CHARACTERISTIC xActDamp_FactorDepOnVehSpeed_XAU16_20___A "active damping factor depending on vehicle speed" CURVE 0x15C214 AblGLKLuw 2 RIGHTSH10NP 0 2 FORMAT "%8.6"
 /begin AXIS_DESCR STD_AXIS vVehSpI_AbsAvgVehSpd_xdu16 VFZHIGH 4 0 500 FORMAT "%8.4" DEPOSIT ABSOLUTE /end AXIS_DESCR
/end CHARACTERISTIC
/begin CHARACTERISTIC xActDamp_FactorDepOnVehSpeed_XAU16_21___A "active damping factor depending on vehicle speed" CURVE 0x15C228 AblGLKLuw 2 RIGHTSH10NP 0 2 FORMAT "%8.6"
 /begin AXIS_DESCR STD_AXIS vVehSpI_AbsAvgVehSpd_xdu16 VFZHIGH 4 0 500 FORMAT "%8.4" DEPOSIT ABSOLUTE /end AXIS_DESCR
/end CHARACTERISTIC
/begin CHARACTERISTIC xActDamp_FactorDepOnVehSpeed_XAU16_22___A "active damping factor depending on vehicle speed" CURVE 0x15C23C AblGLKLuw 2 RIGHTSH10NP 0 2 FORMAT "%8.6"
 /begin AXIS_DESCR STD_AXIS vVehSpI_AbsAvgVehSpd_xdu16 VFZHIGH 4 0 500 FORMAT "%8.4" DEPOSIT ABSOLUTE /end AXIS_DESCR
/end CHARACTERISTIC
/begin CHARACTERISTIC xActDamp_FactorDepOnVehSpeed_XAU16_23___A "active damping factor depending on vehicle speed" CURVE 0x15C250 AblGLKLuw 2 RIGHTSH10NP 0 2 FORMAT "%8.6"
 /begin AXIS_DESCR STD_AXIS vVehSpI_AbsAvgVehSpd_xdu16 VFZHIGH 4 0 500 FORMAT "%8.4" DEPOSIT ABSOLUTE /end AXIS_DESCR
/end CHARACTERISTIC
/begin CHARACTERISTIC xActDamp_FactorDepOnVehSpeed_XAU16_24___A "active damping factor depending on vehicle speed" CURVE 0x15C264 AblGLKLuw 2 RIGHTSH10NP 0 2 FORMAT "%8.6"
 /begin AXIS_DESCR STD_AXIS vVehSpI_AbsAvgVehSpd_xdu16 VFZHIGH 4 0 500 FORMAT "%8.4" DEPOSIT ABSOLUTE /end AXIS_DESCR
/end CHARACTERISTIC
/begin CHARACTERISTIC xActDamp_FactorDepOnVehSpeed_XAU16_25___A "active damping factor depending on vehicle speed" CURVE 0x15C278 AblGLKLuw 2 RIGHTSH10NP 0 2 FORMAT "%8.6"
 /begin AXIS_DESCR STD_AXIS vVehSpI_AbsAvgVehSpd_xdu16 VFZHIGH 4 0 500 FORMAT "%8.4" DEPOSIT ABSOLUTE /end AXIS_DESCR
/end CHARACTERISTIC
/begin CHARACTERISTIC xActDamp_FactorDepOnVehSpeed_XAU16_26___A "active damping factor depending on vehicle speed" CURVE 0x15C28C AblGLKLuw 2 RIGHTSH10NP 0 2 FORMAT "%8.6"
 /begin AXIS_DESCR STD_AXIS vVehSpI_AbsAvgVehSpd_xdu16 VFZHIGH 4 0 500 FORMAT "%8.4" DEPOSIT ABSOLUTE /end AXIS_DESCR
/end CHARACTERISTIC
/begin CHARACTERISTIC xActDamp_FactorDepOnVehSpeed_XAU16_27___A "active damping factor depending on vehicle speed" CURVE 0x15C2A0 AblGLKLuw 2 RIGHTSH10NP 0 2 FORMAT "%8.6"
 /begin AXIS_DESCR STD_AXIS vVehSpI_AbsAvgVehSpd_xdu16 VFZHIGH 4 0 500 FORMAT "%8.4" DEPOSIT ABSOLUTE /end AXIS_DESCR
/end CHARACTERISTIC
/begin CHARACTERISTIC xActDamp_FactorDepOnVehSpeed_XAU16_28___A "active damping factor depending on vehicle speed" CURVE 0x15C2B4 AblGLKLuw 2 RIGHTSH10NP 0 2 FORMAT "%8.6"
 /begin AXIS_DESCR STD_AXIS vVehSpI_AbsAvgVehSpd_xdu16 VFZHIGH 4 0 500 FORMAT "%8.4" DEPOSIT ABSOLUTE /end AXIS_DESCR
/end CHARACTERISTIC
/begin CHARACTERISTIC xActDamp_FactorDepOnVehSpeed_XAU16_29___A "active damping factor depending on vehicle speed" CURVE 0x15C2C8 AblGLKLuw 2 RIGHTSH10NP 0 2 FORMAT "%8.6"
 /begin AXIS_DESCR STD_AXIS vVehSpI_AbsAvgVehSpd_xdu16 VFZHIGH 4 0 500 FORMAT "%8.4" DEPOSIT ABSOLUTE /end AXIS_DESCR
/end CHARACTERISTIC
/begin CHARACTERISTIC xActDamp_FactorDepOnVehSpeed_XAU16_30___A "active damping factor depending on vehicle speed" CURVE 0x15C2DC AblGLKLuw 2 RIGHTSH10NP 0 2 FORMAT "%8.6"
 /begin AXIS_DESCR STD_AXIS vVehSpI_AbsAvgVehSpd_xdu16 VFZHIGH 4 0 500 FORMAT "%8.4" DEPOSIT ABSOLUTE /end AXIS_DESCR
/end CHARACTERISTIC
/begin CHARACTERISTIC xActDamp_FactorDepOnVehSpeed_XAU16_31___A "active damping factor depending on vehicle speed" CURVE 0x15C2F0 AblGLKLuw 2 RIGHTSH10NP 0 2 FORMAT "%8.6"
 /begin AXIS_DESCR STD_AXIS vVehSpI_AbsAvgVehSpd_xdu16 VFZHIGH 4 0 500 FORMAT "%8.4" DEPOSIT ABSOLUTE /end AXIS_DESCR
/end CHARACTERISTIC
/begin CHARACTERISTIC xActDamp_FactorDepOnVehSpeed_XAU16_32___A "active damping factor depending on vehicle speed" CURVE 0x15C304 AblGLKLuw 2 RIGHTSH10NP 0 2 FORMAT "%8.6"
 /begin AXIS_DESCR STD_AXIS vVehSpI_AbsAvgVehSpd_xdu16 VFZHIGH 4 0 500 FORMAT "%8.4" DEPOSIT ABSOLUTE /end AXIS_DESCR
/end CHARACTERISTIC
/begin CHARACTERISTIC xActDamp_FactorDepOnVehSpeed_XAU16_33___A "active damping factor depending on vehicle speed" CURVE 0x15C318 AblGLKLuw 2 RIGHTSH10NP 0 2 FORMAT "%8.6"
 /begin AXIS_DESCR STD_AXIS vVehSpI_AbsAvgVehSpd_xdu16 VFZHIGH 4 0 500 FORMAT "%8.4" DEPOSIT ABSOLUTE /end AXIS_DESCR
/end CHARACTERISTIC
/begin CHARACTERISTIC xActDamp_FactorDepOnVehSpeed_XAU16_34___A "active damping factor depending on vehicle speed" CURVE 0x15C32C AblGLKLuw 2 RIGHTSH10NP 0 2 FORMAT "%8.6"
 /begin AXIS_DESCR STD_AXIS vVehSpI_AbsAvgVehSpd_xdu16 VFZHIGH 4 0 500 FORMAT "%8.4" DEPOSIT ABSOLUTE /end AXIS_DESCR
/end CHARACTERISTIC
/begin CHARACTERISTIC xActDamp_FactorDepOnVehSpeed_XAU16_35___A "active damping factor depending on vehicle speed" CURVE 0x15C340 AblGLKLuw 2 RIGHTSH10NP 0 2 FORMAT "%8.6"
 /begin AXIS_DESCR STD_AXIS vVehSpI_AbsAvgVehSpd_xdu16 VFZHIGH 4 0 500 FORMAT "%8.4" DEPOSIT ABSOLUTE /end AXIS_DESCR
/end CHARACTERISTIC
/begin CHARACTERISTIC xActDamp_FactorGrad_XDU16 "Maximum gradient of vehicle speed and steering angle dependent factor. Primarily done to ramp to substitute value. [factor/cycle] (BE AWARE: depends on CycleTime)" VALUE 0x150936 AblGLKWuw 0.999023 RIGHTSH10NP 0.0009765625 1 FORMAT "%8.6" /end CHARACTERISTIC
/begin CHARACTERISTIC xActDamp_TorqueDepOnRotorSpeed_XAU16_00___A "active damping torque depending on rotor speed" CURVE 0x15C354 AblGLKLuw 2 RIGHTSH10NP 0 2 FORMAT "%8.6"
 /begin AXIS_DESCR STD_AXIS nActDamp_AbsRotorSpeedFilt_xdu16 VROT 4 0 13000 FORMAT "%3.0" DEPOSIT ABSOLUTE /end AXIS_DESCR
/end CHARACTERISTIC
/begin CHARACTERISTIC xActDamp_TorqueDepOnRotorSpeed_XAU16_01___A "active damping torque depending on rotor speed" CURVE 0x15C368 AblGLKLuw 2 RIGHTSH10NP 0 2 FORMAT "%8.6"
 /begin AXIS_DESCR STD_AXIS nActDamp_AbsRotorSpeedFilt_xdu16 VROT 4 0 13000 FORMAT "%3.0" DEPOSIT ABSOLUTE /end AXIS_DESCR
/end CHARACTERISTIC
/begin CHARACTERISTIC xActDamp_TorqueDepOnRotorSpeed_XAU16_02___A "active damping torque depending on rotor speed" CURVE 0x15C37C AblGLKLuw 2 RIGHTSH10NP 0 2 FORMAT "%8.6"
 /begin AXIS_DESCR STD_AXIS nActDamp_AbsRotorSpeedFilt_xdu16 VROT 4 0 13000 FORMAT "%3.0" DEPOSIT ABSOLUTE /end AXIS_DESCR
/end CHARACTERISTIC
/begin CHARACTERISTIC xActDamp_TorqueDepOnRotorSpeed_XAU16_03___A "active damping torque depending on rotor speed" CURVE 0x15C390 AblGLKLuw 2 RIGHTSH10NP 0 2 FORMAT "%8.6"
 /begin AXIS_DESCR STD_AXIS nActDamp_AbsRotorSpeedFilt_xdu16 VROT 4 0 13000 FORMAT "%3.0" DEPOSIT ABSOLUTE /end AXIS_DESCR
/end CHARACTERISTIC
/begin CHARACTERISTIC xActDamp_TorqueDepOnRotorSpeed_XAU16_04___A "active damping torque depending on rotor speed" CURVE 0x15C3A4 AblGLKLuw 2 RIGHTSH10NP 0 2 FORMAT "%8.6"
 /begin AXIS_DESCR STD_AXIS nActDamp_AbsRotorSpeedFilt_xdu16 VROT 4 0 13000 FORMAT "%3.0" DEPOSIT ABSOLUTE /end AXIS_DESCR
/end CHARACTERISTIC
/begin CHARACTERISTIC xActDamp_TorqueDepOnRotorSpeed_XAU16_05___A "active damping torque depending on rotor speed" CURVE 0x15C3B8 AblGLKLuw 2 RIGHTSH10NP 0 2 FORMAT "%8.6"
 /begin AXIS_DESCR STD_AXIS nActDamp_AbsRotorSpeedFilt_xdu16 VROT 4 0 13000 FORMAT "%3.0" DEPOSIT ABSOLUTE /end AXIS_DESCR
/end CHARACTERISTIC
/begin CHARACTERISTIC xActDamp_TorqueDepOnRotorSpeed_XAU16_06___A "active damping torque depending on rotor speed" CURVE 0x15C3CC AblGLKLuw 2 RIGHTSH10NP 0 2 FORMAT "%8.6"
 /begin AXIS_DESCR STD_AXIS nActDamp_AbsRotorSpeedFilt_xdu16 VROT 4 0 13000 FORMAT "%3.0" DEPOSIT ABSOLUTE /end AXIS_DESCR
/end CHARACTERISTIC
/begin CHARACTERISTIC xActDamp_TorqueDepOnRotorSpeed_XAU16_07___A "active damping torque depending on rotor speed" CURVE 0x15C3E0 AblGLKLuw 2 RIGHTSH10NP 0 2 FORMAT "%8.6"
 /begin AXIS_DESCR STD_AXIS nActDamp_AbsRotorSpeedFilt_xdu16 VROT 4 0 13000 FORMAT "%3.0" DEPOSIT ABSOLUTE /end AXIS_DESCR
/end CHARACTERISTIC
/begin CHARACTERISTIC xActDamp_TorqueDepOnRotorSpeed_XAU16_08___A "active damping torque depending on rotor speed" CURVE 0x15C3F4 AblGLKLuw 2 RIGHTSH10NP 0 2 FORMAT "%8.6"
 /begin AXIS_DESCR STD_AXIS nActDamp_AbsRotorSpeedFilt_xdu16 VROT 4 0 13000 FORMAT "%3.0" DEPOSIT ABSOLUTE /end AXIS_DESCR
/end CHARACTERISTIC
/begin CHARACTERISTIC xActDamp_TorqueDepOnRotorSpeed_XAU16_09___A "active damping torque depending on rotor speed" CURVE 0x15C408 AblGLKLuw 2 RIGHTSH10NP 0 2 FORMAT "%8.6"
 /begin AXIS_DESCR STD_AXIS nActDamp_AbsRotorSpeedFilt_xdu16 VROT 4 0 13000 FORMAT "%3.0" DEPOSIT ABSOLUTE /end AXIS_DESCR
/end CHARACTERISTIC
/begin CHARACTERISTIC xActDamp_TorqueDepOnRotorSpeed_XAU16_10___A "active damping torque depending on rotor speed" CURVE 0x15C41C AblGLKLuw 2 RIGHTSH10NP 0 2 FORMAT "%8.6"
 /begin AXIS_DESCR STD_AXIS nActDamp_AbsRotorSpeedFilt_xdu16 VROT 4 0 13000 FORMAT "%3.0" DEPOSIT ABSOLUTE /end AXIS_DESCR
/end CHARACTERISTIC
/begin CHARACTERISTIC xActDamp_TorqueDepOnRotorSpeed_XAU16_11___A "active damping torque depending on rotor speed" CURVE 0x15C430 AblGLKLuw 2 RIGHTSH10NP 0 2 FORMAT "%8.6"
 /begin AXIS_DESCR STD_AXIS nActDamp_AbsRotorSpeedFilt_xdu16 VROT 4 0 13000 FORMAT "%3.0" DEPOSIT ABSOLUTE /end AXIS_DESCR
/end CHARACTERISTIC
/begin CHARACTERISTIC xActDamp_TorqueDepOnRotorSpeed_XAU16_12___A "active damping torque depending on rotor speed" CURVE 0x15C444 AblGLKLuw 2 RIGHTSH10NP 0 2 FORMAT "%8.6"
 /begin AXIS_DESCR STD_AXIS nActDamp_AbsRotorSpeedFilt_xdu16 VROT 4 0 13000 FORMAT "%3.0" DEPOSIT ABSOLUTE /end AXIS_DESCR
/end CHARACTERISTIC
/begin CHARACTERISTIC xActDamp_TorqueDepOnRotorSpeed_XAU16_13___A "active damping torque depending on rotor speed" CURVE 0x15C458 AblGLKLuw 2 RIGHTSH10NP 0 2 FORMAT "%8.6"
 /begin AXIS_DESCR STD_AXIS nActDamp_AbsRotorSpeedFilt_xdu16 VROT 4 0 13000 FORMAT "%3.0" DEPOSIT ABSOLUTE /end AXIS_DESCR
/end CHARACTERISTIC
/begin CHARACTERISTIC xActDamp_TorqueDepOnRotorSpeed_XAU16_14___A "active damping torque depending on rotor speed" CURVE 0x15C46C AblGLKLuw 2 RIGHTSH10NP 0 2 FORMAT "%8.6"
 /begin AXIS_DESCR STD_AXIS nActDamp_AbsRotorSpeedFilt_xdu16 VROT 4 0 13000 FORMAT "%3.0" DEPOSIT ABSOLUTE /end AXIS_DESCR
/end CHARACTERISTIC
/begin CHARACTERISTIC xActDamp_TorqueDepOnRotorSpeed_XAU16_15___A "active damping torque depending on rotor speed" CURVE 0x15C480 AblGLKLuw 2 RIGHTSH10NP 0 2 FORMAT "%8.6"
 /begin AXIS_DESCR STD_AXIS nActDamp_AbsRotorSpeedFilt_xdu16 VROT 4 0 13000 FORMAT "%3.0" DEPOSIT ABSOLUTE /end AXIS_DESCR
/end CHARACTERISTIC
/begin CHARACTERISTIC xActDamp_TorqueDepOnRotorSpeed_XAU16_16___A "active damping torque depending on rotor speed" CURVE 0x15C494 AblGLKLuw 2 RIGHTSH10NP 0 2 FORMAT "%8.6"
 /begin AXIS_DESCR STD_AXIS nActDamp_AbsRotorSpeedFilt_xdu16 VROT 4 0 13000 FORMAT "%3.0" DEPOSIT ABSOLUTE /end AXIS_DESCR
/end CHARACTERISTIC
/begin CHARACTERISTIC xActDamp_TorqueDepOnRotorSpeed_XAU16_17___A "active damping torque depending on rotor speed" CURVE 0x15C4A8 AblGLKLuw 2 RIGHTSH10NP 0 2 FORMAT "%8.6"
 /begin AXIS_DESCR STD_AXIS nActDamp_AbsRotorSpeedFilt_xdu16 VROT 4 0 13000 FORMAT "%3.0" DEPOSIT ABSOLUTE /end AXIS_DESCR
/end CHARACTERISTIC
/begin CHARACTERISTIC xActDamp_TorqueDepOnRotorSpeed_XAU16_18___A "active damping torque depending on rotor speed" CURVE 0x15C4BC AblGLKLuw 2 RIGHTSH10NP 0 2 FORMAT "%8.6"
 /begin AXIS_DESCR STD_AXIS nActDamp_AbsRotorSpeedFilt_xdu16 VROT 4 0 13000 FORMAT "%3.0" DEPOSIT ABSOLUTE /end AXIS_DESCR
/end CHARACTERISTIC
/begin CHARACTERISTIC xActDamp_TorqueDepOnRotorSpeed_XAU16_19___A "active damping torque depending on rotor speed" CURVE 0x15C4D0 AblGLKLuw 2 RIGHTSH10NP 0 2 FORMAT "%8.6"
 /begin AXIS_DESCR STD_AXIS nActDamp_AbsRotorSpeedFilt_xdu16 VROT 4 0 13000 FORMAT "%3.0" DEPOSIT ABSOLUTE /end AXIS_DESCR
/end CHARACTERISTIC
/begin CHARACTERISTIC xActDamp_TorqueDepOnRotorSpeed_XAU16_20___A "active damping torque depending on rotor speed" CURVE 0x15C4E4 AblGLKLuw 2 RIGHTSH10NP 0 2 FORMAT "%8.6"
 /begin AXIS_DESCR STD_AXIS nActDamp_AbsRotorSpeedFilt_xdu16 VROT 4 0 13000 FORMAT "%3.0" DEPOSIT ABSOLUTE /end AXIS_DESCR
/end CHARACTERISTIC
/begin CHARACTERISTIC xActDamp_TorqueDepOnRotorSpeed_XAU16_21___A "active damping torque depending on rotor speed" CURVE 0x15C4F8 AblGLKLuw 2 RIGHTSH10NP 0 2 FORMAT "%8.6"
 /begin AXIS_DESCR STD_AXIS nActDamp_AbsRotorSpeedFilt_xdu16 VROT 4 0 13000 FORMAT "%3.0" DEPOSIT ABSOLUTE /end AXIS_DESCR
/end CHARACTERISTIC
/begin CHARACTERISTIC xActDamp_TorqueDepOnRotorSpeed_XAU16_22___A "active damping torque depending on rotor speed" CURVE 0x15C50C AblGLKLuw 2 RIGHTSH10NP 0 2 FORMAT "%8.6"
 /begin AXIS_DESCR STD_AXIS nActDamp_AbsRotorSpeedFilt_xdu16 VROT 4 0 13000 FORMAT "%3.0" DEPOSIT ABSOLUTE /end AXIS_DESCR
/end CHARACTERISTIC
/begin CHARACTERISTIC xActDamp_TorqueDepOnRotorSpeed_XAU16_23___A "active damping torque depending on rotor speed" CURVE 0x15C520 AblGLKLuw 2 RIGHTSH10NP 0 2 FORMAT "%8.6"
 /begin AXIS_DESCR STD_AXIS nActDamp_AbsRotorSpeedFilt_xdu16 VROT 4 0 13000 FORMAT "%3.0" DEPOSIT ABSOLUTE /end AXIS_DESCR
/end CHARACTERISTIC
/begin CHARACTERISTIC xActDamp_TorqueDepOnRotorSpeed_XAU16_24___A "active damping torque depending on rotor speed" CURVE 0x15C534 AblGLKLuw 2 RIGHTSH10NP 0 2 FORMAT "%8.6"
 /begin AXIS_DESCR STD_AXIS nActDamp_AbsRotorSpeedFilt_xdu16 VROT 4 0 13000 FORMAT "%3.0" DEPOSIT ABSOLUTE /end AXIS_DESCR
/end CHARACTERISTIC
/begin CHARACTERISTIC xActDamp_TorqueDepOnRotorSpeed_XAU16_25___A "active damping torque depending on rotor speed" CURVE 0x15C548 AblGLKLuw 2 RIGHTSH10NP 0 2 FORMAT "%8.6"
 /begin AXIS_DESCR STD_AXIS nActDamp_AbsRotorSpeedFilt_xdu16 VROT 4 0 13000 FORMAT "%3.0" DEPOSIT ABSOLUTE /end AXIS_DESCR
/end CHARACTERISTIC
/begin CHARACTERISTIC xActDamp_TorqueDepOnRotorSpeed_XAU16_26___A "active damping torque depending on rotor speed" CURVE 0x15C55C AblGLKLuw 2 RIGHTSH10NP 0 2 FORMAT "%8.6"
 /begin AXIS_DESCR STD_AXIS nActDamp_AbsRotorSpeedFilt_xdu16 VROT 4 0 13000 FORMAT "%3.0" DEPOSIT ABSOLUTE /end AXIS_DESCR
/end CHARACTERISTIC
/begin CHARACTERISTIC xActDamp_TorqueDepOnRotorSpeed_XAU16_27___A "active damping torque depending on rotor speed" CURVE 0x15C570 AblGLKLuw 2 RIGHTSH10NP 0 2 FORMAT "%8.6"
 /begin AXIS_DESCR STD_AXIS nActDamp_AbsRotorSpeedFilt_xdu16 VROT 4 0 13000 FORMAT "%3.0" DEPOSIT ABSOLUTE /end AXIS_DESCR
/end CHARACTERISTIC
/begin CHARACTERISTIC xActDamp_TorqueDepOnRotorSpeed_XAU16_28___A "active damping torque depending on rotor speed" CURVE 0x15C584 AblGLKLuw 2 RIGHTSH10NP 0 2 FORMAT "%8.6"
 /begin AXIS_DESCR STD_AXIS nActDamp_AbsRotorSpeedFilt_xdu16 VROT 4 0 13000 FORMAT "%3.0" DEPOSIT ABSOLUTE /end AXIS_DESCR
/end CHARACTERISTIC
/begin CHARACTERISTIC xActDamp_TorqueDepOnRotorSpeed_XAU16_29___A "active damping torque depending on rotor speed" CURVE 0x15C598 AblGLKLuw 2 RIGHTSH10NP 0 2 FORMAT "%8.6"
 /begin AXIS_DESCR STD_AXIS nActDamp_AbsRotorSpeedFilt_xdu16 VROT 4 0 13000 FORMAT "%3.0" DEPOSIT ABSOLUTE /end AXIS_DESCR
/end CHARACTERISTIC
/begin CHARACTERISTIC xActDamp_TorqueDepOnRotorSpeed_XAU16_30___A "active damping torque depending on rotor speed" CURVE 0x15C5AC AblGLKLuw 2 RIGHTSH10NP 0 2 FORMAT "%8.6"
 /begin AXIS_DESCR STD_AXIS nActDamp_AbsRotorSpeedFilt_xdu16 VROT 4 0 13000 FORMAT "%3.0" DEPOSIT ABSOLUTE /end AXIS_DESCR
/end CHARACTERISTIC
/begin CHARACTERISTIC xActDamp_TorqueDepOnRotorSpeed_XAU16_31___A "active damping torque depending on rotor speed" CURVE 0x15C5C0 AblGLKLuw 2 RIGHTSH10NP 0 2 FORMAT "%8.6"
 /begin AXIS_DESCR STD_AXIS nActDamp_AbsRotorSpeedFilt_xdu16 VROT 4 0 13000 FORMAT "%3.0" DEPOSIT ABSOLUTE /end AXIS_DESCR
/end CHARACTERISTIC
/begin CHARACTERISTIC xActDamp_TorqueDepOnRotorSpeed_XAU16_32___A "active damping torque depending on rotor speed" CURVE 0x15C5D4 AblGLKLuw 2 RIGHTSH10NP 0 2 FORMAT "%8.6"
 /begin AXIS_DESCR STD_AXIS nActDamp_AbsRotorSpeedFilt_xdu16 VROT 4 0 13000 FORMAT "%3.0" DEPOSIT ABSOLUTE /end AXIS_DESCR
/end CHARACTERISTIC
/begin CHARACTERISTIC xActDamp_TorqueDepOnRotorSpeed_XAU16_33___A "active damping torque depending on rotor speed" CURVE 0x15C5E8 AblGLKLuw 2 RIGHTSH10NP 0 2 FORMAT "%8.6"
 /begin AXIS_DESCR STD_AXIS nActDamp_AbsRotorSpeedFilt_xdu16 VROT 4 0 13000 FORMAT "%3.0" DEPOSIT ABSOLUTE /end AXIS_DESCR
/end CHARACTERISTIC
/begin CHARACTERISTIC xActDamp_TorqueDepOnRotorSpeed_XAU16_34___A "active damping torque depending on rotor speed" CURVE 0x15C5FC AblGLKLuw 2 RIGHTSH10NP 0 2 FORMAT "%8.6"
 /begin AXIS_DESCR STD_AXIS nActDamp_AbsRotorSpeedFilt_xdu16 VROT 4 0 13000 FORMAT "%3.0" DEPOSIT ABSOLUTE /end AXIS_DESCR
/end CHARACTERISTIC
/begin CHARACTERISTIC xActDamp_TorqueDepOnRotorSpeed_XAU16_35___A "active damping torque depending on rotor speed" CURVE 0x15C610 AblGLKLuw 2 RIGHTSH10NP 0 2 FORMAT "%8.6"
 /begin AXIS_DESCR STD_AXIS nActDamp_AbsRotorSpeedFilt_xdu16 VROT 4 0 13000 FORMAT "%3.0" DEPOSIT ABSOLUTE /end AXIS_DESCR
/end CHARACTERISTIC
/begin CHARACTERISTIC xActIn_InertiaFact_XAS16_00___A "Fahrzeuggeschwindigkeitsabhängiger Faktor Trägheit" CURVE 0x15C624 AblGLKLsw 20 RIGHTSH10NP -10 10 FORMAT "%8.5"
 /begin AXIS_DESCR STD_AXIS vApplI_AbsVehicleSpeedFilt_xdu16 VFZHIGH 4 0 400 FORMAT "%8.4" DEPOSIT ABSOLUTE /end AXIS_DESCR
/end CHARACTERISTIC
/begin CHARACTERISTIC xActIn_InertiaFact_XAS16_01___A "Fahrzeuggeschwindigkeitsabhängiger Faktor Trägheit" CURVE 0x15C638 AblGLKLsw 20 RIGHTSH10NP -10 10 FORMAT "%8.5"
 /begin AXIS_DESCR STD_AXIS vApplI_AbsVehicleSpeedFilt_xdu16 VFZHIGH 4 0 400 FORMAT "%8.4" DEPOSIT ABSOLUTE /end AXIS_DESCR
/end CHARACTERISTIC
/begin CHARACTERISTIC xActIn_InertiaFact_XAS16_02___A "Fahrzeuggeschwindigkeitsabhängiger Faktor Trägheit" CURVE 0x15C64C AblGLKLsw 20 RIGHTSH10NP -10 10 FORMAT "%8.5"
 /begin AXIS_DESCR STD_AXIS vApplI_AbsVehicleSpeedFilt_xdu16 VFZHIGH 4 0 400 FORMAT "%8.4" DEPOSIT ABSOLUTE /end AXIS_DESCR
/end CHARACTERISTIC
/begin CHARACTERISTIC xActIn_InertiaFact_XAS16_03___A "Fahrzeuggeschwindigkeitsabhängiger Faktor Trägheit" CURVE 0x15C660 AblGLKLsw 20 RIGHTSH10NP -10 10 FORMAT "%8.5"
 /begin AXIS_DESCR STD_AXIS vApplI_AbsVehicleSpeedFilt_xdu16 VFZHIGH 4 0 400 FORMAT "%8.4" DEPOSIT ABSOLUTE /end AXIS_DESCR
/end CHARACTERISTIC
/begin CHARACTERISTIC xActIn_InertiaFact_XAS16_04___A "Fahrzeuggeschwindigkeitsabhängiger Faktor Trägheit" CURVE 0x15C674 AblGLKLsw 20 RIGHTSH10NP -10 10 FORMAT "%8.5"
 /begin AXIS_DESCR STD_AXIS vApplI_AbsVehicleSpeedFilt_xdu16 VFZHIGH 4 0 400 FORMAT "%8.4" DEPOSIT ABSOLUTE /end AXIS_DESCR
/end CHARACTERISTIC
/begin CHARACTERISTIC xActIn_InertiaFact_XAS16_05___A "Fahrzeuggeschwindigkeitsabhängiger Faktor Trägheit" CURVE 0x15C688 AblGLKLsw 20 RIGHTSH10NP -10 10 FORMAT "%8.5"
 /begin AXIS_DESCR STD_AXIS vApplI_AbsVehicleSpeedFilt_xdu16 VFZHIGH 4 0 400 FORMAT "%8.4" DEPOSIT ABSOLUTE /end AXIS_DESCR
/end CHARACTERISTIC
/begin CHARACTERISTIC xActIn_InertiaFact_XAS16_06___A "Fahrzeuggeschwindigkeitsabhängiger Faktor Trägheit" CURVE 0x15C69C AblGLKLsw 20 RIGHTSH10NP -10 10 FORMAT "%8.5"
 /begin AXIS_DESCR STD_AXIS vApplI_AbsVehicleSpeedFilt_xdu16 VFZHIGH 4 0 400 FORMAT "%8.4" DEPOSIT ABSOLUTE /end AXIS_DESCR
/end CHARACTERISTIC
/begin CHARACTERISTIC xActIn_InertiaFact_XAS16_07___A "Fahrzeuggeschwindigkeitsabhängiger Faktor Trägheit" CURVE 0x15C6B0 AblGLKLsw 20 RIGHTSH10NP -10 10 FORMAT "%8.5"
 /begin AXIS_DESCR STD_AXIS vApplI_AbsVehicleSpeedFilt_xdu16 VFZHIGH 4 0 400 FORMAT "%8.4" DEPOSIT ABSOLUTE /end AXIS_DESCR
/end CHARACTERISTIC
/begin CHARACTERISTIC xActIn_InertiaFact_XAS16_08___A "Fahrzeuggeschwindigkeitsabhängiger Faktor Trägheit" CURVE 0x15C6C4 AblGLKLsw 20 RIGHTSH10NP -10 10 FORMAT "%8.5"
 /begin AXIS_DESCR STD_AXIS vApplI_AbsVehicleSpeedFilt_xdu16 VFZHIGH 4 0 400 FORMAT "%8.4" DEPOSIT ABSOLUTE /end AXIS_DESCR
/end CHARACTERISTIC
/begin CHARACTERISTIC xActIn_InertiaFact_XAS16_09___A "Fahrzeuggeschwindigkeitsabhängiger Faktor Trägheit" CURVE 0x15C6D8 AblGLKLsw 20 RIGHTSH10NP -10 10 FORMAT "%8.5"
 /begin AXIS_DESCR STD_AXIS vApplI_AbsVehicleSpeedFilt_xdu16 VFZHIGH 4 0 400 FORMAT "%8.4" DEPOSIT ABSOLUTE /end AXIS_DESCR
/end CHARACTERISTIC
/begin CHARACTERISTIC xActIn_InertiaFact_XAS16_10___A "Fahrzeuggeschwindigkeitsabhängiger Faktor Trägheit" CURVE 0x15C6EC AblGLKLsw 20 RIGHTSH10NP -10 10 FORMAT "%8.5"
 /begin AXIS_DESCR STD_AXIS vApplI_AbsVehicleSpeedFilt_xdu16 VFZHIGH 4 0 400 FORMAT "%8.4" DEPOSIT ABSOLUTE /end AXIS_DESCR
/end CHARACTERISTIC
/begin CHARACTERISTIC xActIn_InertiaFact_XAS16_11___A "Fahrzeuggeschwindigkeitsabhängiger Faktor Trägheit" CURVE 0x15C700 AblGLKLsw 20 RIGHTSH10NP -10 10 FORMAT "%8.5"
 /begin AXIS_DESCR STD_AXIS vApplI_AbsVehicleSpeedFilt_xdu16 VFZHIGH 4 0 400 FORMAT "%8.4" DEPOSIT ABSOLUTE /end AXIS_DESCR
/end CHARACTERISTIC
/begin CHARACTERISTIC xActIn_InertiaFact_XAS16_12___A "Fahrzeuggeschwindigkeitsabhängiger Faktor Trägheit" CURVE 0x15C714 AblGLKLsw 20 RIGHTSH10NP -10 10 FORMAT "%8.5"
 /begin AXIS_DESCR STD_AXIS vApplI_AbsVehicleSpeedFilt_xdu16 VFZHIGH 4 0 400 FORMAT "%8.4" DEPOSIT ABSOLUTE /end AXIS_DESCR
/end CHARACTERISTIC
/begin CHARACTERISTIC xActIn_InertiaFact_XAS16_13___A "Fahrzeuggeschwindigkeitsabhängiger Faktor Trägheit" CURVE 0x15C728 AblGLKLsw 20 RIGHTSH10NP -10 10 FORMAT "%8.5"
 /begin AXIS_DESCR STD_AXIS vApplI_AbsVehicleSpeedFilt_xdu16 VFZHIGH 4 0 400 FORMAT "%8.4" DEPOSIT ABSOLUTE /end AXIS_DESCR
/end CHARACTERISTIC
/begin CHARACTERISTIC xActIn_InertiaFact_XAS16_14___A "Fahrzeuggeschwindigkeitsabhängiger Faktor Trägheit" CURVE 0x15C73C AblGLKLsw 20 RIGHTSH10NP -10 10 FORMAT "%8.5"
 /begin AXIS_DESCR STD_AXIS vApplI_AbsVehicleSpeedFilt_xdu16 VFZHIGH 4 0 400 FORMAT "%8.4" DEPOSIT ABSOLUTE /end AXIS_DESCR
/end CHARACTERISTIC
/begin CHARACTERISTIC xActIn_InertiaFact_XAS16_15___A "Fahrzeuggeschwindigkeitsabhängiger Faktor Trägheit" CURVE 0x15C750 AblGLKLsw 20 RIGHTSH10NP -10 10 FORMAT "%8.5"
 /begin AXIS_DESCR STD_AXIS vApplI_AbsVehicleSpeedFilt_xdu16 VFZHIGH 4 0 400 FORMAT "%8.4" DEPOSIT ABSOLUTE /end AXIS_DESCR
/end CHARACTERISTIC
/begin CHARACTERISTIC xActIn_InertiaFact_XAS16_16___A "Fahrzeuggeschwindigkeitsabhängiger Faktor Trägheit" CURVE 0x15C764 AblGLKLsw 20 RIGHTSH10NP -10 10 FORMAT "%8.5"
 /begin AXIS_DESCR STD_AXIS vApplI_AbsVehicleSpeedFilt_xdu16 VFZHIGH 4 0 400 FORMAT "%8.4" DEPOSIT ABSOLUTE /end AXIS_DESCR
/end CHARACTERISTIC
/begin CHARACTERISTIC xActIn_InertiaFact_XAS16_17___A "Fahrzeuggeschwindigkeitsabhängiger Faktor Trägheit" CURVE 0x15C778 AblGLKLsw 20 RIGHTSH10NP -10 10 FORMAT "%8.5"
 /begin AXIS_DESCR STD_AXIS vApplI_AbsVehicleSpeedFilt_xdu16 VFZHIGH 4 0 400 FORMAT "%8.4" DEPOSIT ABSOLUTE /end AXIS_DESCR
/end CHARACTERISTIC
/begin CHARACTERISTIC xActIn_InertiaFact_XAS16_18___A "Fahrzeuggeschwindigkeitsabhängiger Faktor Trägheit" CURVE 0x15C78C AblGLKLsw 20 RIGHTSH10NP -10 10 FORMAT "%8.5"
 /begin AXIS_DESCR STD_AXIS vApplI_AbsVehicleSpeedFilt_xdu16 VFZHIGH 4 0 400 FORMAT "%8.4" DEPOSIT ABSOLUTE /end AXIS_DESCR
/end CHARACTERISTIC
/begin CHARACTERISTIC xActIn_InertiaFact_XAS16_19___A "Fahrzeuggeschwindigkeitsabhängiger Faktor Trägheit" CURVE 0x15C7A0 AblGLKLsw 20 RIGHTSH10NP -10 10 FORMAT "%8.5"
 /begin AXIS_DESCR STD_AXIS vApplI_AbsVehicleSpeedFilt_xdu16 VFZHIGH 4 0 400 FORMAT "%8.4" DEPOSIT ABSOLUTE /end AXIS_DESCR
/end CHARACTERISTIC
/begin CHARACTERISTIC xActIn_InertiaFact_XAS16_20___A "Fahrzeuggeschwindigkeitsabhängiger Faktor Trägheit" CURVE 0x15C7B4 AblGLKLsw 20 RIGHTSH10NP -10 10 FORMAT "%8.5"
 /begin AXIS_DESCR STD_AXIS vApplI_AbsVehicleSpeedFilt_xdu16 VFZHIGH 4 0 400 FORMAT "%8.4" DEPOSIT ABSOLUTE /end AXIS_DESCR
/end CHARACTERISTIC
/begin CHARACTERISTIC xActIn_InertiaFact_XAS16_21___A "Fahrzeuggeschwindigkeitsabhängiger Faktor Trägheit" CURVE 0x15C7C8 AblGLKLsw 20 RIGHTSH10NP -10 10 FORMAT "%8.5"
 /begin AXIS_DESCR STD_AXIS vApplI_AbsVehicleSpeedFilt_xdu16 VFZHIGH 4 0 400 FORMAT "%8.4" DEPOSIT ABSOLUTE /end AXIS_DESCR
/end CHARACTERISTIC
/begin CHARACTERISTIC xActIn_InertiaFact_XAS16_22___A "Fahrzeuggeschwindigkeitsabhängiger Faktor Trägheit" CURVE 0x15C7DC AblGLKLsw 20 RIGHTSH10NP -10 10 FORMAT "%8.5"
 /begin AXIS_DESCR STD_AXIS vApplI_AbsVehicleSpeedFilt_xdu16 VFZHIGH 4 0 400 FORMAT "%8.4" DEPOSIT ABSOLUTE /end AXIS_DESCR
/end CHARACTERISTIC
/begin CHARACTERISTIC xActIn_InertiaFact_XAS16_23___A "Fahrzeuggeschwindigkeitsabhängiger Faktor Trägheit" CURVE 0x15C7F0 AblGLKLsw 20 RIGHTSH10NP -10 10 FORMAT "%8.5"
 /begin AXIS_DESCR STD_AXIS vApplI_AbsVehicleSpeedFilt_xdu16 VFZHIGH 4 0 400 FORMAT "%8.4" DEPOSIT ABSOLUTE /end AXIS_DESCR
/end CHARACTERISTIC
/begin CHARACTERISTIC xActIn_InertiaFact_XAS16_24___A "Fahrzeuggeschwindigkeitsabhängiger Faktor Trägheit" CURVE 0x15C804 AblGLKLsw 20 RIGHTSH10NP -10 10 FORMAT "%8.5"
 /begin AXIS_DESCR STD_AXIS vApplI_AbsVehicleSpeedFilt_xdu16 VFZHIGH 4 0 400 FORMAT "%8.4" DEPOSIT ABSOLUTE /end AXIS_DESCR
/end CHARACTERISTIC
/begin CHARACTERISTIC xActIn_InertiaFact_XAS16_25___A "Fahrzeuggeschwindigkeitsabhängiger Faktor Trägheit" CURVE 0x15C818 AblGLKLsw 20 RIGHTSH10NP -10 10 FORMAT "%8.5"
 /begin AXIS_DESCR STD_AXIS vApplI_AbsVehicleSpeedFilt_xdu16 VFZHIGH 4 0 400 FORMAT "%8.4" DEPOSIT ABSOLUTE /end AXIS_DESCR
/end CHARACTERISTIC
/begin CHARACTERISTIC xActIn_InertiaFact_XAS16_26___A "Fahrzeuggeschwindigkeitsabhängiger Faktor Trägheit" CURVE 0x15C82C AblGLKLsw 20 RIGHTSH10NP -10 10 FORMAT "%8.5"
 /begin AXIS_DESCR STD_AXIS vApplI_AbsVehicleSpeedFilt_xdu16 VFZHIGH 4 0 400 FORMAT "%8.4" DEPOSIT ABSOLUTE /end AXIS_DESCR
/end CHARACTERISTIC
/begin CHARACTERISTIC xActIn_InertiaFact_XAS16_27___A "Fahrzeuggeschwindigkeitsabhängiger Faktor Trägheit" CURVE 0x15C840 AblGLKLsw 20 RIGHTSH10NP -10 10 FORMAT "%8.5"
 /begin AXIS_DESCR STD_AXIS vApplI_AbsVehicleSpeedFilt_xdu16 VFZHIGH 4 0 400 FORMAT "%8.4" DEPOSIT ABSOLUTE /end AXIS_DESCR
/end CHARACTERISTIC
/begin CHARACTERISTIC xActIn_InertiaFact_XAS16_28___A "Fahrzeuggeschwindigkeitsabhängiger Faktor Trägheit" CURVE 0x15C854 AblGLKLsw 20 RIGHTSH10NP -10 10 FORMAT "%8.5"
 /begin AXIS_DESCR STD_AXIS vApplI_AbsVehicleSpeedFilt_xdu16 VFZHIGH 4 0 400 FORMAT "%8.4" DEPOSIT ABSOLUTE /end AXIS_DESCR
/end CHARACTERISTIC
/begin CHARACTERISTIC xActIn_InertiaFact_XAS16_29___A "Fahrzeuggeschwindigkeitsabhängiger Faktor Trägheit" CURVE 0x15C868 AblGLKLsw 20 RIGHTSH10NP -10 10 FORMAT "%8.5"
 /begin AXIS_DESCR STD_AXIS vApplI_AbsVehicleSpeedFilt_xdu16 VFZHIGH 4 0 400 FORMAT "%8.4" DEPOSIT ABSOLUTE /end AXIS_DESCR
/end CHARACTERISTIC
/begin CHARACTERISTIC xActIn_InertiaFact_XAS16_30___A "Fahrzeuggeschwindigkeitsabhängiger Faktor Trägheit" CURVE 0x15C87C AblGLKLsw 20 RIGHTSH10NP -10 10 FORMAT "%8.5"
 /begin AXIS_DESCR STD_AXIS vApplI_AbsVehicleSpeedFilt_xdu16 VFZHIGH 4 0 400 FORMAT "%8.4" DEPOSIT ABSOLUTE /end AXIS_DESCR
/end CHARACTERISTIC
/begin CHARACTERISTIC xActIn_InertiaFact_XAS16_31___A "Fahrzeuggeschwindigkeitsabhängiger Faktor Trägheit" CURVE 0x15C890 AblGLKLsw 20 RIGHTSH10NP -10 10 FORMAT "%8.5"
 /begin AXIS_DESCR STD_AXIS vApplI_AbsVehicleSpeedFilt_xdu16 VFZHIGH 4 0 400 FORMAT "%8.4" DEPOSIT ABSOLUTE /end AXIS_DESCR
/end CHARACTERISTIC
/begin CHARACTERISTIC xActIn_InertiaFact_XAS16_32___A "Fahrzeuggeschwindigkeitsabhängiger Faktor Trägheit" CURVE 0x15C8A4 AblGLKLsw 20 RIGHTSH10NP -10 10 FORMAT "%8.5"
 /begin AXIS_DESCR STD_AXIS vApplI_AbsVehicleSpeedFilt_xdu16 VFZHIGH 4 0 400 FORMAT "%8.4" DEPOSIT ABSOLUTE /end AXIS_DESCR
/end CHARACTERISTIC
/begin CHARACTERISTIC xActIn_InertiaFact_XAS16_33___A "Fahrzeuggeschwindigkeitsabhängiger Faktor Trägheit" CURVE 0x15C8B8 AblGLKLsw 20 RIGHTSH10NP -10 10 FORMAT "%8.5"
 /begin AXIS_DESCR STD_AXIS vApplI_AbsVehicleSpeedFilt_xdu16 VFZHIGH 4 0 400 FORMAT "%8.4" DEPOSIT ABSOLUTE /end AXIS_DESCR
/end CHARACTERISTIC
/begin CHARACTERISTIC xActIn_InertiaFact_XAS16_34___A "Fahrzeuggeschwindigkeitsabhängiger Faktor Trägheit" CURVE 0x15C8CC AblGLKLsw 20 RIGHTSH10NP -10 10 FORMAT "%8.5"
 /begin AXIS_DESCR STD_AXIS vApplI_AbsVehicleSpeedFilt_xdu16 VFZHIGH 4 0 400 FORMAT "%8.4" DEPOSIT ABSOLUTE /end AXIS_DESCR
/end CHARACTERISTIC
/begin CHARACTERISTIC xActIn_InertiaFact_XAS16_35___A "Fahrzeuggeschwindigkeitsabhängiger Faktor Trägheit" CURVE 0x15C8E0 AblGLKLsw 20 RIGHTSH10NP -10 10 FORMAT "%8.5"
 /begin AXIS_DESCR STD_AXIS vApplI_AbsVehicleSpeedFilt_xdu16 VFZHIGH 4 0 400 FORMAT "%8.4" DEPOSIT ABSOLUTE /end AXIS_DESCR
/end CHARACTERISTIC
/begin CHARACTERISTIC xActIn_InertiaTBT_XAU16_00___A "Drehstabmomentanabhängiger Faktor trägheit" CURVE 0x15C8F4 AblGLKLuw 1 RIGHTSH6NP 0 1 FORMAT "%8.6"
 /begin AXIS_DESCR STD_AXIS mApplI_AbsTorsionBarTorque_xdu16 TBTHIGH 4 0 8 FORMAT "%8.6" DEPOSIT ABSOLUTE /end AXIS_DESCR
/end CHARACTERISTIC
/begin CHARACTERISTIC xActIn_InertiaTBT_XAU16_01___A "Drehstabmomentanabhängiger Faktor trägheit" CURVE 0x15C908 AblGLKLuw 1 RIGHTSH6NP 0 1 FORMAT "%8.6"
 /begin AXIS_DESCR STD_AXIS mApplI_AbsTorsionBarTorque_xdu16 TBTHIGH 4 0 8 FORMAT "%8.6" DEPOSIT ABSOLUTE /end AXIS_DESCR
/end CHARACTERISTIC
/begin CHARACTERISTIC xActIn_InertiaTBT_XAU16_02___A "Drehstabmomentanabhängiger Faktor trägheit" CURVE 0x15C91C AblGLKLuw 1 RIGHTSH6NP 0 1 FORMAT "%8.6"
 /begin AXIS_DESCR STD_AXIS mApplI_AbsTorsionBarTorque_xdu16 TBTHIGH 4 0 8 FORMAT "%8.6" DEPOSIT ABSOLUTE /end AXIS_DESCR
/end CHARACTERISTIC
/begin CHARACTERISTIC xActIn_InertiaTBT_XAU16_03___A "Drehstabmomentanabhängiger Faktor trägheit" CURVE 0x15C930 AblGLKLuw 1 RIGHTSH6NP 0 1 FORMAT "%8.6"
 /begin AXIS_DESCR STD_AXIS mApplI_AbsTorsionBarTorque_xdu16 TBTHIGH 4 0 8 FORMAT "%8.6" DEPOSIT ABSOLUTE /end AXIS_DESCR
/end CHARACTERISTIC
/begin CHARACTERISTIC xActIn_InertiaTBT_XAU16_04___A "Drehstabmomentanabhängiger Faktor trägheit" CURVE 0x15C944 AblGLKLuw 1 RIGHTSH6NP 0 1 FORMAT "%8.6"
 /begin AXIS_DESCR STD_AXIS mApplI_AbsTorsionBarTorque_xdu16 TBTHIGH 4 0 8 FORMAT "%8.6" DEPOSIT ABSOLUTE /end AXIS_DESCR
/end CHARACTERISTIC
/begin CHARACTERISTIC xActIn_InertiaTBT_XAU16_05___A "Drehstabmomentanabhängiger Faktor trägheit" CURVE 0x15C958 AblGLKLuw 1 RIGHTSH6NP 0 1 FORMAT "%8.6"
 /begin AXIS_DESCR STD_AXIS mApplI_AbsTorsionBarTorque_xdu16 TBTHIGH 4 0 8 FORMAT "%8.6" DEPOSIT ABSOLUTE /end AXIS_DESCR
/end CHARACTERISTIC
/begin CHARACTERISTIC xActIn_InertiaTBT_XAU16_06___A "Drehstabmomentanabhängiger Faktor trägheit" CURVE 0x15C96C AblGLKLuw 1 RIGHTSH6NP 0 1 FORMAT "%8.6"
 /begin AXIS_DESCR STD_AXIS mApplI_AbsTorsionBarTorque_xdu16 TBTHIGH 4 0 8 FORMAT "%8.6" DEPOSIT ABSOLUTE /end AXIS_DESCR
/end CHARACTERISTIC
/begin CHARACTERISTIC xActIn_InertiaTBT_XAU16_07___A "Drehstabmomentanabhängiger Faktor trägheit" CURVE 0x15C980 AblGLKLuw 1 RIGHTSH6NP 0 1 FORMAT "%8.6"
 /begin AXIS_DESCR STD_AXIS mApplI_AbsTorsionBarTorque_xdu16 TBTHIGH 4 0 8 FORMAT "%8.6" DEPOSIT ABSOLUTE /end AXIS_DESCR
/end CHARACTERISTIC
/begin CHARACTERISTIC xActIn_InertiaTBT_XAU16_08___A "Drehstabmomentanabhängiger Faktor trägheit" CURVE 0x15C994 AblGLKLuw 1 RIGHTSH6NP 0 1 FORMAT "%8.6"
 /begin AXIS_DESCR STD_AXIS mApplI_AbsTorsionBarTorque_xdu16 TBTHIGH 4 0 8 FORMAT "%8.6" DEPOSIT ABSOLUTE /end AXIS_DESCR
/end CHARACTERISTIC
/begin CHARACTERISTIC xActIn_InertiaTBT_XAU16_09___A "Drehstabmomentanabhängiger Faktor trägheit" CURVE 0x15C9A8 AblGLKLuw 1 RIGHTSH6NP 0 1 FORMAT "%8.6"
 /begin AXIS_DESCR STD_AXIS mApplI_AbsTorsionBarTorque_xdu16 TBTHIGH 4 0 8 FORMAT "%8.6" DEPOSIT ABSOLUTE /end AXIS_DESCR
/end CHARACTERISTIC
/begin CHARACTERISTIC xActIn_InertiaTBT_XAU16_10___A "Drehstabmomentanabhängiger Faktor trägheit" CURVE 0x15C9BC AblGLKLuw 1 RIGHTSH6NP 0 1 FORMAT "%8.6"
 /begin AXIS_DESCR STD_AXIS mApplI_AbsTorsionBarTorque_xdu16 TBTHIGH 4 0 8 FORMAT "%8.6" DEPOSIT ABSOLUTE /end AXIS_DESCR
/end CHARACTERISTIC
/begin CHARACTERISTIC xActIn_InertiaTBT_XAU16_11___A "Drehstabmomentanabhängiger Faktor trägheit" CURVE 0x15C9D0 AblGLKLuw 1 RIGHTSH6NP 0 1 FORMAT "%8.6"
 /begin AXIS_DESCR STD_AXIS mApplI_AbsTorsionBarTorque_xdu16 TBTHIGH 4 0 8 FORMAT "%8.6" DEPOSIT ABSOLUTE /end AXIS_DESCR
/end CHARACTERISTIC
/begin CHARACTERISTIC xActIn_InertiaTBT_XAU16_12___A "Drehstabmomentanabhängiger Faktor trägheit" CURVE 0x15C9E4 AblGLKLuw 1 RIGHTSH6NP 0 1 FORMAT "%8.6"
 /begin AXIS_DESCR STD_AXIS mApplI_AbsTorsionBarTorque_xdu16 TBTHIGH 4 0 8 FORMAT "%8.6" DEPOSIT ABSOLUTE /end AXIS_DESCR
/end CHARACTERISTIC
/begin CHARACTERISTIC xActIn_InertiaTBT_XAU16_13___A "Drehstabmomentanabhängiger Faktor trägheit" CURVE 0x15C9F8 AblGLKLuw 1 RIGHTSH6NP 0 1 FORMAT "%8.6"
 /begin AXIS_DESCR STD_AXIS mApplI_AbsTorsionBarTorque_xdu16 TBTHIGH 4 0 8 FORMAT "%8.6" DEPOSIT ABSOLUTE /end AXIS_DESCR
/end CHARACTERISTIC
/begin CHARACTERISTIC xActIn_InertiaTBT_XAU16_14___A "Drehstabmomentanabhängiger Faktor trägheit" CURVE 0x15CA0C AblGLKLuw 1 RIGHTSH6NP 0 1 FORMAT "%8.6"
 /begin AXIS_DESCR STD_AXIS mApplI_AbsTorsionBarTorque_xdu16 TBTHIGH 4 0 8 FORMAT "%8.6" DEPOSIT ABSOLUTE /end AXIS_DESCR
/end CHARACTERISTIC
/begin CHARACTERISTIC xActIn_InertiaTBT_XAU16_15___A "Drehstabmomentanabhängiger Faktor trägheit" CURVE 0x15CA20 AblGLKLuw 1 RIGHTSH6NP 0 1 FORMAT "%8.6"
 /begin AXIS_DESCR STD_AXIS mApplI_AbsTorsionBarTorque_xdu16 TBTHIGH 4 0 8 FORMAT "%8.6" DEPOSIT ABSOLUTE /end AXIS_DESCR
/end CHARACTERISTIC
/begin CHARACTERISTIC xActIn_InertiaTBT_XAU16_16___A "Drehstabmomentanabhängiger Faktor trägheit" CURVE 0x15CA34 AblGLKLuw 1 RIGHTSH6NP 0 1 FORMAT "%8.6"
 /begin AXIS_DESCR STD_AXIS mApplI_AbsTorsionBarTorque_xdu16 TBTHIGH 4 0 8 FORMAT "%8.6" DEPOSIT ABSOLUTE /end AXIS_DESCR
/end CHARACTERISTIC
/begin CHARACTERISTIC xActIn_InertiaTBT_XAU16_17___A "Drehstabmomentanabhängiger Faktor trägheit" CURVE 0x15CA48 AblGLKLuw 1 RIGHTSH6NP 0 1 FORMAT "%8.6"
 /begin AXIS_DESCR STD_AXIS mApplI_AbsTorsionBarTorque_xdu16 TBTHIGH 4 0 8 FORMAT "%8.6" DEPOSIT ABSOLUTE /end AXIS_DESCR
/end CHARACTERISTIC
/begin CHARACTERISTIC xActIn_InertiaTBT_XAU16_18___A "Drehstabmomentanabhängiger Faktor trägheit" CURVE 0x15CA5C AblGLKLuw 1 RIGHTSH6NP 0 1 FORMAT "%8.6"
 /begin AXIS_DESCR STD_AXIS mApplI_AbsTorsionBarTorque_xdu16 TBTHIGH 4 0 8 FORMAT "%8.6" DEPOSIT ABSOLUTE /end AXIS_DESCR
/end CHARACTERISTIC
/begin CHARACTERISTIC xActIn_InertiaTBT_XAU16_19___A "Drehstabmomentanabhängiger Faktor trägheit" CURVE 0x15CA70 AblGLKLuw 1 RIGHTSH6NP 0 1 FORMAT "%8.6"
 /begin AXIS_DESCR STD_AXIS mApplI_AbsTorsionBarTorque_xdu16 TBTHIGH 4 0 8 FORMAT "%8.6" DEPOSIT ABSOLUTE /end AXIS_DESCR
/end CHARACTERISTIC
/begin CHARACTERISTIC xActIn_InertiaTBT_XAU16_20___A "Drehstabmomentanabhängiger Faktor trägheit" CURVE 0x15CA84 AblGLKLuw 1 RIGHTSH6NP 0 1 FORMAT "%8.6"
 /begin AXIS_DESCR STD_AXIS mApplI_AbsTorsionBarTorque_xdu16 TBTHIGH 4 0 8 FORMAT "%8.6" DEPOSIT ABSOLUTE /end AXIS_DESCR
/end CHARACTERISTIC
/begin CHARACTERISTIC xActIn_InertiaTBT_XAU16_21___A "Drehstabmomentanabhängiger Faktor trägheit" CURVE 0x15CA98 AblGLKLuw 1 RIGHTSH6NP 0 1 FORMAT "%8.6"
 /begin AXIS_DESCR STD_AXIS mApplI_AbsTorsionBarTorque_xdu16 TBTHIGH 4 0 8 FORMAT "%8.6" DEPOSIT ABSOLUTE /end AXIS_DESCR
/end CHARACTERISTIC
/begin CHARACTERISTIC xActIn_InertiaTBT_XAU16_22___A "Drehstabmomentanabhängiger Faktor trägheit" CURVE 0x15CAAC AblGLKLuw 1 RIGHTSH6NP 0 1 FORMAT "%8.6"
 /begin AXIS_DESCR STD_AXIS mApplI_AbsTorsionBarTorque_xdu16 TBTHIGH 4 0 8 FORMAT "%8.6" DEPOSIT ABSOLUTE /end AXIS_DESCR
/end CHARACTERISTIC
/begin CHARACTERISTIC xActIn_InertiaTBT_XAU16_23___A "Drehstabmomentanabhängiger Faktor trägheit" CURVE 0x15CAC0 AblGLKLuw 1 RIGHTSH6NP 0 1 FORMAT "%8.6"
 /begin AXIS_DESCR STD_AXIS mApplI_AbsTorsionBarTorque_xdu16 TBTHIGH 4 0 8 FORMAT "%8.6" DEPOSIT ABSOLUTE /end AXIS_DESCR
/end CHARACTERISTIC
/begin CHARACTERISTIC xActIn_InertiaTBT_XAU16_24___A "Drehstabmomentanabhängiger Faktor trägheit" CURVE 0x15CAD4 AblGLKLuw 1 RIGHTSH6NP 0 1 FORMAT "%8.6"
 /begin AXIS_DESCR STD_AXIS mApplI_AbsTorsionBarTorque_xdu16 TBTHIGH 4 0 8 FORMAT "%8.6" DEPOSIT ABSOLUTE /end AXIS_DESCR
/end CHARACTERISTIC
/begin CHARACTERISTIC xActIn_InertiaTBT_XAU16_25___A "Drehstabmomentanabhängiger Faktor trägheit" CURVE 0x15CAE8 AblGLKLuw 1 RIGHTSH6NP 0 1 FORMAT "%8.6"
 /begin AXIS_DESCR STD_AXIS mApplI_AbsTorsionBarTorque_xdu16 TBTHIGH 4 0 8 FORMAT "%8.6" DEPOSIT ABSOLUTE /end AXIS_DESCR
/end CHARACTERISTIC
/begin CHARACTERISTIC xActIn_InertiaTBT_XAU16_26___A "Drehstabmomentanabhängiger Faktor trägheit" CURVE 0x15CAFC AblGLKLuw 1 RIGHTSH6NP 0 1 FORMAT "%8.6"
 /begin AXIS_DESCR STD_AXIS mApplI_AbsTorsionBarTorque_xdu16 TBTHIGH 4 0 8 FORMAT "%8.6" DEPOSIT ABSOLUTE /end AXIS_DESCR
/end CHARACTERISTIC
/begin CHARACTERISTIC xActIn_InertiaTBT_XAU16_27___A "Drehstabmomentanabhängiger Faktor trägheit" CURVE 0x15CB10 AblGLKLuw 1 RIGHTSH6NP 0 1 FORMAT "%8.6"
 /begin AXIS_DESCR STD_AXIS mApplI_AbsTorsionBarTorque_xdu16 TBTHIGH 4 0 8 FORMAT "%8.6" DEPOSIT ABSOLUTE /end AXIS_DESCR
/end CHARACTERISTIC
/begin CHARACTERISTIC xActIn_InertiaTBT_XAU16_28___A "Drehstabmomentanabhängiger Faktor trägheit" CURVE 0x15CB24 AblGLKLuw 1 RIGHTSH6NP 0 1 FORMAT "%8.6"
 /begin AXIS_DESCR STD_AXIS mApplI_AbsTorsionBarTorque_xdu16 TBTHIGH 4 0 8 FORMAT "%8.6" DEPOSIT ABSOLUTE /end AXIS_DESCR
/end CHARACTERISTIC
/begin CHARACTERISTIC xActIn_InertiaTBT_XAU16_29___A "Drehstabmomentanabhängiger Faktor trägheit" CURVE 0x15CB38 AblGLKLuw 1 RIGHTSH6NP 0 1 FORMAT "%8.6"
 /begin AXIS_DESCR STD_AXIS mApplI_AbsTorsionBarTorque_xdu16 TBTHIGH 4 0 8 FORMAT "%8.6" DEPOSIT ABSOLUTE /end AXIS_DESCR
/end CHARACTERISTIC
/begin CHARACTERISTIC xActIn_InertiaTBT_XAU16_30___A "Drehstabmomentanabhängiger Faktor trägheit" CURVE 0x15CB4C AblGLKLuw 1 RIGHTSH6NP 0 1 FORMAT "%8.6"
 /begin AXIS_DESCR STD_AXIS mApplI_AbsTorsionBarTorque_xdu16 TBTHIGH 4 0 8 FORMAT "%8.6" DEPOSIT ABSOLUTE /end AXIS_DESCR
/end CHARACTERISTIC
/begin CHARACTERISTIC xActIn_InertiaTBT_XAU16_31___A "Drehstabmomentanabhängiger Faktor trägheit" CURVE 0x15CB60 AblGLKLuw 1 RIGHTSH6NP 0 1 FORMAT "%8.6"
 /begin AXIS_DESCR STD_AXIS mApplI_AbsTorsionBarTorque_xdu16 TBTHIGH 4 0 8 FORMAT "%8.6" DEPOSIT ABSOLUTE /end AXIS_DESCR
/end CHARACTERISTIC
/begin CHARACTERISTIC xActIn_InertiaTBT_XAU16_32___A "Drehstabmomentanabhängiger Faktor trägheit" CURVE 0x15CB74 AblGLKLuw 1 RIGHTSH6NP 0 1 FORMAT "%8.6"
 /begin AXIS_DESCR STD_AXIS mApplI_AbsTorsionBarTorque_xdu16 TBTHIGH 4 0 8 FORMAT "%8.6" DEPOSIT ABSOLUTE /end AXIS_DESCR
/end CHARACTERISTIC
/begin CHARACTERISTIC xActIn_InertiaTBT_XAU16_33___A "Drehstabmomentanabhängiger Faktor trägheit" CURVE 0x15CB88 AblGLKLuw 1 RIGHTSH6NP 0 1 FORMAT "%8.6"
 /begin AXIS_DESCR STD_AXIS mApplI_AbsTorsionBarTorque_xdu16 TBTHIGH 4 0 8 FORMAT "%8.6" DEPOSIT ABSOLUTE /end AXIS_DESCR
/end CHARACTERISTIC
/begin CHARACTERISTIC xActIn_InertiaTBT_XAU16_34___A "Drehstabmomentanabhängiger Faktor trägheit" CURVE 0x15CB9C AblGLKLuw 1 RIGHTSH6NP 0 1 FORMAT "%8.6"
 /begin AXIS_DESCR STD_AXIS mApplI_AbsTorsionBarTorque_xdu16 TBTHIGH 4 0 8 FORMAT "%8.6" DEPOSIT ABSOLUTE /end AXIS_DESCR
/end CHARACTERISTIC
/begin CHARACTERISTIC xActIn_InertiaTBT_XAU16_35___A "Drehstabmomentanabhängiger Faktor trägheit" CURVE 0x15CBB0 AblGLKLuw 1 RIGHTSH6NP 0 1 FORMAT "%8.6"
 /begin AXIS_DESCR STD_AXIS mApplI_AbsTorsionBarTorque_xdu16 TBTHIGH 4 0 8 FORMAT "%8.6" DEPOSIT ABSOLUTE /end AXIS_DESCR
/end CHARACTERISTIC
/begin CHARACTERISTIC xActRet_FilterFactor_XDU16_00___A "filter factor for filtrated nominal steering speed factor and motor torque factor" VALUE 0x1581B0 AblGLKWuw 0.990234 RIGHTSH10NP 0.009765625 1 FORMAT "%8.6" /end CHARACTERISTIC
/begin CHARACTERISTIC xActRet_FilterFactor_XDU16_01___A "filter factor for filtrated nominal steering speed factor and motor torque factor" VALUE 0x1581B2 AblGLKWuw 0.990234 RIGHTSH10NP 0.009765625 1 FORMAT "%8.6" /end CHARACTERISTIC
/begin CHARACTERISTIC xActRet_FilterFactor_XDU16_02___A "filter factor for filtrated nominal steering speed factor and motor torque factor" VALUE 0x1581B4 AblGLKWuw 0.990234 RIGHTSH10NP 0.009765625 1 FORMAT "%8.6" /end CHARACTERISTIC
/begin CHARACTERISTIC xActRet_FilterFactor_XDU16_03___A "filter factor for filtrated nominal steering speed factor and motor torque factor" VALUE 0x1581B6 AblGLKWuw 0.990234 RIGHTSH10NP 0.009765625 1 FORMAT "%8.6" /end CHARACTERISTIC
/begin CHARACTERISTIC xActRet_FilterFactor_XDU16_04___A "filter factor for filtrated nominal steering speed factor and motor torque factor" VALUE 0x1581B8 AblGLKWuw 0.990234 RIGHTSH10NP 0.009765625 1 FORMAT "%8.6" /end CHARACTERISTIC
/begin CHARACTERISTIC xActRet_FilterFactor_XDU16_05___A "filter factor for filtrated nominal steering speed factor and motor torque factor" VALUE 0x1581BA AblGLKWuw 0.990234 RIGHTSH10NP 0.009765625 1 FORMAT "%8.6" /end CHARACTERISTIC
/begin CHARACTERISTIC xActRet_FilterFactor_XDU16_06___A "filter factor for filtrated nominal steering speed factor and motor torque factor" VALUE 0x1581BC AblGLKWuw 0.990234 RIGHTSH10NP 0.009765625 1 FORMAT "%8.6" /end CHARACTERISTIC
/begin CHARACTERISTIC xActRet_FilterFactor_XDU16_07___A "filter factor for filtrated nominal steering speed factor and motor torque factor" VALUE 0x1581BE AblGLKWuw 0.990234 RIGHTSH10NP 0.009765625 1 FORMAT "%8.6" /end CHARACTERISTIC
/begin CHARACTERISTIC xActRet_FilterFactor_XDU16_08___A "filter factor for filtrated nominal steering speed factor and motor torque factor" VALUE 0x1581C0 AblGLKWuw 0.990234 RIGHTSH10NP 0.009765625 1 FORMAT "%8.6" /end CHARACTERISTIC
/begin CHARACTERISTIC xActRet_FilterFactor_XDU16_09___A "filter factor for filtrated nominal steering speed factor and motor torque factor" VALUE 0x1581C2 AblGLKWuw 0.990234 RIGHTSH10NP 0.009765625 1 FORMAT "%8.6" /end CHARACTERISTIC
/begin CHARACTERISTIC xActRet_FilterFactor_XDU16_10___A "filter factor for filtrated nominal steering speed factor and motor torque factor" VALUE 0x1581C4 AblGLKWuw 0.990234 RIGHTSH10NP 0.009765625 1 FORMAT "%8.6" /end CHARACTERISTIC
/begin CHARACTERISTIC xActRet_FilterFactor_XDU16_11___A "filter factor for filtrated nominal steering speed factor and motor torque factor" VALUE 0x1581C6 AblGLKWuw 0.990234 RIGHTSH10NP 0.009765625 1 FORMAT "%8.6" /end CHARACTERISTIC
/begin CHARACTERISTIC xActRet_FilterFactor_XDU16_12___A "filter factor for filtrated nominal steering speed factor and motor torque factor" VALUE 0x1581C8 AblGLKWuw 0.990234 RIGHTSH10NP 0.009765625 1 FORMAT "%8.6" /end CHARACTERISTIC
/begin CHARACTERISTIC xActRet_FilterFactor_XDU16_13___A "filter factor for filtrated nominal steering speed factor and motor torque factor" VALUE 0x1581CA AblGLKWuw 0.990234 RIGHTSH10NP 0.009765625 1 FORMAT "%8.6" /end CHARACTERISTIC
/begin CHARACTERISTIC xActRet_FilterFactor_XDU16_14___A "filter factor for filtrated nominal steering speed factor and motor torque factor" VALUE 0x1581CC AblGLKWuw 0.990234 RIGHTSH10NP 0.009765625 1 FORMAT "%8.6" /end CHARACTERISTIC
/begin CHARACTERISTIC xActRet_FilterFactor_XDU16_15___A "filter factor for filtrated nominal steering speed factor and motor torque factor" VALUE 0x1581CE AblGLKWuw 0.990234 RIGHTSH10NP 0.009765625 1 FORMAT "%8.6" /end CHARACTERISTIC
/begin CHARACTERISTIC xActRet_FilterFactor_XDU16_16___A "filter factor for filtrated nominal steering speed factor and motor torque factor" VALUE 0x1581D0 AblGLKWuw 0.990234 RIGHTSH10NP 0.009765625 1 FORMAT "%8.6" /end CHARACTERISTIC
/begin CHARACTERISTIC xActRet_FilterFactor_XDU16_17___A "filter factor for filtrated nominal steering speed factor and motor torque factor" VALUE 0x1581D2 AblGLKWuw 0.990234 RIGHTSH10NP 0.009765625 1 FORMAT "%8.6" /end CHARACTERISTIC
/begin CHARACTERISTIC xActRet_FilterFactor_XDU16_18___A "filter factor for filtrated nominal steering speed factor and motor torque factor" VALUE 0x1581D4 AblGLKWuw 0.990234 RIGHTSH10NP 0.009765625 1 FORMAT "%8.6" /end CHARACTERISTIC
/begin CHARACTERISTIC xActRet_FilterFactor_XDU16_19___A "filter factor for filtrated nominal steering speed factor and motor torque factor" VALUE 0x1581D6 AblGLKWuw 0.990234 RIGHTSH10NP 0.009765625 1 FORMAT "%8.6" /end CHARACTERISTIC
/begin CHARACTERISTIC xActRet_FilterFactor_XDU16_20___A "filter factor for filtrated nominal steering speed factor and motor torque factor" VALUE 0x1581D8 AblGLKWuw 0.990234 RIGHTSH10NP 0.009765625 1 FORMAT "%8.6" /end CHARACTERISTIC
/begin CHARACTERISTIC xActRet_FilterFactor_XDU16_21___A "filter factor for filtrated nominal steering speed factor and motor torque factor" VALUE 0x1581DA AblGLKWuw 0.990234 RIGHTSH10NP 0.009765625 1 FORMAT "%8.6" /end CHARACTERISTIC
/begin CHARACTERISTIC xActRet_FilterFactor_XDU16_22___A "filter factor for filtrated nominal steering speed factor and motor torque factor" VALUE 0x1581DC AblGLKWuw 0.990234 RIGHTSH10NP 0.009765625 1 FORMAT "%8.6" /end CHARACTERISTIC
/begin CHARACTERISTIC xActRet_FilterFactor_XDU16_23___A "filter factor for filtrated nominal steering speed factor and motor torque factor" VALUE 0x1581DE AblGLKWuw 0.990234 RIGHTSH10NP 0.009765625 1 FORMAT "%8.6" /end CHARACTERISTIC
/begin CHARACTERISTIC xActRet_FilterFactor_XDU16_24___A "filter factor for filtrated nominal steering speed factor and motor torque factor" VALUE 0x1581E0 AblGLKWuw 0.990234 RIGHTSH10NP 0.009765625 1 FORMAT "%8.6" /end CHARACTERISTIC
/begin CHARACTERISTIC xActRet_FilterFactor_XDU16_25___A "filter factor for filtrated nominal steering speed factor and motor torque factor" VALUE 0x1581E2 AblGLKWuw 0.990234 RIGHTSH10NP 0.009765625 1 FORMAT "%8.6" /end CHARACTERISTIC
/begin CHARACTERISTIC xActRet_FilterFactor_XDU16_26___A "filter factor for filtrated nominal steering speed factor and motor torque factor" VALUE 0x1581E4 AblGLKWuw 0.990234 RIGHTSH10NP 0.009765625 1 FORMAT "%8.6" /end CHARACTERISTIC
/begin CHARACTERISTIC xActRet_FilterFactor_XDU16_27___A "filter factor for filtrated nominal steering speed factor and motor torque factor" VALUE 0x1581E6 AblGLKWuw 0.990234 RIGHTSH10NP 0.009765625 1 FORMAT "%8.6" /end CHARACTERISTIC
/begin CHARACTERISTIC xActRet_FilterFactor_XDU16_28___A "filter factor for filtrated nominal steering speed factor and motor torque factor" VALUE 0x1581E8 AblGLKWuw 0.990234 RIGHTSH10NP 0.009765625 1 FORMAT "%8.6" /end CHARACTERISTIC
/begin CHARACTERISTIC xActRet_FilterFactor_XDU16_29___A "filter factor for filtrated nominal steering speed factor and motor torque factor" VALUE 0x1581EA AblGLKWuw 0.990234 RIGHTSH10NP 0.009765625 1 FORMAT "%8.6" /end CHARACTERISTIC
/begin CHARACTERISTIC xActRet_FilterFactor_XDU16_30___A "filter factor for filtrated nominal steering speed factor and motor torque factor" VALUE 0x1581EC AblGLKWuw 0.990234 RIGHTSH10NP 0.009765625 1 FORMAT "%8.6" /end CHARACTERISTIC
/begin CHARACTERISTIC xActRet_FilterFactor_XDU16_31___A "filter factor for filtrated nominal steering speed factor and motor torque factor" VALUE 0x1581EE AblGLKWuw 0.990234 RIGHTSH10NP 0.009765625 1 FORMAT "%8.6" /end CHARACTERISTIC
/begin CHARACTERISTIC xActRet_FilterFactor_XDU16_32___A "filter factor for filtrated nominal steering speed factor and motor torque factor" VALUE 0x1581F0 AblGLKWuw 0.990234 RIGHTSH10NP 0.009765625 1 FORMAT "%8.6" /end CHARACTERISTIC
/begin CHARACTERISTIC xActRet_FilterFactor_XDU16_33___A "filter factor for filtrated nominal steering speed factor and motor torque factor" VALUE 0x1581F2 AblGLKWuw 0.990234 RIGHTSH10NP 0.009765625 1 FORMAT "%8.6" /end CHARACTERISTIC
/begin CHARACTERISTIC xActRet_FilterFactor_XDU16_34___A "filter factor for filtrated nominal steering speed factor and motor torque factor" VALUE 0x1581F4 AblGLKWuw 0.990234 RIGHTSH10NP 0.009765625 1 FORMAT "%8.6" /end CHARACTERISTIC
/begin CHARACTERISTIC xActRet_FilterFactor_XDU16_35___A "filter factor for filtrated nominal steering speed factor and motor torque factor" VALUE 0x1581F6 AblGLKWuw 0.990234 RIGHTSH10NP 0.009765625 1 FORMAT "%8.6" /end CHARACTERISTIC
/begin CHARACTERISTIC xActRet_MotorTorqueGain_XAU16_00___A "motor torque factor" CURVE 0x15CBC4 AblGLKLuw 3 RIGHTSH10NP 0 3 FORMAT "%8.6"
 /begin AXIS_DESCR STD_AXIS vVehSpI_AbsAvgVehSpd_xdu16 VFZHIGH 6 0 250 FORMAT "%8.4" DEPOSIT ABSOLUTE /end AXIS_DESCR
/end CHARACTERISTIC
/begin CHARACTERISTIC xActRet_MotorTorqueGain_XAU16_01___A "motor torque factor" CURVE 0x15CBE0 AblGLKLuw 3 RIGHTSH10NP 0 3 FORMAT "%8.6"
 /begin AXIS_DESCR STD_AXIS vVehSpI_AbsAvgVehSpd_xdu16 VFZHIGH 6 0 250 FORMAT "%8.4" DEPOSIT ABSOLUTE /end AXIS_DESCR
/end CHARACTERISTIC
/begin CHARACTERISTIC xActRet_MotorTorqueGain_XAU16_02___A "motor torque factor" CURVE 0x15CBFC AblGLKLuw 3 RIGHTSH10NP 0 3 FORMAT "%8.6"
 /begin AXIS_DESCR STD_AXIS vVehSpI_AbsAvgVehSpd_xdu16 VFZHIGH 6 0 250 FORMAT "%8.4" DEPOSIT ABSOLUTE /end AXIS_DESCR
/end CHARACTERISTIC
/begin CHARACTERISTIC xActRet_MotorTorqueGain_XAU16_03___A "motor torque factor" CURVE 0x15CC18 AblGLKLuw 3 RIGHTSH10NP 0 3 FORMAT "%8.6"
 /begin AXIS_DESCR STD_AXIS vVehSpI_AbsAvgVehSpd_xdu16 VFZHIGH 6 0 250 FORMAT "%8.4" DEPOSIT ABSOLUTE /end AXIS_DESCR
/end CHARACTERISTIC
/begin CHARACTERISTIC xActRet_MotorTorqueGain_XAU16_04___A "motor torque factor" CURVE 0x15CC34 AblGLKLuw 3 RIGHTSH10NP 0 3 FORMAT "%8.6"
 /begin AXIS_DESCR STD_AXIS vVehSpI_AbsAvgVehSpd_xdu16 VFZHIGH 6 0 250 FORMAT "%8.4" DEPOSIT ABSOLUTE /end AXIS_DESCR
/end CHARACTERISTIC
/begin CHARACTERISTIC xActRet_MotorTorqueGain_XAU16_05___A "motor torque factor" CURVE 0x15CC50 AblGLKLuw 3 RIGHTSH10NP 0 3 FORMAT "%8.6"
 /begin AXIS_DESCR STD_AXIS vVehSpI_AbsAvgVehSpd_xdu16 VFZHIGH 6 0 250 FORMAT "%8.4" DEPOSIT ABSOLUTE /end AXIS_DESCR
/end CHARACTERISTIC
/begin CHARACTERISTIC xActRet_MotorTorqueGain_XAU16_06___A "motor torque factor" CURVE 0x15CC6C AblGLKLuw 3 RIGHTSH10NP 0 3 FORMAT "%8.6"
 /begin AXIS_DESCR STD_AXIS vVehSpI_AbsAvgVehSpd_xdu16 VFZHIGH 6 0 250 FORMAT "%8.4" DEPOSIT ABSOLUTE /end AXIS_DESCR
/end CHARACTERISTIC
/begin CHARACTERISTIC xActRet_MotorTorqueGain_XAU16_07___A "motor torque factor" CURVE 0x15CC88 AblGLKLuw 3 RIGHTSH10NP 0 3 FORMAT "%8.6"
 /begin AXIS_DESCR STD_AXIS vVehSpI_AbsAvgVehSpd_xdu16 VFZHIGH 6 0 250 FORMAT "%8.4" DEPOSIT ABSOLUTE /end AXIS_DESCR
/end CHARACTERISTIC
/begin CHARACTERISTIC xActRet_MotorTorqueGain_XAU16_08___A "motor torque factor" CURVE 0x15CCA4 AblGLKLuw 3 RIGHTSH10NP 0 3 FORMAT "%8.6"
 /begin AXIS_DESCR STD_AXIS vVehSpI_AbsAvgVehSpd_xdu16 VFZHIGH 6 0 250 FORMAT "%8.4" DEPOSIT ABSOLUTE /end AXIS_DESCR
/end CHARACTERISTIC
/begin CHARACTERISTIC xActRet_MotorTorqueGain_XAU16_09___A "motor torque factor" CURVE 0x15CCC0 AblGLKLuw 3 RIGHTSH10NP 0 3 FORMAT "%8.6"
 /begin AXIS_DESCR STD_AXIS vVehSpI_AbsAvgVehSpd_xdu16 VFZHIGH 6 0 250 FORMAT "%8.4" DEPOSIT ABSOLUTE /end AXIS_DESCR
/end CHARACTERISTIC
/begin CHARACTERISTIC xActRet_MotorTorqueGain_XAU16_10___A "motor torque factor" CURVE 0x15CCDC AblGLKLuw 3 RIGHTSH10NP 0 3 FORMAT "%8.6"
 /begin AXIS_DESCR STD_AXIS vVehSpI_AbsAvgVehSpd_xdu16 VFZHIGH 6 0 250 FORMAT "%8.4" DEPOSIT ABSOLUTE /end AXIS_DESCR
/end CHARACTERISTIC
/begin CHARACTERISTIC xActRet_MotorTorqueGain_XAU16_11___A "motor torque factor" CURVE 0x15CCF8 AblGLKLuw 3 RIGHTSH10NP 0 3 FORMAT "%8.6"
 /begin AXIS_DESCR STD_AXIS vVehSpI_AbsAvgVehSpd_xdu16 VFZHIGH 6 0 250 FORMAT "%8.4" DEPOSIT ABSOLUTE /end AXIS_DESCR
/end CHARACTERISTIC
/begin CHARACTERISTIC xActRet_MotorTorqueGain_XAU16_12___A "motor torque factor" CURVE 0x15CD14 AblGLKLuw 3 RIGHTSH10NP 0 3 FORMAT "%8.6"
 /begin AXIS_DESCR STD_AXIS vVehSpI_AbsAvgVehSpd_xdu16 VFZHIGH 6 0 250 FORMAT "%8.4" DEPOSIT ABSOLUTE /end AXIS_DESCR
/end CHARACTERISTIC
/begin CHARACTERISTIC xActRet_MotorTorqueGain_XAU16_13___A "motor torque factor" CURVE 0x15CD30 AblGLKLuw 3 RIGHTSH10NP 0 3 FORMAT "%8.6"
 /begin AXIS_DESCR STD_AXIS vVehSpI_AbsAvgVehSpd_xdu16 VFZHIGH 6 0 250 FORMAT "%8.4" DEPOSIT ABSOLUTE /end AXIS_DESCR
/end CHARACTERISTIC
/begin CHARACTERISTIC xActRet_MotorTorqueGain_XAU16_14___A "motor torque factor" CURVE 0x15CD4C AblGLKLuw 3 RIGHTSH10NP 0 3 FORMAT "%8.6"
 /begin AXIS_DESCR STD_AXIS vVehSpI_AbsAvgVehSpd_xdu16 VFZHIGH 6 0 250 FORMAT "%8.4" DEPOSIT ABSOLUTE /end AXIS_DESCR
/end CHARACTERISTIC
/begin CHARACTERISTIC xActRet_MotorTorqueGain_XAU16_15___A "motor torque factor" CURVE 0x15CD68 AblGLKLuw 3 RIGHTSH10NP 0 3 FORMAT "%8.6"
 /begin AXIS_DESCR STD_AXIS vVehSpI_AbsAvgVehSpd_xdu16 VFZHIGH 6 0 250 FORMAT "%8.4" DEPOSIT ABSOLUTE /end AXIS_DESCR
/end CHARACTERISTIC
/begin CHARACTERISTIC xActRet_MotorTorqueGain_XAU16_16___A "motor torque factor" CURVE 0x15CD84 AblGLKLuw 3 RIGHTSH10NP 0 3 FORMAT "%8.6"
 /begin AXIS_DESCR STD_AXIS vVehSpI_AbsAvgVehSpd_xdu16 VFZHIGH 6 0 250 FORMAT "%8.4" DEPOSIT ABSOLUTE /end AXIS_DESCR
/end CHARACTERISTIC
/begin CHARACTERISTIC xActRet_MotorTorqueGain_XAU16_17___A "motor torque factor" CURVE 0x15CDA0 AblGLKLuw 3 RIGHTSH10NP 0 3 FORMAT "%8.6"
 /begin AXIS_DESCR STD_AXIS vVehSpI_AbsAvgVehSpd_xdu16 VFZHIGH 6 0 250 FORMAT "%8.4" DEPOSIT ABSOLUTE /end AXIS_DESCR
/end CHARACTERISTIC
/begin CHARACTERISTIC xActRet_MotorTorqueGain_XAU16_18___A "motor torque factor" CURVE 0x15CDBC AblGLKLuw 3 RIGHTSH10NP 0 3 FORMAT "%8.6"
 /begin AXIS_DESCR STD_AXIS vVehSpI_AbsAvgVehSpd_xdu16 VFZHIGH 6 0 250 FORMAT "%8.4" DEPOSIT ABSOLUTE /end AXIS_DESCR
/end CHARACTERISTIC
/begin CHARACTERISTIC xActRet_MotorTorqueGain_XAU16_19___A "motor torque factor" CURVE 0x15CDD8 AblGLKLuw 3 RIGHTSH10NP 0 3 FORMAT "%8.6"
 /begin AXIS_DESCR STD_AXIS vVehSpI_AbsAvgVehSpd_xdu16 VFZHIGH 6 0 250 FORMAT "%8.4" DEPOSIT ABSOLUTE /end AXIS_DESCR
/end CHARACTERISTIC
/begin CHARACTERISTIC xActRet_MotorTorqueGain_XAU16_20___A "motor torque factor" CURVE 0x15CDF4 AblGLKLuw 3 RIGHTSH10NP 0 3 FORMAT "%8.6"
 /begin AXIS_DESCR STD_AXIS vVehSpI_AbsAvgVehSpd_xdu16 VFZHIGH 6 0 250 FORMAT "%8.4" DEPOSIT ABSOLUTE /end AXIS_DESCR
/end CHARACTERISTIC
/begin CHARACTERISTIC xActRet_MotorTorqueGain_XAU16_21___A "motor torque factor" CURVE 0x15CE10 AblGLKLuw 3 RIGHTSH10NP 0 3 FORMAT "%8.6"
 /begin AXIS_DESCR STD_AXIS vVehSpI_AbsAvgVehSpd_xdu16 VFZHIGH 6 0 250 FORMAT "%8.4" DEPOSIT ABSOLUTE /end AXIS_DESCR
/end CHARACTERISTIC
/begin CHARACTERISTIC xActRet_MotorTorqueGain_XAU16_22___A "motor torque factor" CURVE 0x15CE2C AblGLKLuw 3 RIGHTSH10NP 0 3 FORMAT "%8.6"
 /begin AXIS_DESCR STD_AXIS vVehSpI_AbsAvgVehSpd_xdu16 VFZHIGH 6 0 250 FORMAT "%8.4" DEPOSIT ABSOLUTE /end AXIS_DESCR
/end CHARACTERISTIC
/begin CHARACTERISTIC xActRet_MotorTorqueGain_XAU16_23___A "motor torque factor" CURVE 0x15CE48 AblGLKLuw 3 RIGHTSH10NP 0 3 FORMAT "%8.6"
 /begin AXIS_DESCR STD_AXIS vVehSpI_AbsAvgVehSpd_xdu16 VFZHIGH 6 0 250 FORMAT "%8.4" DEPOSIT ABSOLUTE /end AXIS_DESCR
/end CHARACTERISTIC
/begin CHARACTERISTIC xActRet_MotorTorqueGain_XAU16_24___A "motor torque factor" CURVE 0x15CE64 AblGLKLuw 3 RIGHTSH10NP 0 3 FORMAT "%8.6"
 /begin AXIS_DESCR STD_AXIS vVehSpI_AbsAvgVehSpd_xdu16 VFZHIGH 6 0 250 FORMAT "%8.4" DEPOSIT ABSOLUTE /end AXIS_DESCR
/end CHARACTERISTIC
/begin CHARACTERISTIC xActRet_MotorTorqueGain_XAU16_25___A "motor torque factor" CURVE 0x15CE80 AblGLKLuw 3 RIGHTSH10NP 0 3 FORMAT "%8.6"
 /begin AXIS_DESCR STD_AXIS vVehSpI_AbsAvgVehSpd_xdu16 VFZHIGH 6 0 250 FORMAT "%8.4" DEPOSIT ABSOLUTE /end AXIS_DESCR
/end CHARACTERISTIC
/begin CHARACTERISTIC xActRet_MotorTorqueGain_XAU16_26___A "motor torque factor" CURVE 0x15CE9C AblGLKLuw 3 RIGHTSH10NP 0 3 FORMAT "%8.6"
 /begin AXIS_DESCR STD_AXIS vVehSpI_AbsAvgVehSpd_xdu16 VFZHIGH 6 0 250 FORMAT "%8.4" DEPOSIT ABSOLUTE /end AXIS_DESCR
/end CHARACTERISTIC
/begin CHARACTERISTIC xActRet_MotorTorqueGain_XAU16_27___A "motor torque factor" CURVE 0x15CEB8 AblGLKLuw 3 RIGHTSH10NP 0 3 FORMAT "%8.6"
 /begin AXIS_DESCR STD_AXIS vVehSpI_AbsAvgVehSpd_xdu16 VFZHIGH 6 0 250 FORMAT "%8.4" DEPOSIT ABSOLUTE /end AXIS_DESCR
/end CHARACTERISTIC
/begin CHARACTERISTIC xActRet_MotorTorqueGain_XAU16_28___A "motor torque factor" CURVE 0x15CED4 AblGLKLuw 3 RIGHTSH10NP 0 3 FORMAT "%8.6"
 /begin AXIS_DESCR STD_AXIS vVehSpI_AbsAvgVehSpd_xdu16 VFZHIGH 6 0 250 FORMAT "%8.4" DEPOSIT ABSOLUTE /end AXIS_DESCR
/end CHARACTERISTIC
/begin CHARACTERISTIC xActRet_MotorTorqueGain_XAU16_29___A "motor torque factor" CURVE 0x15CEF0 AblGLKLuw 3 RIGHTSH10NP 0 3 FORMAT "%8.6"
 /begin AXIS_DESCR STD_AXIS vVehSpI_AbsAvgVehSpd_xdu16 VFZHIGH 6 0 250 FORMAT "%8.4" DEPOSIT ABSOLUTE /end AXIS_DESCR
/end CHARACTERISTIC
/begin CHARACTERISTIC xActRet_MotorTorqueGain_XAU16_30___A "motor torque factor" CURVE 0x15CF0C AblGLKLuw 3 RIGHTSH10NP 0 3 FORMAT "%8.6"
 /begin AXIS_DESCR STD_AXIS vVehSpI_AbsAvgVehSpd_xdu16 VFZHIGH 6 0 250 FORMAT "%8.4" DEPOSIT ABSOLUTE /end AXIS_DESCR
/end CHARACTERISTIC
/begin CHARACTERISTIC xActRet_MotorTorqueGain_XAU16_31___A "motor torque factor" CURVE 0x15CF28 AblGLKLuw 3 RIGHTSH10NP 0 3 FORMAT "%8.6"
 /begin AXIS_DESCR STD_AXIS vVehSpI_AbsAvgVehSpd_xdu16 VFZHIGH 6 0 250 FORMAT "%8.4" DEPOSIT ABSOLUTE /end AXIS_DESCR
/end CHARACTERISTIC
/begin CHARACTERISTIC xActRet_MotorTorqueGain_XAU16_32___A "motor torque factor" CURVE 0x15CF44 AblGLKLuw 3 RIGHTSH10NP 0 3 FORMAT "%8.6"
 /begin AXIS_DESCR STD_AXIS vVehSpI_AbsAvgVehSpd_xdu16 VFZHIGH 6 0 250 FORMAT "%8.4" DEPOSIT ABSOLUTE /end AXIS_DESCR
/end CHARACTERISTIC
/begin CHARACTERISTIC xActRet_MotorTorqueGain_XAU16_33___A "motor torque factor" CURVE 0x15CF60 AblGLKLuw 3 RIGHTSH10NP 0 3 FORMAT "%8.6"
 /begin AXIS_DESCR STD_AXIS vVehSpI_AbsAvgVehSpd_xdu16 VFZHIGH 6 0 250 FORMAT "%8.4" DEPOSIT ABSOLUTE /end AXIS_DESCR
/end CHARACTERISTIC
/begin CHARACTERISTIC xActRet_MotorTorqueGain_XAU16_34___A "motor torque factor" CURVE 0x15CF7C AblGLKLuw 3 RIGHTSH10NP 0 3 FORMAT "%8.6"
 /begin AXIS_DESCR STD_AXIS vVehSpI_AbsAvgVehSpd_xdu16 VFZHIGH 6 0 250 FORMAT "%8.4" DEPOSIT ABSOLUTE /end AXIS_DESCR
/end CHARACTERISTIC
/begin CHARACTERISTIC xActRet_MotorTorqueGain_XAU16_35___A "motor torque factor" CURVE 0x15CF98 AblGLKLuw 3 RIGHTSH10NP 0 3 FORMAT "%8.6"
 /begin AXIS_DESCR STD_AXIS vVehSpI_AbsAvgVehSpd_xdu16 VFZHIGH 6 0 250 FORMAT "%8.4" DEPOSIT ABSOLUTE /end AXIS_DESCR
/end CHARACTERISTIC
/begin CHARACTERISTIC xActRet_RetTorqueFactDepOnDriver_XAU16_00___A "factor of active return motor torque (after limitation) depending on driver torque" CURVE 0x15CFB4 AblGLKLuw 1 RIGHTSH10NP 0 1 FORMAT "%8.6"
 /begin AXIS_DESCR STD_AXIS mApplI_AbsDriverTorque_xdu16 TBTHIGH 6 0 25 FORMAT "%8.5" DEPOSIT ABSOLUTE /end AXIS_DESCR
/end CHARACTERISTIC
/begin CHARACTERISTIC xActRet_RetTorqueFactDepOnDriver_XAU16_01___A "factor of active return motor torque (after limitation) depending on driver torque" CURVE 0x15CFD0 AblGLKLuw 1 RIGHTSH10NP 0 1 FORMAT "%8.6"
 /begin AXIS_DESCR STD_AXIS mApplI_AbsDriverTorque_xdu16 TBTHIGH 6 0 25 FORMAT "%8.5" DEPOSIT ABSOLUTE /end AXIS_DESCR
/end CHARACTERISTIC
/begin CHARACTERISTIC xActRet_RetTorqueFactDepOnDriver_XAU16_02___A "factor of active return motor torque (after limitation) depending on driver torque" CURVE 0x15CFEC AblGLKLuw 1 RIGHTSH10NP 0 1 FORMAT "%8.6"
 /begin AXIS_DESCR STD_AXIS mApplI_AbsDriverTorque_xdu16 TBTHIGH 6 0 25 FORMAT "%8.5" DEPOSIT ABSOLUTE /end AXIS_DESCR
/end CHARACTERISTIC
/begin CHARACTERISTIC xActRet_RetTorqueFactDepOnDriver_XAU16_03___A "factor of active return motor torque (after limitation) depending on driver torque" CURVE 0x15D008 AblGLKLuw 1 RIGHTSH10NP 0 1 FORMAT "%8.6"
 /begin AXIS_DESCR STD_AXIS mApplI_AbsDriverTorque_xdu16 TBTHIGH 6 0 25 FORMAT "%8.5" DEPOSIT ABSOLUTE /end AXIS_DESCR
/end CHARACTERISTIC
/begin CHARACTERISTIC xActRet_RetTorqueFactDepOnDriver_XAU16_04___A "factor of active return motor torque (after limitation) depending on driver torque" CURVE 0x15D024 AblGLKLuw 1 RIGHTSH10NP 0 1 FORMAT "%8.6"
 /begin AXIS_DESCR STD_AXIS mApplI_AbsDriverTorque_xdu16 TBTHIGH 6 0 25 FORMAT "%8.5" DEPOSIT ABSOLUTE /end AXIS_DESCR
/end CHARACTERISTIC
/begin CHARACTERISTIC xActRet_RetTorqueFactDepOnDriver_XAU16_05___A "factor of active return motor torque (after limitation) depending on driver torque" CURVE 0x15D040 AblGLKLuw 1 RIGHTSH10NP 0 1 FORMAT "%8.6"
 /begin AXIS_DESCR STD_AXIS mApplI_AbsDriverTorque_xdu16 TBTHIGH 6 0 25 FORMAT "%8.5" DEPOSIT ABSOLUTE /end AXIS_DESCR
/end CHARACTERISTIC
/begin CHARACTERISTIC xActRet_RetTorqueFactDepOnDriver_XAU16_06___A "factor of active return motor torque (after limitation) depending on driver torque" CURVE 0x15D05C AblGLKLuw 1 RIGHTSH10NP 0 1 FORMAT "%8.6"
 /begin AXIS_DESCR STD_AXIS mApplI_AbsDriverTorque_xdu16 TBTHIGH 6 0 25 FORMAT "%8.5" DEPOSIT ABSOLUTE /end AXIS_DESCR
/end CHARACTERISTIC
/begin CHARACTERISTIC xActRet_RetTorqueFactDepOnDriver_XAU16_07___A "factor of active return motor torque (after limitation) depending on driver torque" CURVE 0x15D078 AblGLKLuw 1 RIGHTSH10NP 0 1 FORMAT "%8.6"
 /begin AXIS_DESCR STD_AXIS mApplI_AbsDriverTorque_xdu16 TBTHIGH 6 0 25 FORMAT "%8.5" DEPOSIT ABSOLUTE /end AXIS_DESCR
/end CHARACTERISTIC
/begin CHARACTERISTIC xActRet_RetTorqueFactDepOnDriver_XAU16_08___A "factor of active return motor torque (after limitation) depending on driver torque" CURVE 0x15D094 AblGLKLuw 1 RIGHTSH10NP 0 1 FORMAT "%8.6"
 /begin AXIS_DESCR STD_AXIS mApplI_AbsDriverTorque_xdu16 TBTHIGH 6 0 25 FORMAT "%8.5" DEPOSIT ABSOLUTE /end AXIS_DESCR
/end CHARACTERISTIC
/begin CHARACTERISTIC xActRet_RetTorqueFactDepOnDriver_XAU16_09___A "factor of active return motor torque (after limitation) depending on driver torque" CURVE 0x15D0B0 AblGLKLuw 1 RIGHTSH10NP 0 1 FORMAT "%8.6"
 /begin AXIS_DESCR STD_AXIS mApplI_AbsDriverTorque_xdu16 TBTHIGH 6 0 25 FORMAT "%8.5" DEPOSIT ABSOLUTE /end AXIS_DESCR
/end CHARACTERISTIC
/begin CHARACTERISTIC xActRet_RetTorqueFactDepOnDriver_XAU16_10___A "factor of active return motor torque (after limitation) depending on driver torque" CURVE 0x15D0CC AblGLKLuw 1 RIGHTSH10NP 0 1 FORMAT "%8.6"
 /begin AXIS_DESCR STD_AXIS mApplI_AbsDriverTorque_xdu16 TBTHIGH 6 0 25 FORMAT "%8.5" DEPOSIT ABSOLUTE /end AXIS_DESCR
/end CHARACTERISTIC
/begin CHARACTERISTIC xActRet_RetTorqueFactDepOnDriver_XAU16_11___A "factor of active return motor torque (after limitation) depending on driver torque" CURVE 0x15D0E8 AblGLKLuw 1 RIGHTSH10NP 0 1 FORMAT "%8.6"
 /begin AXIS_DESCR STD_AXIS mApplI_AbsDriverTorque_xdu16 TBTHIGH 6 0 25 FORMAT "%8.5" DEPOSIT ABSOLUTE /end AXIS_DESCR
/end CHARACTERISTIC
/begin CHARACTERISTIC xActRet_RetTorqueFactDepOnDriver_XAU16_12___A "factor of active return motor torque (after limitation) depending on driver torque" CURVE 0x15D104 AblGLKLuw 1 RIGHTSH10NP 0 1 FORMAT "%8.6"
 /begin AXIS_DESCR STD_AXIS mApplI_AbsDriverTorque_xdu16 TBTHIGH 6 0 25 FORMAT "%8.5" DEPOSIT ABSOLUTE /end AXIS_DESCR
/end CHARACTERISTIC
/begin CHARACTERISTIC xActRet_RetTorqueFactDepOnDriver_XAU16_13___A "factor of active return motor torque (after limitation) depending on driver torque" CURVE 0x15D120 AblGLKLuw 1 RIGHTSH10NP 0 1 FORMAT "%8.6"
 /begin AXIS_DESCR STD_AXIS mApplI_AbsDriverTorque_xdu16 TBTHIGH 6 0 25 FORMAT "%8.5" DEPOSIT ABSOLUTE /end AXIS_DESCR
/end CHARACTERISTIC
/begin CHARACTERISTIC xActRet_RetTorqueFactDepOnDriver_XAU16_14___A "factor of active return motor torque (after limitation) depending on driver torque" CURVE 0x15D13C AblGLKLuw 1 RIGHTSH10NP 0 1 FORMAT "%8.6"
 /begin AXIS_DESCR STD_AXIS mApplI_AbsDriverTorque_xdu16 TBTHIGH 6 0 25 FORMAT "%8.5" DEPOSIT ABSOLUTE /end AXIS_DESCR
/end CHARACTERISTIC
/begin CHARACTERISTIC xActRet_RetTorqueFactDepOnDriver_XAU16_15___A "factor of active return motor torque (after limitation) depending on driver torque" CURVE 0x15D158 AblGLKLuw 1 RIGHTSH10NP 0 1 FORMAT "%8.6"
 /begin AXIS_DESCR STD_AXIS mApplI_AbsDriverTorque_xdu16 TBTHIGH 6 0 25 FORMAT "%8.5" DEPOSIT ABSOLUTE /end AXIS_DESCR
/end CHARACTERISTIC
/begin CHARACTERISTIC xActRet_RetTorqueFactDepOnDriver_XAU16_16___A "factor of active return motor torque (after limitation) depending on driver torque" CURVE 0x15D174 AblGLKLuw 1 RIGHTSH10NP 0 1 FORMAT "%8.6"
 /begin AXIS_DESCR STD_AXIS mApplI_AbsDriverTorque_xdu16 TBTHIGH 6 0 25 FORMAT "%8.5" DEPOSIT ABSOLUTE /end AXIS_DESCR
/end CHARACTERISTIC
/begin CHARACTERISTIC xActRet_RetTorqueFactDepOnDriver_XAU16_17___A "factor of active return motor torque (after limitation) depending on driver torque" CURVE 0x15D190 AblGLKLuw 1 RIGHTSH10NP 0 1 FORMAT "%8.6"
 /begin AXIS_DESCR STD_AXIS mApplI_AbsDriverTorque_xdu16 TBTHIGH 6 0 25 FORMAT "%8.5" DEPOSIT ABSOLUTE /end AXIS_DESCR
/end CHARACTERISTIC
/begin CHARACTERISTIC xActRet_RetTorqueFactDepOnDriver_XAU16_18___A "factor of active return motor torque (after limitation) depending on driver torque" CURVE 0x15D1AC AblGLKLuw 1 RIGHTSH10NP 0 1 FORMAT "%8.6"
 /begin AXIS_DESCR STD_AXIS mApplI_AbsDriverTorque_xdu16 TBTHIGH 6 0 25 FORMAT "%8.5" DEPOSIT ABSOLUTE /end AXIS_DESCR
/end CHARACTERISTIC
/begin CHARACTERISTIC xActRet_RetTorqueFactDepOnDriver_XAU16_19___A "factor of active return motor torque (after limitation) depending on driver torque" CURVE 0x15D1C8 AblGLKLuw 1 RIGHTSH10NP 0 1 FORMAT "%8.6"
 /begin AXIS_DESCR STD_AXIS mApplI_AbsDriverTorque_xdu16 TBTHIGH 6 0 25 FORMAT "%8.5" DEPOSIT ABSOLUTE /end AXIS_DESCR
/end CHARACTERISTIC
/begin CHARACTERISTIC xActRet_RetTorqueFactDepOnDriver_XAU16_20___A "factor of active return motor torque (after limitation) depending on driver torque" CURVE 0x15D1E4 AblGLKLuw 1 RIGHTSH10NP 0 1 FORMAT "%8.6"
 /begin AXIS_DESCR STD_AXIS mApplI_AbsDriverTorque_xdu16 TBTHIGH 6 0 25 FORMAT "%8.5" DEPOSIT ABSOLUTE /end AXIS_DESCR
/end CHARACTERISTIC
/begin CHARACTERISTIC xActRet_RetTorqueFactDepOnDriver_XAU16_21___A "factor of active return motor torque (after limitation) depending on driver torque" CURVE 0x15D200 AblGLKLuw 1 RIGHTSH10NP 0 1 FORMAT "%8.6"
 /begin AXIS_DESCR STD_AXIS mApplI_AbsDriverTorque_xdu16 TBTHIGH 6 0 25 FORMAT "%8.5" DEPOSIT ABSOLUTE /end AXIS_DESCR
/end CHARACTERISTIC
/begin CHARACTERISTIC xActRet_RetTorqueFactDepOnDriver_XAU16_22___A "factor of active return motor torque (after limitation) depending on driver torque" CURVE 0x15D21C AblGLKLuw 1 RIGHTSH10NP 0 1 FORMAT "%8.6"
 /begin AXIS_DESCR STD_AXIS mApplI_AbsDriverTorque_xdu16 TBTHIGH 6 0 25 FORMAT "%8.5" DEPOSIT ABSOLUTE /end AXIS_DESCR
/end CHARACTERISTIC
/begin CHARACTERISTIC xActRet_RetTorqueFactDepOnDriver_XAU16_23___A "factor of active return motor torque (after limitation) depending on driver torque" CURVE 0x15D238 AblGLKLuw 1 RIGHTSH10NP 0 1 FORMAT "%8.6"
 /begin AXIS_DESCR STD_AXIS mApplI_AbsDriverTorque_xdu16 TBTHIGH 6 0 25 FORMAT "%8.5" DEPOSIT ABSOLUTE /end AXIS_DESCR
/end CHARACTERISTIC
/begin CHARACTERISTIC xActRet_RetTorqueFactDepOnDriver_XAU16_24___A "factor of active return motor torque (after limitation) depending on driver torque" CURVE 0x15D254 AblGLKLuw 1 RIGHTSH10NP 0 1 FORMAT "%8.6"
 /begin AXIS_DESCR STD_AXIS mApplI_AbsDriverTorque_xdu16 TBTHIGH 6 0 25 FORMAT "%8.5" DEPOSIT ABSOLUTE /end AXIS_DESCR
/end CHARACTERISTIC
/begin CHARACTERISTIC xActRet_RetTorqueFactDepOnDriver_XAU16_25___A "factor of active return motor torque (after limitation) depending on driver torque" CURVE 0x15D270 AblGLKLuw 1 RIGHTSH10NP 0 1 FORMAT "%8.6"
 /begin AXIS_DESCR STD_AXIS mApplI_AbsDriverTorque_xdu16 TBTHIGH 6 0 25 FORMAT "%8.5" DEPOSIT ABSOLUTE /end AXIS_DESCR
/end CHARACTERISTIC
/begin CHARACTERISTIC xActRet_RetTorqueFactDepOnDriver_XAU16_26___A "factor of active return motor torque (after limitation) depending on driver torque" CURVE 0x15D28C AblGLKLuw 1 RIGHTSH10NP 0 1 FORMAT "%8.6"
 /begin AXIS_DESCR STD_AXIS mApplI_AbsDriverTorque_xdu16 TBTHIGH 6 0 25 FORMAT "%8.5" DEPOSIT ABSOLUTE /end AXIS_DESCR
/end CHARACTERISTIC
/begin CHARACTERISTIC xActRet_RetTorqueFactDepOnDriver_XAU16_27___A "factor of active return motor torque (after limitation) depending on driver torque" CURVE 0x15D2A8 AblGLKLuw 1 RIGHTSH10NP 0 1 FORMAT "%8.6"
 /begin AXIS_DESCR STD_AXIS mApplI_AbsDriverTorque_xdu16 TBTHIGH 6 0 25 FORMAT "%8.5" DEPOSIT ABSOLUTE /end AXIS_DESCR
/end CHARACTERISTIC
/begin CHARACTERISTIC xActRet_RetTorqueFactDepOnDriver_XAU16_28___A "factor of active return motor torque (after limitation) depending on driver torque" CURVE 0x15D2C4 AblGLKLuw 1 RIGHTSH10NP 0 1 FORMAT "%8.6"
 /begin AXIS_DESCR STD_AXIS mApplI_AbsDriverTorque_xdu16 TBTHIGH 6 0 25 FORMAT "%8.5" DEPOSIT ABSOLUTE /end AXIS_DESCR
/end CHARACTERISTIC
/begin CHARACTERISTIC xActRet_RetTorqueFactDepOnDriver_XAU16_29___A "factor of active return motor torque (after limitation) depending on driver torque" CURVE 0x15D2E0 AblGLKLuw 1 RIGHTSH10NP 0 1 FORMAT "%8.6"
 /begin AXIS_DESCR STD_AXIS mApplI_AbsDriverTorque_xdu16 TBTHIGH 6 0 25 FORMAT "%8.5" DEPOSIT ABSOLUTE /end AXIS_DESCR
/end CHARACTERISTIC
/begin CHARACTERISTIC xActRet_RetTorqueFactDepOnDriver_XAU16_30___A "factor of active return motor torque (after limitation) depending on driver torque" CURVE 0x15D2FC AblGLKLuw 1 RIGHTSH10NP 0 1 FORMAT "%8.6"
 /begin AXIS_DESCR STD_AXIS mApplI_AbsDriverTorque_xdu16 TBTHIGH 6 0 25 FORMAT "%8.5" DEPOSIT ABSOLUTE /end AXIS_DESCR
/end CHARACTERISTIC
/begin CHARACTERISTIC xActRet_RetTorqueFactDepOnDriver_XAU16_31___A "factor of active return motor torque (after limitation) depending on driver torque" CURVE 0x15D318 AblGLKLuw 1 RIGHTSH10NP 0 1 FORMAT "%8.6"
 /begin AXIS_DESCR STD_AXIS mApplI_AbsDriverTorque_xdu16 TBTHIGH 6 0 25 FORMAT "%8.5" DEPOSIT ABSOLUTE /end AXIS_DESCR
/end CHARACTERISTIC
/begin CHARACTERISTIC xActRet_RetTorqueFactDepOnDriver_XAU16_32___A "factor of active return motor torque (after limitation) depending on driver torque" CURVE 0x15D334 AblGLKLuw 1 RIGHTSH10NP 0 1 FORMAT "%8.6"
 /begin AXIS_DESCR STD_AXIS mApplI_AbsDriverTorque_xdu16 TBTHIGH 6 0 25 FORMAT "%8.5" DEPOSIT ABSOLUTE /end AXIS_DESCR
/end CHARACTERISTIC
/begin CHARACTERISTIC xActRet_RetTorqueFactDepOnDriver_XAU16_33___A "factor of active return motor torque (after limitation) depending on driver torque" CURVE 0x15D350 AblGLKLuw 1 RIGHTSH10NP 0 1 FORMAT "%8.6"
 /begin AXIS_DESCR STD_AXIS mApplI_AbsDriverTorque_xdu16 TBTHIGH 6 0 25 FORMAT "%8.5" DEPOSIT ABSOLUTE /end AXIS_DESCR
/end CHARACTERISTIC
/begin CHARACTERISTIC xActRet_RetTorqueFactDepOnDriver_XAU16_34___A "factor of active return motor torque (after limitation) depending on driver torque" CURVE 0x15D36C AblGLKLuw 1 RIGHTSH10NP 0 1 FORMAT "%8.6"
 /begin AXIS_DESCR STD_AXIS mApplI_AbsDriverTorque_xdu16 TBTHIGH 6 0 25 FORMAT "%8.5" DEPOSIT ABSOLUTE /end AXIS_DESCR
/end CHARACTERISTIC
/begin CHARACTERISTIC xActRet_RetTorqueFactDepOnDriver_XAU16_35___A "factor of active return motor torque (after limitation) depending on driver torque" CURVE 0x15D388 AblGLKLuw 1 RIGHTSH10NP 0 1 FORMAT "%8.6"
 /begin AXIS_DESCR STD_AXIS mApplI_AbsDriverTorque_xdu16 TBTHIGH 6 0 25 FORMAT "%8.5" DEPOSIT ABSOLUTE /end AXIS_DESCR
/end CHARACTERISTIC
/begin CHARACTERISTIC xActRet_SteeringSpeedAmp_XDU16_00___A "active return control amplification [Nm * s / °]" VALUE 0x1581F8 AblGLKWuw 0.0200195 ARFACT 0 0.02001953 FORMAT "%10.8" /end CHARACTERISTIC
/begin CHARACTERISTIC xActRet_SteeringSpeedAmp_XDU16_01___A "active return control amplification [Nm * s / °]" VALUE 0x1581FA AblGLKWuw 0.0200195 ARFACT 0 0.02001953 FORMAT "%10.8" /end CHARACTERISTIC
/begin CHARACTERISTIC xActRet_SteeringSpeedAmp_XDU16_02___A "active return control amplification [Nm * s / °]" VALUE 0x1581FC AblGLKWuw 0.0200195 ARFACT 0 0.02001953 FORMAT "%10.8" /end CHARACTERISTIC
/begin CHARACTERISTIC xActRet_SteeringSpeedAmp_XDU16_03___A "active return control amplification [Nm * s / °]" VALUE 0x1581FE AblGLKWuw 0.0200195 ARFACT 0 0.02001953 FORMAT "%10.8" /end CHARACTERISTIC
/begin CHARACTERISTIC xActRet_SteeringSpeedAmp_XDU16_04___A "active return control amplification [Nm * s / °]" VALUE 0x158200 AblGLKWuw 0.0200195 ARFACT 0 0.02001953 FORMAT "%10.8" /end CHARACTERISTIC
/begin CHARACTERISTIC xActRet_SteeringSpeedAmp_XDU16_05___A "active return control amplification [Nm * s / °]" VALUE 0x158202 AblGLKWuw 0.0200195 ARFACT 0 0.02001953 FORMAT "%10.8" /end CHARACTERISTIC
/begin CHARACTERISTIC xActRet_SteeringSpeedAmp_XDU16_06___A "active return control amplification [Nm * s / °]" VALUE 0x158204 AblGLKWuw 0.0200195 ARFACT 0 0.02001953 FORMAT "%10.8" /end CHARACTERISTIC
/begin CHARACTERISTIC xActRet_SteeringSpeedAmp_XDU16_07___A "active return control amplification [Nm * s / °]" VALUE 0x158206 AblGLKWuw 0.0200195 ARFACT 0 0.02001953 FORMAT "%10.8" /end CHARACTERISTIC
/begin CHARACTERISTIC xActRet_SteeringSpeedAmp_XDU16_08___A "active return control amplification [Nm * s / °]" VALUE 0x158208 AblGLKWuw 0.0200195 ARFACT 0 0.02001953 FORMAT "%10.8" /end CHARACTERISTIC
/begin CHARACTERISTIC xActRet_SteeringSpeedAmp_XDU16_09___A "active return control amplification [Nm * s / °]" VALUE 0x15820A AblGLKWuw 0.0200195 ARFACT 0 0.02001953 FORMAT "%10.8" /end CHARACTERISTIC
/begin CHARACTERISTIC xActRet_SteeringSpeedAmp_XDU16_10___A "active return control amplification [Nm * s / °]" VALUE 0x15820C AblGLKWuw 0.0200195 ARFACT 0 0.02001953 FORMAT "%10.8" /end CHARACTERISTIC
/begin CHARACTERISTIC xActRet_SteeringSpeedAmp_XDU16_11___A "active return control amplification [Nm * s / °]" VALUE 0x15820E AblGLKWuw 0.0200195 ARFACT 0 0.02001953 FORMAT "%10.8" /end CHARACTERISTIC
/begin CHARACTERISTIC xActRet_SteeringSpeedAmp_XDU16_12___A "active return control amplification [Nm * s / °]" VALUE 0x158210 AblGLKWuw 0.0200195 ARFACT 0 0.02001953 FORMAT "%10.8" /end CHARACTERISTIC
/begin CHARACTERISTIC xActRet_SteeringSpeedAmp_XDU16_13___A "active return control amplification [Nm * s / °]" VALUE 0x158212 AblGLKWuw 0.0200195 ARFACT 0 0.02001953 FORMAT "%10.8" /end CHARACTERISTIC
/begin CHARACTERISTIC xActRet_SteeringSpeedAmp_XDU16_14___A "active return control amplification [Nm * s / °]" VALUE 0x158214 AblGLKWuw 0.0200195 ARFACT 0 0.02001953 FORMAT "%10.8" /end CHARACTERISTIC
/begin CHARACTERISTIC xActRet_SteeringSpeedAmp_XDU16_15___A "active return control amplification [Nm * s / °]" VALUE 0x158216 AblGLKWuw 0.0200195 ARFACT 0 0.02001953 FORMAT "%10.8" /end CHARACTERISTIC
/begin CHARACTERISTIC xActRet_SteeringSpeedAmp_XDU16_16___A "active return control amplification [Nm * s / °]" VALUE 0x158218 AblGLKWuw 0.0200195 ARFACT 0 0.02001953 FORMAT "%10.8" /end CHARACTERISTIC
/begin CHARACTERISTIC xActRet_SteeringSpeedAmp_XDU16_17___A "active return control amplification [Nm * s / °]" VALUE 0x15821A AblGLKWuw 0.0200195 ARFACT 0 0.02001953 FORMAT "%10.8" /end CHARACTERISTIC
/begin CHARACTERISTIC xActRet_SteeringSpeedAmp_XDU16_18___A "active return control amplification [Nm * s / °]" VALUE 0x15821C AblGLKWuw 0.0200195 ARFACT 0 0.02001953 FORMAT "%10.8" /end CHARACTERISTIC
/begin CHARACTERISTIC xActRet_SteeringSpeedAmp_XDU16_19___A "active return control amplification [Nm * s / °]" VALUE 0x15821E AblGLKWuw 0.0200195 ARFACT 0 0.02001953 FORMAT "%10.8" /end CHARACTERISTIC
/begin CHARACTERISTIC xActRet_SteeringSpeedAmp_XDU16_20___A "active return control amplification [Nm * s / °]" VALUE 0x158220 AblGLKWuw 0.0200195 ARFACT 0 0.02001953 FORMAT "%10.8" /end CHARACTERISTIC
/begin CHARACTERISTIC xActRet_SteeringSpeedAmp_XDU16_21___A "active return control amplification [Nm * s / °]" VALUE 0x158222 AblGLKWuw 0.0200195 ARFACT 0 0.02001953 FORMAT "%10.8" /end CHARACTERISTIC
/begin CHARACTERISTIC xActRet_SteeringSpeedAmp_XDU16_22___A "active return control amplification [Nm * s / °]" VALUE 0x158224 AblGLKWuw 0.0200195 ARFACT 0 0.02001953 FORMAT "%10.8" /end CHARACTERISTIC
/begin CHARACTERISTIC xActRet_SteeringSpeedAmp_XDU16_23___A "active return control amplification [Nm * s / °]" VALUE 0x158226 AblGLKWuw 0.0200195 ARFACT 0 0.02001953 FORMAT "%10.8" /end CHARACTERISTIC
/begin CHARACTERISTIC xActRet_SteeringSpeedAmp_XDU16_24___A "active return control amplification [Nm * s / °]" VALUE 0x158228 AblGLKWuw 0.0200195 ARFACT 0 0.02001953 FORMAT "%10.8" /end CHARACTERISTIC
/begin CHARACTERISTIC xActRet_SteeringSpeedAmp_XDU16_25___A "active return control amplification [Nm * s / °]" VALUE 0x15822A AblGLKWuw 0.0200195 ARFACT 0 0.02001953 FORMAT "%10.8" /end CHARACTERISTIC
/begin CHARACTERISTIC xActRet_SteeringSpeedAmp_XDU16_26___A "active return control amplification [Nm * s / °]" VALUE 0x15822C AblGLKWuw 0.0200195 ARFACT 0 0.02001953 FORMAT "%10.8" /end CHARACTERISTIC
/begin CHARACTERISTIC xActRet_SteeringSpeedAmp_XDU16_27___A "active return control amplification [Nm * s / °]" VALUE 0x15822E AblGLKWuw 0.0200195 ARFACT 0 0.02001953 FORMAT "%10.8" /end CHARACTERISTIC
/begin CHARACTERISTIC xActRet_SteeringSpeedAmp_XDU16_28___A "active return control amplification [Nm * s / °]" VALUE 0x158230 AblGLKWuw 0.0200195 ARFACT 0 0.02001953 FORMAT "%10.8" /end CHARACTERISTIC
/begin CHARACTERISTIC xActRet_SteeringSpeedAmp_XDU16_29___A "active return control amplification [Nm * s / °]" VALUE 0x158232 AblGLKWuw 0.0200195 ARFACT 0 0.02001953 FORMAT "%10.8" /end CHARACTERISTIC
/begin CHARACTERISTIC xActRet_SteeringSpeedAmp_XDU16_30___A "active return control amplification [Nm * s / °]" VALUE 0x158234 AblGLKWuw 0.0200195 ARFACT 0 0.02001953 FORMAT "%10.8" /end CHARACTERISTIC
/begin CHARACTERISTIC xActRet_SteeringSpeedAmp_XDU16_31___A "active return control amplification [Nm * s / °]" VALUE 0x158236 AblGLKWuw 0.0200195 ARFACT 0 0.02001953 FORMAT "%10.8" /end CHARACTERISTIC
/begin CHARACTERISTIC xActRet_SteeringSpeedAmp_XDU16_32___A "active return control amplification [Nm * s / °]" VALUE 0x158238 AblGLKWuw 0.0200195 ARFACT 0 0.02001953 FORMAT "%10.8" /end CHARACTERISTIC
/begin CHARACTERISTIC xActRet_SteeringSpeedAmp_XDU16_33___A "active return control amplification [Nm * s / °]" VALUE 0x15823A AblGLKWuw 0.0200195 ARFACT 0 0.02001953 FORMAT "%10.8" /end CHARACTERISTIC
/begin CHARACTERISTIC xActRet_SteeringSpeedAmp_XDU16_34___A "active return control amplification [Nm * s / °]" VALUE 0x15823C AblGLKWuw 0.0200195 ARFACT 0 0.02001953 FORMAT "%10.8" /end CHARACTERISTIC
/begin CHARACTERISTIC xActRet_SteeringSpeedAmp_XDU16_35___A "active return control amplification [Nm * s / °]" VALUE 0x15823E AblGLKWuw 0.0200195 ARFACT 0 0.02001953 FORMAT "%10.8" /end CHARACTERISTIC
/begin CHARACTERISTIC xActRet_SteeringSpeedFact_XDU8_00___A "factor of nominal steering speed" VALUE 0x158568 AblGLKWub 1.5 RIGHTSH7NP 0 1.5 FORMAT "%5.3" /end CHARACTERISTIC
/begin CHARACTERISTIC xActRet_SteeringSpeedFact_XDU8_01___A "factor of nominal steering speed" VALUE 0x158569 AblGLKWub 1.5 RIGHTSH7NP 0 1.5 FORMAT "%5.3" /end CHARACTERISTIC
/begin CHARACTERISTIC xActRet_SteeringSpeedFact_XDU8_02___A "factor of nominal steering speed" VALUE 0x15856A AblGLKWub 1.5 RIGHTSH7NP 0 1.5 FORMAT "%5.3" /end CHARACTERISTIC
/begin CHARACTERISTIC xActRet_SteeringSpeedFact_XDU8_03___A "factor of nominal steering speed" VALUE 0x15856B AblGLKWub 1.5 RIGHTSH7NP 0 1.5 FORMAT "%5.3" /end CHARACTERISTIC
/begin CHARACTERISTIC xActRet_SteeringSpeedFact_XDU8_04___A "factor of nominal steering speed" VALUE 0x15856C AblGLKWub 1.5 RIGHTSH7NP 0 1.5 FORMAT "%5.3" /end CHARACTERISTIC
/begin CHARACTERISTIC xActRet_SteeringSpeedFact_XDU8_05___A "factor of nominal steering speed" VALUE 0x15856D AblGLKWub 1.5 RIGHTSH7NP 0 1.5 FORMAT "%5.3" /end CHARACTERISTIC
/begin CHARACTERISTIC xActRet_SteeringSpeedFact_XDU8_06___A "factor of nominal steering speed" VALUE 0x15856E AblGLKWub 1.5 RIGHTSH7NP 0 1.5 FORMAT "%5.3" /end CHARACTERISTIC
/begin CHARACTERISTIC xActRet_SteeringSpeedFact_XDU8_07___A "factor of nominal steering speed" VALUE 0x15856F AblGLKWub 1.5 RIGHTSH7NP 0 1.5 FORMAT "%5.3" /end CHARACTERISTIC
/begin CHARACTERISTIC xActRet_SteeringSpeedFact_XDU8_08___A "factor of nominal steering speed" VALUE 0x158570 AblGLKWub 1.5 RIGHTSH7NP 0 1.5 FORMAT "%5.3" /end CHARACTERISTIC
/begin CHARACTERISTIC xActRet_SteeringSpeedFact_XDU8_09___A "factor of nominal steering speed" VALUE 0x158571 AblGLKWub 1.5 RIGHTSH7NP 0 1.5 FORMAT "%5.3" /end CHARACTERISTIC
/begin CHARACTERISTIC xActRet_SteeringSpeedFact_XDU8_10___A "factor of nominal steering speed" VALUE 0x158572 AblGLKWub 1.5 RIGHTSH7NP 0 1.5 FORMAT "%5.3" /end CHARACTERISTIC
/begin CHARACTERISTIC xActRet_SteeringSpeedFact_XDU8_11___A "factor of nominal steering speed" VALUE 0x158573 AblGLKWub 1.5 RIGHTSH7NP 0 1.5 FORMAT "%5.3" /end CHARACTERISTIC
/begin CHARACTERISTIC xActRet_SteeringSpeedFact_XDU8_12___A "factor of nominal steering speed" VALUE 0x158574 AblGLKWub 1.5 RIGHTSH7NP 0 1.5 FORMAT "%5.3" /end CHARACTERISTIC
/begin CHARACTERISTIC xActRet_SteeringSpeedFact_XDU8_13___A "factor of nominal steering speed" VALUE 0x158575 AblGLKWub 1.5 RIGHTSH7NP 0 1.5 FORMAT "%5.3" /end CHARACTERISTIC
/begin CHARACTERISTIC xActRet_SteeringSpeedFact_XDU8_14___A "factor of nominal steering speed" VALUE 0x158576 AblGLKWub 1.5 RIGHTSH7NP 0 1.5 FORMAT "%5.3" /end CHARACTERISTIC
/begin CHARACTERISTIC xActRet_SteeringSpeedFact_XDU8_15___A "factor of nominal steering speed" VALUE 0x158577 AblGLKWub 1.5 RIGHTSH7NP 0 1.5 FORMAT "%5.3" /end CHARACTERISTIC
/begin CHARACTERISTIC xActRet_SteeringSpeedFact_XDU8_16___A "factor of nominal steering speed" VALUE 0x158578 AblGLKWub 1.5 RIGHTSH7NP 0 1.5 FORMAT "%5.3" /end CHARACTERISTIC
/begin CHARACTERISTIC xActRet_SteeringSpeedFact_XDU8_17___A "factor of nominal steering speed" VALUE 0x158579 AblGLKWub 1.5 RIGHTSH7NP 0 1.5 FORMAT "%5.3" /end CHARACTERISTIC
/begin CHARACTERISTIC xActRet_SteeringSpeedFact_XDU8_18___A "factor of nominal steering speed" VALUE 0x15857A AblGLKWub 1.5 RIGHTSH7NP 0 1.5 FORMAT "%5.3" /end CHARACTERISTIC
/begin CHARACTERISTIC xActRet_SteeringSpeedFact_XDU8_19___A "factor of nominal steering speed" VALUE 0x15857B AblGLKWub 1.5 RIGHTSH7NP 0 1.5 FORMAT "%5.3" /end CHARACTERISTIC
/begin CHARACTERISTIC xActRet_SteeringSpeedFact_XDU8_20___A "factor of nominal steering speed" VALUE 0x15857C AblGLKWub 1.5 RIGHTSH7NP 0 1.5 FORMAT "%5.3" /end CHARACTERISTIC
/begin CHARACTERISTIC xActRet_SteeringSpeedFact_XDU8_21___A "factor of nominal steering speed" VALUE 0x15857D AblGLKWub 1.5 RIGHTSH7NP 0 1.5 FORMAT "%5.3" /end CHARACTERISTIC
/begin CHARACTERISTIC xActRet_SteeringSpeedFact_XDU8_22___A "factor of nominal steering speed" VALUE 0x15857E AblGLKWub 1.5 RIGHTSH7NP 0 1.5 FORMAT "%5.3" /end CHARACTERISTIC
/begin CHARACTERISTIC xActRet_SteeringSpeedFact_XDU8_23___A "factor of nominal steering speed" VALUE 0x15857F AblGLKWub 1.5 RIGHTSH7NP 0 1.5 FORMAT "%5.3" /end CHARACTERISTIC
/begin CHARACTERISTIC xActRet_SteeringSpeedFact_XDU8_24___A "factor of nominal steering speed" VALUE 0x158580 AblGLKWub 1.5 RIGHTSH7NP 0 1.5 FORMAT "%5.3" /end CHARACTERISTIC
/begin CHARACTERISTIC xActRet_SteeringSpeedFact_XDU8_25___A "factor of nominal steering speed" VALUE 0x158581 AblGLKWub 1.5 RIGHTSH7NP 0 1.5 FORMAT "%5.3" /end CHARACTERISTIC
/begin CHARACTERISTIC xActRet_SteeringSpeedFact_XDU8_26___A "factor of nominal steering speed" VALUE 0x158582 AblGLKWub 1.5 RIGHTSH7NP 0 1.5 FORMAT "%5.3" /end CHARACTERISTIC
/begin CHARACTERISTIC xActRet_SteeringSpeedFact_XDU8_27___A "factor of nominal steering speed" VALUE 0x158583 AblGLKWub 1.5 RIGHTSH7NP 0 1.5 FORMAT "%5.3" /end CHARACTERISTIC
/begin CHARACTERISTIC xActRet_SteeringSpeedFact_XDU8_28___A "factor of nominal steering speed" VALUE 0x158584 AblGLKWub 1.5 RIGHTSH7NP 0 1.5 FORMAT "%5.3" /end CHARACTERISTIC
/begin CHARACTERISTIC xActRet_SteeringSpeedFact_XDU8_29___A "factor of nominal steering speed" VALUE 0x158585 AblGLKWub 1.5 RIGHTSH7NP 0 1.5 FORMAT "%5.3" /end CHARACTERISTIC
/begin CHARACTERISTIC xActRet_SteeringSpeedFact_XDU8_30___A "factor of nominal steering speed" VALUE 0x158586 AblGLKWub 1.5 RIGHTSH7NP 0 1.5 FORMAT "%5.3" /end CHARACTERISTIC
/begin CHARACTERISTIC xActRet_SteeringSpeedFact_XDU8_31___A "factor of nominal steering speed" VALUE 0x158587 AblGLKWub 1.5 RIGHTSH7NP 0 1.5 FORMAT "%5.3" /end CHARACTERISTIC
/begin CHARACTERISTIC xActRet_SteeringSpeedFact_XDU8_32___A "factor of nominal steering speed" VALUE 0x158588 AblGLKWub 1.5 RIGHTSH7NP 0 1.5 FORMAT "%5.3" /end CHARACTERISTIC
/begin CHARACTERISTIC xActRet_SteeringSpeedFact_XDU8_33___A "factor of nominal steering speed" VALUE 0x158589 AblGLKWub 1.5 RIGHTSH7NP 0 1.5 FORMAT "%5.3" /end CHARACTERISTIC
/begin CHARACTERISTIC xActRet_SteeringSpeedFact_XDU8_34___A "factor of nominal steering speed" VALUE 0x15858A AblGLKWub 1.5 RIGHTSH7NP 0 1.5 FORMAT "%5.3" /end CHARACTERISTIC
/begin CHARACTERISTIC xActRet_SteeringSpeedFact_XDU8_35___A "factor of nominal steering speed" VALUE 0x15858B AblGLKWub 1.5 RIGHTSH7NP 0 1.5 FORMAT "%5.3" /end CHARACTERISTIC
/begin CHARACTERISTIC xActRet_SteerSpeedFactDepOnDriver_XAU16_00___A "factor of nominal steering speed depending on driver torque" CURVE 0x15D3A4 AblGLKLuw 1 RIGHTSH10NP 0 1 FORMAT "%8.6"
 /begin AXIS_DESCR STD_AXIS mApplI_AbsDriverTorque_xdu16 TBTHIGH 6 0 25 FORMAT "%8.5" DEPOSIT ABSOLUTE /end AXIS_DESCR
/end CHARACTERISTIC
/begin CHARACTERISTIC xActRet_SteerSpeedFactDepOnDriver_XAU16_01___A "factor of nominal steering speed depending on driver torque" CURVE 0x15D3C0 AblGLKLuw 1 RIGHTSH10NP 0 1 FORMAT "%8.6"
 /begin AXIS_DESCR STD_AXIS mApplI_AbsDriverTorque_xdu16 TBTHIGH 6 0 25 FORMAT "%8.5" DEPOSIT ABSOLUTE /end AXIS_DESCR
/end CHARACTERISTIC
/begin CHARACTERISTIC xActRet_SteerSpeedFactDepOnDriver_XAU16_02___A "factor of nominal steering speed depending on driver torque" CURVE 0x15D3DC AblGLKLuw 1 RIGHTSH10NP 0 1 FORMAT "%8.6"
 /begin AXIS_DESCR STD_AXIS mApplI_AbsDriverTorque_xdu16 TBTHIGH 6 0 25 FORMAT "%8.5" DEPOSIT ABSOLUTE /end AXIS_DESCR
/end CHARACTERISTIC
/begin CHARACTERISTIC xActRet_SteerSpeedFactDepOnDriver_XAU16_03___A "factor of nominal steering speed depending on driver torque" CURVE 0x15D3F8 AblGLKLuw 1 RIGHTSH10NP 0 1 FORMAT "%8.6"
 /begin AXIS_DESCR STD_AXIS mApplI_AbsDriverTorque_xdu16 TBTHIGH 6 0 25 FORMAT "%8.5" DEPOSIT ABSOLUTE /end AXIS_DESCR
/end CHARACTERISTIC
/begin CHARACTERISTIC xActRet_SteerSpeedFactDepOnDriver_XAU16_04___A "factor of nominal steering speed depending on driver torque" CURVE 0x15D414 AblGLKLuw 1 RIGHTSH10NP 0 1 FORMAT "%8.6"
 /begin AXIS_DESCR STD_AXIS mApplI_AbsDriverTorque_xdu16 TBTHIGH 6 0 25 FORMAT "%8.5" DEPOSIT ABSOLUTE /end AXIS_DESCR
/end CHARACTERISTIC
/begin CHARACTERISTIC xActRet_SteerSpeedFactDepOnDriver_XAU16_05___A "factor of nominal steering speed depending on driver torque" CURVE 0x15D430 AblGLKLuw 1 RIGHTSH10NP 0 1 FORMAT "%8.6"
 /begin AXIS_DESCR STD_AXIS mApplI_AbsDriverTorque_xdu16 TBTHIGH 6 0 25 FORMAT "%8.5" DEPOSIT ABSOLUTE /end AXIS_DESCR
/end CHARACTERISTIC
/begin CHARACTERISTIC xActRet_SteerSpeedFactDepOnDriver_XAU16_06___A "factor of nominal steering speed depending on driver torque" CURVE 0x15D44C AblGLKLuw 1 RIGHTSH10NP 0 1 FORMAT "%8.6"
 /begin AXIS_DESCR STD_AXIS mApplI_AbsDriverTorque_xdu16 TBTHIGH 6 0 25 FORMAT "%8.5" DEPOSIT ABSOLUTE /end AXIS_DESCR
/end CHARACTERISTIC
/begin CHARACTERISTIC xActRet_SteerSpeedFactDepOnDriver_XAU16_07___A "factor of nominal steering speed depending on driver torque" CURVE 0x15D468 AblGLKLuw 1 RIGHTSH10NP 0 1 FORMAT "%8.6"
 /begin AXIS_DESCR STD_AXIS mApplI_AbsDriverTorque_xdu16 TBTHIGH 6 0 25 FORMAT "%8.5" DEPOSIT ABSOLUTE /end AXIS_DESCR
/end CHARACTERISTIC
/begin CHARACTERISTIC xActRet_SteerSpeedFactDepOnDriver_XAU16_08___A "factor of nominal steering speed depending on driver torque" CURVE 0x15D484 AblGLKLuw 1 RIGHTSH10NP 0 1 FORMAT "%8.6"
 /begin AXIS_DESCR STD_AXIS mApplI_AbsDriverTorque_xdu16 TBTHIGH 6 0 25 FORMAT "%8.5" DEPOSIT ABSOLUTE /end AXIS_DESCR
/end CHARACTERISTIC
/begin CHARACTERISTIC xActRet_SteerSpeedFactDepOnDriver_XAU16_09___A "factor of nominal steering speed depending on driver torque" CURVE 0x15D4A0 AblGLKLuw 1 RIGHTSH10NP 0 1 FORMAT "%8.6"
 /begin AXIS_DESCR STD_AXIS mApplI_AbsDriverTorque_xdu16 TBTHIGH 6 0 25 FORMAT "%8.5" DEPOSIT ABSOLUTE /end AXIS_DESCR
/end CHARACTERISTIC
/begin CHARACTERISTIC xActRet_SteerSpeedFactDepOnDriver_XAU16_10___A "factor of nominal steering speed depending on driver torque" CURVE 0x15D4BC AblGLKLuw 1 RIGHTSH10NP 0 1 FORMAT "%8.6"
 /begin AXIS_DESCR STD_AXIS mApplI_AbsDriverTorque_xdu16 TBTHIGH 6 0 25 FORMAT "%8.5" DEPOSIT ABSOLUTE /end AXIS_DESCR
/end CHARACTERISTIC
/begin CHARACTERISTIC xActRet_SteerSpeedFactDepOnDriver_XAU16_11___A "factor of nominal steering speed depending on driver torque" CURVE 0x15D4D8 AblGLKLuw 1 RIGHTSH10NP 0 1 FORMAT "%8.6"
 /begin AXIS_DESCR STD_AXIS mApplI_AbsDriverTorque_xdu16 TBTHIGH 6 0 25 FORMAT "%8.5" DEPOSIT ABSOLUTE /end AXIS_DESCR
/end CHARACTERISTIC
/begin CHARACTERISTIC xActRet_SteerSpeedFactDepOnDriver_XAU16_12___A "factor of nominal steering speed depending on driver torque" CURVE 0x15D4F4 AblGLKLuw 1 RIGHTSH10NP 0 1 FORMAT "%8.6"
 /begin AXIS_DESCR STD_AXIS mApplI_AbsDriverTorque_xdu16 TBTHIGH 6 0 25 FORMAT "%8.5" DEPOSIT ABSOLUTE /end AXIS_DESCR
/end CHARACTERISTIC
/begin CHARACTERISTIC xActRet_SteerSpeedFactDepOnDriver_XAU16_13___A "factor of nominal steering speed depending on driver torque" CURVE 0x15D510 AblGLKLuw 1 RIGHTSH10NP 0 1 FORMAT "%8.6"
 /begin AXIS_DESCR STD_AXIS mApplI_AbsDriverTorque_xdu16 TBTHIGH 6 0 25 FORMAT "%8.5" DEPOSIT ABSOLUTE /end AXIS_DESCR
/end CHARACTERISTIC
/begin CHARACTERISTIC xActRet_SteerSpeedFactDepOnDriver_XAU16_14___A "factor of nominal steering speed depending on driver torque" CURVE 0x15D52C AblGLKLuw 1 RIGHTSH10NP 0 1 FORMAT "%8.6"
 /begin AXIS_DESCR STD_AXIS mApplI_AbsDriverTorque_xdu16 TBTHIGH 6 0 25 FORMAT "%8.5" DEPOSIT ABSOLUTE /end AXIS_DESCR
/end CHARACTERISTIC
/begin CHARACTERISTIC xActRet_SteerSpeedFactDepOnDriver_XAU16_15___A "factor of nominal steering speed depending on driver torque" CURVE 0x15D548 AblGLKLuw 1 RIGHTSH10NP 0 1 FORMAT "%8.6"
 /begin AXIS_DESCR STD_AXIS mApplI_AbsDriverTorque_xdu16 TBTHIGH 6 0 25 FORMAT "%8.5" DEPOSIT ABSOLUTE /end AXIS_DESCR
/end CHARACTERISTIC
/begin CHARACTERISTIC xActRet_SteerSpeedFactDepOnDriver_XAU16_16___A "factor of nominal steering speed depending on driver torque" CURVE 0x15D564 AblGLKLuw 1 RIGHTSH10NP 0 1 FORMAT "%8.6"
 /begin AXIS_DESCR STD_AXIS mApplI_AbsDriverTorque_xdu16 TBTHIGH 6 0 25 FORMAT "%8.5" DEPOSIT ABSOLUTE /end AXIS_DESCR
/end CHARACTERISTIC
/begin CHARACTERISTIC xActRet_SteerSpeedFactDepOnDriver_XAU16_17___A "factor of nominal steering speed depending on driver torque" CURVE 0x15D580 AblGLKLuw 1 RIGHTSH10NP 0 1 FORMAT "%8.6"
 /begin AXIS_DESCR STD_AXIS mApplI_AbsDriverTorque_xdu16 TBTHIGH 6 0 25 FORMAT "%8.5" DEPOSIT ABSOLUTE /end AXIS_DESCR
/end CHARACTERISTIC
/begin CHARACTERISTIC xActRet_SteerSpeedFactDepOnDriver_XAU16_18___A "factor of nominal steering speed depending on driver torque" CURVE 0x15D59C AblGLKLuw 1 RIGHTSH10NP 0 1 FORMAT "%8.6"
 /begin AXIS_DESCR STD_AXIS mApplI_AbsDriverTorque_xdu16 TBTHIGH 6 0 25 FORMAT "%8.5" DEPOSIT ABSOLUTE /end AXIS_DESCR
/end CHARACTERISTIC
/begin CHARACTERISTIC xActRet_SteerSpeedFactDepOnDriver_XAU16_19___A "factor of nominal steering speed depending on driver torque" CURVE 0x15D5B8 AblGLKLuw 1 RIGHTSH10NP 0 1 FORMAT "%8.6"
 /begin AXIS_DESCR STD_AXIS mApplI_AbsDriverTorque_xdu16 TBTHIGH 6 0 25 FORMAT "%8.5" DEPOSIT ABSOLUTE /end AXIS_DESCR
/end CHARACTERISTIC
/begin CHARACTERISTIC xActRet_SteerSpeedFactDepOnDriver_XAU16_20___A "factor of nominal steering speed depending on driver torque" CURVE 0x15D5D4 AblGLKLuw 1 RIGHTSH10NP 0 1 FORMAT "%8.6"
 /begin AXIS_DESCR STD_AXIS mApplI_AbsDriverTorque_xdu16 TBTHIGH 6 0 25 FORMAT "%8.5" DEPOSIT ABSOLUTE /end AXIS_DESCR
/end CHARACTERISTIC
/begin CHARACTERISTIC xActRet_SteerSpeedFactDepOnDriver_XAU16_21___A "factor of nominal steering speed depending on driver torque" CURVE 0x15D5F0 AblGLKLuw 1 RIGHTSH10NP 0 1 FORMAT "%8.6"
 /begin AXIS_DESCR STD_AXIS mApplI_AbsDriverTorque_xdu16 TBTHIGH 6 0 25 FORMAT "%8.5" DEPOSIT ABSOLUTE /end AXIS_DESCR
/end CHARACTERISTIC
/begin CHARACTERISTIC xActRet_SteerSpeedFactDepOnDriver_XAU16_22___A "factor of nominal steering speed depending on driver torque" CURVE 0x15D60C AblGLKLuw 1 RIGHTSH10NP 0 1 FORMAT "%8.6"
 /begin AXIS_DESCR STD_AXIS mApplI_AbsDriverTorque_xdu16 TBTHIGH 6 0 25 FORMAT "%8.5" DEPOSIT ABSOLUTE /end AXIS_DESCR
/end CHARACTERISTIC
/begin CHARACTERISTIC xActRet_SteerSpeedFactDepOnDriver_XAU16_23___A "factor of nominal steering speed depending on driver torque" CURVE 0x15D628 AblGLKLuw 1 RIGHTSH10NP 0 1 FORMAT "%8.6"
 /begin AXIS_DESCR STD_AXIS mApplI_AbsDriverTorque_xdu16 TBTHIGH 6 0 25 FORMAT "%8.5" DEPOSIT ABSOLUTE /end AXIS_DESCR
/end CHARACTERISTIC
/begin CHARACTERISTIC xActRet_SteerSpeedFactDepOnDriver_XAU16_24___A "factor of nominal steering speed depending on driver torque" CURVE 0x15D644 AblGLKLuw 1 RIGHTSH10NP 0 1 FORMAT "%8.6"
 /begin AXIS_DESCR STD_AXIS mApplI_AbsDriverTorque_xdu16 TBTHIGH 6 0 25 FORMAT "%8.5" DEPOSIT ABSOLUTE /end AXIS_DESCR
/end CHARACTERISTIC
/begin CHARACTERISTIC xActRet_SteerSpeedFactDepOnDriver_XAU16_25___A "factor of nominal steering speed depending on driver torque" CURVE 0x15D660 AblGLKLuw 1 RIGHTSH10NP 0 1 FORMAT "%8.6"
 /begin AXIS_DESCR STD_AXIS mApplI_AbsDriverTorque_xdu16 TBTHIGH 6 0 25 FORMAT "%8.5" DEPOSIT ABSOLUTE /end AXIS_DESCR
/end CHARACTERISTIC
/begin CHARACTERISTIC xActRet_SteerSpeedFactDepOnDriver_XAU16_26___A "factor of nominal steering speed depending on driver torque" CURVE 0x15D67C AblGLKLuw 1 RIGHTSH10NP 0 1 FORMAT "%8.6"
 /begin AXIS_DESCR STD_AXIS mApplI_AbsDriverTorque_xdu16 TBTHIGH 6 0 25 FORMAT "%8.5" DEPOSIT ABSOLUTE /end AXIS_DESCR
/end CHARACTERISTIC
/begin CHARACTERISTIC xActRet_SteerSpeedFactDepOnDriver_XAU16_27___A "factor of nominal steering speed depending on driver torque" CURVE 0x15D698 AblGLKLuw 1 RIGHTSH10NP 0 1 FORMAT "%8.6"
 /begin AXIS_DESCR STD_AXIS mApplI_AbsDriverTorque_xdu16 TBTHIGH 6 0 25 FORMAT "%8.5" DEPOSIT ABSOLUTE /end AXIS_DESCR
/end CHARACTERISTIC
/begin CHARACTERISTIC xActRet_SteerSpeedFactDepOnDriver_XAU16_28___A "factor of nominal steering speed depending on driver torque" CURVE 0x15D6B4 AblGLKLuw 1 RIGHTSH10NP 0 1 FORMAT "%8.6"
 /begin AXIS_DESCR STD_AXIS mApplI_AbsDriverTorque_xdu16 TBTHIGH 6 0 25 FORMAT "%8.5" DEPOSIT ABSOLUTE /end AXIS_DESCR
/end CHARACTERISTIC
/begin CHARACTERISTIC xActRet_SteerSpeedFactDepOnDriver_XAU16_29___A "factor of nominal steering speed depending on driver torque" CURVE 0x15D6D0 AblGLKLuw 1 RIGHTSH10NP 0 1 FORMAT "%8.6"
 /begin AXIS_DESCR STD_AXIS mApplI_AbsDriverTorque_xdu16 TBTHIGH 6 0 25 FORMAT "%8.5" DEPOSIT ABSOLUTE /end AXIS_DESCR
/end CHARACTERISTIC
/begin CHARACTERISTIC xActRet_SteerSpeedFactDepOnDriver_XAU16_30___A "factor of nominal steering speed depending on driver torque" CURVE 0x15D6EC AblGLKLuw 1 RIGHTSH10NP 0 1 FORMAT "%8.6"
 /begin AXIS_DESCR STD_AXIS mApplI_AbsDriverTorque_xdu16 TBTHIGH 6 0 25 FORMAT "%8.5" DEPOSIT ABSOLUTE /end AXIS_DESCR
/end CHARACTERISTIC
/begin CHARACTERISTIC xActRet_SteerSpeedFactDepOnDriver_XAU16_31___A "factor of nominal steering speed depending on driver torque" CURVE 0x15D708 AblGLKLuw 1 RIGHTSH10NP 0 1 FORMAT "%8.6"
 /begin AXIS_DESCR STD_AXIS mApplI_AbsDriverTorque_xdu16 TBTHIGH 6 0 25 FORMAT "%8.5" DEPOSIT ABSOLUTE /end AXIS_DESCR
/end CHARACTERISTIC
/begin CHARACTERISTIC xActRet_SteerSpeedFactDepOnDriver_XAU16_32___A "factor of nominal steering speed depending on driver torque" CURVE 0x15D724 AblGLKLuw 1 RIGHTSH10NP 0 1 FORMAT "%8.6"
 /begin AXIS_DESCR STD_AXIS mApplI_AbsDriverTorque_xdu16 TBTHIGH 6 0 25 FORMAT "%8.5" DEPOSIT ABSOLUTE /end AXIS_DESCR
/end CHARACTERISTIC
/begin CHARACTERISTIC xActRet_SteerSpeedFactDepOnDriver_XAU16_33___A "factor of nominal steering speed depending on driver torque" CURVE 0x15D740 AblGLKLuw 1 RIGHTSH10NP 0 1 FORMAT "%8.6"
 /begin AXIS_DESCR STD_AXIS mApplI_AbsDriverTorque_xdu16 TBTHIGH 6 0 25 FORMAT "%8.5" DEPOSIT ABSOLUTE /end AXIS_DESCR
/end CHARACTERISTIC
/begin CHARACTERISTIC xActRet_SteerSpeedFactDepOnDriver_XAU16_34___A "factor of nominal steering speed depending on driver torque" CURVE 0x15D75C AblGLKLuw 1 RIGHTSH10NP 0 1 FORMAT "%8.6"
 /begin AXIS_DESCR STD_AXIS mApplI_AbsDriverTorque_xdu16 TBTHIGH 6 0 25 FORMAT "%8.5" DEPOSIT ABSOLUTE /end AXIS_DESCR
/end CHARACTERISTIC
/begin CHARACTERISTIC xActRet_SteerSpeedFactDepOnDriver_XAU16_35___A "factor of nominal steering speed depending on driver torque" CURVE 0x15D778 AblGLKLuw 1 RIGHTSH10NP 0 1 FORMAT "%8.6"
 /begin AXIS_DESCR STD_AXIS mApplI_AbsDriverTorque_xdu16 TBTHIGH 6 0 25 FORMAT "%8.5" DEPOSIT ABSOLUTE /end AXIS_DESCR
/end CHARACTERISTIC
/begin CHARACTERISTIC xActRet_SteerSpeedGradAfterInvalid_XDU16 "Gradient für einrampen nachdem Eingänge wieder gültig sind" VALUE 0x150938 AblGLKWuw 1 RIGHTSH15NP 0 1 FORMAT "%8.6" /end CHARACTERISTIC
/begin CHARACTERISTIC xAhaDet_FiltFactPT1YR_XDU16 "Filter Faktor des PT1-Filters der Gierrate; 1-kein Filtern, 0 - max.Filtern" VALUE 0x15093A AblGLKWuw 1 RIGHTSH10NP 0 1 FORMAT "%8.6" /end CHARACTERISTIC
/begin CHARACTERISTIC xAhaDet_LowerRatioLimitAhead_XDU16 "unterer Grenzwert des Raddrehzahlverhältnisses für Geradeausfahrt" VALUE 0x15093C AblGLKWuw 2 RIGHTSH10NP 0 2 FORMAT "%8.6" /end CHARACTERISTIC
/begin CHARACTERISTIC xAhaDet_MaxRatioGradient_XDU16 "max. Änderung des Radgeschwindigkeitsquotienten für Ahead-Erkennung" VALUE 0x15093E AblGLKWuw 16 RIGHTSH10NP 0 16 FORMAT "%8.5" /end CHARACTERISTIC
/begin CHARACTERISTIC xAhaDet_PedalMax_XDU16 "Maximale Gaspedalstellung" VALUE 0x150940 AblGLKWuw 1 RIGHTSH10NP 0 1 FORMAT "%8.6" /end CHARACTERISTIC
/begin CHARACTERISTIC xAhaDet_RatioLimitAhead_XDU16 "Grenzwert des Raddrehzahlverhältnisses für Geradeausfahrt" VALUE 0x150942 AblGLKWuw 2 RIGHTSH10NP 0 2 FORMAT "%8.6" /end CHARACTERISTIC
/begin CHARACTERISTIC xAhaDet_SlipLimit_XDU16 "Limit für den max. Schlupf zur Plausibilisierung" VALUE 0x150944 AblGLKWuw 2 RIGHTSH10NP 0 2 FORMAT "%8.6" /end CHARACTERISTIC
/begin MEASUREMENT fActRet_Disable_xdb "disable flag: in case of a detected error during the monitoring the disable flag is set" UWORD ZU0 1 100 0 1 BIT_MASK 0x1 FORMAT "%5.3" ECU_ADDRESS 0xFEBE941D /end MEASUREMENT
/begin MEASUREMENT mActDampI_MotorTorque_xds16 "motor torque of active damping component" SWORD MMOT 1 100 -2 2 FORMAT "%8.6" ECU_ADDRESS 0xFEBE8FF4 /end MEASUREMENT
/begin MEASUREMENT mActInI_NominalSteerTorque_xds16 "Sollhandlenkmoment aktive Trägheit" SWORD TBTHIGH 1 100 -10 10 FORMAT "%8.5" ECU_ADDRESS 0xFEBE8FF6 /end MEASUREMENT
/begin MEASUREMENT mActIn_MaxNominalSteerTorque_xdu16 "Maximal erlaubtes Handmoment aktive Trägheit" UWORD TBTHIGH 1 100 0 10 FORMAT "%8.5" ECU_ADDRESS 0xFEBE8FF8 /end MEASUREMENT
/begin MEASUREMENT mActRetI_MotorTorque_xds16 "motor torque of active return functionality" SWORD MMOT 1 100 -3 3 FORMAT "%8.6" ECU_ADDRESS 0xFEBE8FFA /end MEASUREMENT
/begin MEASUREMENT mActRetI_MotTrq4Check_xds16 "motor torque of active return component for check" SWORD MMOT 1 100 -3 3 FORMAT "%8.6" ECU_ADDRESS 0xFEBE8FFC /end MEASUREMENT
/begin MEASUREMENT mActRet_MotTrqSaturated_xds16 "saturated motor torque" SWORD MMOT 1 100 -3 3 FORMAT "%8.6" ECU_ADDRESS 0xFEBE8FFE /end MEASUREMENT
/begin MEASUREMENT nActDamp_AbsRotorSpeedFilt_xdu16 "Absolutwert von RotorspeedFilt" UWORD VROT 1 100 0 13000 FORMAT "%3.0" ECU_ADDRESS 0xFEBE919C /end MEASUREMENT
/begin MEASUREMENT sAhaDetI_AheadFromWheels_xdu8 "Flag: Geradeauslauf erkannt aus Raddrehzahlen" UBYTE ZU0 1 100 0 255 FORMAT "%5.1" ECU_ADDRESS 0xFEBE94DC /end MEASUREMENT
/begin MEASUREMENT sAhaDetI_AheadFromYaw_xdu8 "Flag: Geradeauslauf erkannt aus Drehstabmoment und Fahrzeuggeschwindigkeit (Gierrate etc)" UBYTE ZU0 1 100 0 255 FORMAT "%5.1" ECU_ADDRESS 0xFEBE94DD /end MEASUREMENT
/begin MEASUREMENT sAhaDetI_DetDemandWhlsSupp_xdu8 "Steuerflag aus Supp fuer ahead detection main: 0-Main decides, 1-force ahead, 2-inhibit ahead" UBYTE ZU0 1 100 0 2 FORMAT "%5.3" ECU_ADDRESS 0xFEBE94DE /end MEASUREMENT
/begin MEASUREMENT sAhaDetI_DetDemandYawSupp_xdu8 "Steuerflag aus Supp fuer ahead detection main: 0-Main decides, 1-force ahead, 2-inhibit ahead" UBYTE ZU0 1 100 0 2 FORMAT "%5.3" ECU_ADDRESS 0xFEBE94DF /end MEASUREMENT
/begin MEASUREMENT sAhaDet_AheadDetectionwhlStatus_xdu8 "Ahead detection debug status bits" UBYTE ZU0 1 100 0 255 FORMAT "%5.1" ECU_ADDRESS 0xFEBE94E0 /end MEASUREMENT
/begin MEASUREMENT sApplI_EscBrakeState_xdu8 "Esc Brake State" UBYTE ZU0 1 100 0 255 FORMAT "%5.1" ECU_ADDRESS 0xFEBE94F1 /end MEASUREMENT
/begin MEASUREMENT sApplI_ParkingBrakeState_xdu8 "Parkbremse betÃ¤tigt" UBYTE ZU0 1 100 0 255 FORMAT "%5.1" ECU_ADDRESS 0xFEBE94FD /end MEASUREMENT
/begin MEASUREMENT vActRet_ReturnSpeedDiff_xds16 "difference of steering speed controller" SWORD SAS_8 1 100 -1500 1500 FORMAT "%8.3" ECU_ADDRESS 0xFEBE922A /end MEASUREMENT
/begin MEASUREMENT xActDamp_RateLimitedFactors_xdu16 "rate limited factor dependent on vehicle speed and steering angle" UWORD RIGHTSH10NP 1 100 0 3 FORMAT "%8.6" ECU_ADDRESS 0xFEBE92F4 /end MEASUREMENT
/begin MEASUREMENT xActDamp_TotalDampingFactor_xdu16 "Total Damping factor dependent on vehicle speed, steering angle, driver Torque, ActiveDampingFactor" UWORD RIGHTSH10NP 1 100 0 6 FORMAT "%8.6" ECU_ADDRESS 0xFEBE92F6 /end MEASUREMENT
/begin MEASUREMENT xActIn_TorqueFact_xds16 "Faktor des nominellen Lenkmoments der aktiven Trägheit" SWORD RIGHTSH10NP 1 100 -10 10 FORMAT "%8.5" ECU_ADDRESS 0xFEBE92F8 /end MEASUREMENT
/begin MEASUREMENT xActRet_MotorTorqueGain_xdu16 "value of xActRet_MotorTorqueGain_XAU16" UWORD RIGHTSH10NP 1 100 0 3 FORMAT "%8.6" ECU_ADDRESS 0xFEBE92FA /end MEASUREMENT
/begin MEASUREMENT xActRet_NomSteerSpdFrac_xdu16 "pre-looked up fraction used for the interpolation of axis1 (vehicle speed) of vActRet_NominalSteeringSpeed_XAU16" UWORD RIGHTSH16NP 1 100 0 0.9999847 FORMAT "%9.7" ECU_ADDRESS 0xFEBE92FC /end MEASUREMENT
/begin MEASUREMENT xActRet_SpeedFactorFilt_xds32 "filtrated active return steering speed factor" SLONG RIGHTSH20NP 1 100 0 1 FORMAT "%13.11" ECU_ADDRESS 0xFEBE8E38 /end MEASUREMENT
/begin MEASUREMENT xActRet_TorqueFactorFilt_xds32 "filtrated active return motor torque factor due to driver torque" SLONG RIGHTSH20NP 1 100 0 1 FORMAT "%13.11" ECU_ADDRESS 0xFEBE8E3C /end MEASUREMENT
/begin MEASUREMENT xApplI_AccelPedalPosition_xdu16 "Position des Gaspedals" UWORD RIGHTSH10NP 1 100 0 1 FORMAT "%8.6" ECU_ADDRESS 0xFEBE92FE /end MEASUREMENT
/begin MEASUREMENT yActRet_NomSteerSpdIdx_xdu8 "pre-looked up index used for the interpolation of axis1 (vehicle speed) of vActRet_NominalSteeringSpeed_XAU16" UBYTE ZU0 1 100 0 254 FORMAT "%5.1" ECU_ADDRESS 0xFEBE9618 /end MEASUREMENT
/begin COMPU_METHOD AFZ "" RAT_FUNC "%6.5" "m/s^2" COEFFS 0 1024 0 0 0 1 /end COMPU_METHOD
/begin COMPU_METHOD ARFACT "" RAT_FUNC "%7.6" "Nm s / Â°" COEFFS 0 16384 0 0 0 1 /end COMPU_METHOD
/begin COMPU_METHOD MMOT "" RAT_FUNC "%6.5" "Nm" COEFFS 0 1024 0 0 0 1 /end COMPU_METHOD
/begin COMPU_METHOD MMOT_RSH6 "" RAT_FUNC "%6.4" "Nm" COEFFS 0 64 0 0 0 1 /end COMPU_METHOD
/begin COMPU_METHOD RIGHTSH10NP "" RAT_FUNC "%6.5" "" COEFFS 0 1024 0 0 0 1 /end COMPU_METHOD
/begin COMPU_METHOD RIGHTSH15NP "" RAT_FUNC "%7.6" "" COEFFS 0 32768 0 0 0 1 /end COMPU_METHOD
/begin COMPU_METHOD RIGHTSH16NP "" RAT_FUNC "%7.6" "" COEFFS 0 65536 0 0 0 1 /end COMPU_METHOD
/begin COMPU_METHOD RIGHTSH20NP "" RAT_FUNC "%9.8" "" COEFFS 0 1048576 0 0 0 1 /end COMPU_METHOD
/begin COMPU_METHOD RIGHTSH6NP "" RAT_FUNC "%6.4" "" COEFFS 0 64 0 0 0 1 /end COMPU_METHOD
/begin COMPU_METHOD RIGHTSH7NP "" RAT_FUNC "%6.4" "" COEFFS 0 128 0 0 0 1 /end COMPU_METHOD
/begin COMPU_METHOD SAS_8 "" RAT_FUNC "%6.3" "Â°/s" COEFFS 0 8 0 0 0 1 /end COMPU_METHOD
/begin COMPU_METHOD SA_10 "" RAT_FUNC "%6.3" "Â°" COEFFS 0 10 0 0 0 1 /end COMPU_METHOD
/begin COMPU_METHOD TBTHIGH "" RAT_FUNC "%6.5" "Nm" COEFFS 0 1024 0 0 0 1 /end COMPU_METHOD
/begin COMPU_METHOD TBT_RSH4 "" RAT_FUNC "%6.4" "Nm" COEFFS 0 16 0 0 0 1 /end COMPU_METHOD
/begin COMPU_METHOD TIMSEC "" RAT_FUNC "%6.4" "SEC" COEFFS 0 100 0 0 0 1 /end COMPU_METHOD
/begin COMPU_METHOD VFZHIGH "" RAT_FUNC "%6.4" "km/h" COEFFS 0 64 0 0 0 1 /end COMPU_METHOD
/begin COMPU_METHOD VGIER "" RAT_FUNC "%6.4" "Â°/s" COEFFS 0 200 0 0 0 1 /end COMPU_METHOD
/begin COMPU_METHOD VROT "" RAT_FUNC "%3.1" "1/min" COEFFS 0 1 0 0 0 1 /end COMPU_METHOD
/begin COMPU_METHOD ZU0 "" RAT_FUNC "%6.2" "" COEFFS 0 1 0 0 0 1 /end COMPU_METHOD
/begin FUNCTION ActiveDamping "Active Damping"
 /begin DEF_CHARACTERISTIC mActDamp_MaxMotorTorqueDepOnRotorSpeed_XAU16 xActDamp_FactorDepOnDriverTorque_XAU16_00___A xActDamp_FactorDepOnDriverTorque_XAU16_01___A xActDamp_FactorDepOnDriverTorque_XAU16_02___A xActDamp_FactorDepOnDriverTorque_XAU16_03___A xActDamp_FactorDepOnDriverTorque_XAU16_04___A xActDamp_FactorDepOnDriverTorque_XAU16_05___A xActDamp_FactorDepOnDriverTorque_XAU16_06___A xActDamp_FactorDepOnDriverTorque_XAU16_07___A xActDamp_FactorDepOnDriverTorque_XAU16_08___A xActDamp_FactorDepOnDriverTorque_XAU16_09___A xActDamp_FactorDepOnDriverTorque_XAU16_10___A xActDamp_FactorDepOnDriverTorque_XAU16_11___A xActDamp_FactorDepOnDriverTorque_XAU16_12___A xActDamp_FactorDepOnDriverTorque_XAU16_13___A xActDamp_FactorDepOnDriverTorque_XAU16_14___A xActDamp_FactorDepOnDriverTorque_XAU16_15___A xActDamp_FactorDepOnDriverTorque_XAU16_16___A xActDamp_FactorDepOnDriverTorque_XAU16_17___A xActDamp_FactorDepOnDriverTorque_XAU16_18___A xActDamp_FactorDepOnDriverTorque_XAU16_19___A xActDamp_FactorDepOnDriverTorque_XAU16_20___A xActDamp_FactorDepOnDriverTorque_XAU16_21___A xActDamp_FactorDepOnDriverTorque_XAU16_22___A xActDamp_FactorDepOnDriverTorque_XAU16_23___A xActDamp_FactorDepOnDriverTorque_XAU16_24___A xActDamp_FactorDepOnDriverTorque_XAU16_25___A xActDamp_FactorDepOnDriverTorque_XAU16_26___A xActDamp_FactorDepOnDriverTorque_XAU16_27___A xActDamp_FactorDepOnDriverTorque_XAU16_28___A xActDamp_FactorDepOnDriverTorque_XAU16_29___A xActDamp_FactorDepOnDriverTorque_XAU16_30___A xActDamp_FactorDepOnDriverTorque_XAU16_31___A xActDamp_FactorDepOnDriverTorque_XAU16_32___A xActDamp_FactorDepOnDriverTorque_XAU16_33___A xActDamp_FactorDepOnDriverTorque_XAU16_34___A xActDamp_FactorDepOnDriverTorque_XAU16_35___A xActDamp_FactorDepOnSteerAngle_XAU16_00___A xActDamp_FactorDepOnSteerAngle_XAU16_01___A xActDamp_FactorDepOnSteerAngle_XAU16_02___A xActDamp_FactorDepOnSteerAngle_XAU16_03___A xActDamp_FactorDepOnSteerAngle_XAU16_04___A xActDamp_FactorDepOnSteerAngle_XAU16_05___A xActDamp_FactorDepOnSteerAngle_XAU16_06___A xActDamp_FactorDepOnSteerAngle_XAU16_07___A xActDamp_FactorDepOnSteerAngle_XAU16_08___A xActDamp_FactorDepOnSteerAngle_XAU16_09___A xActDamp_FactorDepOnSteerAngle_XAU16_10___A xActDamp_FactorDepOnSteerAngle_XAU16_11___A xActDamp_FactorDepOnSteerAngle_XAU16_12___A xActDamp_FactorDepOnSteerAngle_XAU16_13___A xActDamp_FactorDepOnSteerAngle_XAU16_14___A xActDamp_FactorDepOnSteerAngle_XAU16_15___A xActDamp_FactorDepOnSteerAngle_XAU16_16___A xActDamp_FactorDepOnSteerAngle_XAU16_17___A xActDamp_FactorDepOnSteerAngle_XAU16_18___A xActDamp_FactorDepOnSteerAngle_XAU16_19___A xActDamp_FactorDepOnSteerAngle_XAU16_20___A xActDamp_FactorDepOnSteerAngle_XAU16_21___A xActDamp_FactorDepOnSteerAngle_XAU16_22___A xActDamp_FactorDepOnSteerAngle_XAU16_23___A xActDamp_FactorDepOnSteerAngle_XAU16_24___A xActDamp_FactorDepOnSteerAngle_XAU16_25___A xActDamp_FactorDepOnSteerAngle_XAU16_26___A xActDamp_FactorDepOnSteerAngle_XAU16_27___A xActDamp_FactorDepOnSteerAngle_XAU16_28___A xActDamp_FactorDepOnSteerAngle_XAU16_29___A xActDamp_FactorDepOnSteerAngle_XAU16_30___A xActDamp_FactorDepOnSteerAngle_XAU16_31___A xActDamp_FactorDepOnSteerAngle_XAU16_32___A xActDamp_FactorDepOnSteerAngle_XAU16_33___A xActDamp_FactorDepOnSteerAngle_XAU16_34___A xActDamp_FactorDepOnSteerAngle_XAU16_35___A xActDamp_FactorDepOnVehSpeed_XAU16_00___A xActDamp_FactorDepOnVehSpeed_XAU16_01___A xActDamp_FactorDepOnVehSpeed_XAU16_02___A xActDamp_FactorDepOnVehSpeed_XAU16_03___A xActDamp_FactorDepOnVehSpeed_XAU16_04___A xActDamp_FactorDepOnVehSpeed_XAU16_05___A xActDamp_FactorDepOnVehSpeed_XAU16_06___A xActDamp_FactorDepOnVehSpeed_XAU16_07___A xActDamp_FactorDepOnVehSpeed_XAU16_08___A xActDamp_FactorDepOnVehSpeed_XAU16_09___A xActDamp_FactorDepOnVehSpeed_XAU16_10___A xActDamp_FactorDepOnVehSpeed_XAU16_11___A xActDamp_FactorDepOnVehSpeed_XAU16_12___A xActDamp_FactorDepOnVehSpeed_XAU16_13___A xActDamp_FactorDepOnVehSpeed_XAU16_14___A xActDamp_FactorDepOnVehSpeed_XAU16_15___A xActDamp_FactorDepOnVehSpeed_XAU16_16___A xActDamp_FactorDepOnVehSpeed_XAU16_17___A xActDamp_FactorDepOnVehSpeed_XAU16_18___A xActDamp_FactorDepOnVehSpeed_XAU16_19___A xActDamp_FactorDepOnVehSpeed_XAU16_20___A xActDamp_FactorDepOnVehSpeed_XAU16_21___A xActDamp_FactorDepOnVehSpeed_XAU16_22___A xActDamp_FactorDepOnVehSpeed_XAU16_23___A xActDamp_FactorDepOnVehSpeed_XAU16_24___A xActDamp_FactorDepOnVehSpeed_XAU16_25___A xActDamp_FactorDepOnVehSpeed_XAU16_26___A xActDamp_FactorDepOnVehSpeed_XAU16_27___A xActDamp_FactorDepOnVehSpeed_XAU16_28___A xActDamp_FactorDepOnVehSpeed_XAU16_29___A xActDamp_FactorDepOnVehSpeed_XAU16_30___A xActDamp_FactorDepOnVehSpeed_XAU16_31___A xActDamp_FactorDepOnVehSpeed_XAU16_32___A xActDamp_FactorDepOnVehSpeed_XAU16_33___A xActDamp_FactorDepOnVehSpeed_XAU16_34___A xActDamp_FactorDepOnVehSpeed_XAU16_35___A xActDamp_FactorGrad_XDU16 xActDamp_TorqueDepOnRotorSpeed_XAU16_00___A xActDamp_TorqueDepOnRotorSpeed_XAU16_01___A xActDamp_TorqueDepOnRotorSpeed_XAU16_02___A xActDamp_TorqueDepOnRotorSpeed_XAU16_03___A xActDamp_TorqueDepOnRotorSpeed_XAU16_04___A xActDamp_TorqueDepOnRotorSpeed_XAU16_05___A xActDamp_TorqueDepOnRotorSpeed_XAU16_06___A xActDamp_TorqueDepOnRotorSpeed_XAU16_07___A xActDamp_TorqueDepOnRotorSpeed_XAU16_08___A xActDamp_TorqueDepOnRotorSpeed_XAU16_09___A xActDamp_TorqueDepOnRotorSpeed_XAU16_10___A xActDamp_TorqueDepOnRotorSpeed_XAU16_11___A xActDamp_TorqueDepOnRotorSpeed_XAU16_12___A xActDamp_TorqueDepOnRotorSpeed_XAU16_13___A xActDamp_TorqueDepOnRotorSpeed_XAU16_14___A xActDamp_TorqueDepOnRotorSpeed_XAU16_15___A xActDamp_TorqueDepOnRotorSpeed_XAU16_16___A xActDamp_TorqueDepOnRotorSpeed_XAU16_17___A xActDamp_TorqueDepOnRotorSpeed_XAU16_18___A xActDamp_TorqueDepOnRotorSpeed_XAU16_19___A xActDamp_TorqueDepOnRotorSpeed_XAU16_20___A xActDamp_TorqueDepOnRotorSpeed_XAU16_21___A xActDamp_TorqueDepOnRotorSpeed_XAU16_22___A xActDamp_TorqueDepOnRotorSpeed_XAU16_23___A xActDamp_TorqueDepOnRotorSpeed_XAU16_24___A xActDamp_TorqueDepOnRotorSpeed_XAU16_25___A xActDamp_TorqueDepOnRotorSpeed_XAU16_26___A xActDamp_TorqueDepOnRotorSpeed_XAU16_27___A xActDamp_TorqueDepOnRotorSpeed_XAU16_28___A xActDamp_TorqueDepOnRotorSpeed_XAU16_29___A xActDamp_TorqueDepOnRotorSpeed_XAU16_30___A xActDamp_TorqueDepOnRotorSpeed_XAU16_31___A xActDamp_TorqueDepOnRotorSpeed_XAU16_32___A xActDamp_TorqueDepOnRotorSpeed_XAU16_33___A xActDamp_TorqueDepOnRotorSpeed_XAU16_34___A xActDamp_TorqueDepOnRotorSpeed_XAU16_35___A /end DEF_CHARACTERISTIC
 /begin IN_MEASUREMENT mApplI_AbsDriverTorque_xdu16 vVehSpI_AbsAvgVehSpd_xdu16 wApplI_AbsSteeringAngle_xdu16 /end IN_MEASUREMENT
 /begin OUT_MEASUREMENT nActDamp_AbsRotorSpeedFilt_xdu16 xActDamp_RateLimitedFactors_xdu16 xActDamp_TotalDampingFactor_xdu16 /end OUT_MEASUREMENT
/end FUNCTION
/begin FUNCTION ActiveDampingInterface "Active Damping Interface" /begin OUT_MEASUREMENT mActDampI_MotorTorque_xds16 /end OUT_MEASUREMENT /end FUNCTION
/begin FUNCTION ActiveInertia_Nst "Active Inertia nominal steer torque"
 /begin DEF_CHARACTERISTIC mActIn_InertiaMax_XAU16 xActIn_InertiaFact_XAS16_00___A xActIn_InertiaFact_XAS16_01___A xActIn_InertiaFact_XAS16_02___A xActIn_InertiaFact_XAS16_03___A xActIn_InertiaFact_XAS16_04___A xActIn_InertiaFact_XAS16_05___A xActIn_InertiaFact_XAS16_06___A xActIn_InertiaFact_XAS16_07___A xActIn_InertiaFact_XAS16_08___A xActIn_InertiaFact_XAS16_09___A xActIn_InertiaFact_XAS16_10___A xActIn_InertiaFact_XAS16_11___A xActIn_InertiaFact_XAS16_12___A xActIn_InertiaFact_XAS16_13___A xActIn_InertiaFact_XAS16_14___A xActIn_InertiaFact_XAS16_15___A xActIn_InertiaFact_XAS16_16___A xActIn_InertiaFact_XAS16_17___A xActIn_InertiaFact_XAS16_18___A xActIn_InertiaFact_XAS16_19___A xActIn_InertiaFact_XAS16_20___A xActIn_InertiaFact_XAS16_21___A xActIn_InertiaFact_XAS16_22___A xActIn_InertiaFact_XAS16_23___A xActIn_InertiaFact_XAS16_24___A xActIn_InertiaFact_XAS16_25___A xActIn_InertiaFact_XAS16_26___A xActIn_InertiaFact_XAS16_27___A xActIn_InertiaFact_XAS16_28___A xActIn_InertiaFact_XAS16_29___A xActIn_InertiaFact_XAS16_30___A xActIn_InertiaFact_XAS16_31___A xActIn_InertiaFact_XAS16_32___A xActIn_InertiaFact_XAS16_33___A xActIn_InertiaFact_XAS16_34___A xActIn_InertiaFact_XAS16_35___A xActIn_InertiaTBT_XAU16_00___A xActIn_InertiaTBT_XAU16_01___A xActIn_InertiaTBT_XAU16_02___A xActIn_InertiaTBT_XAU16_03___A xActIn_InertiaTBT_XAU16_04___A xActIn_InertiaTBT_XAU16_05___A xActIn_InertiaTBT_XAU16_06___A xActIn_InertiaTBT_XAU16_07___A xActIn_InertiaTBT_XAU16_08___A xActIn_InertiaTBT_XAU16_09___A xActIn_InertiaTBT_XAU16_10___A xActIn_InertiaTBT_XAU16_11___A xActIn_InertiaTBT_XAU16_12___A xActIn_InertiaTBT_XAU16_13___A xActIn_InertiaTBT_XAU16_14___A xActIn_InertiaTBT_XAU16_15___A xActIn_InertiaTBT_XAU16_16___A xActIn_InertiaTBT_XAU16_17___A xActIn_InertiaTBT_XAU16_18___A xActIn_InertiaTBT_XAU16_19___A xActIn_InertiaTBT_XAU16_20___A xActIn_InertiaTBT_XAU16_21___A xActIn_InertiaTBT_XAU16_22___A xActIn_InertiaTBT_XAU16_23___A xActIn_InertiaTBT_XAU16_24___A xActIn_InertiaTBT_XAU16_25___A xActIn_InertiaTBT_XAU16_26___A xActIn_InertiaTBT_XAU16_27___A xActIn_InertiaTBT_XAU16_28___A xActIn_InertiaTBT_XAU16_29___A xActIn_InertiaTBT_XAU16_30___A xActIn_InertiaTBT_XAU16_31___A xActIn_InertiaTBT_XAU16_32___A xActIn_InertiaTBT_XAU16_33___A xActIn_InertiaTBT_XAU16_34___A xActIn_InertiaTBT_XAU16_35___A /end DEF_CHARACTERISTIC
 /begin IN_MEASUREMENT mApplI_AbsTorsionBarTorque_xdu16 vApplI_AbsVehicleSpeedFilt_xdu16 /end IN_MEASUREMENT
 /begin OUT_MEASUREMENT mActIn_MaxNominalSteerTorque_xdu16 xActIn_TorqueFact_xds16 /end OUT_MEASUREMENT
/end FUNCTION
/begin FUNCTION ActiveInertia_NstI "Aktiver Trägheit (nominelles Lenkmoment) - Interface" /begin OUT_MEASUREMENT mActInI_NominalSteerTorque_xds16 /end OUT_MEASUREMENT /end FUNCTION
/begin FUNCTION ActiveReturn "Active Return"
 /begin DEF_CHARACTERISTIC mActRet_MaxMotorTorque_XDU8 vActRet_NominalSteeringSpeed_XAU16_00___A vActRet_NominalSteeringSpeed_XAU16_01___A vActRet_NominalSteeringSpeed_XAU16_02___A vActRet_NominalSteeringSpeed_XAU16_03___A vActRet_NominalSteeringSpeed_XAU16_04___A vActRet_NominalSteeringSpeed_XAU16_05___A vActRet_NominalSteeringSpeed_XAU16_06___A vActRet_NominalSteeringSpeed_XAU16_07___A vActRet_NominalSteeringSpeed_XAU16_08___A vActRet_NominalSteeringSpeed_XAU16_09___A vActRet_NominalSteeringSpeed_XAU16_10___A vActRet_NominalSteeringSpeed_XAU16_11___A vActRet_NominalSteeringSpeed_XAU16_12___A vActRet_NominalSteeringSpeed_XAU16_13___A vActRet_NominalSteeringSpeed_XAU16_14___A vActRet_NominalSteeringSpeed_XAU16_15___A vActRet_NominalSteeringSpeed_XAU16_16___A vActRet_NominalSteeringSpeed_XAU16_17___A vActRet_NominalSteeringSpeed_XAU16_18___A vActRet_NominalSteeringSpeed_XAU16_19___A vActRet_NominalSteeringSpeed_XAU16_20___A vActRet_NominalSteeringSpeed_XAU16_21___A vActRet_NominalSteeringSpeed_XAU16_22___A vActRet_NominalSteeringSpeed_XAU16_23___A vActRet_NominalSteeringSpeed_XAU16_24___A vActRet_NominalSteeringSpeed_XAU16_25___A vActRet_NominalSteeringSpeed_XAU16_26___A vActRet_NominalSteeringSpeed_XAU16_27___A vActRet_NominalSteeringSpeed_XAU16_28___A vActRet_NominalSteeringSpeed_XAU16_29___A vActRet_NominalSteeringSpeed_XAU16_30___A vActRet_NominalSteeringSpeed_XAU16_31___A vActRet_NominalSteeringSpeed_XAU16_32___A vActRet_NominalSteeringSpeed_XAU16_33___A vActRet_NominalSteeringSpeed_XAU16_34___A vActRet_NominalSteeringSpeed_XAU16_35___A xActRet_FilterFactor_XDU16_00___A xActRet_FilterFactor_XDU16_01___A xActRet_FilterFactor_XDU16_02___A xActRet_FilterFactor_XDU16_03___A xActRet_FilterFactor_XDU16_04___A xActRet_FilterFactor_XDU16_05___A xActRet_FilterFactor_XDU16_06___A xActRet_FilterFactor_XDU16_07___A xActRet_FilterFactor_XDU16_08___A xActRet_FilterFactor_XDU16_09___A xActRet_FilterFactor_XDU16_10___A xActRet_FilterFactor_XDU16_11___A xActRet_FilterFactor_XDU16_12___A xActRet_FilterFactor_XDU16_13___A xActRet_FilterFactor_XDU16_14___A xActRet_FilterFactor_XDU16_15___A xActRet_FilterFactor_XDU16_16___A xActRet_FilterFactor_XDU16_17___A xActRet_FilterFactor_XDU16_18___A xActRet_FilterFactor_XDU16_19___A xActRet_FilterFactor_XDU16_20___A xActRet_FilterFactor_XDU16_21___A xActRet_FilterFactor_XDU16_22___A xActRet_FilterFactor_XDU16_23___A xActRet_FilterFactor_XDU16_24___A xActRet_FilterFactor_XDU16_25___A xActRet_FilterFactor_XDU16_26___A xActRet_FilterFactor_XDU16_27___A xActRet_FilterFactor_XDU16_28___A xActRet_FilterFactor_XDU16_29___A xActRet_FilterFactor_XDU16_30___A xActRet_FilterFactor_XDU16_31___A xActRet_FilterFactor_XDU16_32___A xActRet_FilterFactor_XDU16_33___A xActRet_FilterFactor_XDU16_34___A xActRet_FilterFactor_XDU16_35___A xActRet_MotorTorqueGain_XAU16_00___A xActRet_MotorTorqueGain_XAU16_01___A xActRet_MotorTorqueGain_XAU16_02___A xActRet_MotorTorqueGain_XAU16_03___A xActRet_MotorTorqueGain_XAU16_04___A xActRet_MotorTorqueGain_XAU16_05___A xActRet_MotorTorqueGain_XAU16_06___A xActRet_MotorTorqueGain_XAU16_07___A xActRet_MotorTorqueGain_XAU16_08___A xActRet_MotorTorqueGain_XAU16_09___A xActRet_MotorTorqueGain_XAU16_10___A xActRet_MotorTorqueGain_XAU16_11___A xActRet_MotorTorqueGain_XAU16_12___A xActRet_MotorTorqueGain_XAU16_13___A xActRet_MotorTorqueGain_XAU16_14___A xActRet_MotorTorqueGain_XAU16_15___A xActRet_MotorTorqueGain_XAU16_16___A xActRet_MotorTorqueGain_XAU16_17___A xActRet_MotorTorqueGain_XAU16_18___A xActRet_MotorTorqueGain_XAU16_19___A xActRet_MotorTorqueGain_XAU16_20___A xActRet_MotorTorqueGain_XAU16_21___A xActRet_MotorTorqueGain_XAU16_22___A xActRet_MotorTorqueGain_XAU16_23___A xActRet_MotorTorqueGain_XAU16_24___A xActRet_MotorTorqueGain_XAU16_25___A xActRet_MotorTorqueGain_XAU16_26___A xActRet_MotorTorqueGain_XAU16_27___A xActRet_MotorTorqueGain_XAU16_28___A xActRet_MotorTorqueGain_XAU16_29___A xActRet_MotorTorqueGain_XAU16_30___A xActRet_MotorTorqueGain_XAU16_31___A xActRet_MotorTorqueGain_XAU16_32___A xActRet_MotorTorqueGain_XAU16_33___A xActRet_MotorTorqueGain_XAU16_34___A xActRet_MotorTorqueGain_XAU16_35___A xActRet_RetTorqueFactDepOnDriver_XAU16_00___A xActRet_RetTorqueFactDepOnDriver_XAU16_01___A xActRet_RetTorqueFactDepOnDriver_XAU16_02___A xActRet_RetTorqueFactDepOnDriver_XAU16_03___A xActRet_RetTorqueFactDepOnDriver_XAU16_04___A xActRet_RetTorqueFactDepOnDriver_XAU16_05___A xActRet_RetTorqueFactDepOnDriver_XAU16_06___A xActRet_RetTorqueFactDepOnDriver_XAU16_07___A xActRet_RetTorqueFactDepOnDriver_XAU16_08___A xActRet_RetTorqueFactDepOnDriver_XAU16_09___A xActRet_RetTorqueFactDepOnDriver_XAU16_10___A xActRet_RetTorqueFactDepOnDriver_XAU16_11___A xActRet_RetTorqueFactDepOnDriver_XAU16_12___A xActRet_RetTorqueFactDepOnDriver_XAU16_13___A xActRet_RetTorqueFactDepOnDriver_XAU16_14___A xActRet_RetTorqueFactDepOnDriver_XAU16_15___A xActRet_RetTorqueFactDepOnDriver_XAU16_16___A xActRet_RetTorqueFactDepOnDriver_XAU16_17___A xActRet_RetTorqueFactDepOnDriver_XAU16_18___A xActRet_RetTorqueFactDepOnDriver_XAU16_19___A xActRet_RetTorqueFactDepOnDriver_XAU16_20___A xActRet_RetTorqueFactDepOnDriver_XAU16_21___A xActRet_RetTorqueFactDepOnDriver_XAU16_22___A xActRet_RetTorqueFactDepOnDriver_XAU16_23___A xActRet_RetTorqueFactDepOnDriver_XAU16_24___A xActRet_RetTorqueFactDepOnDriver_XAU16_25___A xActRet_RetTorqueFactDepOnDriver_XAU16_26___A xActRet_RetTorqueFactDepOnDriver_XAU16_27___A xActRet_RetTorqueFactDepOnDriver_XAU16_28___A xActRet_RetTorqueFactDepOnDriver_XAU16_29___A xActRet_RetTorqueFactDepOnDriver_XAU16_30___A xActRet_RetTorqueFactDepOnDriver_XAU16_31___A xActRet_RetTorqueFactDepOnDriver_XAU16_32___A xActRet_RetTorqueFactDepOnDriver_XAU16_33___A xActRet_RetTorqueFactDepOnDriver_XAU16_34___A xActRet_RetTorqueFactDepOnDriver_XAU16_35___A xActRet_SteeringSpeedAmp_XDU16_00___A xActRet_SteeringSpeedAmp_XDU16_01___A xActRet_SteeringSpeedAmp_XDU16_02___A xActRet_SteeringSpeedAmp_XDU16_03___A xActRet_SteeringSpeedAmp_XDU16_04___A xActRet_SteeringSpeedAmp_XDU16_05___A xActRet_SteeringSpeedAmp_XDU16_06___A xActRet_SteeringSpeedAmp_XDU16_07___A xActRet_SteeringSpeedAmp_XDU16_08___A xActRet_SteeringSpeedAmp_XDU16_09___A xActRet_SteeringSpeedAmp_XDU16_10___A xActRet_SteeringSpeedAmp_XDU16_11___A xActRet_SteeringSpeedAmp_XDU16_12___A xActRet_SteeringSpeedAmp_XDU16_13___A xActRet_SteeringSpeedAmp_XDU16_14___A xActRet_SteeringSpeedAmp_XDU16_15___A xActRet_SteeringSpeedAmp_XDU16_16___A xActRet_SteeringSpeedAmp_XDU16_17___A xActRet_SteeringSpeedAmp_XDU16_18___A xActRet_SteeringSpeedAmp_XDU16_19___A xActRet_SteeringSpeedAmp_XDU16_20___A xActRet_SteeringSpeedAmp_XDU16_21___A xActRet_SteeringSpeedAmp_XDU16_22___A xActRet_SteeringSpeedAmp_XDU16_23___A xActRet_SteeringSpeedAmp_XDU16_24___A xActRet_SteeringSpeedAmp_XDU16_25___A xActRet_SteeringSpeedAmp_XDU16_26___A xActRet_SteeringSpeedAmp_XDU16_27___A xActRet_SteeringSpeedAmp_XDU16_28___A xActRet_SteeringSpeedAmp_XDU16_29___A xActRet_SteeringSpeedAmp_XDU16_30___A xActRet_SteeringSpeedAmp_XDU16_31___A xActRet_SteeringSpeedAmp_XDU16_32___A xActRet_SteeringSpeedAmp_XDU16_33___A xActRet_SteeringSpeedAmp_XDU16_34___A xActRet_SteeringSpeedAmp_XDU16_35___A xActRet_SteeringSpeedFact_XDU8_00___A xActRet_SteeringSpeedFact_XDU8_01___A xActRet_SteeringSpeedFact_XDU8_02___A xActRet_SteeringSpeedFact_XDU8_03___A xActRet_SteeringSpeedFact_XDU8_04___A xActRet_SteeringSpeedFact_XDU8_05___A xActRet_SteeringSpeedFact_XDU8_06___A xActRet_SteeringSpeedFact_XDU8_07___A xActRet_SteeringSpeedFact_XDU8_08___A xActRet_SteeringSpeedFact_XDU8_09___A xActRet_SteeringSpeedFact_XDU8_10___A xActRet_SteeringSpeedFact_XDU8_11___A xActRet_SteeringSpeedFact_XDU8_12___A xActRet_SteeringSpeedFact_XDU8_13___A xActRet_SteeringSpeedFact_XDU8_14___A xActRet_SteeringSpeedFact_XDU8_15___A xActRet_SteeringSpeedFact_XDU8_16___A xActRet_SteeringSpeedFact_XDU8_17___A xActRet_SteeringSpeedFact_XDU8_18___A xActRet_SteeringSpeedFact_XDU8_19___A xActRet_SteeringSpeedFact_XDU8_20___A xActRet_SteeringSpeedFact_XDU8_21___A xActRet_SteeringSpeedFact_XDU8_22___A xActRet_SteeringSpeedFact_XDU8_23___A xActRet_SteeringSpeedFact_XDU8_24___A xActRet_SteeringSpeedFact_XDU8_25___A xActRet_SteeringSpeedFact_XDU8_26___A xActRet_SteeringSpeedFact_XDU8_27___A xActRet_SteeringSpeedFact_XDU8_28___A xActRet_SteeringSpeedFact_XDU8_29___A xActRet_SteeringSpeedFact_XDU8_30___A xActRet_SteeringSpeedFact_XDU8_31___A xActRet_SteeringSpeedFact_XDU8_32___A xActRet_SteeringSpeedFact_XDU8_33___A xActRet_SteeringSpeedFact_XDU8_34___A xActRet_SteeringSpeedFact_XDU8_35___A xActRet_SteerSpeedFactDepOnDriver_XAU16_00___A xActRet_SteerSpeedFactDepOnDriver_XAU16_01___A xActRet_SteerSpeedFactDepOnDriver_XAU16_02___A xActRet_SteerSpeedFactDepOnDriver_XAU16_03___A xActRet_SteerSpeedFactDepOnDriver_XAU16_04___A xActRet_SteerSpeedFactDepOnDriver_XAU16_05___A xActRet_SteerSpeedFactDepOnDriver_XAU16_06___A xActRet_SteerSpeedFactDepOnDriver_XAU16_07___A xActRet_SteerSpeedFactDepOnDriver_XAU16_08___A xActRet_SteerSpeedFactDepOnDriver_XAU16_09___A xActRet_SteerSpeedFactDepOnDriver_XAU16_10___A xActRet_SteerSpeedFactDepOnDriver_XAU16_11___A xActRet_SteerSpeedFactDepOnDriver_XAU16_12___A xActRet_SteerSpeedFactDepOnDriver_XAU16_13___A xActRet_SteerSpeedFactDepOnDriver_XAU16_14___A xActRet_SteerSpeedFactDepOnDriver_XAU16_15___A xActRet_SteerSpeedFactDepOnDriver_XAU16_16___A xActRet_SteerSpeedFactDepOnDriver_XAU16_17___A xActRet_SteerSpeedFactDepOnDriver_XAU16_18___A xActRet_SteerSpeedFactDepOnDriver_XAU16_19___A xActRet_SteerSpeedFactDepOnDriver_XAU16_20___A xActRet_SteerSpeedFactDepOnDriver_XAU16_21___A xActRet_SteerSpeedFactDepOnDriver_XAU16_22___A xActRet_SteerSpeedFactDepOnDriver_XAU16_23___A xActRet_SteerSpeedFactDepOnDriver_XAU16_24___A xActRet_SteerSpeedFactDepOnDriver_XAU16_25___A xActRet_SteerSpeedFactDepOnDriver_XAU16_26___A xActRet_SteerSpeedFactDepOnDriver_XAU16_27___A xActRet_SteerSpeedFactDepOnDriver_XAU16_28___A xActRet_SteerSpeedFactDepOnDriver_XAU16_29___A xActRet_SteerSpeedFactDepOnDriver_XAU16_30___A xActRet_SteerSpeedFactDepOnDriver_XAU16_31___A xActRet_SteerSpeedFactDepOnDriver_XAU16_32___A xActRet_SteerSpeedFactDepOnDriver_XAU16_33___A xActRet_SteerSpeedFactDepOnDriver_XAU16_34___A xActRet_SteerSpeedFactDepOnDriver_XAU16_35___A xActRet_SteerSpeedGradAfterInvalid_XDU16 /end DEF_CHARACTERISTIC
 /begin IN_MEASUREMENT mApplI_AbsDriverTorque_xdu16 vVehSpI_AbsAvgVehSpd_xdu16 wApplI_AbsSteeringAngle_xdu16 /end IN_MEASUREMENT
 /begin OUT_MEASUREMENT vActRet_ReturnSpeedDiff_xds16 xActRet_MotorTorqueGain_xdu16 xActRet_NomSteerSpdFrac_xdu16 xActRet_SpeedFactorFilt_xds32 xActRet_TorqueFactorFilt_xds32 yActRet_NomSteerSpdIdx_xdu8 /end OUT_MEASUREMENT
/end FUNCTION
/begin FUNCTION ActiveReturnCheck "ActiveReturnCheck"
 /begin DEF_CHARACTERISTIC mActRet_MaxMotorTorqueDepOnSteeringAngle_XAU16 mActRet_MaxMotorTorqueDepOnVehSpeed_XAU16 mActRet_MaxTBT4ShutDown_XDU8 /end DEF_CHARACTERISTIC
 /begin IN_MEASUREMENT vVehSpI_AbsMaxSafeVehSpd_xdu16 wApplI_AbsSteeringAngle_xdu16 /end IN_MEASUREMENT
 /begin OUT_MEASUREMENT fActRet_Disable_xdb mActRet_MotTrqSaturated_xds16 /end OUT_MEASUREMENT
/end FUNCTION
/begin FUNCTION ActiveReturnCheckI "ActiveReturnCheckI" /begin OUT_MEASUREMENT mActRetI_MotorTorque_xds16 /end OUT_MEASUREMENT /end FUNCTION
/begin FUNCTION ActiveReturnInterface "Active Return Interface" /begin OUT_MEASUREMENT mActRetI_MotTrq4Check_xds16 /end OUT_MEASUREMENT /end FUNCTION
/begin FUNCTION AheadDetection "AheadDetection kgt"
 /begin DEF_CHARACTERISTIC aAhaDet_AccLimit_XDU16 aAhaDet_MaxAbsLateralAccel_XDU16 mAhaDet_TorqueLimit_XDU16 tAhaDet_AheadDetectionTimer_XDU8 vAhaDet_FrontESPvLimit_XDU16 vAhaDet_FrontRearRotationLimit_XDU16 vAhaDet_LeftRightRotationLimit_XDU16 vAhaDet_MaxAbsYawVelocity_XDU16 vAhaDet_MinRotationLimit_XDU16 vAhaDet_MinVehicleSpeed_XDU16 vAhaDet_StAnSpeedLimit_XDU16 xAhaDet_FiltFactPT1YR_XDU16 xAhaDet_LowerRatioLimitAhead_XDU16 xAhaDet_MaxRatioGradient_XDU16 xAhaDet_RatioLimitAhead_XDU16 xAhaDet_SlipLimit_XDU16 /end DEF_CHARACTERISTIC
 /begin OUT_MEASUREMENT sAhaDet_AheadDetectionwhlStatus_xdu8 /end OUT_MEASUREMENT
/end FUNCTION
/begin FUNCTION AheadDetectionSupp "AheadDetectionSupp kgt" /begin DEF_CHARACTERISTIC xAhaDet_PedalMax_XDU16 /end DEF_CHARACTERISTIC /end FUNCTION
/begin FUNCTION AheadDetectionSupp_Interface "Ahead Detection Supp Interface kgt"
 /begin OUT_MEASUREMENT sAhaDetI_DetDemandWhlsSupp_xdu8 sAhaDetI_DetDemandYawSupp_xdu8 /end OUT_MEASUREMENT
/end FUNCTION
/begin FUNCTION AheadDetectionSupp_Stubs "Ahead Detection supp stubs"
 /begin OUT_MEASUREMENT sApplI_EscBrakeState_xdu8 sApplI_ParkingBrakeState_xdu8 xApplI_AccelPedalPosition_xdu16 /end OUT_MEASUREMENT
/end FUNCTION
/begin FUNCTION AheadDetection_Main_Interface "AheadDetection Main Interface kgt" /begin OUT_MEASUREMENT sAhaDetI_AheadFromWheels_xdu8 sAhaDetI_AheadFromYaw_xdu8 /end OUT_MEASUREMENT /end FUNCTION
/begin RECORD_LAYOUT AblGLKFuw FNC_VALUES 3 UWORD COLUMN_DIR DIRECT AXIS_PTS_X 1 UWORD INDEX_INCR DIRECT AXIS_PTS_Y 2 UWORD INDEX_INCR DIRECT /end RECORD_LAYOUT
/begin RECORD_LAYOUT AblGLKLsw FNC_VALUES 3 SWORD COLUMN_DIR DIRECT AXIS_PTS_X 2 SWORD INDEX_INCR DIRECT NO_AXIS_PTS_X 1 UWORD /end RECORD_LAYOUT
/begin RECORD_LAYOUT AblGLKLuw FNC_VALUES 3 UWORD COLUMN_DIR DIRECT AXIS_PTS_X 2 UWORD INDEX_INCR DIRECT NO_AXIS_PTS_X 1 UWORD /end RECORD_LAYOUT
/begin RECORD_LAYOUT AblGLKWub FNC_VALUES 1 UBYTE COLUMN_DIR DIRECT /end RECORD_LAYOUT
/begin RECORD_LAYOUT AblGLKWuw FNC_VALUES 1 UWORD COLUMN_DIR DIRECT /end RECORD_LAYOUT
/begin VARIANT_CODING /end VARIANT_CODING
/end MODULE
/end PROJECT
